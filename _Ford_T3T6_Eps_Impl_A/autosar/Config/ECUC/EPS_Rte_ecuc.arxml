[part 1 of 5: package /ActiveEcuC]
AUTOSAR XML (schema 4-2-1)
package /ActiveEcuC
  module config Rte: implementation-config-variant=VARIANT-PRE-COMPILE, module-description=Rte_Impl
    RteOsInteraction
      8 x RteUsedOsActivation, all with RteExpectedActivationOffset=0, RteExpectedTickDuration=0:
        Rte_Al_TE2_Task_4msBsw_Appl10_0_4ms: RteActivationOsAlarmRef=Rte_Al_TE2_Task_4msBsw_Appl10_0_4ms, RteActivationOsTaskRef=Task_4msBsw_Appl10
        Rte_Al_TE2_Task_10msBsw_Appl10_0_10ms: RteActivationOsAlarmRef=Rte_Al_TE2_Task_10msBsw_Appl10_0_10ms, RteActivationOsTaskRef=Task_10msBsw_Appl10
        Rte_Al_TE_Task_2ms_Appl10_0_2ms: RteActivationOsAlarmRef=Rte_Al_TE_Task_2ms_Appl10_0_2ms, RteActivationOsTaskRef=Task_2ms_Appl10
        Rte_Al_TE_Task_4ms_Appl10_0_4ms: RteActivationOsAlarmRef=Rte_Al_TE_Task_4ms_Appl10_0_4ms, RteActivationOsTaskRef=Task_4ms_Appl10
        Rte_Al_TE_Task_10ms_Appl10_0_10ms: RteActivationOsAlarmRef=Rte_Al_TE_Task_10ms_Appl10_0_10ms, RteActivationOsTaskRef=Task_10ms_Appl10
        Rte_Al_TE_Task_100ms_Appl10_0_100ms: RteActivationOsAlarmRef=Rte_Al_TE_Task_100ms_Appl10_0_100ms, RteActivationOsTaskRef=Task_100ms_Appl10
        Rte_Al_TE_CanTp_CanTp_MainFunction: RteActivationOsAlarmRef=Rte_Al_TE_CanTp_CanTp_MainFunction, RteActivationOsTaskRef=Task_5msBsw_Appl10
        Rte_Al_TE_Task_2msTmplMonr_Appl10_0_2ms: RteActivationOsAlarmRef=Rte_Al_TE_Task_2msTmplMonr_Appl10_0_2ms, RteActivationOsTaskRef=Task_2msTmplMonr_Appl10
    RteGeneration:
      RteGenerationMode = COMPATIBILITY_MODE
      RteIocInteractionReturnValue = RTE_IOC
      RteValueRangeCheckEnabled = false
      RteCalibrationSupport = DOUBLE_POINTERED
      RteCodeVendorId = 30
      RteDevErrorDetect = false
      RteDevErrorDetectUninit = false
      RteMeasurementSupport = true
      RteOptimizationMode = MEMORY
      RteVfbTraceEnabled = false
      RteA2LVersion = V160
      RteXcpEventSupport = false
    RteInitializationBehavior: RteInitializationStrategy=RTE_INITIALIZATION_STRATEGY_AT_DATA_DECLARATION, RteSectionInitializationPolicy=INIT
    RteBswGeneral: RteSchMVersionInfoApi=false, RteUseComShadowSignalApi=false
    6 x RteBswModuleInstance:
      BswM: RteBswImplementationRef=BswM_Impl, RteBswModuleConfigurationRef=BswM
        BswM_MainFunctionTimingEvent0 (RteBswEventToTaskMapping):
          RteBswImmediateRestart = false
          RteBswPositionInTask = 4
          RteBswEventRef = BswM_MainFunctionTimingEvent0
          RteBswMappedToTaskRef = Task_10msBsw_Appl10
          RteBswUsedOsAlarmRef = Rte_Al_TE2_Task_10msBsw_Appl10_0_10ms
        BSWM_EXCLUSIVE_AREA_0 (RteBswExclusiveAreaImpl): RteExclusiveAreaImplMechanism=ALL_INTERRUPT_BLOCKING, RteBswExclusiveAreaRef=BSWM_EXCLUSIVE_AREA_0
      Dem: RteBswImplementationRef=Dem_Impl, RteBswModuleConfigurationRef=Dem
        Dem_MainFunctionTimingEvent0 (RteBswEventToTaskMapping):
          RteBswImmediateRestart = false
          RteBswPositionInTask = 12
          RteBswEventRef = Dem_MainFunctionTimingEvent0
          RteBswMappedToTaskRef = Task_10msBsw_Appl10
          RteBswUsedOsAlarmRef = Rte_Al_TE2_Task_10msBsw_Appl10_0_10ms
        3 x RteBswExclusiveAreaImpl, all with RteExclusiveAreaImplMechanism=ALL_INTERRUPT_BLOCKING:
          DEM_EXCLUSIVE_AREA_{0..2}: RteBswExclusiveAreaRef=DEM_EXCLUSIVE_AREA_{0..2}
      Det: RteBswImplementationRef=Det_Impl, RteBswModuleConfigurationRef=Det
        DET_EXCLUSIVE_AREA_0 (RteBswExclusiveAreaImpl): RteExclusiveAreaImplMechanism=ALL_INTERRUPT_BLOCKING, RteBswExclusiveAreaRef=DET_EXCLUSIVE_AREA_0
      EcuM: RteBswImplementationRef=EcuM_Impl, RteBswModuleConfigurationRef=EcuM
        EcuM_MainFunctionTimingEvent0 (RteBswEventToTaskMapping):
          RteBswImmediateRestart = false
          RteBswPositionInTask = 13
          RteBswEventRef = EcuM_MainFunctionTimingEvent0
          RteBswMappedToTaskRef = Task_10msBsw_Appl10
          RteBswUsedOsAlarmRef = Rte_Al_TE2_Task_10msBsw_Appl10_0_10ms
        3 x RteBswExclusiveAreaImpl, all with RteExclusiveAreaImplMechanism=ALL_INTERRUPT_BLOCKING:
          ECUM_EXCLUSIVE_AREA_{0..2}: RteBswExclusiveAreaRef=ECUM_EXCLUSIVE_AREA_{0..2}
      Mcu: RteBswImplementationRef=Mcu_Impl, RteBswModuleConfigurationRef=Mcu
        3 x RteBswExclusiveAreaImpl, all with RteExclusiveAreaImplMechanism=ALL_INTERRUPT_BLOCKING:
          MCU_PWR_MODE_PSC_PROTECTION: RteBswExclusiveAreaRef=MCU_PWR_MODE_PSC_PROTECTION
          MCU_REGISTER_PROTECTION: RteBswExclusiveAreaRef=MCU_REGISTER_PROTECTION
          MCU_VARIABLE_PROTECTION: RteBswExclusiveAreaRef=MCU_VARIABLE_PROTECTION
      Rte: RteBswImplementationRef=Rte_Impl, RteBswModuleConfigurationRef=Rte
        Rte_ComSendSignalProxyPeriodicTimingEvent0 (RteBswEventToTaskMapping):
          RteBswImmediateRestart = false
          RteBswPositionInTask = 15
          RteBswEventRef = Rte_ComSendSignalProxyPeriodicTimingEvent0
          RteBswMappedToTaskRef = Task_10msBsw_Appl10
    6 x RteSwComponentInstance:
      BswM_EcuSwComposition: RteSoftwareComponentInstanceRef=BswM
        Timer_BswM_MainFunction (RteEventToTaskMapping):
          RteImmediateRestart = false
          RtePositionInTask = 4
          RteEventRef = Timer_BswM_MainFunction
          RteMappedToTaskRef = Task_10msBsw_Appl10
          RteUsedOsAlarmRef = Rte_Al_TE2_Task_10msBsw_Appl10_0_10ms
      Det_EcuSwComposition: RteSoftwareComponentInstanceRef=Det
        OpEventReportError_ReportError_DetServicePort (RteEventToTaskMapping): RteImmediateRestart=false, RtePositionInTask=21, RteEventRef=OpEventReportError_ReportError_DetServicePort, RteMappedToTaskRef=Task_10msBsw_Appl10
