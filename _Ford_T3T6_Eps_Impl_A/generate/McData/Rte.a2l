/**********************************************************************************************************************
* COPYRIGHT
* This software is copyright protected and proprietary to Vector Informatik GmbH.
* Vector Informatik GmbH grants to you only those rights as set out in the license conditions.
* All other rights remain with Vector Informatik GmbH.
* FILE DESCRIPTION
* File: Rte.a2l
* Config: EPS.dpa
* ECU-Project: PSCM_FD
* Generator: MICROSAR RTE Generator Version 4.13.0
* RTE Core Version 1.13.0
* License: Unlimited license CBD1601056 for Nexteer Automotive Corporation
* Description: MICROSAR RTE A2L file
*********************************************************************************************************************/
/**********************************************************************************************************************
* CHARACTERISTIC
*********************************************************************************************************************/
/begin CHARACTERISTIC AAACalRegn01Rt00_Dummy.TEstimnMagAmbMplr.Ary1D "MICROSAR RTE" VAL_BLK 0x0 RTE_RL_FLOAT32_IEEE 0 NO_COMPU_METHOD -3.402823466e+38 3.402823466e+38 MATRIX_DIM 3 1 1 SYMBOL_LINK "Rte_CalprmRom_CalRegn01Rt00_DEFAULT_RTE_CALPRM_GROUP.TEstimnMagAmbMplr_Ary1D" 0 DISPLAY_IDENTIFIER AAACalRegn01Rt00_Dummy.CalibrationPorts.TEstimnMagAmbMplr.Ary1D /end CHARACTERISTIC
/begin CHARACTERISTIC AAACalRegn01Rt01_Dummy.TEstimnMagAmbMplr.Ary1D "MICROSAR RTE" VAL_BLK 0x0 RTE_RL_FLOAT32_IEEE 0 NO_COMPU_METHOD -3.402823466e+38 3.402823466e+38 MATRIX_DIM 3 1 1 SYMBOL_LINK "Rte_CalprmRom_CalRegn01Rt01_DEFAULT_RTE_CALPRM_GROUP.TEstimnMagAmbMplr_Ary1D" 0 DISPLAY_IDENTIFIER AAACalRegn01Rt01_Dummy.CalibrationPorts.TEstimnMagAmbMplr.Ary1D /end CHARACTERISTIC
/begin CHARACTERISTIC AAACalRegn01Rt02_Dummy.TEstimnMagAmbMplr.Ary1D "MICROSAR RTE" VAL_BLK 0x0 RTE_RL_FLOAT32_IEEE 0 NO_COMPU_METHOD -3.402823466e+38 3.402823466e+38 MATRIX_DIM 3 1 1 SYMBOL_LINK "Rte_CalprmRom_CalRegn01Rt02_DEFAULT_RTE_CALPRM_GROUP.TEstimnMagAmbMplr_Ary1D" 0 DISPLAY_IDENTIFIER AAACalRegn01Rt02_Dummy.CalibrationPorts.TEstimnMagAmbMplr.Ary1D /end CHARACTERISTIC
/begin CHARACTERISTIC AAACalRegn01Rt03_Dummy.TEstimnMagAmbMplr.Ary1D "MICROSAR RTE" VAL_BLK 0x0 RTE_RL_FLOAT32_IEEE 0 NO_COMPU_METHOD -3.402823466e+38 3.402823466e+38 MATRIX_DIM 3 1 1 SYMBOL_LINK "Rte_CalprmRom_CalRegn01Rt03_DEFAULT_RTE_CALPRM_GROUP.TEstimnMagAmbMplr_Ary1D" 0 DISPLAY_IDENTIFIER AAACalRegn01Rt03_Dummy.CalibrationPorts.TEstimnMagAmbMplr.Ary1D /end CHARACTERISTIC
/begin CHARACTERISTIC AAACalRegn01Rt04_Dummy.TEstimnMagAmbMplr.Ary1D "MICROSAR RTE" VAL_BLK 0x0 RTE_RL_FLOAT32_IEEE 0 NO_COMPU_METHOD -3.402823466e+38 3.402823466e+38 MATRIX_DIM 3 1 1 SYMBOL_LINK "Rte_CalprmRom_CalRegn01Rt04_DEFAULT_RTE_CALPRM_GROUP.TEstimnMagAmbMplr_Ary1D" 0 DISPLAY_IDENTIFIER AAACalRegn01Rt04_Dummy.CalibrationPorts.TEstimnMagAmbMplr.Ary1D /end CHARACTERISTIC
/begin CHARACTERISTIC AAACalRegn01Rt05_Dummy.TEstimnMagAmbMplr.Ary1D "MICROSAR RTE" VAL_BLK 0x0 RTE_RL_FLOAT32_IEEE 0 NO_COMPU_METHOD -3.402823466e+38 3.402823466e+38 MATRIX_DIM 3 1 1 SYMBOL_LINK "Rte_CalprmRom_CalRegn01Rt05_DEFAULT_RTE_CALPRM_GROUP.TEstimnMagAmbMplr_Ary1D" 0 DISPLAY_IDENTIFIER AAACalRegn01Rt05_Dummy.CalibrationPorts.TEstimnMagAmbMplr.Ary1D /end CHARACTERISTIC
/begin CHARACTERISTIC AAACalRegn02Rt00GroupA_Dummy.AssiHiFrqGainY.Ary2D "MICROSAR RTE" VAL_BLK 0x0 RTE_RL_UWORD 0 NO_COMPU_METHOD 0 65535 MATRIX_DIM 13 12 1 SYMBOL_LINK "Rte_CalprmRom_CalRegn02Rt00GroupA_DEFAULT_RTE_CALPRM_GROUP.AssiHiFrqGainY_Ary2D" 0 DISPLAY_IDENTIFIER AAACalRegn02Rt00GroupA_Dummy.CalibrationPorts.AssiHiFrqGainY.Ary2D /end CHARACTERISTIC
/begin CHARACTERISTIC AAACalRegn02Rt00GroupA_Dummy.AssiHiFrqHpFilFrqY.Ary1D "MICROSAR RTE" VAL_BLK 0x0 RTE_RL_UWORD 0 NO_COMPU_METHOD 0 65535 MATRIX_DIM 12 1 1 SYMBOL_LINK "Rte_CalprmRom_CalRegn02Rt00GroupA_DEFAULT_RTE_CALPRM_GROUP.AssiHiFrqHpFilFrqY_Ary1D" 0 DISPLAY_IDENTIFIER AAACalRegn02Rt00GroupA_Dummy.CalibrationPorts.AssiHiFrqHpFilFrqY.Ary1D /end CHARACTERISTIC
/begin CHARACTERISTIC AAACalRegn02Rt00GroupA_Dummy.AssiHiFrqTqWhlImbRejctnTqX.Ary2D "MICROSAR RTE" VAL_BLK 0x0 RTE_RL_UWORD 0 NO_COMPU_METHOD 0 65535 MATRIX_DIM 13 12 1 SYMBOL_LINK "Rte_CalprmRom_CalRegn02Rt00GroupA_DEFAULT_RTE_CALPRM_GROUP.AssiHiFrqTqWhlImbRejctnTqX_Ary2D" 0 DISPLAY_IDENTIFIER AAACalRegn02Rt00GroupA_Dummy.CalibrationPorts.AssiHiFrqTqWhlImbRejctnTqX.Ary2D /end CHARACTERISTIC
/begin CHARACTERISTIC AAACalRegn02Rt00GroupA_Dummy.AssiHiFrqTqX.Ary2D "MICROSAR RTE" VAL_BLK 0x0 RTE_RL_UWORD 0 NO_COMPU_METHOD 0 65535 MATRIX_DIM 13 12 1 SYMBOL_LINK "Rte_CalprmRom_CalRegn02Rt00GroupA_DEFAULT_RTE_CALPRM_GROUP.AssiHiFrqTqX_Ary2D" 0 DISPLAY_IDENTIFIER AAACalRegn02Rt00GroupA_Dummy.CalibrationPorts.AssiHiFrqTqX.Ary2D /end CHARACTERISTIC
/begin CHARACTERISTIC AAACalRegn02Rt00GroupA_Dummy.AssiHiFrqWhlImbRejctnBlndX.Ary2D "MICROSAR RTE" VAL_BLK 0x0 RTE_RL_UWORD 0 NO_COMPU_METHOD 0 65535 MATRIX_DIM 5 12 1 SYMBOL_LINK "Rte_CalprmRom_CalRegn02Rt00GroupA_DEFAULT_RTE_CALPRM_GROUP.AssiHiFrqWhlImbRejctnBlndX_Ary2D" 0 DISPLAY_IDENTIFIER AAACalRegn02Rt00GroupA_Dummy.CalibrationPorts.AssiHiFrqWhlImbRejctnBlndX.Ary2D /end CHARACTERISTIC
/begin CHARACTERISTIC AAACalRegn02Rt00GroupA_Dummy.AssiHiFrqWhlImbRejctnBlndY.Ary2D "MICROSAR RTE" VAL_BLK 0x0 RTE_RL_UWORD 0 NO_COMPU_METHOD 0 65535 MATRIX_DIM 5 12 1 SYMBOL_LINK "Rte_CalprmRom_CalRegn02Rt00GroupA_DEFAULT_RTE_CALPRM_GROUP.AssiHiFrqWhlImbRejctnBlndY_Ary2D" 0 DISPLAY_IDENTIFIER AAACalRegn02Rt00GroupA_Dummy.CalibrationPorts.AssiHiFrqWhlImbRejctnBlndY.Ary2D /end CHARACTERISTIC
/begin CHARACTERISTIC AAACalRegn02Rt00GroupA_Dummy.AssiHiFrqWhlImbRejctnGainY.Ary2D "MICROSAR RTE" VAL_BLK 0x0 RTE_RL_UWORD 0 NO_COMPU_METHOD 0 65535 MATRIX_DIM 13 12 1 SYMBOL_LINK "Rte_CalprmRom_CalRegn02Rt00GroupA_DEFAULT_RTE_CALPRM_GROUP.AssiHiFrqWhlImbRejctnGainY_Ary2D" 0 DISPLAY_IDENTIFIER AAACalRegn02Rt00GroupA_Dummy.CalibrationPorts.AssiHiFrqWhlImbRejctnGainY.Ary2D /end CHARACTERISTIC
/begin CHARACTERISTIC AAACalRegn02Rt00GroupA_Dummy.AssiMotTqWhlImbRejctnMaxX.Ary2D "MICROSAR RTE" VAL_BLK 0x0 RTE_RL_UWORD 0 NO_COMPU_METHOD 0 65535 MATRIX_DIM 20 12 1 SYMBOL_LINK "Rte_CalprmRom_CalRegn02Rt00GroupA_DEFAULT_RTE_CALPRM_GROUP.AssiMotTqWhlImbRejctnMaxX_Ary2D" 0 DISPLAY_IDENTIFIER AAACalRegn02Rt00GroupA_Dummy.CalibrationPorts.AssiMotTqWhlImbRejctnMaxX.Ary2D /end CHARACTERISTIC
/begin CHARACTERISTIC AAACalRegn02Rt00GroupA_Dummy.AssiMotTqWhlImbRejctnMaxY.Ary2D "MICROSAR RTE" VAL_BLK 0x0 RTE_RL_SWORD 0 NO_COMPU_METHOD -32768 32767 MATRIX_DIM 20 12 1 SYMBOL_LINK "Rte_CalprmRom_CalRegn02Rt00GroupA_DEFAULT_RTE_CALPRM_GROUP.AssiMotTqWhlImbRejctnMaxY_Ary2D" 0 DISPLAY_IDENTIFIER AAACalRegn02Rt00GroupA_Dummy.CalibrationPorts.AssiMotTqWhlImbRejctnMaxY.Ary2D /end CHARACTERISTIC
/begin CHARACTERISTIC AAACalRegn02Rt00GroupA_Dummy.AssiMotTqWhlImbRejctnMinX.Ary2D "MICROSAR RTE" VAL_BLK 0x0 RTE_RL_UWORD 0 NO_COMPU_METHOD 0 65535 MATRIX_DIM 20 12 1 SYMBOL_LINK "Rte_CalprmRom_CalRegn02Rt00GroupA_DEFAULT_RTE_CALPRM_GROUP.AssiMotTqWhlImbRejctnMinX_Ary2D" 0 DISPLAY_IDENTIFIER AAACalRegn02Rt00GroupA_Dummy.CalibrationPorts.AssiMotTqWhlImbRejctnMinX.Ary2D /end CHARACTERISTIC
/begin CHARACTERISTIC AAACalRegn02Rt00GroupA_Dummy.AssiMotTqWhlImbRejctnMinY.Ary2D "MICROSAR RTE" VAL_BLK 0x0 RTE_RL_SWORD 0 NO_COMPU_METHOD -32768 32767 MATRIX_DIM 20 12 1 SYMBOL_LINK "Rte_CalprmRom_CalRegn02Rt00GroupA_DEFAULT_RTE_CALPRM_GROUP.AssiMotTqWhlImbRejctnMinY_Ary2D" 0 DISPLAY_IDENTIFIER AAACalRegn02Rt00GroupA_Dummy.CalibrationPorts.AssiMotTqWhlImbRejctnMinY.Ary2D /end CHARACTERISTIC
/begin CHARACTERISTIC AAACalRegn02Rt00GroupA_Dummy.AssiWhlImbRejctnBlndScaX.Ary2D "MICROSAR RTE" VAL_BLK 0x0 RTE_RL_UWORD 0 NO_COMPU_METHOD 0 65535 MATRIX_DIM 5 12 1 SYMBOL_LINK "Rte_CalprmRom_CalRegn02Rt00GroupA_DEFAULT_RTE_CALPRM_GROUP.AssiWhlImbRejctnBlndScaX_Ary2D" 0 DISPLAY_IDENTIFIER AAACalRegn02Rt00GroupA_Dummy.CalibrationPorts.AssiWhlImbRejctnBlndScaX.Ary2D /end CHARACTERISTIC
/begin CHARACTERISTIC AAACalRegn02Rt00GroupA_Dummy.AssiWhlImbRejctnBlndScaY.Ary2D "MICROSAR RTE" VAL_BLK 0x0 RTE_RL_UWORD 0 NO_COMPU_METHOD 0 65535 MATRIX_DIM 5 12 1 SYMBOL_LINK "Rte_CalprmRom_CalRegn02Rt00GroupA_DEFAULT_RTE_CALPRM_GROUP.AssiWhlImbRejctnBlndScaY_Ary2D" 0 DISPLAY_IDENTIFIER AAACalRegn02Rt00GroupA_Dummy.CalibrationPorts.AssiWhlImbRejctnBlndScaY.Ary2D /end CHARACTERISTIC
/begin CHARACTERISTIC AAACalRegn02Rt00GroupA_Dummy.DampgHwTqX.Ary1D "MICROSAR RTE" VAL_BLK 0x0 RTE_RL_UWORD 0 NO_COMPU_METHOD 0 65535 MATRIX_DIM 2 1 1 SYMBOL_LINK "Rte_CalprmRom_CalRegn02Rt00GroupA_DEFAULT_RTE_CALPRM_GROUP.DampgHwTqX_Ary1D" 0 DISPLAY_IDENTIFIER AAACalRegn02Rt00GroupA_Dummy.CalibrationPorts.DampgHwTqX.Ary1D /end CHARACTERISTIC
/begin CHARACTERISTIC AAACalRegn02Rt00GroupA_Dummy.DampgHwTqY.Ary1D "MICROSAR RTE" VAL_BLK 0x0 RTE_RL_UWORD 0 NO_COMPU_METHOD 0 65535 MATRIX_DIM 2 1 1 SYMBOL_LINK "Rte_CalprmRom_CalRegn02Rt00GroupA_DEFAULT_RTE_CALPRM_GROUP.DampgHwTqY_Ary1D" 0 DISPLAY_IDENTIFIER AAACalRegn02Rt00GroupA_Dummy.CalibrationPorts.DampgHwTqY.Ary1D /end CHARACTERISTIC
/begin CHARACTERISTIC AAACalRegn02Rt00GroupA_Dummy.DampgHydCoeff1ScaY.Ary1D "MICROSAR RTE" VAL_BLK 0x0 RTE_RL_UWORD 0 NO_COMPU_METHOD 0 65535 MATRIX_DIM 12 1 1 SYMBOL_LINK "Rte_CalprmRom_CalRegn02Rt00GroupA_DEFAULT_RTE_CALPRM_GROUP.DampgHydCoeff1ScaY_Ary1D" 0 DISPLAY_IDENTIFIER AAACalRegn02Rt00GroupA_Dummy.CalibrationPorts.DampgHydCoeff1ScaY.Ary1D /end CHARACTERISTIC
/begin CHARACTERISTIC AAACalRegn02Rt00GroupA_Dummy.DampgHydCoeff2ScaY.Ary1D "MICROSAR RTE" VAL_BLK 0x0 RTE_RL_UWORD 0 NO_COMPU_METHOD 0 65535 MATRIX_DIM 12 1 1 SYMBOL_LINK "Rte_CalprmRom_CalRegn02Rt00GroupA_DEFAULT_RTE_CALPRM_GROUP.DampgHydCoeff2ScaY_Ary1D" 0 DISPLAY_IDENTIFIER AAACalRegn02Rt00GroupA_Dummy.CalibrationPorts.DampgHydCoeff2ScaY.Ary1D /end CHARACTERISTIC
/begin CHARACTERISTIC AAACalRegn02Rt00GroupA_Dummy.DampgHydCoeff3ScaY.Ary1D "MICROSAR RTE" VAL_BLK 0x0 RTE_RL_UWORD 0 NO_COMPU_METHOD 0 65535 MATRIX_DIM 12 1 1 SYMBOL_LINK "Rte_CalprmRom_CalRegn02Rt00GroupA_DEFAULT_RTE_CALPRM_GROUP.DampgHydCoeff3ScaY_Ary1D" 0 DISPLAY_IDENTIFIER AAACalRegn02Rt00GroupA_Dummy.CalibrationPorts.DampgHydCoeff3ScaY.Ary1D /end CHARACTERISTIC
/begin CHARACTERISTIC AAACalRegn02Rt00GroupA_Dummy.DampgHydCoeff4ScaY.Ary1D "MICROSAR RTE" VAL_BLK 0x0 RTE_RL_UWORD 0 NO_COMPU_METHOD 0 65535 MATRIX_DIM 12 1 1 SYMBOL_LINK "Rte_CalprmRom_CalRegn02Rt00GroupA_DEFAULT_RTE_CALPRM_GROUP.DampgHydCoeff4ScaY_Ary1D" 0 DISPLAY_IDENTIFIER AAACalRegn02Rt00GroupA_Dummy.CalibrationPorts.DampgHydCoeff4ScaY.Ary1D /end CHARACTERISTIC
/begin CHARACTERISTIC AAACalRegn02Rt00GroupA_Dummy.DampgMotVelX.Ary2D "MICROSAR RTE" VAL_BLK 0x0 RTE_RL_UWORD 0 NO_COMPU_METHOD 0 65535 MATRIX_DIM 13 12 1 SYMBOL_LINK "Rte_CalprmRom_CalRegn02Rt00GroupA_DEFAULT_RTE_CALPRM_GROUP.DampgMotVelX_Ary2D" 0 DISPLAY_IDENTIFIER AAACalRegn02Rt00GroupA_Dummy.CalibrationPorts.DampgMotVelX.Ary2D /end CHARACTERISTIC
/begin CHARACTERISTIC AAACalRegn02Rt00GroupA_Dummy.DampgMotVelY.Ary2D "MICROSAR RTE" VAL_BLK 0x0 RTE_RL_UWORD 0 NO_COMPU_METHOD 0 65535 MATRIX_DIM 13 12 1 SYMBOL_LINK "Rte_CalprmRom_CalRegn02Rt00GroupA_DEFAULT_RTE_CALPRM_GROUP.DampgMotVelY_Ary2D" 0 DISPLAY_IDENTIFIER AAACalRegn02Rt00GroupA_Dummy.CalibrationPorts.DampgMotVelY.Ary2D /end CHARACTERISTIC
/begin CHARACTERISTIC AAACalRegn02Rt00GroupA_Dummy.HysCmpEffLossY.Ary1D "MICROSAR RTE" VAL_BLK 0x0 RTE_RL_UWORD 0 NO_COMPU_METHOD 0 65535 MATRIX_DIM 12 1 1 SYMBOL_LINK "Rte_CalprmRom_CalRegn02Rt00GroupA_DEFAULT_RTE_CALPRM_GROUP.HysCmpEffLossY_Ary1D" 0 DISPLAY_IDENTIFIER AAACalRegn02Rt00GroupA_Dummy.CalibrationPorts.HysCmpEffLossY.Ary1D /end CHARACTERISTIC
/begin CHARACTERISTIC AAACalRegn02Rt00GroupA_Dummy.HysCmpEffOffsY.Ary1D "MICROSAR RTE" VAL_BLK 0x0 RTE_RL_UWORD 0 NO_COMPU_METHOD 0 65535 MATRIX_DIM 12 1 1 SYMBOL_LINK "Rte_CalprmRom_CalRegn02Rt00GroupA_DEFAULT_RTE_CALPRM_GROUP.HysCmpEffOffsY_Ary1D" 0 DISPLAY_IDENTIFIER AAACalRegn02Rt00GroupA_Dummy.CalibrationPorts.HysCmpEffOffsY.Ary1D /end CHARACTERISTIC
/begin CHARACTERISTIC AAACalRegn02Rt00GroupA_Dummy.HysCmpFricWhlImbRejctnBlndX.Ary1D "MICROSAR RTE" VAL_BLK 0x0 RTE_RL_UWORD 0 NO_COMPU_METHOD 0 65535 MATRIX_DIM 6 1 1 SYMBOL_LINK "Rte_CalprmRom_CalRegn02Rt00GroupA_DEFAULT_RTE_CALPRM_GROUP.HysCmpFricWhlImbRejctnBlndX_Ary1D" 0 DISPLAY_IDENTIFIER AAACalRegn02Rt00GroupA_Dummy.CalibrationPorts.HysCmpFricWhlImbRejctnBlndX.Ary1D /end CHARACTERISTIC
/begin CHARACTERISTIC AAACalRegn02Rt00GroupA_Dummy.HysCmpFricWhlImbRejctnBlndY.Ary1D "MICROSAR RTE" VAL_BLK 0x0 RTE_RL_UWORD 0 NO_COMPU_METHOD 0 65535 MATRIX_DIM 6 1 1 SYMBOL_LINK "Rte_CalprmRom_CalRegn02Rt00GroupA_DEFAULT_RTE_CALPRM_GROUP.HysCmpFricWhlImbRejctnBlndY_Ary1D" 0 DISPLAY_IDENTIFIER AAACalRegn02Rt00GroupA_Dummy.CalibrationPorts.HysCmpFricWhlImbRejctnBlndY.Ary1D /end CHARACTERISTIC
/begin CHARACTERISTIC AAACalRegn02Rt00GroupA_Dummy.HysCmpFricWhlImbRejctnOffY.Ary1D "MICROSAR RTE" VAL_BLK 0x0 RTE_RL_UWORD 0 NO_COMPU_METHOD 0 65535 MATRIX_DIM 12 1 1 SYMBOL_LINK "Rte_CalprmRom_CalRegn02Rt00GroupA_DEFAULT_RTE_CALPRM_GROUP.HysCmpFricWhlImbRejctnOffY_Ary1D" 0 DISPLAY_IDENTIFIER AAACalRegn02Rt00GroupA_Dummy.CalibrationPorts.HysCmpFricWhlImbRejctnOffY.Ary1D /end CHARACTERISTIC
/begin CHARACTERISTIC AAACalRegn02Rt00GroupA_Dummy.HysCmpFricWhlImbRejctnOnY.Ary1D "MICROSAR RTE" VAL_BLK 0x0 RTE_RL_UWORD 0 NO_COMPU_METHOD 0 65535 MATRIX_DIM 12 1 1 SYMBOL_LINK "Rte_CalprmRom_CalRegn02Rt00GroupA_DEFAULT_RTE_CALPRM_GROUP.HysCmpFricWhlImbRejctnOnY_Ary1D" 0 DISPLAY_IDENTIFIER AAACalRegn02Rt00GroupA_Dummy.CalibrationPorts.HysCmpFricWhlImbRejctnOnY.Ary1D /end CHARACTERISTIC
/begin CHARACTERISTIC AAACalRegn02Rt00GroupA_Dummy.HysCmpHwTqScaX.Ary2D "MICROSAR RTE" VAL_BLK 0x0 RTE_RL_UWORD 0 NO_COMPU_METHOD 0 65535 MATRIX_DIM 8 12 1 SYMBOL_LINK "Rte_CalprmRom_CalRegn02Rt00GroupA_DEFAULT_RTE_CALPRM_GROUP.HysCmpHwTqScaX_Ary2D" 0 DISPLAY_IDENTIFIER AAACalRegn02Rt00GroupA_Dummy.CalibrationPorts.HysCmpHwTqScaX.Ary2D /end CHARACTERISTIC
/begin CHARACTERISTIC AAACalRegn02Rt00GroupA_Dummy.HysCmpHwTqScaY.Ary2D "MICROSAR RTE" VAL_BLK 0x0 RTE_RL_UWORD 0 NO_COMPU_METHOD 0 65535 MATRIX_DIM 8 12 1 SYMBOL_LINK "Rte_CalprmRom_CalRegn02Rt00GroupA_DEFAULT_RTE_CALPRM_GROUP.HysCmpHwTqScaY_Ary2D" 0 DISPLAY_IDENTIFIER AAACalRegn02Rt00GroupA_Dummy.CalibrationPorts.HysCmpHwTqScaY.Ary2D /end CHARACTERISTIC
/begin CHARACTERISTIC AAACalRegn02Rt00GroupA_Dummy.HysCmpHysSatnY.Ary1D "MICROSAR RTE" VAL_BLK 0x0 RTE_RL_UWORD 0 NO_COMPU_METHOD 0 65535 MATRIX_DIM 12 1 1 SYMBOL_LINK "Rte_CalprmRom_CalRegn02Rt00GroupA_DEFAULT_RTE_CALPRM_GROUP.HysCmpHysSatnY_Ary1D" 0 DISPLAY_IDENTIFIER AAACalRegn02Rt00GroupA_Dummy.CalibrationPorts.HysCmpHysSatnY.Ary1D /end CHARACTERISTIC
/begin CHARACTERISTIC AAACalRegn02Rt00GroupA_Dummy.HysCmpNegHysCmpScaX.Ary1D "MICROSAR RTE" VAL_BLK 0x0 RTE_RL_UWORD 0 NO_COMPU_METHOD 0 65535 MATRIX_DIM 5 1 1 SYMBOL_LINK "Rte_CalprmRom_CalRegn02Rt00GroupA_DEFAULT_RTE_CALPRM_GROUP.HysCmpNegHysCmpScaX_Ary1D" 0 DISPLAY_IDENTIFIER AAACalRegn02Rt00GroupA_Dummy.CalibrationPorts.HysCmpNegHysCmpScaX.Ary1D /end CHARACTERISTIC
/begin CHARACTERISTIC AAACalRegn02Rt00GroupA_Dummy.HysCmpNegHysCmpScaY.Ary1D "MICROSAR RTE" VAL_BLK 0x0 RTE_RL_UWORD 0 NO_COMPU_METHOD 0 65535 MATRIX_DIM 5 1 1 SYMBOL_LINK "Rte_CalprmRom_CalRegn02Rt00GroupA_DEFAULT_RTE_CALPRM_GROUP.HysCmpNegHysCmpScaY_Ary1D" 0 DISPLAY_IDENTIFIER AAACalRegn02Rt00GroupA_Dummy.CalibrationPorts.HysCmpNegHysCmpScaY.Ary1D /end CHARACTERISTIC
/begin CHARACTERISTIC AAACalRegn02Rt00GroupA_Dummy.HysCmpNegHysCmpX.Ary1D "MICROSAR RTE" VAL_BLK 0x0 RTE_RL_UWORD 0 NO_COMPU_METHOD 0 65535 MATRIX_DIM 8 1 1 SYMBOL_LINK "Rte_CalprmRom_CalRegn02Rt00GroupA_DEFAULT_RTE_CALPRM_GROUP.HysCmpNegHysCmpX_Ary1D" 0 DISPLAY_IDENTIFIER AAACalRegn02Rt00GroupA_Dummy.CalibrationPorts.HysCmpNegHysCmpX.Ary1D /end CHARACTERISTIC
/begin CHARACTERISTIC AAACalRegn02Rt00GroupA_Dummy.HysCmpNegHysCmpY.Ary1D "MICROSAR RTE" VAL_BLK 0x0 RTE_RL_UWORD 0 NO_COMPU_METHOD 0 65535 MATRIX_DIM 8 1 1 SYMBOL_LINK "Rte_CalprmRom_CalRegn02Rt00GroupA_DEFAULT_RTE_CALPRM_GROUP.HysCmpNegHysCmpY_Ary1D" 0 DISPLAY_IDENTIFIER AAACalRegn02Rt00GroupA_Dummy.CalibrationPorts.HysCmpNegHysCmpY.Ary1D /end CHARACTERISTIC
/begin CHARACTERISTIC AAACalRegn02Rt00GroupA_Dummy.HysCmpOutpLim.Val "MICROSAR RTE" VALUE 0x0 RTE_RL_FLOAT32_IEEE 0 NO_COMPU_METHOD -3.402823466e+38 3.402823466e+38 SYMBOL_LINK "Rte_CalprmRom_CalRegn02Rt00GroupA_DEFAULT_RTE_CALPRM_GROUP.HysCmpOutpLim_Val" 0 DISPLAY_IDENTIFIER AAACalRegn02Rt00GroupA_Dummy.CalibrationPorts.HysCmpOutpLim.Val /end CHARACTERISTIC
/begin CHARACTERISTIC AAACalRegn02Rt00GroupA_Dummy.HysCmpRevGain.Val "MICROSAR RTE" VALUE 0x0 RTE_RL_FLOAT32_IEEE 0 NO_COMPU_METHOD -3.402823466e+38 3.402823466e+38 SYMBOL_LINK "Rte_CalprmRom_CalRegn02Rt00GroupA_DEFAULT_RTE_CALPRM_GROUP.HysCmpRevGain_Val" 0 DISPLAY_IDENTIFIER AAACalRegn02Rt00GroupA_Dummy.CalibrationPorts.HysCmpRevGain.Val /end CHARACTERISTIC
/begin CHARACTERISTIC AAACalRegn02Rt00GroupA_Dummy.HysCmpRiseX.Ary1D "MICROSAR RTE" VAL_BLK 0x0 RTE_RL_UWORD 0 NO_COMPU_METHOD 0 65535 MATRIX_DIM 6 1 1 SYMBOL_LINK "Rte_CalprmRom_CalRegn02Rt00GroupA_DEFAULT_RTE_CALPRM_GROUP.HysCmpRiseX_Ary1D" 0 DISPLAY_IDENTIFIER AAACalRegn02Rt00GroupA_Dummy.CalibrationPorts.HysCmpRiseX.Ary1D /end CHARACTERISTIC
/begin CHARACTERISTIC AAACalRegn02Rt00GroupA_Dummy.HysCmpRiseY.Ary1D "MICROSAR RTE" VAL_BLK 0x0 RTE_RL_UWORD 0 NO_COMPU_METHOD 0 65535 MATRIX_DIM 6 1 1 SYMBOL_LINK "Rte_CalprmRom_CalRegn02Rt00GroupA_DEFAULT_RTE_CALPRM_GROUP.HysCmpRiseY_Ary1D" 0 DISPLAY_IDENTIFIER AAACalRegn02Rt00GroupA_Dummy.CalibrationPorts.HysCmpRiseY.Ary1D /end CHARACTERISTIC
/begin CHARACTERISTIC AAACalRegn02Rt00GroupA_Dummy.InertiaCmpVelAssiBasdDampgStatY.Ary1D "MICROSAR RTE" VAL_BLK 0x0 RTE_RL_UWORD 0 NO_COMPU_METHOD 0 65535 MATRIX_DIM 10 1 1 SYMBOL_LINK "Rte_CalprmRom_CalRegn02Rt00GroupA_DEFAULT_RTE_CALPRM_GROUP.InertiaCmpVelAssiBasdDampgStatY_Ary1D" 0 DISPLAY_IDENTIFIER AAACalRegn02Rt00GroupA_Dummy.CalibrationPorts.InertiaCmpVelAssiBasdDampgStatY.Ary1D /end CHARACTERISTIC
/begin CHARACTERISTIC AAACalRegn02Rt00GroupA_Dummy.InertiaCmpVelDampgFilFrq.Ary1D "MICROSAR RTE" VAL_BLK 0x0 RTE_RL_UWORD 0 NO_COMPU_METHOD 0 65535 MATRIX_DIM 12 1 1 SYMBOL_LINK "Rte_CalprmRom_CalRegn02Rt00GroupA_DEFAULT_RTE_CALPRM_GROUP.InertiaCmpVelDampgFilFrq_Ary1D" 0 DISPLAY_IDENTIFIER AAACalRegn02Rt00GroupA_Dummy.CalibrationPorts.InertiaCmpVelDampgFilFrq.Ary1D /end CHARACTERISTIC
/begin CHARACTERISTIC AAACalRegn02Rt00GroupA_Dummy.InertiaCmpVelDampgFilFrqWhlImbRejctnOn.Ary1D "MICROSAR RTE" VAL_BLK 0x0 RTE_RL_UWORD 0 NO_COMPU_METHOD 0 65535 MATRIX_DIM 12 1 1 SYMBOL_LINK "Rte_CalprmRom_CalRegn02Rt00GroupA_DEFAULT_RTE_CALPRM_GROUP.InertiaCmpVelDampgFilFrqWhlImbRejctnOn_Ary1D" 0 DISPLAY_IDENTIFIER AAACalRegn02Rt00GroupA_Dummy.CalibrationPorts.InertiaCmpVelDampgFilFrqWhlImbRejctnOn.Ary1D /end CHARACTERISTIC
/begin CHARACTERISTIC AAACalRegn02Rt00GroupA_Dummy.InertiaCmpVelDampgSpdBlndY.Ary1D "MICROSAR RTE" VAL_BLK 0x0 RTE_RL_UWORD 0 NO_COMPU_METHOD 0 65535 MATRIX_DIM 12 1 1 SYMBOL_LINK "Rte_CalprmRom_CalRegn02Rt00GroupA_DEFAULT_RTE_CALPRM_GROUP.InertiaCmpVelDampgSpdBlndY_Ary1D" 0 DISPLAY_IDENTIFIER AAACalRegn02Rt00GroupA_Dummy.CalibrationPorts.InertiaCmpVelDampgSpdBlndY.Ary1D /end CHARACTERISTIC
/begin CHARACTERISTIC AAACalRegn02Rt00GroupA_Dummy.InertiaCmpVelDampgWhlImbRejctnBlndX.Ary1D "MICROSAR RTE" VAL_BLK 0x0 RTE_RL_UWORD 0 NO_COMPU_METHOD 0 65535 MATRIX_DIM 5 1 1 SYMBOL_LINK "Rte_CalprmRom_CalRegn02Rt00GroupA_DEFAULT_RTE_CALPRM_GROUP.InertiaCmpVelDampgWhlImbRejctnBlndX_Ary1D" 0 DISPLAY_IDENTIFIER AAACalRegn02Rt00GroupA_Dummy.CalibrationPorts.InertiaCmpVelDampgWhlImbRejctnBlndX.Ary1D /end CHARACTERISTIC
/begin CHARACTERISTIC AAACalRegn02Rt00GroupA_Dummy.InertiaCmpVelDampgWhlImbRejctnBlndY.Ary1D "MICROSAR RTE" VAL_BLK 0x0 RTE_RL_UWORD 0 NO_COMPU_METHOD 0 65535 MATRIX_DIM 5 1 1 SYMBOL_LINK "Rte_CalprmRom_CalRegn02Rt00GroupA_DEFAULT_RTE_CALPRM_GROUP.InertiaCmpVelDampgWhlImbRejctnBlndY_Ary1D" 0 DISPLAY_IDENTIFIER AAACalRegn02Rt00GroupA_Dummy.CalibrationPorts.InertiaCmpVelDampgWhlImbRejctnBlndY.Ary1D /end CHARACTERISTIC
/begin CHARACTERISTIC AAACalRegn02Rt00GroupB_Dummy.EotProtnDampgVehSpdTbl.Ary1D "MICROSAR RTE" VAL_BLK 0x0 RTE_RL_UWORD 0 NO_COMPU_METHOD 0 65535 MATRIX_DIM 4 1 1 SYMBOL_LINK "Rte_CalprmRom_CalRegn02Rt00GroupB_DEFAULT_RTE_CALPRM_GROUP.EotProtnDampgVehSpdTbl_Ary1D" 0 DISPLAY_IDENTIFIER AAACalRegn02Rt00GroupB_Dummy.CalibrationPorts.EotProtnDampgVehSpdTbl.Ary1D /end CHARACTERISTIC
/begin CHARACTERISTIC AAACalRegn02Rt00GroupB_Dummy.EotProtnDeltaTqThd.Val "MICROSAR RTE" VALUE 0x0 RTE_RL_FLOAT32_IEEE 0 NO_COMPU_METHOD -3.402823466e+38 3.402823466e+38 SYMBOL_LINK "Rte_CalprmRom_CalRegn02Rt00GroupB_DEFAULT_RTE_CALPRM_GROUP.EotProtnDeltaTqThd_Val" 0 DISPLAY_IDENTIFIER AAACalRegn02Rt00GroupB_Dummy.CalibrationPorts.EotProtnDeltaTqThd.Val /end CHARACTERISTIC
/begin CHARACTERISTIC AAACalRegn02Rt00GroupB_Dummy.EotProtnEntrGainVehSpdTbl.Ary1D "MICROSAR RTE" VAL_BLK 0x0 RTE_RL_UWORD 0 NO_COMPU_METHOD 0 65535 MATRIX_DIM 5 1 1 SYMBOL_LINK "Rte_CalprmRom_CalRegn02Rt00GroupB_DEFAULT_RTE_CALPRM_GROUP.EotProtnEntrGainVehSpdTbl_Ary1D" 0 DISPLAY_IDENTIFIER AAACalRegn02Rt00GroupB_Dummy.CalibrationPorts.EotProtnEntrGainVehSpdTbl.Ary1D /end CHARACTERISTIC
/begin CHARACTERISTIC AAACalRegn02Rt00GroupB_Dummy.EotProtnEntrGainY.Ary2D "MICROSAR RTE" VAL_BLK 0x0 RTE_RL_UWORD 0 NO_COMPU_METHOD 0 65535 MATRIX_DIM 4 5 1 SYMBOL_LINK "Rte_CalprmRom_CalRegn02Rt00GroupB_DEFAULT_RTE_CALPRM_GROUP.EotProtnEntrGainY_Ary2D" 0 DISPLAY_IDENTIFIER AAACalRegn02Rt00GroupB_Dummy.CalibrationPorts.EotProtnEntrGainY.Ary2D /end CHARACTERISTIC
/begin CHARACTERISTIC AAACalRegn02Rt00GroupB_Dummy.EotProtnLoAuthyEntrGainY.Ary2D "MICROSAR RTE" VAL_BLK 0x0 RTE_RL_UWORD 0 NO_COMPU_METHOD 0 65535 MATRIX_DIM 4 5 1 SYMBOL_LINK "Rte_CalprmRom_CalRegn02Rt00GroupB_DEFAULT_RTE_CALPRM_GROUP.EotProtnLoAuthyEntrGainY_Ary2D" 0 DISPLAY_IDENTIFIER AAACalRegn02Rt00GroupB_Dummy.CalibrationPorts.EotProtnLoAuthyEntrGainY.Ary2D /end CHARACTERISTIC
/begin CHARACTERISTIC AAACalRegn02Rt00GroupB_Dummy.EotProtnMotSpdIncptY.Ary1D "MICROSAR RTE" VAL_BLK 0x0 RTE_RL_UWORD 0 NO_COMPU_METHOD 0 65535 MATRIX_DIM 2 1 1 SYMBOL_LINK "Rte_CalprmRom_CalRegn02Rt00GroupB_DEFAULT_RTE_CALPRM_GROUP.EotProtnMotSpdIncptY_Ary1D" 0 DISPLAY_IDENTIFIER AAACalRegn02Rt00GroupB_Dummy.CalibrationPorts.EotProtnMotSpdIncptY.Ary1D /end CHARACTERISTIC
/begin CHARACTERISTIC AAACalRegn02Rt00GroupB_Dummy.EotProtnNormDampgY.Ary2D "MICROSAR RTE" VAL_BLK 0x0 RTE_RL_UWORD 0 NO_COMPU_METHOD 0 65535 MATRIX_DIM 2 4 1 SYMBOL_LINK "Rte_CalprmRom_CalRegn02Rt00GroupB_DEFAULT_RTE_CALPRM_GROUP.EotProtnNormDampgY_Ary2D" 0 DISPLAY_IDENTIFIER AAACalRegn02Rt00GroupB_Dummy.CalibrationPorts.EotProtnNormDampgY.Ary2D /end CHARACTERISTIC
/begin CHARACTERISTIC AAACalRegn02Rt00GroupB_Dummy.EotProtnSoftEndStopAuthyThd.Val "MICROSAR RTE" VALUE 0x0 RTE_RL_FLOAT32_IEEE 0 NO_COMPU_METHOD -3.402823466e+38 3.402823466e+38 SYMBOL_LINK "Rte_CalprmRom_CalRegn02Rt00GroupB_DEFAULT_RTE_CALPRM_GROUP.EotProtnSoftEndStopAuthyThd_Val" 0 DISPLAY_IDENTIFIER AAACalRegn02Rt00GroupB_Dummy.CalibrationPorts.EotProtnSoftEndStopAuthyThd.Val /end CHARACTERISTIC
/begin CHARACTERISTIC AAACalRegn02Rt00GroupB_Dummy.RtnHwAgOffsCalcdX.Ary2D "MICROSAR RTE" VAL_BLK 0x0 RTE_RL_UWORD 0 NO_COMPU_METHOD 0 65535 MATRIX_DIM 16 9 1 SYMBOL_LINK "Rte_CalprmRom_CalRegn02Rt00GroupB_DEFAULT_RTE_CALPRM_GROUP.RtnHwAgOffsCalcdX_Ary2D" 0 DISPLAY_IDENTIFIER AAACalRegn02Rt00GroupB_Dummy.CalibrationPorts.RtnHwAgOffsCalcdX.Ary2D /end CHARACTERISTIC
/begin CHARACTERISTIC AAACalRegn02Rt00GroupB_Dummy.RtnHwAgOffsCalcdY.Ary2D "MICROSAR RTE" VAL_BLK 0x0 RTE_RL_UWORD 0 NO_COMPU_METHOD 0 65535 MATRIX_DIM 16 9 1 SYMBOL_LINK "Rte_CalprmRom_CalRegn02Rt00GroupB_DEFAULT_RTE_CALPRM_GROUP.RtnHwAgOffsCalcdY_Ary2D" 0 DISPLAY_IDENTIFIER AAACalRegn02Rt00GroupB_Dummy.CalibrationPorts.RtnHwAgOffsCalcdY.Ary2D /end CHARACTERISTIC
/begin CHARACTERISTIC AAACalRegn02Rt00GroupB_Dummy.RtnScaTqX.Ary2D "MICROSAR RTE" VAL_BLK 0x0 RTE_RL_UWORD 0 NO_COMPU_METHOD 0 65535 MATRIX_DIM 8 9 1 SYMBOL_LINK "Rte_CalprmRom_CalRegn02Rt00GroupB_DEFAULT_RTE_CALPRM_GROUP.RtnScaTqX_Ary2D" 0 DISPLAY_IDENTIFIER AAACalRegn02Rt00GroupB_Dummy.CalibrationPorts.RtnScaTqX.Ary2D /end CHARACTERISTIC
/begin CHARACTERISTIC AAACalRegn02Rt00GroupB_Dummy.RtnScaTqY.Ary2D "MICROSAR RTE" VAL_BLK 0x0 RTE_RL_UWORD 0 NO_COMPU_METHOD 0 65535 MATRIX_DIM 8 9 1 SYMBOL_LINK "Rte_CalprmRom_CalRegn02Rt00GroupB_DEFAULT_RTE_CALPRM_GROUP.RtnScaTqY_Ary2D" 0 DISPLAY_IDENTIFIER AAACalRegn02Rt00GroupB_Dummy.CalibrationPorts.RtnScaTqY.Ary2D /end CHARACTERISTIC
/begin CHARACTERISTIC AAACalRegn02Rt00GroupB_Dummy.RtnScaVelX.Ary2D "MICROSAR RTE" VAL_BLK 0x0 RTE_RL_UWORD 0 NO_COMPU_METHOD 0 65535 MATRIX_DIM 4 9 1 SYMBOL_LINK "Rte_CalprmRom_CalRegn02Rt00GroupB_DEFAULT_RTE_CALPRM_GROUP.RtnScaVelX_Ary2D" 0 DISPLAY_IDENTIFIER AAACalRegn02Rt00GroupB_Dummy.CalibrationPorts.RtnScaVelX.Ary2D /end CHARACTERISTIC
/begin CHARACTERISTIC AAACalRegn02Rt00GroupB_Dummy.RtnScaVelY.Ary2D "MICROSAR RTE" VAL_BLK 0x0 RTE_RL_UWORD 0 NO_COMPU_METHOD 0 65535 MATRIX_DIM 4 9 1 SYMBOL_LINK "Rte_CalprmRom_CalRegn02Rt00GroupB_DEFAULT_RTE_CALPRM_GROUP.RtnScaVelY_Ary2D" 0 DISPLAY_IDENTIFIER AAACalRegn02Rt00GroupB_Dummy.CalibrationPorts.RtnScaVelY.Ary2D /end CHARACTERISTIC
/begin CHARACTERISTIC AAACalRegn02Rt00GroupB_Dummy.RtnVehSpdSeln.Ary1D "MICROSAR RTE" VAL_BLK 0x0 RTE_RL_UWORD 0 NO_COMPU_METHOD 0 65535 MATRIX_DIM 9 1 1 SYMBOL_LINK "Rte_CalprmRom_CalRegn02Rt00GroupB_DEFAULT_RTE_CALPRM_GROUP.RtnVehSpdSeln_Ary1D" 0 DISPLAY_IDENTIFIER AAACalRegn02Rt00GroupB_Dummy.CalibrationPorts.RtnVehSpdSeln.Ary1D /end CHARACTERISTIC
/begin CHARACTERISTIC AAACalRegn02Rt01GroupA_Dummy.AssiHiFrqGainY.Ary2D "MICROSAR RTE" VAL_BLK 0x0 RTE_RL_UWORD 0 NO_COMPU_METHOD 0 65535 MATRIX_DIM 13 12 1 SYMBOL_LINK "Rte_CalprmRom_CalRegn02Rt01GroupA_DEFAULT_RTE_CALPRM_GROUP.AssiHiFrqGainY_Ary2D" 0 DISPLAY_IDENTIFIER AAACalRegn02Rt01GroupA_Dummy.CalibrationPorts.AssiHiFrqGainY.Ary2D /end CHARACTERISTIC
/begin CHARACTERISTIC AAACalRegn02Rt01GroupA_Dummy.AssiHiFrqHpFilFrqY.Ary1D "MICROSAR RTE" VAL_BLK 0x0 RTE_RL_UWORD 0 NO_COMPU_METHOD 0 65535 MATRIX_DIM 12 1 1 SYMBOL_LINK "Rte_CalprmRom_CalRegn02Rt01GroupA_DEFAULT_RTE_CALPRM_GROUP.AssiHiFrqHpFilFrqY_Ary1D" 0 DISPLAY_IDENTIFIER AAACalRegn02Rt01GroupA_Dummy.CalibrationPorts.AssiHiFrqHpFilFrqY.Ary1D /end CHARACTERISTIC
/begin CHARACTERISTIC AAACalRegn02Rt01GroupA_Dummy.AssiHiFrqTqWhlImbRejctnTqX.Ary2D "MICROSAR RTE" VAL_BLK 0x0 RTE_RL_UWORD 0 NO_COMPU_METHOD 0 65535 MATRIX_DIM 13 12 1 SYMBOL_LINK "Rte_CalprmRom_CalRegn02Rt01GroupA_DEFAULT_RTE_CALPRM_GROUP.AssiHiFrqTqWhlImbRejctnTqX_Ary2D" 0 DISPLAY_IDENTIFIER AAACalRegn02Rt01GroupA_Dummy.CalibrationPorts.AssiHiFrqTqWhlImbRejctnTqX.Ary2D /end CHARACTERISTIC
/begin CHARACTERISTIC AAACalRegn02Rt01GroupA_Dummy.AssiHiFrqTqX.Ary2D "MICROSAR RTE" VAL_BLK 0x0 RTE_RL_UWORD 0 NO_COMPU_METHOD 0 65535 MATRIX_DIM 13 12 1 SYMBOL_LINK "Rte_CalprmRom_CalRegn02Rt01GroupA_DEFAULT_RTE_CALPRM_GROUP.AssiHiFrqTqX_Ary2D" 0 DISPLAY_IDENTIFIER AAACalRegn02Rt01GroupA_Dummy.CalibrationPorts.AssiHiFrqTqX.Ary2D /end CHARACTERISTIC
/begin CHARACTERISTIC AAACalRegn02Rt01GroupA_Dummy.AssiHiFrqWhlImbRejctnBlndX.Ary2D "MICROSAR RTE" VAL_BLK 0x0 RTE_RL_UWORD 0 NO_COMPU_METHOD 0 65535 MATRIX_DIM 5 12 1 SYMBOL_LINK "Rte_CalprmRom_CalRegn02Rt01GroupA_DEFAULT_RTE_CALPRM_GROUP.AssiHiFrqWhlImbRejctnBlndX_Ary2D" 0 DISPLAY_IDENTIFIER AAACalRegn02Rt01GroupA_Dummy.CalibrationPorts.AssiHiFrqWhlImbRejctnBlndX.Ary2D /end CHARACTERISTIC
/begin CHARACTERISTIC AAACalRegn02Rt01GroupA_Dummy.AssiHiFrqWhlImbRejctnBlndY.Ary2D "MICROSAR RTE" VAL_BLK 0x0 RTE_RL_UWORD 0 NO_COMPU_METHOD 0 65535 MATRIX_DIM 5 12 1 SYMBOL_LINK "Rte_CalprmRom_CalRegn02Rt01GroupA_DEFAULT_RTE_CALPRM_GROUP.AssiHiFrqWhlImbRejctnBlndY_Ary2D" 0 DISPLAY_IDENTIFIER AAACalRegn02Rt01GroupA_Dummy.CalibrationPorts.AssiHiFrqWhlImbRejctnBlndY.Ary2D /end CHARACTERISTIC
/begin CHARACTERISTIC AAACalRegn02Rt01GroupA_Dummy.AssiHiFrqWhlImbRejctnGainY.Ary2D "MICROSAR RTE" VAL_BLK 0x0 RTE_RL_UWORD 0 NO_COMPU_METHOD 0 65535 MATRIX_DIM 13 12 1 SYMBOL_LINK "Rte_CalprmRom_CalRegn02Rt01GroupA_DEFAULT_RTE_CALPRM_GROUP.AssiHiFrqWhlImbRejctnGainY_Ary2D" 0 DISPLAY_IDENTIFIER AAACalRegn02Rt01GroupA_Dummy.CalibrationPorts.AssiHiFrqWhlImbRejctnGainY.Ary2D /end CHARACTERISTIC
/begin CHARACTERISTIC AAACalRegn02Rt01GroupA_Dummy.AssiMotTqWhlImbRejctnMaxX.Ary2D "MICROSAR RTE" VAL_BLK 0x0 RTE_RL_UWORD 0 NO_COMPU_METHOD 0 65535 MATRIX_DIM 20 12 1 SYMBOL_LINK "Rte_CalprmRom_CalRegn02Rt01GroupA_DEFAULT_RTE_CALPRM_GROUP.AssiMotTqWhlImbRejctnMaxX_Ary2D" 0 DISPLAY_IDENTIFIER AAACalRegn02Rt01GroupA_Dummy.CalibrationPorts.AssiMotTqWhlImbRejctnMaxX.Ary2D /end CHARACTERISTIC
/begin CHARACTERISTIC AAACalRegn02Rt01GroupA_Dummy.AssiMotTqWhlImbRejctnMaxY.Ary2D "MICROSAR RTE" VAL_BLK 0x0 RTE_RL_SWORD 0 NO_COMPU_METHOD -32768 32767 MATRIX_DIM 20 12 1 SYMBOL_LINK "Rte_CalprmRom_CalRegn02Rt01GroupA_DEFAULT_RTE_CALPRM_GROUP.AssiMotTqWhlImbRejctnMaxY_Ary2D" 0 DISPLAY_IDENTIFIER AAACalRegn02Rt01GroupA_Dummy.CalibrationPorts.AssiMotTqWhlImbRejctnMaxY.Ary2D /end CHARACTERISTIC
/begin CHARACTERISTIC AAACalRegn02Rt01GroupA_Dummy.AssiMotTqWhlImbRejctnMinX.Ary2D "MICROSAR RTE" VAL_BLK 0x0 RTE_RL_UWORD 0 NO_COMPU_METHOD 0 65535 MATRIX_DIM 20 12 1 SYMBOL_LINK "Rte_CalprmRom_CalRegn02Rt01GroupA_DEFAULT_RTE_CALPRM_GROUP.AssiMotTqWhlImbRejctnMinX_Ary2D" 0 DISPLAY_IDENTIFIER AAACalRegn02Rt01GroupA_Dummy.CalibrationPorts.AssiMotTqWhlImbRejctnMinX.Ary2D /end CHARACTERISTIC
/begin CHARACTERISTIC AAACalRegn02Rt01GroupA_Dummy.AssiMotTqWhlImbRejctnMinY.Ary2D "MICROSAR RTE" VAL_BLK 0x0 RTE_RL_SWORD 0 NO_COMPU_METHOD -32768 32767 MATRIX_DIM 20 12 1 SYMBOL_LINK "Rte_CalprmRom_CalRegn02Rt01GroupA_DEFAULT_RTE_CALPRM_GROUP.AssiMotTqWhlImbRejctnMinY_Ary2D" 0 DISPLAY_IDENTIFIER AAACalRegn02Rt01GroupA_Dummy.CalibrationPorts.AssiMotTqWhlImbRejctnMinY.Ary2D /end CHARACTERISTIC
/begin CHARACTERISTIC AAACalRegn02Rt01GroupA_Dummy.AssiWhlImbRejctnBlndScaX.Ary2D "MICROSAR RTE" VAL_BLK 0x0 RTE_RL_UWORD 0 NO_COMPU_METHOD 0 65535 MATRIX_DIM 5 12 1 SYMBOL_LINK "Rte_CalprmRom_CalRegn02Rt01GroupA_DEFAULT_RTE_CALPRM_GROUP.AssiWhlImbRejctnBlndScaX_Ary2D" 0 DISPLAY_IDENTIFIER AAACalRegn02Rt01GroupA_Dummy.CalibrationPorts.AssiWhlImbRejctnBlndScaX.Ary2D /end CHARACTERISTIC
/begin CHARACTERISTIC AAACalRegn02Rt01GroupA_Dummy.AssiWhlImbRejctnBlndScaY.Ary2D "MICROSAR RTE" VAL_BLK 0x0 RTE_RL_UWORD 0 NO_COMPU_METHOD 0 65535 MATRIX_DIM 5 12 1 SYMBOL_LINK "Rte_CalprmRom_CalRegn02Rt01GroupA_DEFAULT_RTE_CALPRM_GROUP.AssiWhlImbRejctnBlndScaY_Ary2D" 0 DISPLAY_IDENTIFIER AAACalRegn02Rt01GroupA_Dummy.CalibrationPorts.AssiWhlImbRejctnBlndScaY.Ary2D /end CHARACTERISTIC
/begin CHARACTERISTIC AAACalRegn02Rt01GroupA_Dummy.DampgHwTqX.Ary1D "MICROSAR RTE" VAL_BLK 0x0 RTE_RL_UWORD 0 NO_COMPU_METHOD 0 65535 MATRIX_DIM 2 1 1 SYMBOL_LINK "Rte_CalprmRom_CalRegn02Rt01GroupA_DEFAULT_RTE_CALPRM_GROUP.DampgHwTqX_Ary1D" 0 DISPLAY_IDENTIFIER AAACalRegn02Rt01GroupA_Dummy.CalibrationPorts.DampgHwTqX.Ary1D /end CHARACTERISTIC
/begin CHARACTERISTIC AAACalRegn02Rt01GroupA_Dummy.DampgHwTqY.Ary1D "MICROSAR RTE" VAL_BLK 0x0 RTE_RL_UWORD 0 NO_COMPU_METHOD 0 65535 MATRIX_DIM 2 1 1 SYMBOL_LINK "Rte_CalprmRom_CalRegn02Rt01GroupA_DEFAULT_RTE_CALPRM_GROUP.DampgHwTqY_Ary1D" 0 DISPLAY_IDENTIFIER AAACalRegn02Rt01GroupA_Dummy.CalibrationPorts.DampgHwTqY.Ary1D /end CHARACTERISTIC
/begin CHARACTERISTIC AAACalRegn02Rt01GroupA_Dummy.DampgHydCoeff1ScaY.Ary1D "MICROSAR RTE" VAL_BLK 0x0 RTE_RL_UWORD 0 NO_COMPU_METHOD 0 65535 MATRIX_DIM 12 1 1 SYMBOL_LINK "Rte_CalprmRom_CalRegn02Rt01GroupA_DEFAULT_RTE_CALPRM_GROUP.DampgHydCoeff1ScaY_Ary1D" 0 DISPLAY_IDENTIFIER AAACalRegn02Rt01GroupA_Dummy.CalibrationPorts.DampgHydCoeff1ScaY.Ary1D /end CHARACTERISTIC
/begin CHARACTERISTIC AAACalRegn02Rt01GroupA_Dummy.DampgHydCoeff2ScaY.Ary1D "MICROSAR RTE" VAL_BLK 0x0 RTE_RL_UWORD 0 NO_COMPU_METHOD 0 65535 MATRIX_DIM 12 1 1 SYMBOL_LINK "Rte_CalprmRom_CalRegn02Rt01GroupA_DEFAULT_RTE_CALPRM_GROUP.DampgHydCoeff2ScaY_Ary1D" 0 DISPLAY_IDENTIFIER AAACalRegn02Rt01GroupA_Dummy.CalibrationPorts.DampgHydCoeff2ScaY.Ary1D /end CHARACTERISTIC
/begin CHARACTERISTIC AAACalRegn02Rt01GroupA_Dummy.DampgHydCoeff3ScaY.Ary1D "MICROSAR RTE" VAL_BLK 0x0 RTE_RL_UWORD 0 NO_COMPU_METHOD 0 65535 MATRIX_DIM 12 1 1 SYMBOL_LINK "Rte_CalprmRom_CalRegn02Rt01GroupA_DEFAULT_RTE_CALPRM_GROUP.DampgHydCoeff3ScaY_Ary1D" 0 DISPLAY_IDENTIFIER AAACalRegn02Rt01GroupA_Dummy.CalibrationPorts.DampgHydCoeff3ScaY.Ary1D /end CHARACTERISTIC
/begin CHARACTERISTIC AAACalRegn02Rt01GroupA_Dummy.DampgHydCoeff4ScaY.Ary1D "MICROSAR RTE" VAL_BLK 0x0 RTE_RL_UWORD 0 NO_COMPU_METHOD 0 65535 MATRIX_DIM 12 1 1 SYMBOL_LINK "Rte_CalprmRom_CalRegn02Rt01GroupA_DEFAULT_RTE_CALPRM_GROUP.DampgHydCoeff4ScaY_Ary1D" 0 DISPLAY_IDENTIFIER AAACalRegn02Rt01GroupA_Dummy.CalibrationPorts.DampgHydCoeff4ScaY.Ary1D /end CHARACTERISTIC
/begin CHARACTERISTIC AAACalRegn02Rt01GroupA_Dummy.DampgMotVelX.Ary2D "MICROSAR RTE" VAL_BLK 0x0 RTE_RL_UWORD 0 NO_COMPU_METHOD 0 65535 MATRIX_DIM 13 12 1 SYMBOL_LINK "Rte_CalprmRom_CalRegn02Rt01GroupA_DEFAULT_RTE_CALPRM_GROUP.DampgMotVelX_Ary2D" 0 DISPLAY_IDENTIFIER AAACalRegn02Rt01GroupA_Dummy.CalibrationPorts.DampgMotVelX.Ary2D /end CHARACTERISTIC
/begin CHARACTERISTIC AAACalRegn02Rt01GroupA_Dummy.DampgMotVelY.Ary2D "MICROSAR RTE" VAL_BLK 0x0 RTE_RL_UWORD 0 NO_COMPU_METHOD 0 65535 MATRIX_DIM 13 12 1 SYMBOL_LINK "Rte_CalprmRom_CalRegn02Rt01GroupA_DEFAULT_RTE_CALPRM_GROUP.DampgMotVelY_Ary2D" 0 DISPLAY_IDENTIFIER AAACalRegn02Rt01GroupA_Dummy.CalibrationPorts.DampgMotVelY.Ary2D /end CHARACTERISTIC
/begin CHARACTERISTIC AAACalRegn02Rt01GroupA_Dummy.HysCmpEffLossY.Ary1D "MICROSAR RTE" VAL_BLK 0x0 RTE_RL_UWORD 0 NO_COMPU_METHOD 0 65535 MATRIX_DIM 12 1 1 SYMBOL_LINK "Rte_CalprmRom_CalRegn02Rt01GroupA_DEFAULT_RTE_CALPRM_GROUP.HysCmpEffLossY_Ary1D" 0 DISPLAY_IDENTIFIER AAACalRegn02Rt01GroupA_Dummy.CalibrationPorts.HysCmpEffLossY.Ary1D /end CHARACTERISTIC
/begin CHARACTERISTIC AAACalRegn02Rt01GroupA_Dummy.HysCmpEffOffsY.Ary1D "MICROSAR RTE" VAL_BLK 0x0 RTE_RL_UWORD 0 NO_COMPU_METHOD 0 65535 MATRIX_DIM 12 1 1 SYMBOL_LINK "Rte_CalprmRom_CalRegn02Rt01GroupA_DEFAULT_RTE_CALPRM_GROUP.HysCmpEffOffsY_Ary1D" 0 DISPLAY_IDENTIFIER AAACalRegn02Rt01GroupA_Dummy.CalibrationPorts.HysCmpEffOffsY.Ary1D /end CHARACTERISTIC
/begin CHARACTERISTIC AAACalRegn02Rt01GroupA_Dummy.HysCmpFricWhlImbRejctnBlndX.Ary1D "MICROSAR RTE" VAL_BLK 0x0 RTE_RL_UWORD 0 NO_COMPU_METHOD 0 65535 MATRIX_DIM 6 1 1 SYMBOL_LINK "Rte_CalprmRom_CalRegn02Rt01GroupA_DEFAULT_RTE_CALPRM_GROUP.HysCmpFricWhlImbRejctnBlndX_Ary1D" 0 DISPLAY_IDENTIFIER AAACalRegn02Rt01GroupA_Dummy.CalibrationPorts.HysCmpFricWhlImbRejctnBlndX.Ary1D /end CHARACTERISTIC
/begin CHARACTERISTIC AAACalRegn02Rt01GroupA_Dummy.HysCmpFricWhlImbRejctnBlndY.Ary1D "MICROSAR RTE" VAL_BLK 0x0 RTE_RL_UWORD 0 NO_COMPU_METHOD 0 65535 MATRIX_DIM 6 1 1 SYMBOL_LINK "Rte_CalprmRom_CalRegn02Rt01GroupA_DEFAULT_RTE_CALPRM_GROUP.HysCmpFricWhlImbRejctnBlndY_Ary1D" 0 DISPLAY_IDENTIFIER AAACalRegn02Rt01GroupA_Dummy.CalibrationPorts.HysCmpFricWhlImbRejctnBlndY.Ary1D /end CHARACTERISTIC
/begin CHARACTERISTIC AAACalRegn02Rt01GroupA_Dummy.HysCmpFricWhlImbRejctnOffY.Ary1D "MICROSAR RTE" VAL_BLK 0x0 RTE_RL_UWORD 0 NO_COMPU_METHOD 0 65535 MATRIX_DIM 12 1 1 SYMBOL_LINK "Rte_CalprmRom_CalRegn02Rt01GroupA_DEFAULT_RTE_CALPRM_GROUP.HysCmpFricWhlImbRejctnOffY_Ary1D" 0 DISPLAY_IDENTIFIER AAACalRegn02Rt01GroupA_Dummy.CalibrationPorts.HysCmpFricWhlImbRejctnOffY.Ary1D /end CHARACTERISTIC
/begin CHARACTERISTIC AAACalRegn02Rt01GroupA_Dummy.HysCmpFricWhlImbRejctnOnY.Ary1D "MICROSAR RTE" VAL_BLK 0x0 RTE_RL_UWORD 0 NO_COMPU_METHOD 0 65535 MATRIX_DIM 12 1 1 SYMBOL_LINK "Rte_CalprmRom_CalRegn02Rt01GroupA_DEFAULT_RTE_CALPRM_GROUP.HysCmpFricWhlImbRejctnOnY_Ary1D" 0 DISPLAY_IDENTIFIER AAACalRegn02Rt01GroupA_Dummy.CalibrationPorts.HysCmpFricWhlImbRejctnOnY.Ary1D /end CHARACTERISTIC
/begin CHARACTERISTIC AAACalRegn02Rt01GroupA_Dummy.HysCmpHwTqScaX.Ary2D "MICROSAR RTE" VAL_BLK 0x0 RTE_RL_UWORD 0 NO_COMPU_METHOD 0 65535 MATRIX_DIM 8 12 1 SYMBOL_LINK "Rte_CalprmRom_CalRegn02Rt01GroupA_DEFAULT_RTE_CALPRM_GROUP.HysCmpHwTqScaX_Ary2D" 0 DISPLAY_IDENTIFIER AAACalRegn02Rt01GroupA_Dummy.CalibrationPorts.HysCmpHwTqScaX.Ary2D /end CHARACTERISTIC
/begin CHARACTERISTIC AAACalRegn02Rt01GroupA_Dummy.HysCmpHwTqScaY.Ary2D "MICROSAR RTE" VAL_BLK 0x0 RTE_RL_UWORD 0 NO_COMPU_METHOD 0 65535 MATRIX_DIM 8 12 1 SYMBOL_LINK "Rte_CalprmRom_CalRegn02Rt01GroupA_DEFAULT_RTE_CALPRM_GROUP.HysCmpHwTqScaY_Ary2D" 0 DISPLAY_IDENTIFIER AAACalRegn02Rt01GroupA_Dummy.CalibrationPorts.HysCmpHwTqScaY.Ary2D /end CHARACTERISTIC
/begin CHARACTERISTIC AAACalRegn02Rt01GroupA_Dummy.HysCmpHysSatnY.Ary1D "MICROSAR RTE" VAL_BLK 0x0 RTE_RL_UWORD 0 NO_COMPU_METHOD 0 65535 MATRIX_DIM 12 1 1 SYMBOL_LINK "Rte_CalprmRom_CalRegn02Rt01GroupA_DEFAULT_RTE_CALPRM_GROUP.HysCmpHysSatnY_Ary1D" 0 DISPLAY_IDENTIFIER AAACalRegn02Rt01GroupA_Dummy.CalibrationPorts.HysCmpHysSatnY.Ary1D /end CHARACTERISTIC
/begin CHARACTERISTIC AAACalRegn02Rt01GroupA_Dummy.HysCmpNegHysCmpScaX.Ary1D "MICROSAR RTE" VAL_BLK 0x0 RTE_RL_UWORD 0 NO_COMPU_METHOD 0 65535 MATRIX_DIM 5 1 1 SYMBOL_LINK "Rte_CalprmRom_CalRegn02Rt01GroupA_DEFAULT_RTE_CALPRM_GROUP.HysCmpNegHysCmpScaX_Ary1D" 0 DISPLAY_IDENTIFIER AAACalRegn02Rt01GroupA_Dummy.CalibrationPorts.HysCmpNegHysCmpScaX.Ary1D /end CHARACTERISTIC
/begin CHARACTERISTIC AAACalRegn02Rt01GroupA_Dummy.HysCmpNegHysCmpScaY.Ary1D "MICROSAR RTE" VAL_BLK 0x0 RTE_RL_UWORD 0 NO_COMPU_METHOD 0 65535 MATRIX_DIM 5 1 1 SYMBOL_LINK "Rte_CalprmRom_CalRegn02Rt01GroupA_DEFAULT_RTE_CALPRM_GROUP.HysCmpNegHysCmpScaY_Ary1D" 0 DISPLAY_IDENTIFIER AAACalRegn02Rt01GroupA_Dummy.CalibrationPorts.HysCmpNegHysCmpScaY.Ary1D /end CHARACTERISTIC
/begin CHARACTERISTIC AAACalRegn02Rt01GroupA_Dummy.HysCmpNegHysCmpX.Ary1D "MICROSAR RTE" VAL_BLK 0x0 RTE_RL_UWORD 0 NO_COMPU_METHOD 0 65535 MATRIX_DIM 8 1 1 SYMBOL_LINK "Rte_CalprmRom_CalRegn02Rt01GroupA_DEFAULT_RTE_CALPRM_GROUP.HysCmpNegHysCmpX_Ary1D" 0 DISPLAY_IDENTIFIER AAACalRegn02Rt01GroupA_Dummy.CalibrationPorts.HysCmpNegHysCmpX.Ary1D /end CHARACTERISTIC
/begin CHARACTERISTIC AAACalRegn02Rt01GroupA_Dummy.HysCmpNegHysCmpY.Ary1D "MICROSAR RTE" VAL_BLK 0x0 RTE_RL_UWORD 0 NO_COMPU_METHOD 0 65535 MATRIX_DIM 8 1 1 SYMBOL_LINK "Rte_CalprmRom_CalRegn02Rt01GroupA_DEFAULT_RTE_CALPRM_GROUP.HysCmpNegHysCmpY_Ary1D" 0 DISPLAY_IDENTIFIER AAACalRegn02Rt01GroupA_Dummy.CalibrationPorts.HysCmpNegHysCmpY.Ary1D /end CHARACTERISTIC
/begin CHARACTERISTIC AAACalRegn02Rt01GroupA_Dummy.HysCmpOutpLim.Val "MICROSAR RTE" VALUE 0x0 RTE_RL_FLOAT32_IEEE 0 NO_COMPU_METHOD -3.402823466e+38 3.402823466e+38 SYMBOL_LINK "Rte_CalprmRom_CalRegn02Rt01GroupA_DEFAULT_RTE_CALPRM_GROUP.HysCmpOutpLim_Val" 0 DISPLAY_IDENTIFIER AAACalRegn02Rt01GroupA_Dummy.CalibrationPorts.HysCmpOutpLim.Val /end CHARACTERISTIC
/begin CHARACTERISTIC AAACalRegn02Rt01GroupA_Dummy.HysCmpRevGain.Val "MICROSAR RTE" VALUE 0x0 RTE_RL_FLOAT32_IEEE 0 NO_COMPU_METHOD -3.402823466e+38 3.402823466e+38 SYMBOL_LINK "Rte_CalprmRom_CalRegn02Rt01GroupA_DEFAULT_RTE_CALPRM_GROUP.HysCmpRevGain_Val" 0 DISPLAY_IDENTIFIER AAACalRegn02Rt01GroupA_Dummy.CalibrationPorts.HysCmpRevGain.Val /end CHARACTERISTIC
/begin CHARACTERISTIC AAACalRegn02Rt01GroupA_Dummy.HysCmpRiseX.Ary1D "MICROSAR RTE" VAL_BLK 0x0 RTE_RL_UWORD 0 NO_COMPU_METHOD 0 65535 MATRIX_DIM 6 1 1 SYMBOL_LINK "Rte_CalprmRom_CalRegn02Rt01GroupA_DEFAULT_RTE_CALPRM_GROUP.HysCmpRiseX_Ary1D" 0 DISPLAY_IDENTIFIER AAACalRegn02Rt01GroupA_Dummy.CalibrationPorts.HysCmpRiseX.Ary1D /end CHARACTERISTIC
/begin CHARACTERISTIC AAACalRegn02Rt01GroupA_Dummy.HysCmpRiseY.Ary1D "MICROSAR RTE" VAL_BLK 0x0 RTE_RL_UWORD 0 NO_COMPU_METHOD 0 65535 MATRIX_DIM 6 1 1 SYMBOL_LINK "Rte_CalprmRom_CalRegn02Rt01GroupA_DEFAULT_RTE_CALPRM_GROUP.HysCmpRiseY_Ary1D" 0 DISPLAY_IDENTIFIER AAACalRegn02Rt01GroupA_Dummy.CalibrationPorts.HysCmpRiseY.Ary1D /end CHARACTERISTIC
/begin CHARACTERISTIC AAACalRegn02Rt01GroupA_Dummy.InertiaCmpVelAssiBasdDampgStatY.Ary1D "MICROSAR RTE" VAL_BLK 0x0 RTE_RL_UWORD 0 NO_COMPU_METHOD 0 65535 MATRIX_DIM 10 1 1 SYMBOL_LINK "Rte_CalprmRom_CalRegn02Rt01GroupA_DEFAULT_RTE_CALPRM_GROUP.InertiaCmpVelAssiBasdDampgStatY_Ary1D" 0 DISPLAY_IDENTIFIER AAACalRegn02Rt01GroupA_Dummy.CalibrationPorts.InertiaCmpVelAssiBasdDampgStatY.Ary1D /end CHARACTERISTIC
/begin CHARACTERISTIC AAACalRegn02Rt01GroupA_Dummy.InertiaCmpVelDampgFilFrq.Ary1D "MICROSAR RTE" VAL_BLK 0x0 RTE_RL_UWORD 0 NO_COMPU_METHOD 0 65535 MATRIX_DIM 12 1 1 SYMBOL_LINK "Rte_CalprmRom_CalRegn02Rt01GroupA_DEFAULT_RTE_CALPRM_GROUP.InertiaCmpVelDampgFilFrq_Ary1D" 0 DISPLAY_IDENTIFIER AAACalRegn02Rt01GroupA_Dummy.CalibrationPorts.InertiaCmpVelDampgFilFrq.Ary1D /end CHARACTERISTIC
/begin CHARACTERISTIC AAACalRegn02Rt01GroupA_Dummy.InertiaCmpVelDampgFilFrqWhlImbRejctnOn.Ary1D "MICROSAR RTE" VAL_BLK 0x0 RTE_RL_UWORD 0 NO_COMPU_METHOD 0 65535 MATRIX_DIM 12 1 1 SYMBOL_LINK "Rte_CalprmRom_CalRegn02Rt01GroupA_DEFAULT_RTE_CALPRM_GROUP.InertiaCmpVelDampgFilFrqWhlImbRejctnOn_Ary1D" 0 DISPLAY_IDENTIFIER AAACalRegn02Rt01GroupA_Dummy.CalibrationPorts.InertiaCmpVelDampgFilFrqWhlImbRejctnOn.Ary1D /end CHARACTERISTIC
/begin CHARACTERISTIC AAACalRegn02Rt01GroupA_Dummy.InertiaCmpVelDampgSpdBlndY.Ary1D "MICROSAR RTE" VAL_BLK 0x0 RTE_RL_UWORD 0 NO_COMPU_METHOD 0 65535 MATRIX_DIM 12 1 1 SYMBOL_LINK "Rte_CalprmRom_CalRegn02Rt01GroupA_DEFAULT_RTE_CALPRM_GROUP.InertiaCmpVelDampgSpdBlndY_Ary1D" 0 DISPLAY_IDENTIFIER AAACalRegn02Rt01GroupA_Dummy.CalibrationPorts.InertiaCmpVelDampgSpdBlndY.Ary1D /end CHARACTERISTIC
/begin CHARACTERISTIC AAACalRegn02Rt01GroupA_Dummy.InertiaCmpVelDampgWhlImbRejctnBlndX.Ary1D "MICROSAR RTE" VAL_BLK 0x0 RTE_RL_UWORD 0 NO_COMPU_METHOD 0 65535 MATRIX_DIM 5 1 1 SYMBOL_LINK "Rte_CalprmRom_CalRegn02Rt01GroupA_DEFAULT_RTE_CALPRM_GROUP.InertiaCmpVelDampgWhlImbRejctnBlndX_Ary1D" 0 DISPLAY_IDENTIFIER AAACalRegn02Rt01GroupA_Dummy.CalibrationPorts.InertiaCmpVelDampgWhlImbRejctnBlndX.Ary1D /end CHARACTERISTIC
/begin CHARACTERISTIC AAACalRegn02Rt01GroupA_Dummy.InertiaCmpVelDampgWhlImbRejctnBlndY.Ary1D "MICROSAR RTE" VAL_BLK 0x0 RTE_RL_UWORD 0 NO_COMPU_METHOD 0 65535 MATRIX_DIM 5 1 1 SYMBOL_LINK "Rte_CalprmRom_CalRegn02Rt01GroupA_DEFAULT_RTE_CALPRM_GROUP.InertiaCmpVelDampgWhlImbRejctnBlndY_Ary1D" 0 DISPLAY_IDENTIFIER AAACalRegn02Rt01GroupA_Dummy.CalibrationPorts.InertiaCmpVelDampgWhlImbRejctnBlndY.Ary1D /end CHARACTERISTIC
/begin CHARACTERISTIC AAACalRegn02Rt01GroupB_Dummy.EotProtnDampgVehSpdTbl.Ary1D "MICROSAR RTE" VAL_BLK 0x0 RTE_RL_UWORD 0 NO_COMPU_METHOD 0 65535 MATRIX_DIM 4 1 1 SYMBOL_LINK "Rte_CalprmRom_CalRegn02Rt01GroupB_DEFAULT_RTE_CALPRM_GROUP.EotProtnDampgVehSpdTbl_Ary1D" 0 DISPLAY_IDENTIFIER AAACalRegn02Rt01GroupB_Dummy.CalibrationPorts.EotProtnDampgVehSpdTbl.Ary1D /end CHARACTERISTIC
/begin CHARACTERISTIC AAACalRegn02Rt01GroupB_Dummy.EotProtnDeltaTqThd.Val "MICROSAR RTE" VALUE 0x0 RTE_RL_FLOAT32_IEEE 0 NO_COMPU_METHOD -3.402823466e+38 3.402823466e+38 SYMBOL_LINK "Rte_CalprmRom_CalRegn02Rt01GroupB_DEFAULT_RTE_CALPRM_GROUP.EotProtnDeltaTqThd_Val" 0 DISPLAY_IDENTIFIER AAACalRegn02Rt01GroupB_Dummy.CalibrationPorts.EotProtnDeltaTqThd.Val /end CHARACTERISTIC
/begin CHARACTERISTIC AAACalRegn02Rt01GroupB_Dummy.EotProtnEntrGainVehSpdTbl.Ary1D "MICROSAR RTE" VAL_BLK 0x0 RTE_RL_UWORD 0 NO_COMPU_METHOD 0 65535 MATRIX_DIM 5 1 1 SYMBOL_LINK "Rte_CalprmRom_CalRegn02Rt01GroupB_DEFAULT_RTE_CALPRM_GROUP.EotProtnEntrGainVehSpdTbl_Ary1D" 0 DISPLAY_IDENTIFIER AAACalRegn02Rt01GroupB_Dummy.CalibrationPorts.EotProtnEntrGainVehSpdTbl.Ary1D /end CHARACTERISTIC
/begin CHARACTERISTIC AAACalRegn02Rt01GroupB_Dummy.EotProtnEntrGainY.Ary2D "MICROSAR RTE" VAL_BLK 0x0 RTE_RL_UWORD 0 NO_COMPU_METHOD 0 65535 MATRIX_DIM 4 5 1 SYMBOL_LINK "Rte_CalprmRom_CalRegn02Rt01GroupB_DEFAULT_RTE_CALPRM_GROUP.EotProtnEntrGainY_Ary2D" 0 DISPLAY_IDENTIFIER AAACalRegn02Rt01GroupB_Dummy.CalibrationPorts.EotProtnEntrGainY.Ary2D /end CHARACTERISTIC
/begin CHARACTERISTIC AAACalRegn02Rt01GroupB_Dummy.EotProtnLoAuthyEntrGainY.Ary2D "MICROSAR RTE" VAL_BLK 0x0 RTE_RL_UWORD 0 NO_COMPU_METHOD 0 65535 MATRIX_DIM 4 5 1 SYMBOL_LINK "Rte_CalprmRom_CalRegn02Rt01GroupB_DEFAULT_RTE_CALPRM_GROUP.EotProtnLoAuthyEntrGainY_Ary2D" 0 DISPLAY_IDENTIFIER AAACalRegn02Rt01GroupB_Dummy.CalibrationPorts.EotProtnLoAuthyEntrGainY.Ary2D /end CHARACTERISTIC
/begin CHARACTERISTIC AAACalRegn02Rt01GroupB_Dummy.EotProtnMotSpdIncptY.Ary1D "MICROSAR RTE" VAL_BLK 0x0 RTE_RL_UWORD 0 NO_COMPU_METHOD 0 65535 MATRIX_DIM 2 1 1 SYMBOL_LINK "Rte_CalprmRom_CalRegn02Rt01GroupB_DEFAULT_RTE_CALPRM_GROUP.EotProtnMotSpdIncptY_Ary1D" 0 DISPLAY_IDENTIFIER AAACalRegn02Rt01GroupB_Dummy.CalibrationPorts.EotProtnMotSpdIncptY.Ary1D /end CHARACTERISTIC
/begin CHARACTERISTIC AAACalRegn02Rt01GroupB_Dummy.EotProtnNormDampgY.Ary2D "MICROSAR RTE" VAL_BLK 0x0 RTE_RL_UWORD 0 NO_COMPU_METHOD 0 65535 MATRIX_DIM 2 4 1 SYMBOL_LINK "Rte_CalprmRom_CalRegn02Rt01GroupB_DEFAULT_RTE_CALPRM_GROUP.EotProtnNormDampgY_Ary2D" 0 DISPLAY_IDENTIFIER AAACalRegn02Rt01GroupB_Dummy.CalibrationPorts.EotProtnNormDampgY.Ary2D /end CHARACTERISTIC
/begin CHARACTERISTIC AAACalRegn02Rt01GroupB_Dummy.EotProtnSoftEndStopAuthyThd.Val "MICROSAR RTE" VALUE 0x0 RTE_RL_FLOAT32_IEEE 0 NO_COMPU_METHOD -3.402823466e+38 3.402823466e+38 SYMBOL_LINK "Rte_CalprmRom_CalRegn02Rt01GroupB_DEFAULT_RTE_CALPRM_GROUP.EotProtnSoftEndStopAuthyThd_Val" 0 DISPLAY_IDENTIFIER AAACalRegn02Rt01GroupB_Dummy.CalibrationPorts.EotProtnSoftEndStopAuthyThd.Val /end CHARACTERISTIC
/begin CHARACTERISTIC AAACalRegn02Rt01GroupB_Dummy.RtnHwAgOffsCalcdX.Ary2D "MICROSAR RTE" VAL_BLK 0x0 RTE_RL_UWORD 0 NO_COMPU_METHOD 0 65535 MATRIX_DIM 16 9 1 SYMBOL_LINK "Rte_CalprmRom_CalRegn02Rt01GroupB_DEFAULT_RTE_CALPRM_GROUP.RtnHwAgOffsCalcdX_Ary2D" 0 DISPLAY_IDENTIFIER AAACalRegn02Rt01GroupB_Dummy.CalibrationPorts.RtnHwAgOffsCalcdX.Ary2D /end CHARACTERISTIC
/begin CHARACTERISTIC AAACalRegn02Rt01GroupB_Dummy.RtnHwAgOffsCalcdY.Ary2D "MICROSAR RTE" VAL_BLK 0x0 RTE_RL_UWORD 0 NO_COMPU_METHOD 0 65535 MATRIX_DIM 16 9 1 SYMBOL_LINK "Rte_CalprmRom_CalRegn02Rt01GroupB_DEFAULT_RTE_CALPRM_GROUP.RtnHwAgOffsCalcdY_Ary2D" 0 DISPLAY_IDENTIFIER AAACalRegn02Rt01GroupB_Dummy.CalibrationPorts.RtnHwAgOffsCalcdY.Ary2D /end CHARACTERISTIC
/begin CHARACTERISTIC AAACalRegn02Rt01GroupB_Dummy.RtnScaTqX.Ary2D "MICROSAR RTE" VAL_BLK 0x0 RTE_RL_UWORD 0 NO_COMPU_METHOD 0 65535 MATRIX_DIM 8 9 1 SYMBOL_LINK "Rte_CalprmRom_CalRegn02Rt01GroupB_DEFAULT_RTE_CALPRM_GROUP.RtnScaTqX_Ary2D" 0 DISPLAY_IDENTIFIER AAACalRegn02Rt01GroupB_Dummy.CalibrationPorts.RtnScaTqX.Ary2D /end CHARACTERISTIC
/begin CHARACTERISTIC AAACalRegn02Rt01GroupB_Dummy.RtnScaTqY.Ary2D "MICROSAR RTE" VAL_BLK 0x0 RTE_RL_UWORD 0 NO_COMPU_METHOD 0 65535 MATRIX_DIM 8 9 1 SYMBOL_LINK "Rte_CalprmRom_CalRegn02Rt01GroupB_DEFAULT_RTE_CALPRM_GROUP.RtnScaTqY_Ary2D" 0 DISPLAY_IDENTIFIER AAACalRegn02Rt01GroupB_Dummy.CalibrationPorts.RtnScaTqY.Ary2D /end CHARACTERISTIC
/begin CHARACTERISTIC AAACalRegn02Rt01GroupB_Dummy.RtnScaVelX.Ary2D "MICROSAR RTE" VAL_BLK 0x0 RTE_RL_UWORD 0 NO_COMPU_METHOD 0 65535 MATRIX_DIM 4 9 1 SYMBOL_LINK "Rte_CalprmRom_CalRegn02Rt01GroupB_DEFAULT_RTE_CALPRM_GROUP.RtnScaVelX_Ary2D" 0 DISPLAY_IDENTIFIER AAACalRegn02Rt01GroupB_Dummy.CalibrationPorts.RtnScaVelX.Ary2D /end CHARACTERISTIC
/begin CHARACTERISTIC AAACalRegn02Rt01GroupB_Dummy.RtnScaVelY.Ary2D "MICROSAR RTE" VAL_BLK 0x0 RTE_RL_UWORD 0 NO_COMPU_METHOD 0 65535 MATRIX_DIM 4 9 1 SYMBOL_LINK "Rte_CalprmRom_CalRegn02Rt01GroupB_DEFAULT_RTE_CALPRM_GROUP.RtnScaVelY_Ary2D" 0 DISPLAY_IDENTIFIER AAACalRegn02Rt01GroupB_Dummy.CalibrationPorts.RtnScaVelY.Ary2D /end CHARACTERISTIC
/begin CHARACTERISTIC AAACalRegn02Rt01GroupB_Dummy.RtnVehSpdSeln.Ary1D "MICROSAR RTE" VAL_BLK 0x0 RTE_RL_UWORD 0 NO_COMPU_METHOD 0 65535 MATRIX_DIM 9 1 1 SYMBOL_LINK "Rte_CalprmRom_CalRegn02Rt01GroupB_DEFAULT_RTE_CALPRM_GROUP.RtnVehSpdSeln_Ary1D" 0 DISPLAY_IDENTIFIER AAACalRegn02Rt01GroupB_Dummy.CalibrationPorts.RtnVehSpdSeln.Ary1D /end CHARACTERISTIC
/begin CHARACTERISTIC AAACalRegn02Rt02GroupA_Dummy.AssiHiFrqGainY.Ary2D "MICROSAR RTE" VAL_BLK 0x0 RTE_RL_UWORD 0 NO_COMPU_METHOD 0 65535 MATRIX_DIM 13 12 1 SYMBOL_LINK "Rte_CalprmRom_CalRegn02Rt02GroupA_DEFAULT_RTE_CALPRM_GROUP.AssiHiFrqGainY_Ary2D" 0 DISPLAY_IDENTIFIER AAACalRegn02Rt02GroupA_Dummy.CalibrationPorts.AssiHiFrqGainY.Ary2D /end CHARACTERISTIC
/begin CHARACTERISTIC AAACalRegn02Rt02GroupA_Dummy.AssiHiFrqHpFilFrqY.Ary1D "MICROSAR RTE" VAL_BLK 0x0 RTE_RL_UWORD 0 NO_COMPU_METHOD 0 65535 MATRIX_DIM 12 1 1 SYMBOL_LINK "Rte_CalprmRom_CalRegn02Rt02GroupA_DEFAULT_RTE_CALPRM_GROUP.AssiHiFrqHpFilFrqY_Ary1D" 0 DISPLAY_IDENTIFIER AAACalRegn02Rt02GroupA_Dummy.CalibrationPorts.AssiHiFrqHpFilFrqY.Ary1D /end CHARACTERISTIC
/begin CHARACTERISTIC AAACalRegn02Rt02GroupA_Dummy.AssiHiFrqTqWhlImbRejctnTqX.Ary2D "MICROSAR RTE" VAL_BLK 0x0 RTE_RL_UWORD 0 NO_COMPU_METHOD 0 65535 MATRIX_DIM 13 12 1 SYMBOL_LINK "Rte_CalprmRom_CalRegn02Rt02GroupA_DEFAULT_RTE_CALPRM_GROUP.AssiHiFrqTqWhlImbRejctnTqX_Ary2D" 0 DISPLAY_IDENTIFIER AAACalRegn02Rt02GroupA_Dummy.CalibrationPorts.AssiHiFrqTqWhlImbRejctnTqX.Ary2D /end CHARACTERISTIC
/begin CHARACTERISTIC AAACalRegn02Rt02GroupA_Dummy.AssiHiFrqTqX.Ary2D "MICROSAR RTE" VAL_BLK 0x0 RTE_RL_UWORD 0 NO_COMPU_METHOD 0 65535 MATRIX_DIM 13 12 1 SYMBOL_LINK "Rte_CalprmRom_CalRegn02Rt02GroupA_DEFAULT_RTE_CALPRM_GROUP.AssiHiFrqTqX_Ary2D" 0 DISPLAY_IDENTIFIER AAACalRegn02Rt02GroupA_Dummy.CalibrationPorts.AssiHiFrqTqX.Ary2D /end CHARACTERISTIC
/begin CHARACTERISTIC AAACalRegn02Rt02GroupA_Dummy.AssiHiFrqWhlImbRejctnBlndX.Ary2D "MICROSAR RTE" VAL_BLK 0x0 RTE_RL_UWORD 0 NO_COMPU_METHOD 0 65535 MATRIX_DIM 5 12 1 SYMBOL_LINK "Rte_CalprmRom_CalRegn02Rt02GroupA_DEFAULT_RTE_CALPRM_GROUP.AssiHiFrqWhlImbRejctnBlndX_Ary2D" 0 DISPLAY_IDENTIFIER AAACalRegn02Rt02GroupA_Dummy.CalibrationPorts.AssiHiFrqWhlImbRejctnBlndX.Ary2D /end CHARACTERISTIC
/begin CHARACTERISTIC AAACalRegn02Rt02GroupA_Dummy.AssiHiFrqWhlImbRejctnBlndY.Ary2D "MICROSAR RTE" VAL_BLK 0x0 RTE_RL_UWORD 0 NO_COMPU_METHOD 0 65535 MATRIX_DIM 5 12 1 SYMBOL_LINK "Rte_CalprmRom_CalRegn02Rt02GroupA_DEFAULT_RTE_CALPRM_GROUP.AssiHiFrqWhlImbRejctnBlndY_Ary2D" 0 DISPLAY_IDENTIFIER AAACalRegn02Rt02GroupA_Dummy.CalibrationPorts.AssiHiFrqWhlImbRejctnBlndY.Ary2D /end CHARACTERISTIC
/begin CHARACTERISTIC AAACalRegn02Rt02GroupA_Dummy.AssiHiFrqWhlImbRejctnGainY.Ary2D "MICROSAR RTE" VAL_BLK 0x0 RTE_RL_UWORD 0 NO_COMPU_METHOD 0 65535 MATRIX_DIM 13 12 1 SYMBOL_LINK "Rte_CalprmRom_CalRegn02Rt02GroupA_DEFAULT_RTE_CALPRM_GROUP.AssiHiFrqWhlImbRejctnGainY_Ary2D" 0 DISPLAY_IDENTIFIER AAACalRegn02Rt02GroupA_Dummy.CalibrationPorts.AssiHiFrqWhlImbRejctnGainY.Ary2D /end CHARACTERISTIC
/begin CHARACTERISTIC AAACalRegn02Rt02GroupA_Dummy.AssiMotTqWhlImbRejctnMaxX.Ary2D "MICROSAR RTE" VAL_BLK 0x0 RTE_RL_UWORD 0 NO_COMPU_METHOD 0 65535 MATRIX_DIM 20 12 1 SYMBOL_LINK "Rte_CalprmRom_CalRegn02Rt02GroupA_DEFAULT_RTE_CALPRM_GROUP.AssiMotTqWhlImbRejctnMaxX_Ary2D" 0 DISPLAY_IDENTIFIER AAACalRegn02Rt02GroupA_Dummy.CalibrationPorts.AssiMotTqWhlImbRejctnMaxX.Ary2D /end CHARACTERISTIC
/begin CHARACTERISTIC AAACalRegn02Rt02GroupA_Dummy.AssiMotTqWhlImbRejctnMaxY.Ary2D "MICROSAR RTE" VAL_BLK 0x0 RTE_RL_SWORD 0 NO_COMPU_METHOD -32768 32767 MATRIX_DIM 20 12 1 SYMBOL_LINK "Rte_CalprmRom_CalRegn02Rt02GroupA_DEFAULT_RTE_CALPRM_GROUP.AssiMotTqWhlImbRejctnMaxY_Ary2D" 0 DISPLAY_IDENTIFIER AAACalRegn02Rt02GroupA_Dummy.CalibrationPorts.AssiMotTqWhlImbRejctnMaxY.Ary2D /end CHARACTERISTIC
/begin CHARACTERISTIC AAACalRegn02Rt02GroupA_Dummy.AssiMotTqWhlImbRejctnMinX.Ary2D "MICROSAR RTE" VAL_BLK 0x0 RTE_RL_UWORD 0 NO_COMPU_METHOD 0 65535 MATRIX_DIM 20 12 1 SYMBOL_LINK "Rte_CalprmRom_CalRegn02Rt02GroupA_DEFAULT_RTE_CALPRM_GROUP.AssiMotTqWhlImbRejctnMinX_Ary2D" 0 DISPLAY_IDENTIFIER AAACalRegn02Rt02GroupA_Dummy.CalibrationPorts.AssiMotTqWhlImbRejctnMinX.Ary2D /end CHARACTERISTIC
/begin CHARACTERISTIC AAACalRegn02Rt02GroupA_Dummy.AssiMotTqWhlImbRejctnMinY.Ary2D "MICROSAR RTE" VAL_BLK 0x0 RTE_RL_SWORD 0 NO_COMPU_METHOD -32768 32767 MATRIX_DIM 20 12 1 SYMBOL_LINK "Rte_CalprmRom_CalRegn02Rt02GroupA_DEFAULT_RTE_CALPRM_GROUP.AssiMotTqWhlImbRejctnMinY_Ary2D" 0 DISPLAY_IDENTIFIER AAACalRegn02Rt02GroupA_Dummy.CalibrationPorts.AssiMotTqWhlImbRejctnMinY.Ary2D /end CHARACTERISTIC
/begin CHARACTERISTIC AAACalRegn02Rt02GroupA_Dummy.AssiWhlImbRejctnBlndScaX.Ary2D "MICROSAR RTE" VAL_BLK 0x0 RTE_RL_UWORD 0 NO_COMPU_METHOD 0 65535 MATRIX_DIM 5 12 1 SYMBOL_LINK "Rte_CalprmRom_CalRegn02Rt02GroupA_DEFAULT_RTE_CALPRM_GROUP.AssiWhlImbRejctnBlndScaX_Ary2D" 0 DISPLAY_IDENTIFIER AAACalRegn02Rt02GroupA_Dummy.CalibrationPorts.AssiWhlImbRejctnBlndScaX.Ary2D /end CHARACTERISTIC
/begin CHARACTERISTIC AAACalRegn02Rt02GroupA_Dummy.AssiWhlImbRejctnBlndScaY.Ary2D "MICROSAR RTE" VAL_BLK 0x0 RTE_RL_UWORD 0 NO_COMPU_METHOD 0 65535 MATRIX_DIM 5 12 1 SYMBOL_LINK "Rte_CalprmRom_CalRegn02Rt02GroupA_DEFAULT_RTE_CALPRM_GROUP.AssiWhlImbRejctnBlndScaY_Ary2D" 0 DISPLAY_IDENTIFIER AAACalRegn02Rt02GroupA_Dummy.CalibrationPorts.AssiWhlImbRejctnBlndScaY.Ary2D /end CHARACTERISTIC
/begin CHARACTERISTIC AAACalRegn02Rt02GroupA_Dummy.DampgHwTqX.Ary1D "MICROSAR RTE" VAL_BLK 0x0 RTE_RL_UWORD 0 NO_COMPU_METHOD 0 65535 MATRIX_DIM 2 1 1 SYMBOL_LINK "Rte_CalprmRom_CalRegn02Rt02GroupA_DEFAULT_RTE_CALPRM_GROUP.DampgHwTqX_Ary1D" 0 DISPLAY_IDENTIFIER AAACalRegn02Rt02GroupA_Dummy.CalibrationPorts.DampgHwTqX.Ary1D /end CHARACTERISTIC
/begin CHARACTERISTIC AAACalRegn02Rt02GroupA_Dummy.DampgHwTqY.Ary1D "MICROSAR RTE" VAL_BLK 0x0 RTE_RL_UWORD 0 NO_COMPU_METHOD 0 65535 MATRIX_DIM 2 1 1 SYMBOL_LINK "Rte_CalprmRom_CalRegn02Rt02GroupA_DEFAULT_RTE_CALPRM_GROUP.DampgHwTqY_Ary1D" 0 DISPLAY_IDENTIFIER AAACalRegn02Rt02GroupA_Dummy.CalibrationPorts.DampgHwTqY.Ary1D /end CHARACTERISTIC
/begin CHARACTERISTIC AAACalRegn02Rt02GroupA_Dummy.DampgHydCoeff1ScaY.Ary1D "MICROSAR RTE" VAL_BLK 0x0 RTE_RL_UWORD 0 NO_COMPU_METHOD 0 65535 MATRIX_DIM 12 1 1 SYMBOL_LINK "Rte_CalprmRom_CalRegn02Rt02GroupA_DEFAULT_RTE_CALPRM_GROUP.DampgHydCoeff1ScaY_Ary1D" 0 DISPLAY_IDENTIFIER AAACalRegn02Rt02GroupA_Dummy.CalibrationPorts.DampgHydCoeff1ScaY.Ary1D /end CHARACTERISTIC
/begin CHARACTERISTIC AAACalRegn02Rt02GroupA_Dummy.DampgHydCoeff2ScaY.Ary1D "MICROSAR RTE" VAL_BLK 0x0 RTE_RL_UWORD 0 NO_COMPU_METHOD 0 65535 MATRIX_DIM 12 1 1 SYMBOL_LINK "Rte_CalprmRom_CalRegn02Rt02GroupA_DEFAULT_RTE_CALPRM_GROUP.DampgHydCoeff2ScaY_Ary1D" 0 DISPLAY_IDENTIFIER AAACalRegn02Rt02GroupA_Dummy.CalibrationPorts.DampgHydCoeff2ScaY.Ary1D /end CHARACTERISTIC
/begin CHARACTERISTIC AAACalRegn02Rt02GroupA_Dummy.DampgHydCoeff3ScaY.Ary1D "MICROSAR RTE" VAL_BLK 0x0 RTE_RL_UWORD 0 NO_COMPU_METHOD 0 65535 MATRIX_DIM 12 1 1 SYMBOL_LINK "Rte_CalprmRom_CalRegn02Rt02GroupA_DEFAULT_RTE_CALPRM_GROUP.DampgHydCoeff3ScaY_Ary1D" 0 DISPLAY_IDENTIFIER AAACalRegn02Rt02GroupA_Dummy.CalibrationPorts.DampgHydCoeff3ScaY.Ary1D /end CHARACTERISTIC
/begin CHARACTERISTIC AAACalRegn02Rt02GroupA_Dummy.DampgHydCoeff4ScaY.Ary1D "MICROSAR RTE" VAL_BLK 0x0 RTE_RL_UWORD 0 NO_COMPU_METHOD 0 65535 MATRIX_DIM 12 1 1 SYMBOL_LINK "Rte_CalprmRom_CalRegn02Rt02GroupA_DEFAULT_RTE_CALPRM_GROUP.DampgHydCoeff4ScaY_Ary1D" 0 DISPLAY_IDENTIFIER AAACalRegn02Rt02GroupA_Dummy.CalibrationPorts.DampgHydCoeff4ScaY.Ary1D /end CHARACTERISTIC
/begin CHARACTERISTIC AAACalRegn02Rt02GroupA_Dummy.DampgMotVelX.Ary2D "MICROSAR RTE" VAL_BLK 0x0 RTE_RL_UWORD 0 NO_COMPU_METHOD 0 65535 MATRIX_DIM 13 12 1 SYMBOL_LINK "Rte_CalprmRom_CalRegn02Rt02GroupA_DEFAULT_RTE_CALPRM_GROUP.DampgMotVelX_Ary2D" 0 DISPLAY_IDENTIFIER AAACalRegn02Rt02GroupA_Dummy.CalibrationPorts.DampgMotVelX.Ary2D /end CHARACTERISTIC
/begin CHARACTERISTIC AAACalRegn02Rt02GroupA_Dummy.DampgMotVelY.Ary2D "MICROSAR RTE" VAL_BLK 0x0 RTE_RL_UWORD 0 NO_COMPU_METHOD 0 65535 MATRIX_DIM 13 12 1 SYMBOL_LINK "Rte_CalprmRom_CalRegn02Rt02GroupA_DEFAULT_RTE_CALPRM_GROUP.DampgMotVelY_Ary2D" 0 DISPLAY_IDENTIFIER AAACalRegn02Rt02GroupA_Dummy.CalibrationPorts.DampgMotVelY.Ary2D /end CHARACTERISTIC
/begin CHARACTERISTIC AAACalRegn02Rt02GroupA_Dummy.HysCmpEffLossY.Ary1D "MICROSAR RTE" VAL_BLK 0x0 RTE_RL_UWORD 0 NO_COMPU_METHOD 0 65535 MATRIX_DIM 12 1 1 SYMBOL_LINK "Rte_CalprmRom_CalRegn02Rt02GroupA_DEFAULT_RTE_CALPRM_GROUP.HysCmpEffLossY_Ary1D" 0 DISPLAY_IDENTIFIER AAACalRegn02Rt02GroupA_Dummy.CalibrationPorts.HysCmpEffLossY.Ary1D /end CHARACTERISTIC
/begin CHARACTERISTIC AAACalRegn02Rt02GroupA_Dummy.HysCmpEffOffsY.Ary1D "MICROSAR RTE" VAL_BLK 0x0 RTE_RL_UWORD 0 NO_COMPU_METHOD 0 65535 MATRIX_DIM 12 1 1 SYMBOL_LINK "Rte_CalprmRom_CalRegn02Rt02GroupA_DEFAULT_RTE_CALPRM_GROUP.HysCmpEffOffsY_Ary1D" 0 DISPLAY_IDENTIFIER AAACalRegn02Rt02GroupA_Dummy.CalibrationPorts.HysCmpEffOffsY.Ary1D /end CHARACTERISTIC
/begin CHARACTERISTIC AAACalRegn02Rt02GroupA_Dummy.HysCmpFricWhlImbRejctnBlndX.Ary1D "MICROSAR RTE" VAL_BLK 0x0 RTE_RL_UWORD 0 NO_COMPU_METHOD 0 65535 MATRIX_DIM 6 1 1 SYMBOL_LINK "Rte_CalprmRom_CalRegn02Rt02GroupA_DEFAULT_RTE_CALPRM_GROUP.HysCmpFricWhlImbRejctnBlndX_Ary1D" 0 DISPLAY_IDENTIFIER AAACalRegn02Rt02GroupA_Dummy.CalibrationPorts.HysCmpFricWhlImbRejctnBlndX.Ary1D /end CHARACTERISTIC
/begin CHARACTERISTIC AAACalRegn02Rt02GroupA_Dummy.HysCmpFricWhlImbRejctnBlndY.Ary1D "MICROSAR RTE" VAL_BLK 0x0 RTE_RL_UWORD 0 NO_COMPU_METHOD 0 65535 MATRIX_DIM 6 1 1 SYMBOL_LINK "Rte_CalprmRom_CalRegn02Rt02GroupA_DEFAULT_RTE_CALPRM_GROUP.HysCmpFricWhlImbRejctnBlndY_Ary1D" 0 DISPLAY_IDENTIFIER AAACalRegn02Rt02GroupA_Dummy.CalibrationPorts.HysCmpFricWhlImbRejctnBlndY.Ary1D /end CHARACTERISTIC
/begin CHARACTERISTIC AAACalRegn02Rt02GroupA_Dummy.HysCmpFricWhlImbRejctnOffY.Ary1D "MICROSAR RTE" VAL_BLK 0x0 RTE_RL_UWORD 0 NO_COMPU_METHOD 0 65535 MATRIX_DIM 12 1 1 SYMBOL_LINK "Rte_CalprmRom_CalRegn02Rt02GroupA_DEFAULT_RTE_CALPRM_GROUP.HysCmpFricWhlImbRejctnOffY_Ary1D" 0 DISPLAY_IDENTIFIER AAACalRegn02Rt02GroupA_Dummy.CalibrationPorts.HysCmpFricWhlImbRejctnOffY.Ary1D /end CHARACTERISTIC
/begin CHARACTERISTIC AAACalRegn02Rt02GroupA_Dummy.HysCmpFricWhlImbRejctnOnY.Ary1D "MICROSAR RTE" VAL_BLK 0x0 RTE_RL_UWORD 0 NO_COMPU_METHOD 0 65535 MATRIX_DIM 12 1 1 SYMBOL_LINK "Rte_CalprmRom_CalRegn02Rt02GroupA_DEFAULT_RTE_CALPRM_GROUP.HysCmpFricWhlImbRejctnOnY_Ary1D" 0 DISPLAY_IDENTIFIER AAACalRegn02Rt02GroupA_Dummy.CalibrationPorts.HysCmpFricWhlImbRejctnOnY.Ary1D /end CHARACTERISTIC
/begin CHARACTERISTIC AAACalRegn02Rt02GroupA_Dummy.HysCmpHwTqScaX.Ary2D "MICROSAR RTE" VAL_BLK 0x0 RTE_RL_UWORD 0 NO_COMPU_METHOD 0 65535 MATRIX_DIM 8 12 1 SYMBOL_LINK "Rte_CalprmRom_CalRegn02Rt02GroupA_DEFAULT_RTE_CALPRM_GROUP.HysCmpHwTqScaX_Ary2D" 0 DISPLAY_IDENTIFIER AAACalRegn02Rt02GroupA_Dummy.CalibrationPorts.HysCmpHwTqScaX.Ary2D /end CHARACTERISTIC
/begin CHARACTERISTIC AAACalRegn02Rt02GroupA_Dummy.HysCmpHwTqScaY.Ary2D "MICROSAR RTE" VAL_BLK 0x0 RTE_RL_UWORD 0 NO_COMPU_METHOD 0 65535 MATRIX_DIM 8 12 1 SYMBOL_LINK "Rte_CalprmRom_CalRegn02Rt02GroupA_DEFAULT_RTE_CALPRM_GROUP.HysCmpHwTqScaY_Ary2D" 0 DISPLAY_IDENTIFIER AAACalRegn02Rt02GroupA_Dummy.CalibrationPorts.HysCmpHwTqScaY.Ary2D /end CHARACTERISTIC
/begin CHARACTERISTIC AAACalRegn02Rt02GroupA_Dummy.HysCmpHysSatnY.Ary1D "MICROSAR RTE" VAL_BLK 0x0 RTE_RL_UWORD 0 NO_COMPU_METHOD 0 65535 MATRIX_DIM 12 1 1 SYMBOL_LINK "Rte_CalprmRom_CalRegn02Rt02GroupA_DEFAULT_RTE_CALPRM_GROUP.HysCmpHysSatnY_Ary1D" 0 DISPLAY_IDENTIFIER AAACalRegn02Rt02GroupA_Dummy.CalibrationPorts.HysCmpHysSatnY.Ary1D /end CHARACTERISTIC
/begin CHARACTERISTIC AAACalRegn02Rt02GroupA_Dummy.HysCmpNegHysCmpScaX.Ary1D "MICROSAR RTE" VAL_BLK 0x0 RTE_RL_UWORD 0 NO_COMPU_METHOD 0 65535 MATRIX_DIM 5 1 1 SYMBOL_LINK "Rte_CalprmRom_CalRegn02Rt02GroupA_DEFAULT_RTE_CALPRM_GROUP.HysCmpNegHysCmpScaX_Ary1D" 0 DISPLAY_IDENTIFIER AAACalRegn02Rt02GroupA_Dummy.CalibrationPorts.HysCmpNegHysCmpScaX.Ary1D /end CHARACTERISTIC
/begin CHARACTERISTIC AAACalRegn02Rt02GroupA_Dummy.HysCmpNegHysCmpScaY.Ary1D "MICROSAR RTE" VAL_BLK 0x0 RTE_RL_UWORD 0 NO_COMPU_METHOD 0 65535 MATRIX_DIM 5 1 1 SYMBOL_LINK "Rte_CalprmRom_CalRegn02Rt02GroupA_DEFAULT_RTE_CALPRM_GROUP.HysCmpNegHysCmpScaY_Ary1D" 0 DISPLAY_IDENTIFIER AAACalRegn02Rt02GroupA_Dummy.CalibrationPorts.HysCmpNegHysCmpScaY.Ary1D /end CHARACTERISTIC
/begin CHARACTERISTIC AAACalRegn02Rt02GroupA_Dummy.HysCmpNegHysCmpX.Ary1D "MICROSAR RTE" VAL_BLK 0x0 RTE_RL_UWORD 0 NO_COMPU_METHOD 0 65535 MATRIX_DIM 8 1 1 SYMBOL_LINK "Rte_CalprmRom_CalRegn02Rt02GroupA_DEFAULT_RTE_CALPRM_GROUP.HysCmpNegHysCmpX_Ary1D" 0 DISPLAY_IDENTIFIER AAACalRegn02Rt02GroupA_Dummy.CalibrationPorts.HysCmpNegHysCmpX.Ary1D /end CHARACTERISTIC
/begin CHARACTERISTIC AAACalRegn02Rt02GroupA_Dummy.HysCmpNegHysCmpY.Ary1D "MICROSAR RTE" VAL_BLK 0x0 RTE_RL_UWORD 0 NO_COMPU_METHOD 0 65535 MATRIX_DIM 8 1 1 SYMBOL_LINK "Rte_CalprmRom_CalRegn02Rt02GroupA_DEFAULT_RTE_CALPRM_GROUP.HysCmpNegHysCmpY_Ary1D" 0 DISPLAY_IDENTIFIER AAACalRegn02Rt02GroupA_Dummy.CalibrationPorts.HysCmpNegHysCmpY.Ary1D /end CHARACTERISTIC
/begin CHARACTERISTIC AAACalRegn02Rt02GroupA_Dummy.HysCmpOutpLim.Val "MICROSAR RTE" VALUE 0x0 RTE_RL_FLOAT32_IEEE 0 NO_COMPU_METHOD -3.402823466e+38 3.402823466e+38 SYMBOL_LINK "Rte_CalprmRom_CalRegn02Rt02GroupA_DEFAULT_RTE_CALPRM_GROUP.HysCmpOutpLim_Val" 0 DISPLAY_IDENTIFIER AAACalRegn02Rt02GroupA_Dummy.CalibrationPorts.HysCmpOutpLim.Val /end CHARACTERISTIC
/begin CHARACTERISTIC AAACalRegn02Rt02GroupA_Dummy.HysCmpRevGain.Val "MICROSAR RTE" VALUE 0x0 RTE_RL_FLOAT32_IEEE 0 NO_COMPU_METHOD -3.402823466e+38 3.402823466e+38 SYMBOL_LINK "Rte_CalprmRom_CalRegn02Rt02GroupA_DEFAULT_RTE_CALPRM_GROUP.HysCmpRevGain_Val" 0 DISPLAY_IDENTIFIER AAACalRegn02Rt02GroupA_Dummy.CalibrationPorts.HysCmpRevGain.Val /end CHARACTERISTIC
/begin CHARACTERISTIC AAACalRegn02Rt02GroupA_Dummy.HysCmpRiseX.Ary1D "MICROSAR RTE" VAL_BLK 0x0 RTE_RL_UWORD 0 NO_COMPU_METHOD 0 65535 MATRIX_DIM 6 1 1 SYMBOL_LINK "Rte_CalprmRom_CalRegn02Rt02GroupA_DEFAULT_RTE_CALPRM_GROUP.HysCmpRiseX_Ary1D" 0 DISPLAY_IDENTIFIER AAACalRegn02Rt02GroupA_Dummy.CalibrationPorts.HysCmpRiseX.Ary1D /end CHARACTERISTIC
/begin CHARACTERISTIC AAACalRegn02Rt02GroupA_Dummy.HysCmpRiseY.Ary1D "MICROSAR RTE" VAL_BLK 0x0 RTE_RL_UWORD 0 NO_COMPU_METHOD 0 65535 MATRIX_DIM 6 1 1 SYMBOL_LINK "Rte_CalprmRom_CalRegn02Rt02GroupA_DEFAULT_RTE_CALPRM_GROUP.HysCmpRiseY_Ary1D" 0 DISPLAY_IDENTIFIER AAACalRegn02Rt02GroupA_Dummy.CalibrationPorts.HysCmpRiseY.Ary1D /end CHARACTERISTIC
/begin CHARACTERISTIC AAACalRegn02Rt02GroupA_Dummy.InertiaCmpVelAssiBasdDampgStatY.Ary1D "MICROSAR RTE" VAL_BLK 0x0 RTE_RL_UWORD 0 NO_COMPU_METHOD 0 65535 MATRIX_DIM 10 1 1 SYMBOL_LINK "Rte_CalprmRom_CalRegn02Rt02GroupA_DEFAULT_RTE_CALPRM_GROUP.InertiaCmpVelAssiBasdDampgStatY_Ary1D" 0 DISPLAY_IDENTIFIER AAACalRegn02Rt02GroupA_Dummy.CalibrationPorts.InertiaCmpVelAssiBasdDampgStatY.Ary1D /end CHARACTERISTIC
/begin CHARACTERISTIC AAACalRegn02Rt02GroupA_Dummy.InertiaCmpVelDampgFilFrq.Ary1D "MICROSAR RTE" VAL_BLK 0x0 RTE_RL_UWORD 0 NO_COMPU_METHOD 0 65535 MATRIX_DIM 12 1 1 SYMBOL_LINK "Rte_CalprmRom_CalRegn02Rt02GroupA_DEFAULT_RTE_CALPRM_GROUP.InertiaCmpVelDampgFilFrq_Ary1D" 0 DISPLAY_IDENTIFIER AAACalRegn02Rt02GroupA_Dummy.CalibrationPorts.InertiaCmpVelDampgFilFrq.Ary1D /end CHARACTERISTIC
/begin CHARACTERISTIC AAACalRegn02Rt02GroupA_Dummy.InertiaCmpVelDampgFilFrqWhlImbRejctnOn.Ary1D "MICROSAR RTE" VAL_BLK 0x0 RTE_RL_UWORD 0 NO_COMPU_METHOD 0 65535 MATRIX_DIM 12 1 1 SYMBOL_LINK "Rte_CalprmRom_CalRegn02Rt02GroupA_DEFAULT_RTE_CALPRM_GROUP.InertiaCmpVelDampgFilFrqWhlImbRejctnOn_Ary1D" 0 DISPLAY_IDENTIFIER AAACalRegn02Rt02GroupA_Dummy.CalibrationPorts.InertiaCmpVelDampgFilFrqWhlImbRejctnOn.Ary1D /end CHARACTERISTIC
/begin CHARACTERISTIC AAACalRegn02Rt02GroupA_Dummy.InertiaCmpVelDampgSpdBlndY.Ary1D "MICROSAR RTE" VAL_BLK 0x0 RTE_RL_UWORD 0 NO_COMPU_METHOD 0 65535 MATRIX_DIM 12 1 1 SYMBOL_LINK "Rte_CalprmRom_CalRegn02Rt02GroupA_DEFAULT_RTE_CALPRM_GROUP.InertiaCmpVelDampgSpdBlndY_Ary1D" 0 DISPLAY_IDENTIFIER AAACalRegn02Rt02GroupA_Dummy.CalibrationPorts.InertiaCmpVelDampgSpdBlndY.Ary1D /end CHARACTERISTIC
/begin CHARACTERISTIC AAACalRegn02Rt02GroupA_Dummy.InertiaCmpVelDampgWhlImbRejctnBlndX.Ary1D "MICROSAR RTE" VAL_BLK 0x0 RTE_RL_UWORD 0 NO_COMPU_METHOD 0 65535 MATRIX_DIM 5 1 1 SYMBOL_LINK "Rte_CalprmRom_CalRegn02Rt02GroupA_DEFAULT_RTE_CALPRM_GROUP.InertiaCmpVelDampgWhlImbRejctnBlndX_Ary1D" 0 DISPLAY_IDENTIFIER AAACalRegn02Rt02GroupA_Dummy.CalibrationPorts.InertiaCmpVelDampgWhlImbRejctnBlndX.Ary1D /end CHARACTERISTIC
/begin CHARACTERISTIC AAACalRegn02Rt02GroupA_Dummy.InertiaCmpVelDampgWhlImbRejctnBlndY.Ary1D "MICROSAR RTE" VAL_BLK 0x0 RTE_RL_UWORD 0 NO_COMPU_METHOD 0 65535 MATRIX_DIM 5 1 1 SYMBOL_LINK "Rte_CalprmRom_CalRegn02Rt02GroupA_DEFAULT_RTE_CALPRM_GROUP.InertiaCmpVelDampgWhlImbRejctnBlndY_Ary1D" 0 DISPLAY_IDENTIFIER AAACalRegn02Rt02GroupA_Dummy.CalibrationPorts.InertiaCmpVelDampgWhlImbRejctnBlndY.Ary1D /end CHARACTERISTIC
/begin CHARACTERISTIC AAACalRegn02Rt02GroupB_Dummy.EotProtnDampgVehSpdTbl.Ary1D "MICROSAR RTE" VAL_BLK 0x0 RTE_RL_UWORD 0 NO_COMPU_METHOD 0 65535 MATRIX_DIM 4 1 1 SYMBOL_LINK "Rte_CalprmRom_CalRegn02Rt02GroupB_DEFAULT_RTE_CALPRM_GROUP.EotProtnDampgVehSpdTbl_Ary1D" 0 DISPLAY_IDENTIFIER AAACalRegn02Rt02GroupB_Dummy.CalibrationPorts.EotProtnDampgVehSpdTbl.Ary1D /end CHARACTERISTIC
/begin CHARACTERISTIC AAACalRegn02Rt02GroupB_Dummy.EotProtnDeltaTqThd.Val "MICROSAR RTE" VALUE 0x0 RTE_RL_FLOAT32_IEEE 0 NO_COMPU_METHOD -3.402823466e+38 3.402823466e+38 SYMBOL_LINK "Rte_CalprmRom_CalRegn02Rt02GroupB_DEFAULT_RTE_CALPRM_GROUP.EotProtnDeltaTqThd_Val" 0 DISPLAY_IDENTIFIER AAACalRegn02Rt02GroupB_Dummy.CalibrationPorts.EotProtnDeltaTqThd.Val /end CHARACTERISTIC
/begin CHARACTERISTIC AAACalRegn02Rt02GroupB_Dummy.EotProtnEntrGainVehSpdTbl.Ary1D "MICROSAR RTE" VAL_BLK 0x0 RTE_RL_UWORD 0 NO_COMPU_METHOD 0 65535 MATRIX_DIM 5 1 1 SYMBOL_LINK "Rte_CalprmRom_CalRegn02Rt02GroupB_DEFAULT_RTE_CALPRM_GROUP.EotProtnEntrGainVehSpdTbl_Ary1D" 0 DISPLAY_IDENTIFIER AAACalRegn02Rt02GroupB_Dummy.CalibrationPorts.EotProtnEntrGainVehSpdTbl.Ary1D /end CHARACTERISTIC
/begin CHARACTERISTIC AAACalRegn02Rt02GroupB_Dummy.EotProtnEntrGainY.Ary2D "MICROSAR RTE" VAL_BLK 0x0 RTE_RL_UWORD 0 NO_COMPU_METHOD 0 65535 MATRIX_DIM 4 5 1 SYMBOL_LINK "Rte_CalprmRom_CalRegn02Rt02GroupB_DEFAULT_RTE_CALPRM_GROUP.EotProtnEntrGainY_Ary2D" 0 DISPLAY_IDENTIFIER AAACalRegn02Rt02GroupB_Dummy.CalibrationPorts.EotProtnEntrGainY.Ary2D /end CHARACTERISTIC
/begin CHARACTERISTIC AAACalRegn02Rt02GroupB_Dummy.EotProtnLoAuthyEntrGainY.Ary2D "MICROSAR RTE" VAL_BLK 0x0 RTE_RL_UWORD 0 NO_COMPU_METHOD 0 65535 MATRIX_DIM 4 5 1 SYMBOL_LINK "Rte_CalprmRom_CalRegn02Rt02GroupB_DEFAULT_RTE_CALPRM_GROUP.EotProtnLoAuthyEntrGainY_Ary2D" 0 DISPLAY_IDENTIFIER AAACalRegn02Rt02GroupB_Dummy.CalibrationPorts.EotProtnLoAuthyEntrGainY.Ary2D /end CHARACTERISTIC
/begin CHARACTERISTIC AAACalRegn02Rt02GroupB_Dummy.EotProtnMotSpdIncptY.Ary1D "MICROSAR RTE" VAL_BLK 0x0 RTE_RL_UWORD 0 NO_COMPU_METHOD 0 65535 MATRIX_DIM 2 1 1 SYMBOL_LINK "Rte_CalprmRom_CalRegn02Rt02GroupB_DEFAULT_RTE_CALPRM_GROUP.EotProtnMotSpdIncptY_Ary1D" 0 DISPLAY_IDENTIFIER AAACalRegn02Rt02GroupB_Dummy.CalibrationPorts.EotProtnMotSpdIncptY.Ary1D /end CHARACTERISTIC
/begin CHARACTERISTIC AAACalRegn02Rt02GroupB_Dummy.EotProtnNormDampgY.Ary2D "MICROSAR RTE" VAL_BLK 0x0 RTE_RL_UWORD 0 NO_COMPU_METHOD 0 65535 MATRIX_DIM 2 4 1 SYMBOL_LINK "Rte_CalprmRom_CalRegn02Rt02GroupB_DEFAULT_RTE_CALPRM_GROUP.EotProtnNormDampgY_Ary2D" 0 DISPLAY_IDENTIFIER AAACalRegn02Rt02GroupB_Dummy.CalibrationPorts.EotProtnNormDampgY.Ary2D /end CHARACTERISTIC
/begin CHARACTERISTIC AAACalRegn02Rt02GroupB_Dummy.EotProtnSoftEndStopAuthyThd.Val "MICROSAR RTE" VALUE 0x0 RTE_RL_FLOAT32_IEEE 0 NO_COMPU_METHOD -3.402823466e+38 3.402823466e+38 SYMBOL_LINK "Rte_CalprmRom_CalRegn02Rt02GroupB_DEFAULT_RTE_CALPRM_GROUP.EotProtnSoftEndStopAuthyThd_Val" 0 DISPLAY_IDENTIFIER AAACalRegn02Rt02GroupB_Dummy.CalibrationPorts.EotProtnSoftEndStopAuthyThd.Val /end CHARACTERISTIC
/begin CHARACTERISTIC AAACalRegn02Rt02GroupB_Dummy.RtnHwAgOffsCalcdX.Ary2D "MICROSAR RTE" VAL_BLK 0x0 RTE_RL_UWORD 0 NO_COMPU_METHOD 0 65535 MATRIX_DIM 16 9 1 SYMBOL_LINK "Rte_CalprmRom_CalRegn02Rt02GroupB_DEFAULT_RTE_CALPRM_GROUP.RtnHwAgOffsCalcdX_Ary2D" 0 DISPLAY_IDENTIFIER AAACalRegn02Rt02GroupB_Dummy.CalibrationPorts.RtnHwAgOffsCalcdX.Ary2D /end CHARACTERISTIC
/begin CHARACTERISTIC AAACalRegn02Rt02GroupB_Dummy.RtnHwAgOffsCalcdY.Ary2D "MICROSAR RTE" VAL_BLK 0x0 RTE_RL_UWORD 0 NO_COMPU_METHOD 0 65535 MATRIX_DIM 16 9 1 SYMBOL_LINK "Rte_CalprmRom_CalRegn02Rt02GroupB_DEFAULT_RTE_CALPRM_GROUP.RtnHwAgOffsCalcdY_Ary2D" 0 DISPLAY_IDENTIFIER AAACalRegn02Rt02GroupB_Dummy.CalibrationPorts.RtnHwAgOffsCalcdY.Ary2D /end CHARACTERISTIC
/begin CHARACTERISTIC AAACalRegn02Rt02GroupB_Dummy.RtnScaTqX.Ary2D "MICROSAR RTE" VAL_BLK 0x0 RTE_RL_UWORD 0 NO_COMPU_METHOD 0 65535 MATRIX_DIM 8 9 1 SYMBOL_LINK "Rte_CalprmRom_CalRegn02Rt02GroupB_DEFAULT_RTE_CALPRM_GROUP.RtnScaTqX_Ary2D" 0 DISPLAY_IDENTIFIER AAACalRegn02Rt02GroupB_Dummy.CalibrationPorts.RtnScaTqX.Ary2D /end CHARACTERISTIC
/begin CHARACTERISTIC AAACalRegn02Rt02GroupB_Dummy.RtnScaTqY.Ary2D "MICROSAR RTE" VAL_BLK 0x0 RTE_RL_UWORD 0 NO_COMPU_METHOD 0 65535 MATRIX_DIM 8 9 1 SYMBOL_LINK "Rte_CalprmRom_CalRegn02Rt02GroupB_DEFAULT_RTE_CALPRM_GROUP.RtnScaTqY_Ary2D" 0 DISPLAY_IDENTIFIER AAACalRegn02Rt02GroupB_Dummy.CalibrationPorts.RtnScaTqY.Ary2D /end CHARACTERISTIC
/begin CHARACTERISTIC AAACalRegn02Rt02GroupB_Dummy.RtnScaVelX.Ary2D "MICROSAR RTE" VAL_BLK 0x0 RTE_RL_UWORD 0 NO_COMPU_METHOD 0 65535 MATRIX_DIM 4 9 1 SYMBOL_LINK "Rte_CalprmRom_CalRegn02Rt02GroupB_DEFAULT_RTE_CALPRM_GROUP.RtnScaVelX_Ary2D" 0 DISPLAY_IDENTIFIER AAACalRegn02Rt02GroupB_Dummy.CalibrationPorts.RtnScaVelX.Ary2D /end CHARACTERISTIC
/begin CHARACTERISTIC AAACalRegn02Rt02GroupB_Dummy.RtnScaVelY.Ary2D "MICROSAR RTE" VAL_BLK 0x0 RTE_RL_UWORD 0 NO_COMPU_METHOD 0 65535 MATRIX_DIM 4 9 1 SYMBOL_LINK "Rte_CalprmRom_CalRegn02Rt02GroupB_DEFAULT_RTE_CALPRM_GROUP.RtnScaVelY_Ary2D" 0 DISPLAY_IDENTIFIER AAACalRegn02Rt02GroupB_Dummy.CalibrationPorts.RtnScaVelY.Ary2D /end CHARACTERISTIC
/begin CHARACTERISTIC AAACalRegn02Rt02GroupB_Dummy.RtnVehSpdSeln.Ary1D "MICROSAR RTE" VAL_BLK 0x0 RTE_RL_UWORD 0 NO_COMPU_METHOD 0 65535 MATRIX_DIM 9 1 1 SYMBOL_LINK "Rte_CalprmRom_CalRegn02Rt02GroupB_DEFAULT_RTE_CALPRM_GROUP.RtnVehSpdSeln_Ary1D" 0 DISPLAY_IDENTIFIER AAACalRegn02Rt02GroupB_Dummy.CalibrationPorts.RtnVehSpdSeln.Ary1D /end CHARACTERISTIC
/begin CHARACTERISTIC AAACalRegn02Rt03GroupA_Dummy.AssiHiFrqGainY.Ary2D "MICROSAR RTE" VAL_BLK 0x0 RTE_RL_UWORD 0 NO_COMPU_METHOD 0 65535 MATRIX_DIM 13 12 1 SYMBOL_LINK "Rte_CalprmRom_CalRegn02Rt03GroupA_DEFAULT_RTE_CALPRM_GROUP.AssiHiFrqGainY_Ary2D" 0 DISPLAY_IDENTIFIER AAACalRegn02Rt03GroupA_Dummy.CalibrationPorts.AssiHiFrqGainY.Ary2D /end CHARACTERISTIC
/begin CHARACTERISTIC AAACalRegn02Rt03GroupA_Dummy.AssiHiFrqHpFilFrqY.Ary1D "MICROSAR RTE" VAL_BLK 0x0 RTE_RL_UWORD 0 NO_COMPU_METHOD 0 65535 MATRIX_DIM 12 1 1 SYMBOL_LINK "Rte_CalprmRom_CalRegn02Rt03GroupA_DEFAULT_RTE_CALPRM_GROUP.AssiHiFrqHpFilFrqY_Ary1D" 0 DISPLAY_IDENTIFIER AAACalRegn02Rt03GroupA_Dummy.CalibrationPorts.AssiHiFrqHpFilFrqY.Ary1D /end CHARACTERISTIC
/begin CHARACTERISTIC AAACalRegn02Rt03GroupA_Dummy.AssiHiFrqTqWhlImbRejctnTqX.Ary2D "MICROSAR RTE" VAL_BLK 0x0 RTE_RL_UWORD 0 NO_COMPU_METHOD 0 65535 MATRIX_DIM 13 12 1 SYMBOL_LINK "Rte_CalprmRom_CalRegn02Rt03GroupA_DEFAULT_RTE_CALPRM_GROUP.AssiHiFrqTqWhlImbRejctnTqX_Ary2D" 0 DISPLAY_IDENTIFIER AAACalRegn02Rt03GroupA_Dummy.CalibrationPorts.AssiHiFrqTqWhlImbRejctnTqX.Ary2D /end CHARACTERISTIC
/begin CHARACTERISTIC AAACalRegn02Rt03GroupA_Dummy.AssiHiFrqTqX.Ary2D "MICROSAR RTE" VAL_BLK 0x0 RTE_RL_UWORD 0 NO_COMPU_METHOD 0 65535 MATRIX_DIM 13 12 1 SYMBOL_LINK "Rte_CalprmRom_CalRegn02Rt03GroupA_DEFAULT_RTE_CALPRM_GROUP.AssiHiFrqTqX_Ary2D" 0 DISPLAY_IDENTIFIER AAACalRegn02Rt03GroupA_Dummy.CalibrationPorts.AssiHiFrqTqX.Ary2D /end CHARACTERISTIC
/begin CHARACTERISTIC AAACalRegn02Rt03GroupA_Dummy.AssiHiFrqWhlImbRejctnBlndX.Ary2D "MICROSAR RTE" VAL_BLK 0x0 RTE_RL_UWORD 0 NO_COMPU_METHOD 0 65535 MATRIX_DIM 5 12 1 SYMBOL_LINK "Rte_CalprmRom_CalRegn02Rt03GroupA_DEFAULT_RTE_CALPRM_GROUP.AssiHiFrqWhlImbRejctnBlndX_Ary2D" 0 DISPLAY_IDENTIFIER AAACalRegn02Rt03GroupA_Dummy.CalibrationPorts.AssiHiFrqWhlImbRejctnBlndX.Ary2D /end CHARACTERISTIC
/begin CHARACTERISTIC AAACalRegn02Rt03GroupA_Dummy.AssiHiFrqWhlImbRejctnBlndY.Ary2D "MICROSAR RTE" VAL_BLK 0x0 RTE_RL_UWORD 0 NO_COMPU_METHOD 0 65535 MATRIX_DIM 5 12 1 SYMBOL_LINK "Rte_CalprmRom_CalRegn02Rt03GroupA_DEFAULT_RTE_CALPRM_GROUP.AssiHiFrqWhlImbRejctnBlndY_Ary2D" 0 DISPLAY_IDENTIFIER AAACalRegn02Rt03GroupA_Dummy.CalibrationPorts.AssiHiFrqWhlImbRejctnBlndY.Ary2D /end CHARACTERISTIC
/begin CHARACTERISTIC AAACalRegn02Rt03GroupA_Dummy.AssiHiFrqWhlImbRejctnGainY.Ary2D "MICROSAR RTE" VAL_BLK 0x0 RTE_RL_UWORD 0 NO_COMPU_METHOD 0 65535 MATRIX_DIM 13 12 1 SYMBOL_LINK "Rte_CalprmRom_CalRegn02Rt03GroupA_DEFAULT_RTE_CALPRM_GROUP.AssiHiFrqWhlImbRejctnGainY_Ary2D" 0 DISPLAY_IDENTIFIER AAACalRegn02Rt03GroupA_Dummy.CalibrationPorts.AssiHiFrqWhlImbRejctnGainY.Ary2D /end CHARACTERISTIC
/begin CHARACTERISTIC AAACalRegn02Rt03GroupA_Dummy.AssiMotTqWhlImbRejctnMaxX.Ary2D "MICROSAR RTE" VAL_BLK 0x0 RTE_RL_UWORD 0 NO_COMPU_METHOD 0 65535 MATRIX_DIM 20 12 1 SYMBOL_LINK "Rte_CalprmRom_CalRegn02Rt03GroupA_DEFAULT_RTE_CALPRM_GROUP.AssiMotTqWhlImbRejctnMaxX_Ary2D" 0 DISPLAY_IDENTIFIER AAACalRegn02Rt03GroupA_Dummy.CalibrationPorts.AssiMotTqWhlImbRejctnMaxX.Ary2D /end CHARACTERISTIC
/begin CHARACTERISTIC AAACalRegn02Rt03GroupA_Dummy.AssiMotTqWhlImbRejctnMaxY.Ary2D "MICROSAR RTE" VAL_BLK 0x0 RTE_RL_SWORD 0 NO_COMPU_METHOD -32768 32767 MATRIX_DIM 20 12 1 SYMBOL_LINK "Rte_CalprmRom_CalRegn02Rt03GroupA_DEFAULT_RTE_CALPRM_GROUP.AssiMotTqWhlImbRejctnMaxY_Ary2D" 0 DISPLAY_IDENTIFIER AAACalRegn02Rt03GroupA_Dummy.CalibrationPorts.AssiMotTqWhlImbRejctnMaxY.Ary2D /end CHARACTERISTIC
/begin CHARACTERISTIC AAACalRegn02Rt03GroupA_Dummy.AssiMotTqWhlImbRejctnMinX.Ary2D "MICROSAR RTE" VAL_BLK 0x0 RTE_RL_UWORD 0 NO_COMPU_METHOD 0 65535 MATRIX_DIM 20 12 1 SYMBOL_LINK "Rte_CalprmRom_CalRegn02Rt03GroupA_DEFAULT_RTE_CALPRM_GROUP.AssiMotTqWhlImbRejctnMinX_Ary2D" 0 DISPLAY_IDENTIFIER AAACalRegn02Rt03GroupA_Dummy.CalibrationPorts.AssiMotTqWhlImbRejctnMinX.Ary2D /end CHARACTERISTIC
/begin CHARACTERISTIC AAACalRegn02Rt03GroupA_Dummy.AssiMotTqWhlImbRejctnMinY.Ary2D "MICROSAR RTE" VAL_BLK 0x0 RTE_RL_SWORD 0 NO_COMPU_METHOD -32768 32767 MATRIX_DIM 20 12 1 SYMBOL_LINK "Rte_CalprmRom_CalRegn02Rt03GroupA_DEFAULT_RTE_CALPRM_GROUP.AssiMotTqWhlImbRejctnMinY_Ary2D" 0 DISPLAY_IDENTIFIER AAACalRegn02Rt03GroupA_Dummy.CalibrationPorts.AssiMotTqWhlImbRejctnMinY.Ary2D /end CHARACTERISTIC
/begin CHARACTERISTIC AAACalRegn02Rt03GroupA_Dummy.AssiWhlImbRejctnBlndScaX.Ary2D "MICROSAR RTE" VAL_BLK 0x0 RTE_RL_UWORD 0 NO_COMPU_METHOD 0 65535 MATRIX_DIM 5 12 1 SYMBOL_LINK "Rte_CalprmRom_CalRegn02Rt03GroupA_DEFAULT_RTE_CALPRM_GROUP.AssiWhlImbRejctnBlndScaX_Ary2D" 0 DISPLAY_IDENTIFIER AAACalRegn02Rt03GroupA_Dummy.CalibrationPorts.AssiWhlImbRejctnBlndScaX.Ary2D /end CHARACTERISTIC
/begin CHARACTERISTIC AAACalRegn02Rt03GroupA_Dummy.AssiWhlImbRejctnBlndScaY.Ary2D "MICROSAR RTE" VAL_BLK 0x0 RTE_RL_UWORD 0 NO_COMPU_METHOD 0 65535 MATRIX_DIM 5 12 1 SYMBOL_LINK "Rte_CalprmRom_CalRegn02Rt03GroupA_DEFAULT_RTE_CALPRM_GROUP.AssiWhlImbRejctnBlndScaY_Ary2D" 0 DISPLAY_IDENTIFIER AAACalRegn02Rt03GroupA_Dummy.CalibrationPorts.AssiWhlImbRejctnBlndScaY.Ary2D /end CHARACTERISTIC
/begin CHARACTERISTIC AAACalRegn02Rt03GroupA_Dummy.DampgHwTqX.Ary1D "MICROSAR RTE" VAL_BLK 0x0 RTE_RL_UWORD 0 NO_COMPU_METHOD 0 65535 MATRIX_DIM 2 1 1 SYMBOL_LINK "Rte_CalprmRom_CalRegn02Rt03GroupA_DEFAULT_RTE_CALPRM_GROUP.DampgHwTqX_Ary1D" 0 DISPLAY_IDENTIFIER AAACalRegn02Rt03GroupA_Dummy.CalibrationPorts.DampgHwTqX.Ary1D /end CHARACTERISTIC
/begin CHARACTERISTIC AAACalRegn02Rt03GroupA_Dummy.DampgHwTqY.Ary1D "MICROSAR RTE" VAL_BLK 0x0 RTE_RL_UWORD 0 NO_COMPU_METHOD 0 65535 MATRIX_DIM 2 1 1 SYMBOL_LINK "Rte_CalprmRom_CalRegn02Rt03GroupA_DEFAULT_RTE_CALPRM_GROUP.DampgHwTqY_Ary1D" 0 DISPLAY_IDENTIFIER AAACalRegn02Rt03GroupA_Dummy.CalibrationPorts.DampgHwTqY.Ary1D /end CHARACTERISTIC
/begin CHARACTERISTIC AAACalRegn02Rt03GroupA_Dummy.DampgHydCoeff1ScaY.Ary1D "MICROSAR RTE" VAL_BLK 0x0 RTE_RL_UWORD 0 NO_COMPU_METHOD 0 65535 MATRIX_DIM 12 1 1 SYMBOL_LINK "Rte_CalprmRom_CalRegn02Rt03GroupA_DEFAULT_RTE_CALPRM_GROUP.DampgHydCoeff1ScaY_Ary1D" 0 DISPLAY_IDENTIFIER AAACalRegn02Rt03GroupA_Dummy.CalibrationPorts.DampgHydCoeff1ScaY.Ary1D /end CHARACTERISTIC
/begin CHARACTERISTIC AAACalRegn02Rt03GroupA_Dummy.DampgHydCoeff2ScaY.Ary1D "MICROSAR RTE" VAL_BLK 0x0 RTE_RL_UWORD 0 NO_COMPU_METHOD 0 65535 MATRIX_DIM 12 1 1 SYMBOL_LINK "Rte_CalprmRom_CalRegn02Rt03GroupA_DEFAULT_RTE_CALPRM_GROUP.DampgHydCoeff2ScaY_Ary1D" 0 DISPLAY_IDENTIFIER AAACalRegn02Rt03GroupA_Dummy.CalibrationPorts.DampgHydCoeff2ScaY.Ary1D /end CHARACTERISTIC
/begin CHARACTERISTIC AAACalRegn02Rt03GroupA_Dummy.DampgHydCoeff3ScaY.Ary1D "MICROSAR RTE" VAL_BLK 0x0 RTE_RL_UWORD 0 NO_COMPU_METHOD 0 65535 MATRIX_DIM 12 1 1 SYMBOL_LINK "Rte_CalprmRom_CalRegn02Rt03GroupA_DEFAULT_RTE_CALPRM_GROUP.DampgHydCoeff3ScaY_Ary1D" 0 DISPLAY_IDENTIFIER AAACalRegn02Rt03GroupA_Dummy.CalibrationPorts.DampgHydCoeff3ScaY.Ary1D /end CHARACTERISTIC
/begin CHARACTERISTIC AAACalRegn02Rt03GroupA_Dummy.DampgHydCoeff4ScaY.Ary1D "MICROSAR RTE" VAL_BLK 0x0 RTE_RL_UWORD 0 NO_COMPU_METHOD 0 65535 MATRIX_DIM 12 1 1 SYMBOL_LINK "Rte_CalprmRom_CalRegn02Rt03GroupA_DEFAULT_RTE_CALPRM_GROUP.DampgHydCoeff4ScaY_Ary1D" 0 DISPLAY_IDENTIFIER AAACalRegn02Rt03GroupA_Dummy.CalibrationPorts.DampgHydCoeff4ScaY.Ary1D /end CHARACTERISTIC
/begin CHARACTERISTIC AAACalRegn02Rt03GroupA_Dummy.DampgMotVelX.Ary2D "MICROSAR RTE" VAL_BLK 0x0 RTE_RL_UWORD 0 NO_COMPU_METHOD 0 65535 MATRIX_DIM 13 12 1 SYMBOL_LINK "Rte_CalprmRom_CalRegn02Rt03GroupA_DEFAULT_RTE_CALPRM_GROUP.DampgMotVelX_Ary2D" 0 DISPLAY_IDENTIFIER AAACalRegn02Rt03GroupA_Dummy.CalibrationPorts.DampgMotVelX.Ary2D /end CHARACTERISTIC
/begin CHARACTERISTIC AAACalRegn02Rt03GroupA_Dummy.DampgMotVelY.Ary2D "MICROSAR RTE" VAL_BLK 0x0 RTE_RL_UWORD 0 NO_COMPU_METHOD 0 65535 MATRIX_DIM 13 12 1 SYMBOL_LINK "Rte_CalprmRom_CalRegn02Rt03GroupA_DEFAULT_RTE_CALPRM_GROUP.DampgMotVelY_Ary2D" 0 DISPLAY_IDENTIFIER AAACalRegn02Rt03GroupA_Dummy.CalibrationPorts.DampgMotVelY.Ary2D /end CHARACTERISTIC
/begin CHARACTERISTIC AAACalRegn02Rt03GroupA_Dummy.HysCmpEffLossY.Ary1D "MICROSAR RTE" VAL_BLK 0x0 RTE_RL_UWORD 0 NO_COMPU_METHOD 0 65535 MATRIX_DIM 12 1 1 SYMBOL_LINK "Rte_CalprmRom_CalRegn02Rt03GroupA_DEFAULT_RTE_CALPRM_GROUP.HysCmpEffLossY_Ary1D" 0 DISPLAY_IDENTIFIER AAACalRegn02Rt03GroupA_Dummy.CalibrationPorts.HysCmpEffLossY.Ary1D /end CHARACTERISTIC
/begin CHARACTERISTIC AAACalRegn02Rt03GroupA_Dummy.HysCmpEffOffsY.Ary1D "MICROSAR RTE" VAL_BLK 0x0 RTE_RL_UWORD 0 NO_COMPU_METHOD 0 65535 MATRIX_DIM 12 1 1 SYMBOL_LINK "Rte_CalprmRom_CalRegn02Rt03GroupA_DEFAULT_RTE_CALPRM_GROUP.HysCmpEffOffsY_Ary1D" 0 DISPLAY_IDENTIFIER AAACalRegn02Rt03GroupA_Dummy.CalibrationPorts.HysCmpEffOffsY.Ary1D /end CHARACTERISTIC
/begin CHARACTERISTIC AAACalRegn02Rt03GroupA_Dummy.HysCmpFricWhlImbRejctnBlndX.Ary1D "MICROSAR RTE" VAL_BLK 0x0 RTE_RL_UWORD 0 NO_COMPU_METHOD 0 65535 MATRIX_DIM 6 1 1 SYMBOL_LINK "Rte_CalprmRom_CalRegn02Rt03GroupA_DEFAULT_RTE_CALPRM_GROUP.HysCmpFricWhlImbRejctnBlndX_Ary1D" 0 DISPLAY_IDENTIFIER AAACalRegn02Rt03GroupA_Dummy.CalibrationPorts.HysCmpFricWhlImbRejctnBlndX.Ary1D /end CHARACTERISTIC
/begin CHARACTERISTIC AAACalRegn02Rt03GroupA_Dummy.HysCmpFricWhlImbRejctnBlndY.Ary1D "MICROSAR RTE" VAL_BLK 0x0 RTE_RL_UWORD 0 NO_COMPU_METHOD 0 65535 MATRIX_DIM 6 1 1 SYMBOL_LINK "Rte_CalprmRom_CalRegn02Rt03GroupA_DEFAULT_RTE_CALPRM_GROUP.HysCmpFricWhlImbRejctnBlndY_Ary1D" 0 DISPLAY_IDENTIFIER AAACalRegn02Rt03GroupA_Dummy.CalibrationPorts.HysCmpFricWhlImbRejctnBlndY.Ary1D /end CHARACTERISTIC
/begin CHARACTERISTIC AAACalRegn02Rt03GroupA_Dummy.HysCmpFricWhlImbRejctnOffY.Ary1D "MICROSAR RTE" VAL_BLK 0x0 RTE_RL_UWORD 0 NO_COMPU_METHOD 0 65535 MATRIX_DIM 12 1 1 SYMBOL_LINK "Rte_CalprmRom_CalRegn02Rt03GroupA_DEFAULT_RTE_CALPRM_GROUP.HysCmpFricWhlImbRejctnOffY_Ary1D" 0 DISPLAY_IDENTIFIER AAACalRegn02Rt03GroupA_Dummy.CalibrationPorts.HysCmpFricWhlImbRejctnOffY.Ary1D /end CHARACTERISTIC
/begin CHARACTERISTIC AAACalRegn02Rt03GroupA_Dummy.HysCmpFricWhlImbRejctnOnY.Ary1D "MICROSAR RTE" VAL_BLK 0x0 RTE_RL_UWORD 0 NO_COMPU_METHOD 0 65535 MATRIX_DIM 12 1 1 SYMBOL_LINK "Rte_CalprmRom_CalRegn02Rt03GroupA_DEFAULT_RTE_CALPRM_GROUP.HysCmpFricWhlImbRejctnOnY_Ary1D" 0 DISPLAY_IDENTIFIER AAACalRegn02Rt03GroupA_Dummy.CalibrationPorts.HysCmpFricWhlImbRejctnOnY.Ary1D /end CHARACTERISTIC
/begin CHARACTERISTIC AAACalRegn02Rt03GroupA_Dummy.HysCmpHwTqScaX.Ary2D "MICROSAR RTE" VAL_BLK 0x0 RTE_RL_UWORD 0 NO_COMPU_METHOD 0 65535 MATRIX_DIM 8 12 1 SYMBOL_LINK "Rte_CalprmRom_CalRegn02Rt03GroupA_DEFAULT_RTE_CALPRM_GROUP.HysCmpHwTqScaX_Ary2D" 0 DISPLAY_IDENTIFIER AAACalRegn02Rt03GroupA_Dummy.CalibrationPorts.HysCmpHwTqScaX.Ary2D /end CHARACTERISTIC
/begin CHARACTERISTIC AAACalRegn02Rt03GroupA_Dummy.HysCmpHwTqScaY.Ary2D "MICROSAR RTE" VAL_BLK 0x0 RTE_RL_UWORD 0 NO_COMPU_METHOD 0 65535 MATRIX_DIM 8 12 1 SYMBOL_LINK "Rte_CalprmRom_CalRegn02Rt03GroupA_DEFAULT_RTE_CALPRM_GROUP.HysCmpHwTqScaY_Ary2D" 0 DISPLAY_IDENTIFIER AAACalRegn02Rt03GroupA_Dummy.CalibrationPorts.HysCmpHwTqScaY.Ary2D /end CHARACTERISTIC
/begin CHARACTERISTIC AAACalRegn02Rt03GroupA_Dummy.HysCmpHysSatnY.Ary1D "MICROSAR RTE" VAL_BLK 0x0 RTE_RL_UWORD 0 NO_COMPU_METHOD 0 65535 MATRIX_DIM 12 1 1 SYMBOL_LINK "Rte_CalprmRom_CalRegn02Rt03GroupA_DEFAULT_RTE_CALPRM_GROUP.HysCmpHysSatnY_Ary1D" 0 DISPLAY_IDENTIFIER AAACalRegn02Rt03GroupA_Dummy.CalibrationPorts.HysCmpHysSatnY.Ary1D /end CHARACTERISTIC
/begin CHARACTERISTIC AAACalRegn02Rt03GroupA_Dummy.HysCmpNegHysCmpScaX.Ary1D "MICROSAR RTE" VAL_BLK 0x0 RTE_RL_UWORD 0 NO_COMPU_METHOD 0 65535 MATRIX_DIM 5 1 1 SYMBOL_LINK "Rte_CalprmRom_CalRegn02Rt03GroupA_DEFAULT_RTE_CALPRM_GROUP.HysCmpNegHysCmpScaX_Ary1D" 0 DISPLAY_IDENTIFIER AAACalRegn02Rt03GroupA_Dummy.CalibrationPorts.HysCmpNegHysCmpScaX.Ary1D /end CHARACTERISTIC
/begin CHARACTERISTIC AAACalRegn02Rt03GroupA_Dummy.HysCmpNegHysCmpScaY.Ary1D "MICROSAR RTE" VAL_BLK 0x0 RTE_RL_UWORD 0 NO_COMPU_METHOD 0 65535 MATRIX_DIM 5 1 1 SYMBOL_LINK "Rte_CalprmRom_CalRegn02Rt03GroupA_DEFAULT_RTE_CALPRM_GROUP.HysCmpNegHysCmpScaY_Ary1D" 0 DISPLAY_IDENTIFIER AAACalRegn02Rt03GroupA_Dummy.CalibrationPorts.HysCmpNegHysCmpScaY.Ary1D /end CHARACTERISTIC
/begin CHARACTERISTIC AAACalRegn02Rt03GroupA_Dummy.HysCmpNegHysCmpX.Ary1D "MICROSAR RTE" VAL_BLK 0x0 RTE_RL_UWORD 0 NO_COMPU_METHOD 0 65535 MATRIX_DIM 8 1 1 SYMBOL_LINK "Rte_CalprmRom_CalRegn02Rt03GroupA_DEFAULT_RTE_CALPRM_GROUP.HysCmpNegHysCmpX_Ary1D" 0 DISPLAY_IDENTIFIER AAACalRegn02Rt03GroupA_Dummy.CalibrationPorts.HysCmpNegHysCmpX.Ary1D /end CHARACTERISTIC
/begin CHARACTERISTIC AAACalRegn02Rt03GroupA_Dummy.HysCmpNegHysCmpY.Ary1D "MICROSAR RTE" VAL_BLK 0x0 RTE_RL_UWORD 0 NO_COMPU_METHOD 0 65535 MATRIX_DIM 8 1 1 SYMBOL_LINK "Rte_CalprmRom_CalRegn02Rt03GroupA_DEFAULT_RTE_CALPRM_GROUP.HysCmpNegHysCmpY_Ary1D" 0 DISPLAY_IDENTIFIER AAACalRegn02Rt03GroupA_Dummy.CalibrationPorts.HysCmpNegHysCmpY.Ary1D /end CHARACTERISTIC
/begin CHARACTERISTIC AAACalRegn02Rt03GroupA_Dummy.HysCmpOutpLim.Val "MICROSAR RTE" VALUE 0x0 RTE_RL_FLOAT32_IEEE 0 NO_COMPU_METHOD -3.402823466e+38 3.402823466e+38 SYMBOL_LINK "Rte_CalprmRom_CalRegn02Rt03GroupA_DEFAULT_RTE_CALPRM_GROUP.HysCmpOutpLim_Val" 0 DISPLAY_IDENTIFIER AAACalRegn02Rt03GroupA_Dummy.CalibrationPorts.HysCmpOutpLim.Val /end CHARACTERISTIC
/begin CHARACTERISTIC AAACalRegn02Rt03GroupA_Dummy.HysCmpRevGain.Val "MICROSAR RTE" VALUE 0x0 RTE_RL_FLOAT32_IEEE 0 NO_COMPU_METHOD -3.402823466e+38 3.402823466e+38 SYMBOL_LINK "Rte_CalprmRom_CalRegn02Rt03GroupA_DEFAULT_RTE_CALPRM_GROUP.HysCmpRevGain_Val" 0 DISPLAY_IDENTIFIER AAACalRegn02Rt03GroupA_Dummy.CalibrationPorts.HysCmpRevGain.Val /end CHARACTERISTIC
/begin CHARACTERISTIC AAACalRegn02Rt03GroupA_Dummy.HysCmpRiseX.Ary1D "MICROSAR RTE" VAL_BLK 0x0 RTE_RL_UWORD 0 NO_COMPU_METHOD 0 65535 MATRIX_DIM 6 1 1 SYMBOL_LINK "Rte_CalprmRom_CalRegn02Rt03GroupA_DEFAULT_RTE_CALPRM_GROUP.HysCmpRiseX_Ary1D" 0 DISPLAY_IDENTIFIER AAACalRegn02Rt03GroupA_Dummy.CalibrationPorts.HysCmpRiseX.Ary1D /end CHARACTERISTIC
/begin CHARACTERISTIC AAACalRegn02Rt03GroupA_Dummy.HysCmpRiseY.Ary1D "MICROSAR RTE" VAL_BLK 0x0 RTE_RL_UWORD 0 NO_COMPU_METHOD 0 65535 MATRIX_DIM 6 1 1 SYMBOL_LINK "Rte_CalprmRom_CalRegn02Rt03GroupA_DEFAULT_RTE_CALPRM_GROUP.HysCmpRiseY_Ary1D" 0 DISPLAY_IDENTIFIER AAACalRegn02Rt03GroupA_Dummy.CalibrationPorts.HysCmpRiseY.Ary1D /end CHARACTERISTIC
/begin CHARACTERISTIC AAACalRegn02Rt03GroupA_Dummy.InertiaCmpVelAssiBasdDampgStatY.Ary1D "MICROSAR RTE" VAL_BLK 0x0 RTE_RL_UWORD 0 NO_COMPU_METHOD 0 65535 MATRIX_DIM 10 1 1 SYMBOL_LINK "Rte_CalprmRom_CalRegn02Rt03GroupA_DEFAULT_RTE_CALPRM_GROUP.InertiaCmpVelAssiBasdDampgStatY_Ary1D" 0 DISPLAY_IDENTIFIER AAACalRegn02Rt03GroupA_Dummy.CalibrationPorts.InertiaCmpVelAssiBasdDampgStatY.Ary1D /end CHARACTERISTIC
/begin CHARACTERISTIC AAACalRegn02Rt03GroupA_Dummy.InertiaCmpVelDampgFilFrq.Ary1D "MICROSAR RTE" VAL_BLK 0x0 RTE_RL_UWORD 0 NO_COMPU_METHOD 0 65535 MATRIX_DIM 12 1 1 SYMBOL_LINK "Rte_CalprmRom_CalRegn02Rt03GroupA_DEFAULT_RTE_CALPRM_GROUP.InertiaCmpVelDampgFilFrq_Ary1D" 0 DISPLAY_IDENTIFIER AAACalRegn02Rt03GroupA_Dummy.CalibrationPorts.InertiaCmpVelDampgFilFrq.Ary1D /end CHARACTERISTIC
/begin CHARACTERISTIC AAACalRegn02Rt03GroupA_Dummy.InertiaCmpVelDampgFilFrqWhlImbRejctnOn.Ary1D "MICROSAR RTE" VAL_BLK 0x0 RTE_RL_UWORD 0 NO_COMPU_METHOD 0 65535 MATRIX_DIM 12 1 1 SYMBOL_LINK "Rte_CalprmRom_CalRegn02Rt03GroupA_DEFAULT_RTE_CALPRM_GROUP.InertiaCmpVelDampgFilFrqWhlImbRejctnOn_Ary1D" 0 DISPLAY_IDENTIFIER AAACalRegn02Rt03GroupA_Dummy.CalibrationPorts.InertiaCmpVelDampgFilFrqWhlImbRejctnOn.Ary1D /end CHARACTERISTIC
/begin CHARACTERISTIC AAACalRegn02Rt03GroupA_Dummy.InertiaCmpVelDampgSpdBlndY.Ary1D "MICROSAR RTE" VAL_BLK 0x0 RTE_RL_UWORD 0 NO_COMPU_METHOD 0 65535 MATRIX_DIM 12 1 1 SYMBOL_LINK "Rte_CalprmRom_CalRegn02Rt03GroupA_DEFAULT_RTE_CALPRM_GROUP.InertiaCmpVelDampgSpdBlndY_Ary1D" 0 DISPLAY_IDENTIFIER AAACalRegn02Rt03GroupA_Dummy.CalibrationPorts.InertiaCmpVelDampgSpdBlndY.Ary1D /end CHARACTERISTIC
/begin CHARACTERISTIC AAACalRegn02Rt03GroupA_Dummy.InertiaCmpVelDampgWhlImbRejctnBlndX.Ary1D "MICROSAR RTE" VAL_BLK 0x0 RTE_RL_UWORD 0 NO_COMPU_METHOD 0 65535 MATRIX_DIM 5 1 1 SYMBOL_LINK "Rte_CalprmRom_CalRegn02Rt03GroupA_DEFAULT_RTE_CALPRM_GROUP.InertiaCmpVelDampgWhlImbRejctnBlndX_Ary1D" 0 DISPLAY_IDENTIFIER AAACalRegn02Rt03GroupA_Dummy.CalibrationPorts.InertiaCmpVelDampgWhlImbRejctnBlndX.Ary1D /end CHARACTERISTIC
/begin CHARACTERISTIC AAACalRegn02Rt03GroupA_Dummy.InertiaCmpVelDampgWhlImbRejctnBlndY.Ary1D "MICROSAR RTE" VAL_BLK 0x0 RTE_RL_UWORD 0 NO_COMPU_METHOD 0 65535 MATRIX_DIM 5 1 1 SYMBOL_LINK "Rte_CalprmRom_CalRegn02Rt03GroupA_DEFAULT_RTE_CALPRM_GROUP.InertiaCmpVelDampgWhlImbRejctnBlndY_Ary1D" 0 DISPLAY_IDENTIFIER AAACalRegn02Rt03GroupA_Dummy.CalibrationPorts.InertiaCmpVelDampgWhlImbRejctnBlndY.Ary1D /end CHARACTERISTIC
/begin CHARACTERISTIC AAACalRegn02Rt03GroupB_Dummy.EotProtnDampgVehSpdTbl.Ary1D "MICROSAR RTE" VAL_BLK 0x0 RTE_RL_UWORD 0 NO_COMPU_METHOD 0 65535 MATRIX_DIM 4 1 1 SYMBOL_LINK "Rte_CalprmRom_CalRegn02Rt03GroupB_DEFAULT_RTE_CALPRM_GROUP.EotProtnDampgVehSpdTbl_Ary1D" 0 DISPLAY_IDENTIFIER AAACalRegn02Rt03GroupB_Dummy.CalibrationPorts.EotProtnDampgVehSpdTbl.Ary1D /end CHARACTERISTIC
/begin CHARACTERISTIC AAACalRegn02Rt03GroupB_Dummy.EotProtnDeltaTqThd.Val "MICROSAR RTE" VALUE 0x0 RTE_RL_FLOAT32_IEEE 0 NO_COMPU_METHOD -3.402823466e+38 3.402823466e+38 SYMBOL_LINK "Rte_CalprmRom_CalRegn02Rt03GroupB_DEFAULT_RTE_CALPRM_GROUP.EotProtnDeltaTqThd_Val" 0 DISPLAY_IDENTIFIER AAACalRegn02Rt03GroupB_Dummy.CalibrationPorts.EotProtnDeltaTqThd.Val /end CHARACTERISTIC
/begin CHARACTERISTIC AAACalRegn02Rt03GroupB_Dummy.EotProtnEntrGainVehSpdTbl.Ary1D "MICROSAR RTE" VAL_BLK 0x0 RTE_RL_UWORD 0 NO_COMPU_METHOD 0 65535 MATRIX_DIM 5 1 1 SYMBOL_LINK "Rte_CalprmRom_CalRegn02Rt03GroupB_DEFAULT_RTE_CALPRM_GROUP.EotProtnEntrGainVehSpdTbl_Ary1D" 0 DISPLAY_IDENTIFIER AAACalRegn02Rt03GroupB_Dummy.CalibrationPorts.EotProtnEntrGainVehSpdTbl.Ary1D /end CHARACTERISTIC
/begin CHARACTERISTIC AAACalRegn02Rt03GroupB_Dummy.EotProtnEntrGainY.Ary2D "MICROSAR RTE" VAL_BLK 0x0 RTE_RL_UWORD 0 NO_COMPU_METHOD 0 65535 MATRIX_DIM 4 5 1 SYMBOL_LINK "Rte_CalprmRom_CalRegn02Rt03GroupB_DEFAULT_RTE_CALPRM_GROUP.EotProtnEntrGainY_Ary2D" 0 DISPLAY_IDENTIFIER AAACalRegn02Rt03GroupB_Dummy.CalibrationPorts.EotProtnEntrGainY.Ary2D /end CHARACTERISTIC
/begin CHARACTERISTIC AAACalRegn02Rt03GroupB_Dummy.EotProtnLoAuthyEntrGainY.Ary2D "MICROSAR RTE" VAL_BLK 0x0 RTE_RL_UWORD 0 NO_COMPU_METHOD 0 65535 MATRIX_DIM 4 5 1 SYMBOL_LINK "Rte_CalprmRom_CalRegn02Rt03GroupB_DEFAULT_RTE_CALPRM_GROUP.EotProtnLoAuthyEntrGainY_Ary2D" 0 DISPLAY_IDENTIFIER AAACalRegn02Rt03GroupB_Dummy.CalibrationPorts.EotProtnLoAuthyEntrGainY.Ary2D /end CHARACTERISTIC
/begin CHARACTERISTIC AAACalRegn02Rt03GroupB_Dummy.EotProtnMotSpdIncptY.Ary1D "MICROSAR RTE" VAL_BLK 0x0 RTE_RL_UWORD 0 NO_COMPU_METHOD 0 65535 MATRIX_DIM 2 1 1 SYMBOL_LINK "Rte_CalprmRom_CalRegn02Rt03GroupB_DEFAULT_RTE_CALPRM_GROUP.EotProtnMotSpdIncptY_Ary1D" 0 DISPLAY_IDENTIFIER AAACalRegn02Rt03GroupB_Dummy.CalibrationPorts.EotProtnMotSpdIncptY.Ary1D /end CHARACTERISTIC
/begin CHARACTERISTIC AAACalRegn02Rt03GroupB_Dummy.EotProtnNormDampgY.Ary2D "MICROSAR RTE" VAL_BLK 0x0 RTE_RL_UWORD 0 NO_COMPU_METHOD 0 65535 MATRIX_DIM 2 4 1 SYMBOL_LINK "Rte_CalprmRom_CalRegn02Rt03GroupB_DEFAULT_RTE_CALPRM_GROUP.EotProtnNormDampgY_Ary2D" 0 DISPLAY_IDENTIFIER AAACalRegn02Rt03GroupB_Dummy.CalibrationPorts.EotProtnNormDampgY.Ary2D /end CHARACTERISTIC
/**********************************************************************************************************************
* GROUP
*********************************************************************************************************************/
/begin GROUP AAACalRegn01Rt00_Dummy "MICROSAR RTE" /begin SUB_GROUP AAACalRegn01Rt00_Dummy.CalibrationPorts /end SUB_GROUP /begin FUNCTION_LIST /end FUNCTION_LIST /begin REF_CHARACTERISTIC /end REF_CHARACTERISTIC /begin REF_MEASUREMENT /end REF_MEASUREMENT /end GROUP
/begin GROUP AAACalRegn01Rt00_Dummy.CalibrationPorts "MICROSAR RTE" /begin SUB_GROUP AAACalRegn01Rt00_Dummy.TEstimnMagAmbMplr.Ary1D /end SUB_GROUP /begin FUNCTION_LIST /end FUNCTION_LIST /begin REF_CHARACTERISTIC /end REF_CHARACTERISTIC /begin REF_MEASUREMENT /end REF_MEASUREMENT /end GROUP
/begin GROUP AAACalRegn01Rt00_Dummy.TEstimnMagAmbMplr.Ary1D "MICROSAR RTE" /begin SUB_GROUP /end SUB_GROUP /begin FUNCTION_LIST /end FUNCTION_LIST /begin REF_CHARACTERISTIC AAACalRegn01Rt00_Dummy.TEstimnMagAmbMplr.Ary1D /end REF_CHARACTERISTIC /begin REF_MEASUREMENT /end REF_MEASUREMENT /end GROUP
/begin GROUP AAACalRegn01Rt01_Dummy "MICROSAR RTE" /begin SUB_GROUP AAACalRegn01Rt01_Dummy.CalibrationPorts /end SUB_GROUP /begin FUNCTION_LIST /end FUNCTION_LIST /begin REF_CHARACTERISTIC /end REF_CHARACTERISTIC /begin REF_MEASUREMENT /end REF_MEASUREMENT /end GROUP
/begin GROUP AAACalRegn01Rt01_Dummy.CalibrationPorts "MICROSAR RTE" /begin SUB_GROUP AAACalRegn01Rt01_Dummy.TEstimnMagAmbMplr.Ary1D /end SUB_GROUP /begin FUNCTION_LIST /end FUNCTION_LIST /begin REF_CHARACTERISTIC /end REF_CHARACTERISTIC /begin REF_MEASUREMENT /end REF_MEASUREMENT /end GROUP
/begin GROUP AAACalRegn01Rt01_Dummy.TEstimnMagAmbMplr.Ary1D "MICROSAR RTE" /begin SUB_GROUP /end SUB_GROUP /begin FUNCTION_LIST /end FUNCTION_LIST /begin REF_CHARACTERISTIC AAACalRegn01Rt01_Dummy.TEstimnMagAmbMplr.Ary1D /end REF_CHARACTERISTIC /begin REF_MEASUREMENT /end REF_MEASUREMENT /end GROUP
/begin GROUP AAACalRegn01Rt02_Dummy "MICROSAR RTE" /begin SUB_GROUP AAACalRegn01Rt02_Dummy.CalibrationPorts /end SUB_GROUP /begin FUNCTION_LIST /end FUNCTION_LIST /begin REF_CHARACTERISTIC /end REF_CHARACTERISTIC /begin REF_MEASUREMENT /end REF_MEASUREMENT /end GROUP
/begin GROUP AAACalRegn01Rt02_Dummy.CalibrationPorts "MICROSAR RTE" /begin SUB_GROUP AAACalRegn01Rt02_Dummy.TEstimnMagAmbMplr.Ary1D /end SUB_GROUP /begin FUNCTION_LIST /end FUNCTION_LIST /begin REF_CHARACTERISTIC /end REF_CHARACTERISTIC /begin REF_MEASUREMENT /end REF_MEASUREMENT /end GROUP
/begin GROUP AAACalRegn01Rt02_Dummy.TEstimnMagAmbMplr.Ary1D "MICROSAR RTE" /begin SUB_GROUP /end SUB_GROUP /begin FUNCTION_LIST /end FUNCTION_LIST /begin REF_CHARACTERISTIC AAACalRegn01Rt02_Dummy.TEstimnMagAmbMplr.Ary1D /end REF_CHARACTERISTIC /begin REF_MEASUREMENT /end REF_MEASUREMENT /end GROUP
/begin GROUP AAACalRegn01Rt03_Dummy "MICROSAR RTE" /begin SUB_GROUP AAACalRegn01Rt03_Dummy.CalibrationPorts /end SUB_GROUP /begin FUNCTION_LIST /end FUNCTION_LIST /begin REF_CHARACTERISTIC /end REF_CHARACTERISTIC /begin REF_MEASUREMENT /end REF_MEASUREMENT /end GROUP
/begin GROUP AAACalRegn01Rt03_Dummy.CalibrationPorts "MICROSAR RTE" /begin SUB_GROUP AAACalRegn01Rt03_Dummy.TEstimnMagAmbMplr.Ary1D /end SUB_GROUP /begin FUNCTION_LIST /end FUNCTION_LIST /begin REF_CHARACTERISTIC /end REF_CHARACTERISTIC /begin REF_MEASUREMENT /end REF_MEASUREMENT /end GROUP
/begin GROUP AAACalRegn01Rt03_Dummy.TEstimnMagAmbMplr.Ary1D "MICROSAR RTE" /begin SUB_GROUP /end SUB_GROUP /begin FUNCTION_LIST /end FUNCTION_LIST /begin REF_CHARACTERISTIC AAACalRegn01Rt03_Dummy.TEstimnMagAmbMplr.Ary1D /end REF_CHARACTERISTIC /begin REF_MEASUREMENT /end REF_MEASUREMENT /end GROUP
/begin GROUP AAACalRegn01Rt04_Dummy "MICROSAR RTE" /begin SUB_GROUP AAACalRegn01Rt04_Dummy.CalibrationPorts /end SUB_GROUP /begin FUNCTION_LIST /end FUNCTION_LIST /begin REF_CHARACTERISTIC /end REF_CHARACTERISTIC /begin REF_MEASUREMENT /end REF_MEASUREMENT /end GROUP
/begin GROUP AAACalRegn01Rt04_Dummy.CalibrationPorts "MICROSAR RTE" /begin SUB_GROUP AAACalRegn01Rt04_Dummy.TEstimnMagAmbMplr.Ary1D /end SUB_GROUP /begin FUNCTION_LIST /end FUNCTION_LIST /begin REF_CHARACTERISTIC /end REF_CHARACTERISTIC /begin REF_MEASUREMENT /end REF_MEASUREMENT /end GROUP
/begin GROUP AAACalRegn01Rt04_Dummy.TEstimnMagAmbMplr.Ary1D "MICROSAR RTE" /begin SUB_GROUP /end SUB_GROUP /begin FUNCTION_LIST /end FUNCTION_LIST /begin REF_CHARACTERISTIC AAACalRegn01Rt04_Dummy.TEstimnMagAmbMplr.Ary1D /end REF_CHARACTERISTIC /begin REF_MEASUREMENT /end REF_MEASUREMENT /end GROUP
/begin GROUP AAACalRegn01Rt05_Dummy "MICROSAR RTE" /begin SUB_GROUP AAACalRegn01Rt05_Dummy.CalibrationPorts /end SUB_GROUP /begin FUNCTION_LIST /end FUNCTION_LIST /begin REF_CHARACTERISTIC /end REF_CHARACTERISTIC /begin REF_MEASUREMENT /end REF_MEASUREMENT /end GROUP
/begin GROUP AAACalRegn01Rt05_Dummy.CalibrationPorts "MICROSAR RTE" /begin SUB_GROUP AAACalRegn01Rt05_Dummy.TEstimnMagAmbMplr.Ary1D /end SUB_GROUP /begin FUNCTION_LIST /end FUNCTION_LIST /begin REF_CHARACTERISTIC /end REF_CHARACTERISTIC /begin REF_MEASUREMENT /end REF_MEASUREMENT /end GROUP
/begin GROUP AAACalRegn01Rt05_Dummy.TEstimnMagAmbMplr.Ary1D "MICROSAR RTE" /begin SUB_GROUP /end SUB_GROUP /begin FUNCTION_LIST /end FUNCTION_LIST /begin REF_CHARACTERISTIC AAACalRegn01Rt05_Dummy.TEstimnMagAmbMplr.Ary1D /end REF_CHARACTERISTIC /begin REF_MEASUREMENT /end REF_MEASUREMENT /end GROUP
/begin GROUP AAACalRegn02Rt00GroupA_Dummy "MICROSAR RTE" /begin SUB_GROUP AAACalRegn02Rt00GroupA_Dummy.CalibrationPorts /end SUB_GROUP /begin FUNCTION_LIST /end FUNCTION_LIST /begin REF_CHARACTERISTIC /end REF_CHARACTERISTIC /begin REF_MEASUREMENT /end REF_MEASUREMENT /end GROUP
/begin GROUP AAACalRegn02Rt00GroupA_Dummy.AssiHiFrqGainY.Ary2D "MICROSAR RTE" /begin SUB_GROUP /end SUB_GROUP /begin FUNCTION_LIST /end FUNCTION_LIST /begin REF_CHARACTERISTIC AAACalRegn02Rt00GroupA_Dummy.AssiHiFrqGainY.Ary2D /end REF_CHARACTERISTIC /begin REF_MEASUREMENT /end REF_MEASUREMENT /end GROUP
/begin GROUP AAACalRegn02Rt00GroupA_Dummy.AssiHiFrqHpFilFrqY.Ary1D "MICROSAR RTE" /begin SUB_GROUP /end SUB_GROUP /begin FUNCTION_LIST /end FUNCTION_LIST /begin REF_CHARACTERISTIC AAACalRegn02Rt00GroupA_Dummy.AssiHiFrqHpFilFrqY.Ary1D /end REF_CHARACTERISTIC /begin REF_MEASUREMENT /end REF_MEASUREMENT /end GROUP
/begin GROUP AAACalRegn02Rt00GroupA_Dummy.AssiHiFrqTqWhlImbRejctnTqX.Ary2D "MICROSAR RTE" /begin SUB_GROUP /end SUB_GROUP /begin FUNCTION_LIST /end FUNCTION_LIST
 /begin REF_CHARACTERISTIC AAACalRegn02Rt00GroupA_Dummy.AssiHiFrqTqWhlImbRejctnTqX.Ary2D /end REF_CHARACTERISTIC
 /begin REF_MEASUREMENT /end REF_MEASUREMENT
/end GROUP
/begin GROUP AAACalRegn02Rt00GroupA_Dummy.AssiHiFrqTqX.Ary2D "MICROSAR RTE" /begin SUB_GROUP /end SUB_GROUP /begin FUNCTION_LIST /end FUNCTION_LIST /begin REF_CHARACTERISTIC AAACalRegn02Rt00GroupA_Dummy.AssiHiFrqTqX.Ary2D /end REF_CHARACTERISTIC /begin REF_MEASUREMENT /end REF_MEASUREMENT /end GROUP
/begin GROUP AAACalRegn02Rt00GroupA_Dummy.AssiHiFrqWhlImbRejctnBlndX.Ary2D "MICROSAR RTE" /begin SUB_GROUP /end SUB_GROUP /begin FUNCTION_LIST /end FUNCTION_LIST
 /begin REF_CHARACTERISTIC AAACalRegn02Rt00GroupA_Dummy.AssiHiFrqWhlImbRejctnBlndX.Ary2D /end REF_CHARACTERISTIC
 /begin REF_MEASUREMENT /end REF_MEASUREMENT
/end GROUP
/begin GROUP AAACalRegn02Rt00GroupA_Dummy.AssiHiFrqWhlImbRejctnBlndY.Ary2D "MICROSAR RTE" /begin SUB_GROUP /end SUB_GROUP /begin FUNCTION_LIST /end FUNCTION_LIST
 /begin REF_CHARACTERISTIC AAACalRegn02Rt00GroupA_Dummy.AssiHiFrqWhlImbRejctnBlndY.Ary2D /end REF_CHARACTERISTIC
 /begin REF_MEASUREMENT /end REF_MEASUREMENT
/end GROUP
/begin GROUP AAACalRegn02Rt00GroupA_Dummy.AssiHiFrqWhlImbRejctnGainY.Ary2D "MICROSAR RTE" /begin SUB_GROUP /end SUB_GROUP /begin FUNCTION_LIST /end FUNCTION_LIST
 /begin REF_CHARACTERISTIC AAACalRegn02Rt00GroupA_Dummy.AssiHiFrqWhlImbRejctnGainY.Ary2D /end REF_CHARACTERISTIC
 /begin REF_MEASUREMENT /end REF_MEASUREMENT
/end GROUP
/begin GROUP AAACalRegn02Rt00GroupA_Dummy.AssiMotTqWhlImbRejctnMaxX.Ary2D "MICROSAR RTE" /begin SUB_GROUP /end SUB_GROUP /begin FUNCTION_LIST /end FUNCTION_LIST
 /begin REF_CHARACTERISTIC AAACalRegn02Rt00GroupA_Dummy.AssiMotTqWhlImbRejctnMaxX.Ary2D /end REF_CHARACTERISTIC
 /begin REF_MEASUREMENT /end REF_MEASUREMENT
/end GROUP
/begin GROUP AAACalRegn02Rt00GroupA_Dummy.AssiMotTqWhlImbRejctnMaxY.Ary2D "MICROSAR RTE" /begin SUB_GROUP /end SUB_GROUP /begin FUNCTION_LIST /end FUNCTION_LIST
 /begin REF_CHARACTERISTIC AAACalRegn02Rt00GroupA_Dummy.AssiMotTqWhlImbRejctnMaxY.Ary2D /end REF_CHARACTERISTIC
 /begin REF_MEASUREMENT /end REF_MEASUREMENT
/end GROUP
/begin GROUP AAACalRegn02Rt00GroupA_Dummy.AssiMotTqWhlImbRejctnMinX.Ary2D "MICROSAR RTE" /begin SUB_GROUP /end SUB_GROUP /begin FUNCTION_LIST /end FUNCTION_LIST
 /begin REF_CHARACTERISTIC AAACalRegn02Rt00GroupA_Dummy.AssiMotTqWhlImbRejctnMinX.Ary2D /end REF_CHARACTERISTIC
 /begin REF_MEASUREMENT /end REF_MEASUREMENT
/end GROUP
/begin GROUP AAACalRegn02Rt00GroupA_Dummy.AssiMotTqWhlImbRejctnMinY.Ary2D "MICROSAR RTE" /begin SUB_GROUP /end SUB_GROUP /begin FUNCTION_LIST /end FUNCTION_LIST
 /begin REF_CHARACTERISTIC AAACalRegn02Rt00GroupA_Dummy.AssiMotTqWhlImbRejctnMinY.Ary2D /end REF_CHARACTERISTIC
 /begin REF_MEASUREMENT /end REF_MEASUREMENT
/end GROUP
/begin GROUP AAACalRegn02Rt00GroupA_Dummy.AssiWhlImbRejctnBlndScaX.Ary2D "MICROSAR RTE" /begin SUB_GROUP /end SUB_GROUP /begin FUNCTION_LIST /end FUNCTION_LIST
 /begin REF_CHARACTERISTIC AAACalRegn02Rt00GroupA_Dummy.AssiWhlImbRejctnBlndScaX.Ary2D /end REF_CHARACTERISTIC
 /begin REF_MEASUREMENT /end REF_MEASUREMENT
/end GROUP
/begin GROUP AAACalRegn02Rt00GroupA_Dummy.AssiWhlImbRejctnBlndScaY.Ary2D "MICROSAR RTE" /begin SUB_GROUP /end SUB_GROUP /begin FUNCTION_LIST /end FUNCTION_LIST
 /begin REF_CHARACTERISTIC AAACalRegn02Rt00GroupA_Dummy.AssiWhlImbRejctnBlndScaY.Ary2D /end REF_CHARACTERISTIC
 /begin REF_MEASUREMENT /end REF_MEASUREMENT
/end GROUP
/begin GROUP AAACalRegn02Rt00GroupA_Dummy.CalibrationPorts "MICROSAR RTE"
 /begin SUB_GROUP AAACalRegn02Rt00GroupA_Dummy.AssiHiFrqGainY.Ary2D AAACalRegn02Rt00GroupA_Dummy.AssiHiFrqHpFilFrqY.Ary1D AAACalRegn02Rt00GroupA_Dummy.AssiHiFrqTqWhlImbRejctnTqX.Ary2D AAACalRegn02Rt00GroupA_Dummy.AssiHiFrqTqX.Ary2D AAACalRegn02Rt00GroupA_Dummy.AssiHiFrqWhlImbRejctnBlndX.Ary2D AAACalRegn02Rt00GroupA_Dummy.AssiHiFrqWhlImbRejctnBlndY.Ary2D AAACalRegn02Rt00GroupA_Dummy.AssiHiFrqWhlImbRejctnGainY.Ary2D AAACalRegn02Rt00GroupA_Dummy.AssiMotTqWhlImbRejctnMaxX.Ary2D AAACalRegn02Rt00GroupA_Dummy.AssiMotTqWhlImbRejctnMaxY.Ary2D AAACalRegn02Rt00GroupA_Dummy.AssiMotTqWhlImbRejctnMinX.Ary2D AAACalRegn02Rt00GroupA_Dummy.AssiMotTqWhlImbRejctnMinY.Ary2D AAACalRegn02Rt00GroupA_Dummy.AssiWhlImbRejctnBlndScaX.Ary2D AAACalRegn02Rt00GroupA_Dummy.AssiWhlImbRejctnBlndScaY.Ary2D AAACalRegn02Rt00GroupA_Dummy.DampgHwTqX.Ary1D AAACalRegn02Rt00GroupA_Dummy.DampgHwTqY.Ary1D AAACalRegn02Rt00GroupA_Dummy.DampgHydCoeff1ScaY.Ary1D AAACalRegn02Rt00GroupA_Dummy.DampgHydCoeff2ScaY.Ary1D AAACalRegn02Rt00GroupA_Dummy.DampgHydCoeff3ScaY.Ary1D AAACalRegn02Rt00GroupA_Dummy.DampgHydCoeff4ScaY.Ary1D AAACalRegn02Rt00GroupA_Dummy.DampgMotVelX.Ary2D AAACalRegn02Rt00GroupA_Dummy.DampgMotVelY.Ary2D AAACalRegn02Rt00GroupA_Dummy.HysCmpEffLossY.Ary1D AAACalRegn02Rt00GroupA_Dummy.HysCmpEffOffsY.Ary1D AAACalRegn02Rt00GroupA_Dummy.HysCmpFricWhlImbRejctnBlndX.Ary1D AAACalRegn02Rt00GroupA_Dummy.HysCmpFricWhlImbRejctnBlndY.Ary1D AAACalRegn02Rt00GroupA_Dummy.HysCmpFricWhlImbRejctnOffY.Ary1D AAACalRegn02Rt00GroupA_Dummy.HysCmpFricWhlImbRejctnOnY.Ary1D AAACalRegn02Rt00GroupA_Dummy.HysCmpHwTqScaX.Ary2D AAACalRegn02Rt00GroupA_Dummy.HysCmpHwTqScaY.Ary2D AAACalRegn02Rt00GroupA_Dummy.HysCmpHysSatnY.Ary1D AAACalRegn02Rt00GroupA_Dummy.HysCmpNegHysCmpScaX.Ary1D AAACalRegn02Rt00GroupA_Dummy.HysCmpNegHysCmpScaY.Ary1D AAACalRegn02Rt00GroupA_Dummy.HysCmpNegHysCmpX.Ary1D AAACalRegn02Rt00GroupA_Dummy.HysCmpNegHysCmpY.Ary1D AAACalRegn02Rt00GroupA_Dummy.HysCmpOutpLim.Val AAACalRegn02Rt00GroupA_Dummy.HysCmpRevGain.Val AAACalRegn02Rt00GroupA_Dummy.HysCmpRiseX.Ary1D AAACalRegn02Rt00GroupA_Dummy.HysCmpRiseY.Ary1D AAACalRegn02Rt00GroupA_Dummy.InertiaCmpVelAssiBasdDampgStatY.Ary1D AAACalRegn02Rt00GroupA_Dummy.InertiaCmpVelDampgFilFrq.Ary1D AAACalRegn02Rt00GroupA_Dummy.InertiaCmpVelDampgFilFrqWhlImbRejctnOn.Ary1D AAACalRegn02Rt00GroupA_Dummy.InertiaCmpVelDampgSpdBlndY.Ary1D AAACalRegn02Rt00GroupA_Dummy.InertiaCmpVelDampgWhlImbRejctnBlndX.Ary1D AAACalRegn02Rt00GroupA_Dummy.InertiaCmpVelDampgWhlImbRejctnBlndY.Ary1D /end SUB_GROUP
 /begin FUNCTION_LIST /end FUNCTION_LIST
 /begin REF_CHARACTERISTIC /end REF_CHARACTERISTIC
 /begin REF_MEASUREMENT /end REF_MEASUREMENT
/end GROUP
/begin GROUP AAACalRegn02Rt00GroupA_Dummy.DampgHwTqX.Ary1D "MICROSAR RTE" /begin SUB_GROUP /end SUB_GROUP /begin FUNCTION_LIST /end FUNCTION_LIST /begin REF_CHARACTERISTIC AAACalRegn02Rt00GroupA_Dummy.DampgHwTqX.Ary1D /end REF_CHARACTERISTIC /begin REF_MEASUREMENT /end REF_MEASUREMENT /end GROUP
/begin GROUP AAACalRegn02Rt00GroupA_Dummy.DampgHwTqY.Ary1D "MICROSAR RTE" /begin SUB_GROUP /end SUB_GROUP /begin FUNCTION_LIST /end FUNCTION_LIST /begin REF_CHARACTERISTIC AAACalRegn02Rt00GroupA_Dummy.DampgHwTqY.Ary1D /end REF_CHARACTERISTIC /begin REF_MEASUREMENT /end REF_MEASUREMENT /end GROUP
/begin GROUP AAACalRegn02Rt00GroupA_Dummy.DampgHydCoeff1ScaY.Ary1D "MICROSAR RTE" /begin SUB_GROUP /end SUB_GROUP /begin FUNCTION_LIST /end FUNCTION_LIST /begin REF_CHARACTERISTIC AAACalRegn02Rt00GroupA_Dummy.DampgHydCoeff1ScaY.Ary1D /end REF_CHARACTERISTIC /begin REF_MEASUREMENT /end REF_MEASUREMENT /end GROUP
/begin GROUP AAACalRegn02Rt00GroupA_Dummy.DampgHydCoeff2ScaY.Ary1D "MICROSAR RTE" /begin SUB_GROUP /end SUB_GROUP /begin FUNCTION_LIST /end FUNCTION_LIST /begin REF_CHARACTERISTIC AAACalRegn02Rt00GroupA_Dummy.DampgHydCoeff2ScaY.Ary1D /end REF_CHARACTERISTIC /begin REF_MEASUREMENT /end REF_MEASUREMENT /end GROUP
/begin GROUP AAACalRegn02Rt00GroupA_Dummy.DampgHydCoeff3ScaY.Ary1D "MICROSAR RTE" /begin SUB_GROUP /end SUB_GROUP /begin FUNCTION_LIST /end FUNCTION_LIST /begin REF_CHARACTERISTIC AAACalRegn02Rt00GroupA_Dummy.DampgHydCoeff3ScaY.Ary1D /end REF_CHARACTERISTIC /begin REF_MEASUREMENT /end REF_MEASUREMENT /end GROUP
/begin GROUP AAACalRegn02Rt00GroupA_Dummy.DampgHydCoeff4ScaY.Ary1D "MICROSAR RTE" /begin SUB_GROUP /end SUB_GROUP /begin FUNCTION_LIST /end FUNCTION_LIST /begin REF_CHARACTERISTIC AAACalRegn02Rt00GroupA_Dummy.DampgHydCoeff4ScaY.Ary1D /end REF_CHARACTERISTIC /begin REF_MEASUREMENT /end REF_MEASUREMENT /end GROUP
/begin GROUP AAACalRegn02Rt00GroupA_Dummy.DampgMotVelX.Ary2D "MICROSAR RTE" /begin SUB_GROUP /end SUB_GROUP /begin FUNCTION_LIST /end FUNCTION_LIST /begin REF_CHARACTERISTIC AAACalRegn02Rt00GroupA_Dummy.DampgMotVelX.Ary2D /end REF_CHARACTERISTIC /begin REF_MEASUREMENT /end REF_MEASUREMENT /end GROUP
/begin GROUP AAACalRegn02Rt00GroupA_Dummy.DampgMotVelY.Ary2D "MICROSAR RTE" /begin SUB_GROUP /end SUB_GROUP /begin FUNCTION_LIST /end FUNCTION_LIST /begin REF_CHARACTERISTIC AAACalRegn02Rt00GroupA_Dummy.DampgMotVelY.Ary2D /end REF_CHARACTERISTIC /begin REF_MEASUREMENT /end REF_MEASUREMENT /end GROUP
/begin GROUP AAACalRegn02Rt00GroupA_Dummy.HysCmpEffLossY.Ary1D "MICROSAR RTE" /begin SUB_GROUP /end SUB_GROUP /begin FUNCTION_LIST /end FUNCTION_LIST /begin REF_CHARACTERISTIC AAACalRegn02Rt00GroupA_Dummy.HysCmpEffLossY.Ary1D /end REF_CHARACTERISTIC /begin REF_MEASUREMENT /end REF_MEASUREMENT /end GROUP
/begin GROUP AAACalRegn02Rt00GroupA_Dummy.HysCmpEffOffsY.Ary1D "MICROSAR RTE" /begin SUB_GROUP /end SUB_GROUP /begin FUNCTION_LIST /end FUNCTION_LIST /begin REF_CHARACTERISTIC AAACalRegn02Rt00GroupA_Dummy.HysCmpEffOffsY.Ary1D /end REF_CHARACTERISTIC /begin REF_MEASUREMENT /end REF_MEASUREMENT /end GROUP
/begin GROUP AAACalRegn02Rt00GroupA_Dummy.HysCmpFricWhlImbRejctnBlndX.Ary1D "MICROSAR RTE" /begin SUB_GROUP /end SUB_GROUP /begin FUNCTION_LIST /end FUNCTION_LIST
 /begin REF_CHARACTERISTIC AAACalRegn02Rt00GroupA_Dummy.HysCmpFricWhlImbRejctnBlndX.Ary1D /end REF_CHARACTERISTIC
 /begin REF_MEASUREMENT /end REF_MEASUREMENT
/end GROUP
/begin GROUP AAACalRegn02Rt00GroupA_Dummy.HysCmpFricWhlImbRejctnBlndY.Ary1D "MICROSAR RTE" /begin SUB_GROUP /end SUB_GROUP /begin FUNCTION_LIST /end FUNCTION_LIST
 /begin REF_CHARACTERISTIC AAACalRegn02Rt00GroupA_Dummy.HysCmpFricWhlImbRejctnBlndY.Ary1D /end REF_CHARACTERISTIC
 /begin REF_MEASUREMENT /end REF_MEASUREMENT
/end GROUP
/begin GROUP AAACalRegn02Rt00GroupA_Dummy.HysCmpFricWhlImbRejctnOffY.Ary1D "MICROSAR RTE" /begin SUB_GROUP /end SUB_GROUP /begin FUNCTION_LIST /end FUNCTION_LIST
 /begin REF_CHARACTERISTIC AAACalRegn02Rt00GroupA_Dummy.HysCmpFricWhlImbRejctnOffY.Ary1D /end REF_CHARACTERISTIC
 /begin REF_MEASUREMENT /end REF_MEASUREMENT
/end GROUP
/begin GROUP AAACalRegn02Rt00GroupA_Dummy.HysCmpFricWhlImbRejctnOnY.Ary1D "MICROSAR RTE" /begin SUB_GROUP /end SUB_GROUP /begin FUNCTION_LIST /end FUNCTION_LIST
 /begin REF_CHARACTERISTIC AAACalRegn02Rt00GroupA_Dummy.HysCmpFricWhlImbRejctnOnY.Ary1D /end REF_CHARACTERISTIC
 /begin REF_MEASUREMENT /end REF_MEASUREMENT
/end GROUP
/begin GROUP AAACalRegn02Rt00GroupA_Dummy.HysCmpHwTqScaX.Ary2D "MICROSAR RTE" /begin SUB_GROUP /end SUB_GROUP /begin FUNCTION_LIST /end FUNCTION_LIST /begin REF_CHARACTERISTIC AAACalRegn02Rt00GroupA_Dummy.HysCmpHwTqScaX.Ary2D /end REF_CHARACTERISTIC /begin REF_MEASUREMENT /end REF_MEASUREMENT /end GROUP
/begin GROUP AAACalRegn02Rt00GroupA_Dummy.HysCmpHwTqScaY.Ary2D "MICROSAR RTE" /begin SUB_GROUP /end SUB_GROUP /begin FUNCTION_LIST /end FUNCTION_LIST /begin REF_CHARACTERISTIC AAACalRegn02Rt00GroupA_Dummy.HysCmpHwTqScaY.Ary2D /end REF_CHARACTERISTIC /begin REF_MEASUREMENT /end REF_MEASUREMENT /end GROUP
/begin GROUP AAACalRegn02Rt00GroupA_Dummy.HysCmpHysSatnY.Ary1D "MICROSAR RTE" /begin SUB_GROUP /end SUB_GROUP /begin FUNCTION_LIST /end FUNCTION_LIST /begin REF_CHARACTERISTIC AAACalRegn02Rt00GroupA_Dummy.HysCmpHysSatnY.Ary1D /end REF_CHARACTERISTIC /begin REF_MEASUREMENT /end REF_MEASUREMENT /end GROUP
/begin GROUP AAACalRegn02Rt00GroupA_Dummy.HysCmpNegHysCmpScaX.Ary1D "MICROSAR RTE" /begin SUB_GROUP /end SUB_GROUP /begin FUNCTION_LIST /end FUNCTION_LIST /begin REF_CHARACTERISTIC AAACalRegn02Rt00GroupA_Dummy.HysCmpNegHysCmpScaX.Ary1D /end REF_CHARACTERISTIC /begin REF_MEASUREMENT /end REF_MEASUREMENT /end GROUP
/begin GROUP AAACalRegn02Rt00GroupA_Dummy.HysCmpNegHysCmpScaY.Ary1D "MICROSAR RTE" /begin SUB_GROUP /end SUB_GROUP /begin FUNCTION_LIST /end FUNCTION_LIST /begin REF_CHARACTERISTIC AAACalRegn02Rt00GroupA_Dummy.HysCmpNegHysCmpScaY.Ary1D /end REF_CHARACTERISTIC /begin REF_MEASUREMENT /end REF_MEASUREMENT /end GROUP
/begin GROUP AAACalRegn02Rt00GroupA_Dummy.HysCmpNegHysCmpX.Ary1D "MICROSAR RTE" /begin SUB_GROUP /end SUB_GROUP /begin FUNCTION_LIST /end FUNCTION_LIST /begin REF_CHARACTERISTIC AAACalRegn02Rt00GroupA_Dummy.HysCmpNegHysCmpX.Ary1D /end REF_CHARACTERISTIC /begin REF_MEASUREMENT /end REF_MEASUREMENT /end GROUP
/begin GROUP AAACalRegn02Rt00GroupA_Dummy.HysCmpNegHysCmpY.Ary1D "MICROSAR RTE" /begin SUB_GROUP /end SUB_GROUP /begin FUNCTION_LIST /end FUNCTION_LIST /begin REF_CHARACTERISTIC AAACalRegn02Rt00GroupA_Dummy.HysCmpNegHysCmpY.Ary1D /end REF_CHARACTERISTIC /begin REF_MEASUREMENT /end REF_MEASUREMENT /end GROUP
/begin GROUP AAACalRegn02Rt00GroupA_Dummy.HysCmpOutpLim.Val "MICROSAR RTE" /begin SUB_GROUP /end SUB_GROUP /begin FUNCTION_LIST /end FUNCTION_LIST /begin REF_CHARACTERISTIC AAACalRegn02Rt00GroupA_Dummy.HysCmpOutpLim.Val /end REF_CHARACTERISTIC /begin REF_MEASUREMENT /end REF_MEASUREMENT /end GROUP
/begin GROUP AAACalRegn02Rt00GroupA_Dummy.HysCmpRevGain.Val "MICROSAR RTE" /begin SUB_GROUP /end SUB_GROUP /begin FUNCTION_LIST /end FUNCTION_LIST /begin REF_CHARACTERISTIC AAACalRegn02Rt00GroupA_Dummy.HysCmpRevGain.Val /end REF_CHARACTERISTIC /begin REF_MEASUREMENT /end REF_MEASUREMENT /end GROUP
/begin GROUP AAACalRegn02Rt00GroupA_Dummy.HysCmpRiseX.Ary1D "MICROSAR RTE" /begin SUB_GROUP /end SUB_GROUP /begin FUNCTION_LIST /end FUNCTION_LIST /begin REF_CHARACTERISTIC AAACalRegn02Rt00GroupA_Dummy.HysCmpRiseX.Ary1D /end REF_CHARACTERISTIC /begin REF_MEASUREMENT /end REF_MEASUREMENT /end GROUP
/begin GROUP AAACalRegn02Rt00GroupA_Dummy.HysCmpRiseY.Ary1D "MICROSAR RTE" /begin SUB_GROUP /end SUB_GROUP /begin FUNCTION_LIST /end FUNCTION_LIST /begin REF_CHARACTERISTIC AAACalRegn02Rt00GroupA_Dummy.HysCmpRiseY.Ary1D /end REF_CHARACTERISTIC /begin REF_MEASUREMENT /end REF_MEASUREMENT /end GROUP
/begin GROUP AAACalRegn02Rt00GroupA_Dummy.InertiaCmpVelAssiBasdDampgStatY.Ary1D "MICROSAR RTE" /begin SUB_GROUP /end SUB_GROUP /begin FUNCTION_LIST /end FUNCTION_LIST
 /begin REF_CHARACTERISTIC AAACalRegn02Rt00GroupA_Dummy.InertiaCmpVelAssiBasdDampgStatY.Ary1D /end REF_CHARACTERISTIC
 /begin REF_MEASUREMENT /end REF_MEASUREMENT
/end GROUP
/begin GROUP AAACalRegn02Rt00GroupA_Dummy.InertiaCmpVelDampgFilFrq.Ary1D "MICROSAR RTE" /begin SUB_GROUP /end SUB_GROUP /begin FUNCTION_LIST /end FUNCTION_LIST
 /begin REF_CHARACTERISTIC AAACalRegn02Rt00GroupA_Dummy.InertiaCmpVelDampgFilFrq.Ary1D /end REF_CHARACTERISTIC
 /begin REF_MEASUREMENT /end REF_MEASUREMENT
/end GROUP
/begin GROUP AAACalRegn02Rt00GroupA_Dummy.InertiaCmpVelDampgFilFrqWhlImbRejctnOn.Ary1D "MICROSAR RTE" /begin SUB_GROUP /end SUB_GROUP /begin FUNCTION_LIST /end FUNCTION_LIST
 /begin REF_CHARACTERISTIC AAACalRegn02Rt00GroupA_Dummy.InertiaCmpVelDampgFilFrqWhlImbRejctnOn.Ary1D /end REF_CHARACTERISTIC
 /begin REF_MEASUREMENT /end REF_MEASUREMENT
/end GROUP
/begin GROUP AAACalRegn02Rt00GroupA_Dummy.InertiaCmpVelDampgSpdBlndY.Ary1D "MICROSAR RTE" /begin SUB_GROUP /end SUB_GROUP /begin FUNCTION_LIST /end FUNCTION_LIST
 /begin REF_CHARACTERISTIC AAACalRegn02Rt00GroupA_Dummy.InertiaCmpVelDampgSpdBlndY.Ary1D /end REF_CHARACTERISTIC
 /begin REF_MEASUREMENT /end REF_MEASUREMENT
/end GROUP
/begin GROUP AAACalRegn02Rt00GroupA_Dummy.InertiaCmpVelDampgWhlImbRejctnBlndX.Ary1D "MICROSAR RTE" /begin SUB_GROUP /end SUB_GROUP /begin FUNCTION_LIST /end FUNCTION_LIST
 /begin REF_CHARACTERISTIC AAACalRegn02Rt00GroupA_Dummy.InertiaCmpVelDampgWhlImbRejctnBlndX.Ary1D /end REF_CHARACTERISTIC
 /begin REF_MEASUREMENT /end REF_MEASUREMENT
/end GROUP
/begin GROUP AAACalRegn02Rt00GroupA_Dummy.InertiaCmpVelDampgWhlImbRejctnBlndY.Ary1D "MICROSAR RTE" /begin SUB_GROUP /end SUB_GROUP /begin FUNCTION_LIST /end FUNCTION_LIST
 /begin REF_CHARACTERISTIC AAACalRegn02Rt00GroupA_Dummy.InertiaCmpVelDampgWhlImbRejctnBlndY.Ary1D /end REF_CHARACTERISTIC
 /begin REF_MEASUREMENT /end REF_MEASUREMENT
/end GROUP
/begin GROUP AAACalRegn02Rt00GroupB_Dummy "MICROSAR RTE" /begin SUB_GROUP AAACalRegn02Rt00GroupB_Dummy.CalibrationPorts /end SUB_GROUP /begin FUNCTION_LIST /end FUNCTION_LIST /begin REF_CHARACTERISTIC /end REF_CHARACTERISTIC /begin REF_MEASUREMENT /end REF_MEASUREMENT /end GROUP
/begin GROUP AAACalRegn02Rt00GroupB_Dummy.CalibrationPorts "MICROSAR RTE"
 /begin SUB_GROUP AAACalRegn02Rt00GroupB_Dummy.EotProtnDampgVehSpdTbl.Ary1D AAACalRegn02Rt00GroupB_Dummy.EotProtnDeltaTqThd.Val AAACalRegn02Rt00GroupB_Dummy.EotProtnEntrGainVehSpdTbl.Ary1D AAACalRegn02Rt00GroupB_Dummy.EotProtnEntrGainY.Ary2D AAACalRegn02Rt00GroupB_Dummy.EotProtnLoAuthyEntrGainY.Ary2D AAACalRegn02Rt00GroupB_Dummy.EotProtnMotSpdIncptY.Ary1D AAACalRegn02Rt00GroupB_Dummy.EotProtnNormDampgY.Ary2D AAACalRegn02Rt00GroupB_Dummy.EotProtnSoftEndStopAuthyThd.Val AAACalRegn02Rt00GroupB_Dummy.RtnHwAgOffsCalcdX.Ary2D AAACalRegn02Rt00GroupB_Dummy.RtnHwAgOffsCalcdY.Ary2D AAACalRegn02Rt00GroupB_Dummy.RtnScaTqX.Ary2D AAACalRegn02Rt00GroupB_Dummy.RtnScaTqY.Ary2D AAACalRegn02Rt00GroupB_Dummy.RtnScaVelX.Ary2D AAACalRegn02Rt00GroupB_Dummy.RtnScaVelY.Ary2D AAACalRegn02Rt00GroupB_Dummy.RtnVehSpdSeln.Ary1D /end SUB_GROUP
 /begin FUNCTION_LIST /end FUNCTION_LIST
 /begin REF_CHARACTERISTIC /end REF_CHARACTERISTIC
 /begin REF_MEASUREMENT /end REF_MEASUREMENT
/end GROUP
/begin GROUP AAACalRegn02Rt00GroupB_Dummy.EotProtnDampgVehSpdTbl.Ary1D "MICROSAR RTE" /begin SUB_GROUP /end SUB_GROUP /begin FUNCTION_LIST /end FUNCTION_LIST /begin REF_CHARACTERISTIC AAACalRegn02Rt00GroupB_Dummy.EotProtnDampgVehSpdTbl.Ary1D /end REF_CHARACTERISTIC /begin REF_MEASUREMENT /end REF_MEASUREMENT /end GROUP
/begin GROUP AAACalRegn02Rt00GroupB_Dummy.EotProtnDeltaTqThd.Val "MICROSAR RTE" /begin SUB_GROUP /end SUB_GROUP /begin FUNCTION_LIST /end FUNCTION_LIST /begin REF_CHARACTERISTIC AAACalRegn02Rt00GroupB_Dummy.EotProtnDeltaTqThd.Val /end REF_CHARACTERISTIC /begin REF_MEASUREMENT /end REF_MEASUREMENT /end GROUP
/begin GROUP AAACalRegn02Rt00GroupB_Dummy.EotProtnEntrGainVehSpdTbl.Ary1D "MICROSAR RTE" /begin SUB_GROUP /end SUB_GROUP /begin FUNCTION_LIST /end FUNCTION_LIST
 /begin REF_CHARACTERISTIC AAACalRegn02Rt00GroupB_Dummy.EotProtnEntrGainVehSpdTbl.Ary1D /end REF_CHARACTERISTIC
 /begin REF_MEASUREMENT /end REF_MEASUREMENT
/end GROUP
/begin GROUP AAACalRegn02Rt00GroupB_Dummy.EotProtnEntrGainY.Ary2D "MICROSAR RTE" /begin SUB_GROUP /end SUB_GROUP /begin FUNCTION_LIST /end FUNCTION_LIST /begin REF_CHARACTERISTIC AAACalRegn02Rt00GroupB_Dummy.EotProtnEntrGainY.Ary2D /end REF_CHARACTERISTIC /begin REF_MEASUREMENT /end REF_MEASUREMENT /end GROUP
/begin GROUP AAACalRegn02Rt00GroupB_Dummy.EotProtnLoAuthyEntrGainY.Ary2D "MICROSAR RTE" /begin SUB_GROUP /end SUB_GROUP /begin FUNCTION_LIST /end FUNCTION_LIST
 /begin REF_CHARACTERISTIC AAACalRegn02Rt00GroupB_Dummy.EotProtnLoAuthyEntrGainY.Ary2D /end REF_CHARACTERISTIC
 /begin REF_MEASUREMENT /end REF_MEASUREMENT
/end GROUP
/begin GROUP AAACalRegn02Rt00GroupB_Dummy.EotProtnMotSpdIncptY.Ary1D "MICROSAR RTE" /begin SUB_GROUP /end SUB_GROUP /begin FUNCTION_LIST /end FUNCTION_LIST /begin REF_CHARACTERISTIC AAACalRegn02Rt00GroupB_Dummy.EotProtnMotSpdIncptY.Ary1D /end REF_CHARACTERISTIC /begin REF_MEASUREMENT /end REF_MEASUREMENT /end GROUP
/begin GROUP AAACalRegn02Rt00GroupB_Dummy.EotProtnNormDampgY.Ary2D "MICROSAR RTE" /begin SUB_GROUP /end SUB_GROUP /begin FUNCTION_LIST /end FUNCTION_LIST /begin REF_CHARACTERISTIC AAACalRegn02Rt00GroupB_Dummy.EotProtnNormDampgY.Ary2D /end REF_CHARACTERISTIC /begin REF_MEASUREMENT /end REF_MEASUREMENT /end GROUP
/begin GROUP AAACalRegn02Rt00GroupB_Dummy.EotProtnSoftEndStopAuthyThd.Val "MICROSAR RTE" /begin SUB_GROUP /end SUB_GROUP /begin FUNCTION_LIST /end FUNCTION_LIST
 /begin REF_CHARACTERISTIC AAACalRegn02Rt00GroupB_Dummy.EotProtnSoftEndStopAuthyThd.Val /end REF_CHARACTERISTIC
 /begin REF_MEASUREMENT /end REF_MEASUREMENT
/end GROUP
/begin GROUP AAACalRegn02Rt00GroupB_Dummy.RtnHwAgOffsCalcdX.Ary2D "MICROSAR RTE" /begin SUB_GROUP /end SUB_GROUP /begin FUNCTION_LIST /end FUNCTION_LIST /begin REF_CHARACTERISTIC AAACalRegn02Rt00GroupB_Dummy.RtnHwAgOffsCalcdX.Ary2D /end REF_CHARACTERISTIC /begin REF_MEASUREMENT /end REF_MEASUREMENT /end GROUP
/begin GROUP AAACalRegn02Rt00GroupB_Dummy.RtnHwAgOffsCalcdY.Ary2D "MICROSAR RTE" /begin SUB_GROUP /end SUB_GROUP /begin FUNCTION_LIST /end FUNCTION_LIST /begin REF_CHARACTERISTIC AAACalRegn02Rt00GroupB_Dummy.RtnHwAgOffsCalcdY.Ary2D /end REF_CHARACTERISTIC /begin REF_MEASUREMENT /end REF_MEASUREMENT /end GROUP
/begin GROUP AAACalRegn02Rt00GroupB_Dummy.RtnScaTqX.Ary2D "MICROSAR RTE" /begin SUB_GROUP /end SUB_GROUP /begin FUNCTION_LIST /end FUNCTION_LIST /begin REF_CHARACTERISTIC AAACalRegn02Rt00GroupB_Dummy.RtnScaTqX.Ary2D /end REF_CHARACTERISTIC /begin REF_MEASUREMENT /end REF_MEASUREMENT /end GROUP
/begin GROUP AAACalRegn02Rt00GroupB_Dummy.RtnScaTqY.Ary2D "MICROSAR RTE" /begin SUB_GROUP /end SUB_GROUP /begin FUNCTION_LIST /end FUNCTION_LIST /begin REF_CHARACTERISTIC AAACalRegn02Rt00GroupB_Dummy.RtnScaTqY.Ary2D /end REF_CHARACTERISTIC /begin REF_MEASUREMENT /end REF_MEASUREMENT /end GROUP
/begin GROUP AAACalRegn02Rt00GroupB_Dummy.RtnScaVelX.Ary2D "MICROSAR RTE" /begin SUB_GROUP /end SUB_GROUP /begin FUNCTION_LIST /end FUNCTION_LIST /begin REF_CHARACTERISTIC AAACalRegn02Rt00GroupB_Dummy.RtnScaVelX.Ary2D /end REF_CHARACTERISTIC /begin REF_MEASUREMENT /end REF_MEASUREMENT /end GROUP
/begin GROUP AAACalRegn02Rt00GroupB_Dummy.RtnScaVelY.Ary2D "MICROSAR RTE" /begin SUB_GROUP /end SUB_GROUP /begin FUNCTION_LIST /end FUNCTION_LIST /begin REF_CHARACTERISTIC AAACalRegn02Rt00GroupB_Dummy.RtnScaVelY.Ary2D /end REF_CHARACTERISTIC /begin REF_MEASUREMENT /end REF_MEASUREMENT /end GROUP
/begin GROUP AAACalRegn02Rt00GroupB_Dummy.RtnVehSpdSeln.Ary1D "MICROSAR RTE" /begin SUB_GROUP /end SUB_GROUP /begin FUNCTION_LIST /end FUNCTION_LIST /begin REF_CHARACTERISTIC AAACalRegn02Rt00GroupB_Dummy.RtnVehSpdSeln.Ary1D /end REF_CHARACTERISTIC /begin REF_MEASUREMENT /end REF_MEASUREMENT /end GROUP
/begin GROUP AAACalRegn02Rt01GroupA_Dummy "MICROSAR RTE" /begin SUB_GROUP AAACalRegn02Rt01GroupA_Dummy.CalibrationPorts /end SUB_GROUP /begin FUNCTION_LIST /end FUNCTION_LIST /begin REF_CHARACTERISTIC /end REF_CHARACTERISTIC /begin REF_MEASUREMENT /end REF_MEASUREMENT /end GROUP
/begin GROUP AAACalRegn02Rt01GroupA_Dummy.AssiHiFrqGainY.Ary2D "MICROSAR RTE" /begin SUB_GROUP /end SUB_GROUP /begin FUNCTION_LIST /end FUNCTION_LIST /begin REF_CHARACTERISTIC AAACalRegn02Rt01GroupA_Dummy.AssiHiFrqGainY.Ary2D /end REF_CHARACTERISTIC /begin REF_MEASUREMENT /end REF_MEASUREMENT /end GROUP
/begin GROUP AAACalRegn02Rt01GroupA_Dummy.AssiHiFrqHpFilFrqY.Ary1D "MICROSAR RTE" /begin SUB_GROUP /end SUB_GROUP /begin FUNCTION_LIST /end FUNCTION_LIST /begin REF_CHARACTERISTIC AAACalRegn02Rt01GroupA_Dummy.AssiHiFrqHpFilFrqY.Ary1D /end REF_CHARACTERISTIC /begin REF_MEASUREMENT /end REF_MEASUREMENT /end GROUP
/begin GROUP AAACalRegn02Rt01GroupA_Dummy.AssiHiFrqTqWhlImbRejctnTqX.Ary2D "MICROSAR RTE" /begin SUB_GROUP /end SUB_GROUP /begin FUNCTION_LIST /end FUNCTION_LIST
 /begin REF_CHARACTERISTIC AAACalRegn02Rt01GroupA_Dummy.AssiHiFrqTqWhlImbRejctnTqX.Ary2D /end REF_CHARACTERISTIC
 /begin REF_MEASUREMENT /end REF_MEASUREMENT
/end GROUP
/begin GROUP AAACalRegn02Rt01GroupA_Dummy.AssiHiFrqTqX.Ary2D "MICROSAR RTE" /begin SUB_GROUP /end SUB_GROUP /begin FUNCTION_LIST /end FUNCTION_LIST /begin REF_CHARACTERISTIC AAACalRegn02Rt01GroupA_Dummy.AssiHiFrqTqX.Ary2D /end REF_CHARACTERISTIC /begin REF_MEASUREMENT /end REF_MEASUREMENT /end GROUP
/begin GROUP AAACalRegn02Rt01GroupA_Dummy.AssiHiFrqWhlImbRejctnBlndX.Ary2D "MICROSAR RTE" /begin SUB_GROUP /end SUB_GROUP /begin FUNCTION_LIST /end FUNCTION_LIST
 /begin REF_CHARACTERISTIC AAACalRegn02Rt01GroupA_Dummy.AssiHiFrqWhlImbRejctnBlndX.Ary2D /end REF_CHARACTERISTIC
 /begin REF_MEASUREMENT /end REF_MEASUREMENT
/end GROUP
/begin GROUP AAACalRegn02Rt01GroupA_Dummy.AssiHiFrqWhlImbRejctnBlndY.Ary2D "MICROSAR RTE" /begin SUB_GROUP /end SUB_GROUP /begin FUNCTION_LIST /end FUNCTION_LIST
 /begin REF_CHARACTERISTIC AAACalRegn02Rt01GroupA_Dummy.AssiHiFrqWhlImbRejctnBlndY.Ary2D /end REF_CHARACTERISTIC
 /begin REF_MEASUREMENT /end REF_MEASUREMENT
/end GROUP
/begin GROUP AAACalRegn02Rt01GroupA_Dummy.AssiHiFrqWhlImbRejctnGainY.Ary2D "MICROSAR RTE" /begin SUB_GROUP /end SUB_GROUP /begin FUNCTION_LIST /end FUNCTION_LIST
 /begin REF_CHARACTERISTIC AAACalRegn02Rt01GroupA_Dummy.AssiHiFrqWhlImbRejctnGainY.Ary2D /end REF_CHARACTERISTIC
 /begin REF_MEASUREMENT /end REF_MEASUREMENT
/end GROUP
/begin GROUP AAACalRegn02Rt01GroupA_Dummy.AssiMotTqWhlImbRejctnMaxX.Ary2D "MICROSAR RTE" /begin SUB_GROUP /end SUB_GROUP /begin FUNCTION_LIST /end FUNCTION_LIST
 /begin REF_CHARACTERISTIC AAACalRegn02Rt01GroupA_Dummy.AssiMotTqWhlImbRejctnMaxX.Ary2D /end REF_CHARACTERISTIC
 /begin REF_MEASUREMENT /end REF_MEASUREMENT
/end GROUP
/begin GROUP AAACalRegn02Rt01GroupA_Dummy.AssiMotTqWhlImbRejctnMaxY.Ary2D "MICROSAR RTE" /begin SUB_GROUP /end SUB_GROUP /begin FUNCTION_LIST /end FUNCTION_LIST
 /begin REF_CHARACTERISTIC AAACalRegn02Rt01GroupA_Dummy.AssiMotTqWhlImbRejctnMaxY.Ary2D /end REF_CHARACTERISTIC
 /begin REF_MEASUREMENT /end REF_MEASUREMENT
/end GROUP
/begin GROUP AAACalRegn02Rt01GroupA_Dummy.AssiMotTqWhlImbRejctnMinX.Ary2D "MICROSAR RTE" /begin SUB_GROUP /end SUB_GROUP /begin FUNCTION_LIST /end FUNCTION_LIST
 /begin REF_CHARACTERISTIC AAACalRegn02Rt01GroupA_Dummy.AssiMotTqWhlImbRejctnMinX.Ary2D /end REF_CHARACTERISTIC
 /begin REF_MEASUREMENT /end REF_MEASUREMENT
/end GROUP
/begin GROUP AAACalRegn02Rt01GroupA_Dummy.AssiMotTqWhlImbRejctnMinY.Ary2D "MICROSAR RTE" /begin SUB_GROUP /end SUB_GROUP /begin FUNCTION_LIST /end FUNCTION_LIST
 /begin REF_CHARACTERISTIC AAACalRegn02Rt01GroupA_Dummy.AssiMotTqWhlImbRejctnMinY.Ary2D /end REF_CHARACTERISTIC
 /begin REF_MEASUREMENT /end REF_MEASUREMENT
/end GROUP
/begin GROUP AAACalRegn02Rt01GroupA_Dummy.AssiWhlImbRejctnBlndScaX.Ary2D "MICROSAR RTE" /begin SUB_GROUP /end SUB_GROUP /begin FUNCTION_LIST /end FUNCTION_LIST
 /begin REF_CHARACTERISTIC AAACalRegn02Rt01GroupA_Dummy.AssiWhlImbRejctnBlndScaX.Ary2D /end REF_CHARACTERISTIC
 /begin REF_MEASUREMENT /end REF_MEASUREMENT
/end GROUP
/begin GROUP AAACalRegn02Rt01GroupA_Dummy.AssiWhlImbRejctnBlndScaY.Ary2D "MICROSAR RTE" /begin SUB_GROUP /end SUB_GROUP /begin FUNCTION_LIST /end FUNCTION_LIST
 /begin REF_CHARACTERISTIC AAACalRegn02Rt01GroupA_Dummy.AssiWhlImbRejctnBlndScaY.Ary2D /end REF_CHARACTERISTIC
 /begin REF_MEASUREMENT /end REF_MEASUREMENT
/end GROUP
/begin GROUP AAACalRegn02Rt01GroupA_Dummy.CalibrationPorts "MICROSAR RTE"
 /begin SUB_GROUP AAACalRegn02Rt01GroupA_Dummy.AssiHiFrqGainY.Ary2D AAACalRegn02Rt01GroupA_Dummy.AssiHiFrqHpFilFrqY.Ary1D AAACalRegn02Rt01GroupA_Dummy.AssiHiFrqTqWhlImbRejctnTqX.Ary2D AAACalRegn02Rt01GroupA_Dummy.AssiHiFrqTqX.Ary2D AAACalRegn02Rt01GroupA_Dummy.AssiHiFrqWhlImbRejctnBlndX.Ary2D AAACalRegn02Rt01GroupA_Dummy.AssiHiFrqWhlImbRejctnBlndY.Ary2D AAACalRegn02Rt01GroupA_Dummy.AssiHiFrqWhlImbRejctnGainY.Ary2D AAACalRegn02Rt01GroupA_Dummy.AssiMotTqWhlImbRejctnMaxX.Ary2D AAACalRegn02Rt01GroupA_Dummy.AssiMotTqWhlImbRejctnMaxY.Ary2D AAACalRegn02Rt01GroupA_Dummy.AssiMotTqWhlImbRejctnMinX.Ary2D AAACalRegn02Rt01GroupA_Dummy.AssiMotTqWhlImbRejctnMinY.Ary2D AAACalRegn02Rt01GroupA_Dummy.AssiWhlImbRejctnBlndScaX.Ary2D AAACalRegn02Rt01GroupA_Dummy.AssiWhlImbRejctnBlndScaY.Ary2D AAACalRegn02Rt01GroupA_Dummy.DampgHwTqX.Ary1D AAACalRegn02Rt01GroupA_Dummy.DampgHwTqY.Ary1D AAACalRegn02Rt01GroupA_Dummy.DampgHydCoeff1ScaY.Ary1D AAACalRegn02Rt01GroupA_Dummy.DampgHydCoeff2ScaY.Ary1D AAACalRegn02Rt01GroupA_Dummy.DampgHydCoeff3ScaY.Ary1D AAACalRegn02Rt01GroupA_Dummy.DampgHydCoeff4ScaY.Ary1D AAACalRegn02Rt01GroupA_Dummy.DampgMotVelX.Ary2D AAACalRegn02Rt01GroupA_Dummy.DampgMotVelY.Ary2D AAACalRegn02Rt01GroupA_Dummy.HysCmpEffLossY.Ary1D AAACalRegn02Rt01GroupA_Dummy.HysCmpEffOffsY.Ary1D AAACalRegn02Rt01GroupA_Dummy.HysCmpFricWhlImbRejctnBlndX.Ary1D AAACalRegn02Rt01GroupA_Dummy.HysCmpFricWhlImbRejctnBlndY.Ary1D AAACalRegn02Rt01GroupA_Dummy.HysCmpFricWhlImbRejctnOffY.Ary1D AAACalRegn02Rt01GroupA_Dummy.HysCmpFricWhlImbRejctnOnY.Ary1D AAACalRegn02Rt01GroupA_Dummy.HysCmpHwTqScaX.Ary2D AAACalRegn02Rt01GroupA_Dummy.HysCmpHwTqScaY.Ary2D AAACalRegn02Rt01GroupA_Dummy.HysCmpHysSatnY.Ary1D AAACalRegn02Rt01GroupA_Dummy.HysCmpNegHysCmpScaX.Ary1D AAACalRegn02Rt01GroupA_Dummy.HysCmpNegHysCmpScaY.Ary1D AAACalRegn02Rt01GroupA_Dummy.HysCmpNegHysCmpX.Ary1D AAACalRegn02Rt01GroupA_Dummy.HysCmpNegHysCmpY.Ary1D AAACalRegn02Rt01GroupA_Dummy.HysCmpOutpLim.Val AAACalRegn02Rt01GroupA_Dummy.HysCmpRevGain.Val AAACalRegn02Rt01GroupA_Dummy.HysCmpRiseX.Ary1D AAACalRegn02Rt01GroupA_Dummy.HysCmpRiseY.Ary1D AAACalRegn02Rt01GroupA_Dummy.InertiaCmpVelAssiBasdDampgStatY.Ary1D AAACalRegn02Rt01GroupA_Dummy.InertiaCmpVelDampgFilFrq.Ary1D AAACalRegn02Rt01GroupA_Dummy.InertiaCmpVelDampgFilFrqWhlImbRejctnOn.Ary1D AAACalRegn02Rt01GroupA_Dummy.InertiaCmpVelDampgSpdBlndY.Ary1D AAACalRegn02Rt01GroupA_Dummy.InertiaCmpVelDampgWhlImbRejctnBlndX.Ary1D AAACalRegn02Rt01GroupA_Dummy.InertiaCmpVelDampgWhlImbRejctnBlndY.Ary1D /end SUB_GROUP
 /begin FUNCTION_LIST /end FUNCTION_LIST
 /begin REF_CHARACTERISTIC /end REF_CHARACTERISTIC
 /begin REF_MEASUREMENT /end REF_MEASUREMENT
/end GROUP
/begin GROUP AAACalRegn02Rt01GroupA_Dummy.DampgHwTqX.Ary1D "MICROSAR RTE" /begin SUB_GROUP /end SUB_GROUP /begin FUNCTION_LIST /end FUNCTION_LIST /begin REF_CHARACTERISTIC AAACalRegn02Rt01GroupA_Dummy.DampgHwTqX.Ary1D /end REF_CHARACTERISTIC /begin REF_MEASUREMENT /end REF_MEASUREMENT /end GROUP
/begin GROUP AAACalRegn02Rt01GroupA_Dummy.DampgHwTqY.Ary1D "MICROSAR RTE" /begin SUB_GROUP /end SUB_GROUP /begin FUNCTION_LIST /end FUNCTION_LIST /begin REF_CHARACTERISTIC AAACalRegn02Rt01GroupA_Dummy.DampgHwTqY.Ary1D /end REF_CHARACTERISTIC /begin REF_MEASUREMENT /end REF_MEASUREMENT /end GROUP
/begin GROUP AAACalRegn02Rt01GroupA_Dummy.DampgHydCoeff1ScaY.Ary1D "MICROSAR RTE" /begin SUB_GROUP /end SUB_GROUP /begin FUNCTION_LIST /end FUNCTION_LIST /begin REF_CHARACTERISTIC AAACalRegn02Rt01GroupA_Dummy.DampgHydCoeff1ScaY.Ary1D /end REF_CHARACTERISTIC /begin REF_MEASUREMENT /end REF_MEASUREMENT /end GROUP
/begin GROUP AAACalRegn02Rt01GroupA_Dummy.DampgHydCoeff2ScaY.Ary1D "MICROSAR RTE" /begin SUB_GROUP /end SUB_GROUP /begin FUNCTION_LIST /end FUNCTION_LIST /begin REF_CHARACTERISTIC AAACalRegn02Rt01GroupA_Dummy.DampgHydCoeff2ScaY.Ary1D /end REF_CHARACTERISTIC /begin REF_MEASUREMENT /end REF_MEASUREMENT /end GROUP
/begin GROUP AAACalRegn02Rt01GroupA_Dummy.DampgHydCoeff3ScaY.Ary1D "MICROSAR RTE" /begin SUB_GROUP /end SUB_GROUP /begin FUNCTION_LIST /end FUNCTION_LIST /begin REF_CHARACTERISTIC AAACalRegn02Rt01GroupA_Dummy.DampgHydCoeff3ScaY.Ary1D /end REF_CHARACTERISTIC /begin REF_MEASUREMENT /end REF_MEASUREMENT /end GROUP
/begin GROUP AAACalRegn02Rt01GroupA_Dummy.DampgHydCoeff4ScaY.Ary1D "MICROSAR RTE" /begin SUB_GROUP /end SUB_GROUP /begin FUNCTION_LIST /end FUNCTION_LIST /begin REF_CHARACTERISTIC AAACalRegn02Rt01GroupA_Dummy.DampgHydCoeff4ScaY.Ary1D /end REF_CHARACTERISTIC /begin REF_MEASUREMENT /end REF_MEASUREMENT /end GROUP
/begin GROUP AAACalRegn02Rt01GroupA_Dummy.DampgMotVelX.Ary2D "MICROSAR RTE" /begin SUB_GROUP /end SUB_GROUP /begin FUNCTION_LIST /end FUNCTION_LIST /begin REF_CHARACTERISTIC AAACalRegn02Rt01GroupA_Dummy.DampgMotVelX.Ary2D /end REF_CHARACTERISTIC /begin REF_MEASUREMENT /end REF_MEASUREMENT /end GROUP
/begin GROUP AAACalRegn02Rt01GroupA_Dummy.DampgMotVelY.Ary2D "MICROSAR RTE" /begin SUB_GROUP /end SUB_GROUP /begin FUNCTION_LIST /end FUNCTION_LIST /begin REF_CHARACTERISTIC AAACalRegn02Rt01GroupA_Dummy.DampgMotVelY.Ary2D /end REF_CHARACTERISTIC /begin REF_MEASUREMENT /end REF_MEASUREMENT /end GROUP
/begin GROUP AAACalRegn02Rt01GroupA_Dummy.HysCmpEffLossY.Ary1D "MICROSAR RTE" /begin SUB_GROUP /end SUB_GROUP /begin FUNCTION_LIST /end FUNCTION_LIST /begin REF_CHARACTERISTIC AAACalRegn02Rt01GroupA_Dummy.HysCmpEffLossY.Ary1D /end REF_CHARACTERISTIC /begin REF_MEASUREMENT /end REF_MEASUREMENT /end GROUP
/begin GROUP AAACalRegn02Rt01GroupA_Dummy.HysCmpEffOffsY.Ary1D "MICROSAR RTE" /begin SUB_GROUP /end SUB_GROUP /begin FUNCTION_LIST /end FUNCTION_LIST /begin REF_CHARACTERISTIC AAACalRegn02Rt01GroupA_Dummy.HysCmpEffOffsY.Ary1D /end REF_CHARACTERISTIC /begin REF_MEASUREMENT /end REF_MEASUREMENT /end GROUP
/begin GROUP AAACalRegn02Rt01GroupA_Dummy.HysCmpFricWhlImbRejctnBlndX.Ary1D "MICROSAR RTE" /begin SUB_GROUP /end SUB_GROUP /begin FUNCTION_LIST /end FUNCTION_LIST
 /begin REF_CHARACTERISTIC AAACalRegn02Rt01GroupA_Dummy.HysCmpFricWhlImbRejctnBlndX.Ary1D /end REF_CHARACTERISTIC
 /begin REF_MEASUREMENT /end REF_MEASUREMENT
/end GROUP
/begin GROUP AAACalRegn02Rt01GroupA_Dummy.HysCmpFricWhlImbRejctnBlndY.Ary1D "MICROSAR RTE" /begin SUB_GROUP /end SUB_GROUP /begin FUNCTION_LIST /end FUNCTION_LIST
 /begin REF_CHARACTERISTIC AAACalRegn02Rt01GroupA_Dummy.HysCmpFricWhlImbRejctnBlndY.Ary1D /end REF_CHARACTERISTIC
 /begin REF_MEASUREMENT /end REF_MEASUREMENT
/end GROUP
/begin GROUP AAACalRegn02Rt01GroupA_Dummy.HysCmpFricWhlImbRejctnOffY.Ary1D "MICROSAR RTE" /begin SUB_GROUP /end SUB_GROUP /begin FUNCTION_LIST /end FUNCTION_LIST
 /begin REF_CHARACTERISTIC AAACalRegn02Rt01GroupA_Dummy.HysCmpFricWhlImbRejctnOffY.Ary1D /end REF_CHARACTERISTIC
 /begin REF_MEASUREMENT /end REF_MEASUREMENT
/end GROUP
/begin GROUP AAACalRegn02Rt01GroupA_Dummy.HysCmpFricWhlImbRejctnOnY.Ary1D "MICROSAR RTE" /begin SUB_GROUP /end SUB_GROUP /begin FUNCTION_LIST /end FUNCTION_LIST
 /begin REF_CHARACTERISTIC AAACalRegn02Rt01GroupA_Dummy.HysCmpFricWhlImbRejctnOnY.Ary1D /end REF_CHARACTERISTIC
 /begin REF_MEASUREMENT /end REF_MEASUREMENT
/end GROUP
/begin GROUP AAACalRegn02Rt01GroupA_Dummy.HysCmpHwTqScaX.Ary2D "MICROSAR RTE" /begin SUB_GROUP /end SUB_GROUP /begin FUNCTION_LIST /end FUNCTION_LIST /begin REF_CHARACTERISTIC AAACalRegn02Rt01GroupA_Dummy.HysCmpHwTqScaX.Ary2D /end REF_CHARACTERISTIC /begin REF_MEASUREMENT /end REF_MEASUREMENT /end GROUP
/begin GROUP AAACalRegn02Rt01GroupA_Dummy.HysCmpHwTqScaY.Ary2D "MICROSAR RTE" /begin SUB_GROUP /end SUB_GROUP /begin FUNCTION_LIST /end FUNCTION_LIST /begin REF_CHARACTERISTIC AAACalRegn02Rt01GroupA_Dummy.HysCmpHwTqScaY.Ary2D /end REF_CHARACTERISTIC /begin REF_MEASUREMENT /end REF_MEASUREMENT /end GROUP
/begin GROUP AAACalRegn02Rt01GroupA_Dummy.HysCmpHysSatnY.Ary1D "MICROSAR RTE" /begin SUB_GROUP /end SUB_GROUP /begin FUNCTION_LIST /end FUNCTION_LIST /begin REF_CHARACTERISTIC AAACalRegn02Rt01GroupA_Dummy.HysCmpHysSatnY.Ary1D /end REF_CHARACTERISTIC /begin REF_MEASUREMENT /end REF_MEASUREMENT /end GROUP
/begin GROUP AAACalRegn02Rt01GroupA_Dummy.HysCmpNegHysCmpScaX.Ary1D "MICROSAR RTE" /begin SUB_GROUP /end SUB_GROUP /begin FUNCTION_LIST /end FUNCTION_LIST /begin REF_CHARACTERISTIC AAACalRegn02Rt01GroupA_Dummy.HysCmpNegHysCmpScaX.Ary1D /end REF_CHARACTERISTIC /begin REF_MEASUREMENT /end REF_MEASUREMENT /end GROUP
/begin GROUP AAACalRegn02Rt01GroupA_Dummy.HysCmpNegHysCmpScaY.Ary1D "MICROSAR RTE" /begin SUB_GROUP /end SUB_GROUP /begin FUNCTION_LIST /end FUNCTION_LIST /begin REF_CHARACTERISTIC AAACalRegn02Rt01GroupA_Dummy.HysCmpNegHysCmpScaY.Ary1D /end REF_CHARACTERISTIC /begin REF_MEASUREMENT /end REF_MEASUREMENT /end GROUP
/begin GROUP AAACalRegn02Rt01GroupA_Dummy.HysCmpNegHysCmpX.Ary1D "MICROSAR RTE" /begin SUB_GROUP /end SUB_GROUP /begin FUNCTION_LIST /end FUNCTION_LIST /begin REF_CHARACTERISTIC AAACalRegn02Rt01GroupA_Dummy.HysCmpNegHysCmpX.Ary1D /end REF_CHARACTERISTIC /begin REF_MEASUREMENT /end REF_MEASUREMENT /end GROUP
/begin GROUP AAACalRegn02Rt01GroupA_Dummy.HysCmpNegHysCmpY.Ary1D "MICROSAR RTE" /begin SUB_GROUP /end SUB_GROUP /begin FUNCTION_LIST /end FUNCTION_LIST /begin REF_CHARACTERISTIC AAACalRegn02Rt01GroupA_Dummy.HysCmpNegHysCmpY.Ary1D /end REF_CHARACTERISTIC /begin REF_MEASUREMENT /end REF_MEASUREMENT /end GROUP
/begin GROUP AAACalRegn02Rt01GroupA_Dummy.HysCmpOutpLim.Val "MICROSAR RTE" /begin SUB_GROUP /end SUB_GROUP /begin FUNCTION_LIST /end FUNCTION_LIST /begin REF_CHARACTERISTIC AAACalRegn02Rt01GroupA_Dummy.HysCmpOutpLim.Val /end REF_CHARACTERISTIC /begin REF_MEASUREMENT /end REF_MEASUREMENT /end GROUP
/begin GROUP AAACalRegn02Rt01GroupA_Dummy.HysCmpRevGain.Val "MICROSAR RTE" /begin SUB_GROUP /end SUB_GROUP /begin FUNCTION_LIST /end FUNCTION_LIST /begin REF_CHARACTERISTIC AAACalRegn02Rt01GroupA_Dummy.HysCmpRevGain.Val /end REF_CHARACTERISTIC /begin REF_MEASUREMENT /end REF_MEASUREMENT /end GROUP
/begin GROUP AAACalRegn02Rt01GroupA_Dummy.HysCmpRiseX.Ary1D "MICROSAR RTE" /begin SUB_GROUP /end SUB_GROUP /begin FUNCTION_LIST /end FUNCTION_LIST /begin REF_CHARACTERISTIC AAACalRegn02Rt01GroupA_Dummy.HysCmpRiseX.Ary1D /end REF_CHARACTERISTIC /begin REF_MEASUREMENT /end REF_MEASUREMENT /end GROUP
/begin GROUP AAACalRegn02Rt01GroupA_Dummy.HysCmpRiseY.Ary1D "MICROSAR RTE" /begin SUB_GROUP /end SUB_GROUP /begin FUNCTION_LIST /end FUNCTION_LIST /begin REF_CHARACTERISTIC AAACalRegn02Rt01GroupA_Dummy.HysCmpRiseY.Ary1D /end REF_CHARACTERISTIC /begin REF_MEASUREMENT /end REF_MEASUREMENT /end GROUP
/begin GROUP AAACalRegn02Rt01GroupA_Dummy.InertiaCmpVelAssiBasdDampgStatY.Ary1D "MICROSAR RTE" /begin SUB_GROUP /end SUB_GROUP /begin FUNCTION_LIST /end FUNCTION_LIST
 /begin REF_CHARACTERISTIC AAACalRegn02Rt01GroupA_Dummy.InertiaCmpVelAssiBasdDampgStatY.Ary1D /end REF_CHARACTERISTIC
 /begin REF_MEASUREMENT /end REF_MEASUREMENT
/end GROUP
/begin GROUP AAACalRegn02Rt01GroupA_Dummy.InertiaCmpVelDampgFilFrq.Ary1D "MICROSAR RTE" /begin SUB_GROUP /end SUB_GROUP /begin FUNCTION_LIST /end FUNCTION_LIST
 /begin REF_CHARACTERISTIC AAACalRegn02Rt01GroupA_Dummy.InertiaCmpVelDampgFilFrq.Ary1D /end REF_CHARACTERISTIC
 /begin REF_MEASUREMENT /end REF_MEASUREMENT
/end GROUP
/begin GROUP AAACalRegn02Rt01GroupA_Dummy.InertiaCmpVelDampgFilFrqWhlImbRejctnOn.Ary1D "MICROSAR RTE" /begin SUB_GROUP /end SUB_GROUP /begin FUNCTION_LIST /end FUNCTION_LIST
 /begin REF_CHARACTERISTIC AAACalRegn02Rt01GroupA_Dummy.InertiaCmpVelDampgFilFrqWhlImbRejctnOn.Ary1D /end REF_CHARACTERISTIC
 /begin REF_MEASUREMENT /end REF_MEASUREMENT
/end GROUP
/begin GROUP AAACalRegn02Rt01GroupA_Dummy.InertiaCmpVelDampgSpdBlndY.Ary1D "MICROSAR RTE" /begin SUB_GROUP /end SUB_GROUP /begin FUNCTION_LIST /end FUNCTION_LIST
 /begin REF_CHARACTERISTIC AAACalRegn02Rt01GroupA_Dummy.InertiaCmpVelDampgSpdBlndY.Ary1D /end REF_CHARACTERISTIC
 /begin REF_MEASUREMENT /end REF_MEASUREMENT
/end GROUP
/begin GROUP AAACalRegn02Rt01GroupA_Dummy.InertiaCmpVelDampgWhlImbRejctnBlndX.Ary1D "MICROSAR RTE" /begin SUB_GROUP /end SUB_GROUP /begin FUNCTION_LIST /end FUNCTION_LIST
 /begin REF_CHARACTERISTIC AAACalRegn02Rt01GroupA_Dummy.InertiaCmpVelDampgWhlImbRejctnBlndX.Ary1D /end REF_CHARACTERISTIC
 /begin REF_MEASUREMENT /end REF_MEASUREMENT
/end GROUP
/begin GROUP AAACalRegn02Rt01GroupA_Dummy.InertiaCmpVelDampgWhlImbRejctnBlndY.Ary1D "MICROSAR RTE" /begin SUB_GROUP /end SUB_GROUP /begin FUNCTION_LIST /end FUNCTION_LIST
 /begin REF_CHARACTERISTIC AAACalRegn02Rt01GroupA_Dummy.InertiaCmpVelDampgWhlImbRejctnBlndY.Ary1D /end REF_CHARACTERISTIC
 /begin REF_MEASUREMENT /end REF_MEASUREMENT
/end GROUP
/begin GROUP AAACalRegn02Rt01GroupB_Dummy "MICROSAR RTE" /begin SUB_GROUP AAACalRegn02Rt01GroupB_Dummy.CalibrationPorts /end SUB_GROUP /begin FUNCTION_LIST /end FUNCTION_LIST /begin REF_CHARACTERISTIC /end REF_CHARACTERISTIC /begin REF_MEASUREMENT /end REF_MEASUREMENT /end GROUP
/begin GROUP AAACalRegn02Rt01GroupB_Dummy.CalibrationPorts "MICROSAR RTE"
 /begin SUB_GROUP AAACalRegn02Rt01GroupB_Dummy.EotProtnDampgVehSpdTbl.Ary1D AAACalRegn02Rt01GroupB_Dummy.EotProtnDeltaTqThd.Val AAACalRegn02Rt01GroupB_Dummy.EotProtnEntrGainVehSpdTbl.Ary1D AAACalRegn02Rt01GroupB_Dummy.EotProtnEntrGainY.Ary2D AAACalRegn02Rt01GroupB_Dummy.EotProtnLoAuthyEntrGainY.Ary2D AAACalRegn02Rt01GroupB_Dummy.EotProtnMotSpdIncptY.Ary1D AAACalRegn02Rt01GroupB_Dummy.EotProtnNormDampgY.Ary2D AAACalRegn02Rt01GroupB_Dummy.EotProtnSoftEndStopAuthyThd.Val AAACalRegn02Rt01GroupB_Dummy.RtnHwAgOffsCalcdX.Ary2D AAACalRegn02Rt01GroupB_Dummy.RtnHwAgOffsCalcdY.Ary2D AAACalRegn02Rt01GroupB_Dummy.RtnScaTqX.Ary2D AAACalRegn02Rt01GroupB_Dummy.RtnScaTqY.Ary2D AAACalRegn02Rt01GroupB_Dummy.RtnScaVelX.Ary2D AAACalRegn02Rt01GroupB_Dummy.RtnScaVelY.Ary2D AAACalRegn02Rt01GroupB_Dummy.RtnVehSpdSeln.Ary1D /end SUB_GROUP
 /begin FUNCTION_LIST /end FUNCTION_LIST
 /begin REF_CHARACTERISTIC /end REF_CHARACTERISTIC
 /begin REF_MEASUREMENT /end REF_MEASUREMENT
/end GROUP
/begin GROUP AAACalRegn02Rt01GroupB_Dummy.EotProtnDampgVehSpdTbl.Ary1D "MICROSAR RTE" /begin SUB_GROUP /end SUB_GROUP /begin FUNCTION_LIST /end FUNCTION_LIST /begin REF_CHARACTERISTIC AAACalRegn02Rt01GroupB_Dummy.EotProtnDampgVehSpdTbl.Ary1D /end REF_CHARACTERISTIC /begin REF_MEASUREMENT /end REF_MEASUREMENT /end GROUP
/begin GROUP AAACalRegn02Rt01GroupB_Dummy.EotProtnDeltaTqThd.Val "MICROSAR RTE" /begin SUB_GROUP /end SUB_GROUP /begin FUNCTION_LIST /end FUNCTION_LIST /begin REF_CHARACTERISTIC AAACalRegn02Rt01GroupB_Dummy.EotProtnDeltaTqThd.Val /end REF_CHARACTERISTIC /begin REF_MEASUREMENT /end REF_MEASUREMENT /end GROUP
/begin GROUP AAACalRegn02Rt01GroupB_Dummy.EotProtnEntrGainVehSpdTbl.Ary1D "MICROSAR RTE" /begin SUB_GROUP /end SUB_GROUP /begin FUNCTION_LIST /end FUNCTION_LIST
 /begin REF_CHARACTERISTIC AAACalRegn02Rt01GroupB_Dummy.EotProtnEntrGainVehSpdTbl.Ary1D /end REF_CHARACTERISTIC
 /begin REF_MEASUREMENT /end REF_MEASUREMENT
/end GROUP
/begin GROUP AAACalRegn02Rt01GroupB_Dummy.EotProtnEntrGainY.Ary2D "MICROSAR RTE" /begin SUB_GROUP /end SUB_GROUP /begin FUNCTION_LIST /end FUNCTION_LIST /begin REF_CHARACTERISTIC AAACalRegn02Rt01GroupB_Dummy.EotProtnEntrGainY.Ary2D /end REF_CHARACTERISTIC /begin REF_MEASUREMENT /end REF_MEASUREMENT /end GROUP
/begin GROUP AAACalRegn02Rt01GroupB_Dummy.EotProtnLoAuthyEntrGainY.Ary2D "MICROSAR RTE" /begin SUB_GROUP /end SUB_GROUP /begin FUNCTION_LIST /end FUNCTION_LIST
 /begin REF_CHARACTERISTIC AAACalRegn02Rt01GroupB_Dummy.EotProtnLoAuthyEntrGainY.Ary2D /end REF_CHARACTERISTIC
 /begin REF_MEASUREMENT /end REF_MEASUREMENT
/end GROUP
/begin GROUP AAACalRegn02Rt01GroupB_Dummy.EotProtnMotSpdIncptY.Ary1D "MICROSAR RTE" /begin SUB_GROUP /end SUB_GROUP /begin FUNCTION_LIST /end FUNCTION_LIST /begin REF_CHARACTERISTIC AAACalRegn02Rt01GroupB_Dummy.EotProtnMotSpdIncptY.Ary1D /end REF_CHARACTERISTIC /begin REF_MEASUREMENT /end REF_MEASUREMENT /end GROUP
/begin GROUP AAACalRegn02Rt01GroupB_Dummy.EotProtnNormDampgY.Ary2D "MICROSAR RTE" /begin SUB_GROUP /end SUB_GROUP /begin FUNCTION_LIST /end FUNCTION_LIST /begin REF_CHARACTERISTIC AAACalRegn02Rt01GroupB_Dummy.EotProtnNormDampgY.Ary2D /end REF_CHARACTERISTIC /begin REF_MEASUREMENT /end REF_MEASUREMENT /end GROUP
/begin GROUP AAACalRegn02Rt01GroupB_Dummy.EotProtnSoftEndStopAuthyThd.Val "MICROSAR RTE" /begin SUB_GROUP /end SUB_GROUP /begin FUNCTION_LIST /end FUNCTION_LIST
 /begin REF_CHARACTERISTIC AAACalRegn02Rt01GroupB_Dummy.EotProtnSoftEndStopAuthyThd.Val /end REF_CHARACTERISTIC
 /begin REF_MEASUREMENT /end REF_MEASUREMENT
/end GROUP
/begin GROUP AAACalRegn02Rt01GroupB_Dummy.RtnHwAgOffsCalcdX.Ary2D "MICROSAR RTE" /begin SUB_GROUP /end SUB_GROUP /begin FUNCTION_LIST /end FUNCTION_LIST /begin REF_CHARACTERISTIC AAACalRegn02Rt01GroupB_Dummy.RtnHwAgOffsCalcdX.Ary2D /end REF_CHARACTERISTIC /begin REF_MEASUREMENT /end REF_MEASUREMENT /end GROUP
/begin GROUP AAACalRegn02Rt01GroupB_Dummy.RtnHwAgOffsCalcdY.Ary2D "MICROSAR RTE" /begin SUB_GROUP /end SUB_GROUP /begin FUNCTION_LIST /end FUNCTION_LIST /begin REF_CHARACTERISTIC AAACalRegn02Rt01GroupB_Dummy.RtnHwAgOffsCalcdY.Ary2D /end REF_CHARACTERISTIC /begin REF_MEASUREMENT /end REF_MEASUREMENT /end GROUP
/begin GROUP AAACalRegn02Rt01GroupB_Dummy.RtnScaTqX.Ary2D "MICROSAR RTE" /begin SUB_GROUP /end SUB_GROUP /begin FUNCTION_LIST /end FUNCTION_LIST /begin REF_CHARACTERISTIC AAACalRegn02Rt01GroupB_Dummy.RtnScaTqX.Ary2D /end REF_CHARACTERISTIC /begin REF_MEASUREMENT /end REF_MEASUREMENT /end GROUP
/begin GROUP AAACalRegn02Rt01GroupB_Dummy.RtnScaTqY.Ary2D "MICROSAR RTE" /begin SUB_GROUP /end SUB_GROUP /begin FUNCTION_LIST /end FUNCTION_LIST /begin REF_CHARACTERISTIC AAACalRegn02Rt01GroupB_Dummy.RtnScaTqY.Ary2D /end REF_CHARACTERISTIC /begin REF_MEASUREMENT /end REF_MEASUREMENT /end GROUP
/begin GROUP AAACalRegn02Rt01GroupB_Dummy.RtnScaVelX.Ary2D "MICROSAR RTE" /begin SUB_GROUP /end SUB_GROUP /begin FUNCTION_LIST /end FUNCTION_LIST /begin REF_CHARACTERISTIC AAACalRegn02Rt01GroupB_Dummy.RtnScaVelX.Ary2D /end REF_CHARACTERISTIC /begin REF_MEASUREMENT /end REF_MEASUREMENT /end GROUP
/begin GROUP AAACalRegn02Rt01GroupB_Dummy.RtnScaVelY.Ary2D "MICROSAR RTE" /begin SUB_GROUP /end SUB_GROUP /begin FUNCTION_LIST /end FUNCTION_LIST /begin REF_CHARACTERISTIC AAACalRegn02Rt01GroupB_Dummy.RtnScaVelY.Ary2D /end REF_CHARACTERISTIC /begin REF_MEASUREMENT /end REF_MEASUREMENT /end GROUP
/begin GROUP AAACalRegn02Rt01GroupB_Dummy.RtnVehSpdSeln.Ary1D "MICROSAR RTE" /begin SUB_GROUP /end SUB_GROUP /begin FUNCTION_LIST /end FUNCTION_LIST /begin REF_CHARACTERISTIC AAACalRegn02Rt01GroupB_Dummy.RtnVehSpdSeln.Ary1D /end REF_CHARACTERISTIC /begin REF_MEASUREMENT /end REF_MEASUREMENT /end GROUP
/begin GROUP AAACalRegn02Rt02GroupA_Dummy "MICROSAR RTE" /begin SUB_GROUP AAACalRegn02Rt02GroupA_Dummy.CalibrationPorts /end SUB_GROUP /begin FUNCTION_LIST /end FUNCTION_LIST /begin REF_CHARACTERISTIC /end REF_CHARACTERISTIC /begin REF_MEASUREMENT /end REF_MEASUREMENT /end GROUP
/begin GROUP AAACalRegn02Rt02GroupA_Dummy.AssiHiFrqGainY.Ary2D "MICROSAR RTE" /begin SUB_GROUP /end SUB_GROUP /begin FUNCTION_LIST /end FUNCTION_LIST /begin REF_CHARACTERISTIC AAACalRegn02Rt02GroupA_Dummy.AssiHiFrqGainY.Ary2D /end REF_CHARACTERISTIC /begin REF_MEASUREMENT /end REF_MEASUREMENT /end GROUP
/begin GROUP AAACalRegn02Rt02GroupA_Dummy.AssiHiFrqHpFilFrqY.Ary1D "MICROSAR RTE" /begin SUB_GROUP /end SUB_GROUP /begin FUNCTION_LIST /end FUNCTION_LIST /begin REF_CHARACTERISTIC AAACalRegn02Rt02GroupA_Dummy.AssiHiFrqHpFilFrqY.Ary1D /end REF_CHARACTERISTIC /begin REF_MEASUREMENT /end REF_MEASUREMENT /end GROUP
/begin GROUP AAACalRegn02Rt02GroupA_Dummy.AssiHiFrqTqWhlImbRejctnTqX.Ary2D "MICROSAR RTE" /begin SUB_GROUP /end SUB_GROUP /begin FUNCTION_LIST /end FUNCTION_LIST
 /begin REF_CHARACTERISTIC AAACalRegn02Rt02GroupA_Dummy.AssiHiFrqTqWhlImbRejctnTqX.Ary2D /end REF_CHARACTERISTIC
 /begin REF_MEASUREMENT /end REF_MEASUREMENT
/end GROUP
/begin GROUP AAACalRegn02Rt02GroupA_Dummy.AssiHiFrqTqX.Ary2D "MICROSAR RTE" /begin SUB_GROUP /end SUB_GROUP /begin FUNCTION_LIST /end FUNCTION_LIST /begin REF_CHARACTERISTIC AAACalRegn02Rt02GroupA_Dummy.AssiHiFrqTqX.Ary2D /end REF_CHARACTERISTIC /begin REF_MEASUREMENT /end REF_MEASUREMENT /end GROUP
/begin GROUP AAACalRegn02Rt02GroupA_Dummy.AssiHiFrqWhlImbRejctnBlndX.Ary2D "MICROSAR RTE" /begin SUB_GROUP /end SUB_GROUP /begin FUNCTION_LIST /end FUNCTION_LIST
 /begin REF_CHARACTERISTIC AAACalRegn02Rt02GroupA_Dummy.AssiHiFrqWhlImbRejctnBlndX.Ary2D /end REF_CHARACTERISTIC
 /begin REF_MEASUREMENT /end REF_MEASUREMENT
/end GROUP
/begin GROUP AAACalRegn02Rt02GroupA_Dummy.AssiHiFrqWhlImbRejctnBlndY.Ary2D "MICROSAR RTE" /begin SUB_GROUP /end SUB_GROUP /begin FUNCTION_LIST /end FUNCTION_LIST
 /begin REF_CHARACTERISTIC AAACalRegn02Rt02GroupA_Dummy.AssiHiFrqWhlImbRejctnBlndY.Ary2D /end REF_CHARACTERISTIC
 /begin REF_MEASUREMENT /end REF_MEASUREMENT
/end GROUP
/begin GROUP AAACalRegn02Rt02GroupA_Dummy.AssiHiFrqWhlImbRejctnGainY.Ary2D "MICROSAR RTE" /begin SUB_GROUP /end SUB_GROUP /begin FUNCTION_LIST /end FUNCTION_LIST
 /begin REF_CHARACTERISTIC AAACalRegn02Rt02GroupA_Dummy.AssiHiFrqWhlImbRejctnGainY.Ary2D /end REF_CHARACTERISTIC
 /begin REF_MEASUREMENT /end REF_MEASUREMENT
/end GROUP
/begin GROUP AAACalRegn02Rt02GroupA_Dummy.AssiMotTqWhlImbRejctnMaxX.Ary2D "MICROSAR RTE" /begin SUB_GROUP /end SUB_GROUP /begin FUNCTION_LIST /end FUNCTION_LIST
 /begin REF_CHARACTERISTIC AAACalRegn02Rt02GroupA_Dummy.AssiMotTqWhlImbRejctnMaxX.Ary2D /end REF_CHARACTERISTIC
 /begin REF_MEASUREMENT /end REF_MEASUREMENT
/end GROUP
/begin GROUP AAACalRegn02Rt02GroupA_Dummy.AssiMotTqWhlImbRejctnMaxY.Ary2D "MICROSAR RTE" /begin SUB_GROUP /end SUB_GROUP /begin FUNCTION_LIST /end FUNCTION_LIST
 /begin REF_CHARACTERISTIC AAACalRegn02Rt02GroupA_Dummy.AssiMotTqWhlImbRejctnMaxY.Ary2D /end REF_CHARACTERISTIC
 /begin REF_MEASUREMENT /end REF_MEASUREMENT
/end GROUP
/begin GROUP AAACalRegn02Rt02GroupA_Dummy.AssiMotTqWhlImbRejctnMinX.Ary2D "MICROSAR RTE" /begin SUB_GROUP /end SUB_GROUP /begin FUNCTION_LIST /end FUNCTION_LIST
 /begin REF_CHARACTERISTIC AAACalRegn02Rt02GroupA_Dummy.AssiMotTqWhlImbRejctnMinX.Ary2D /end REF_CHARACTERISTIC
 /begin REF_MEASUREMENT /end REF_MEASUREMENT
/end GROUP
/begin GROUP AAACalRegn02Rt02GroupA_Dummy.AssiMotTqWhlImbRejctnMinY.Ary2D "MICROSAR RTE" /begin SUB_GROUP /end SUB_GROUP /begin FUNCTION_LIST /end FUNCTION_LIST
 /begin REF_CHARACTERISTIC AAACalRegn02Rt02GroupA_Dummy.AssiMotTqWhlImbRejctnMinY.Ary2D /end REF_CHARACTERISTIC
 /begin REF_MEASUREMENT /end REF_MEASUREMENT
/end GROUP
/begin GROUP AAACalRegn02Rt02GroupA_Dummy.AssiWhlImbRejctnBlndScaX.Ary2D "MICROSAR RTE" /begin SUB_GROUP /end SUB_GROUP /begin FUNCTION_LIST /end FUNCTION_LIST
 /begin REF_CHARACTERISTIC AAACalRegn02Rt02GroupA_Dummy.AssiWhlImbRejctnBlndScaX.Ary2D /end REF_CHARACTERISTIC
 /begin REF_MEASUREMENT /end REF_MEASUREMENT
/end GROUP
/begin GROUP AAACalRegn02Rt02GroupA_Dummy.AssiWhlImbRejctnBlndScaY.Ary2D "MICROSAR RTE" /begin SUB_GROUP /end SUB_GROUP /begin FUNCTION_LIST /end FUNCTION_LIST
 /begin REF_CHARACTERISTIC AAACalRegn02Rt02GroupA_Dummy.AssiWhlImbRejctnBlndScaY.Ary2D /end REF_CHARACTERISTIC
 /begin REF_MEASUREMENT /end REF_MEASUREMENT
/end GROUP
/begin GROUP AAACalRegn02Rt02GroupA_Dummy.CalibrationPorts "MICROSAR RTE"
 /begin SUB_GROUP AAACalRegn02Rt02GroupA_Dummy.AssiHiFrqGainY.Ary2D AAACalRegn02Rt02GroupA_Dummy.AssiHiFrqHpFilFrqY.Ary1D AAACalRegn02Rt02GroupA_Dummy.AssiHiFrqTqWhlImbRejctnTqX.Ary2D AAACalRegn02Rt02GroupA_Dummy.AssiHiFrqTqX.Ary2D AAACalRegn02Rt02GroupA_Dummy.AssiHiFrqWhlImbRejctnBlndX.Ary2D AAACalRegn02Rt02GroupA_Dummy.AssiHiFrqWhlImbRejctnBlndY.Ary2D AAACalRegn02Rt02GroupA_Dummy.AssiHiFrqWhlImbRejctnGainY.Ary2D AAACalRegn02Rt02GroupA_Dummy.AssiMotTqWhlImbRejctnMaxX.Ary2D AAACalRegn02Rt02GroupA_Dummy.AssiMotTqWhlImbRejctnMaxY.Ary2D AAACalRegn02Rt02GroupA_Dummy.AssiMotTqWhlImbRejctnMinX.Ary2D AAACalRegn02Rt02GroupA_Dummy.AssiMotTqWhlImbRejctnMinY.Ary2D AAACalRegn02Rt02GroupA_Dummy.AssiWhlImbRejctnBlndScaX.Ary2D AAACalRegn02Rt02GroupA_Dummy.AssiWhlImbRejctnBlndScaY.Ary2D AAACalRegn02Rt02GroupA_Dummy.DampgHwTqX.Ary1D AAACalRegn02Rt02GroupA_Dummy.DampgHwTqY.Ary1D AAACalRegn02Rt02GroupA_Dummy.DampgHydCoeff1ScaY.Ary1D AAACalRegn02Rt02GroupA_Dummy.DampgHydCoeff2ScaY.Ary1D AAACalRegn02Rt02GroupA_Dummy.DampgHydCoeff3ScaY.Ary1D AAACalRegn02Rt02GroupA_Dummy.DampgHydCoeff4ScaY.Ary1D AAACalRegn02Rt02GroupA_Dummy.DampgMotVelX.Ary2D AAACalRegn02Rt02GroupA_Dummy.DampgMotVelY.Ary2D AAACalRegn02Rt02GroupA_Dummy.HysCmpEffLossY.Ary1D AAACalRegn02Rt02GroupA_Dummy.HysCmpEffOffsY.Ary1D AAACalRegn02Rt02GroupA_Dummy.HysCmpFricWhlImbRejctnBlndX.Ary1D AAACalRegn02Rt02GroupA_Dummy.HysCmpFricWhlImbRejctnBlndY.Ary1D AAACalRegn02Rt02GroupA_Dummy.HysCmpFricWhlImbRejctnOffY.Ary1D AAACalRegn02Rt02GroupA_Dummy.HysCmpFricWhlImbRejctnOnY.Ary1D AAACalRegn02Rt02GroupA_Dummy.HysCmpHwTqScaX.Ary2D AAACalRegn02Rt02GroupA_Dummy.HysCmpHwTqScaY.Ary2D AAACalRegn02Rt02GroupA_Dummy.HysCmpHysSatnY.Ary1D AAACalRegn02Rt02GroupA_Dummy.HysCmpNegHysCmpScaX.Ary1D AAACalRegn02Rt02GroupA_Dummy.HysCmpNegHysCmpScaY.Ary1D AAACalRegn02Rt02GroupA_Dummy.HysCmpNegHysCmpX.Ary1D AAACalRegn02Rt02GroupA_Dummy.HysCmpNegHysCmpY.Ary1D AAACalRegn02Rt02GroupA_Dummy.HysCmpOutpLim.Val AAACalRegn02Rt02GroupA_Dummy.HysCmpRevGain.Val AAACalRegn02Rt02GroupA_Dummy.HysCmpRiseX.Ary1D AAACalRegn02Rt02GroupA_Dummy.HysCmpRiseY.Ary1D AAACalRegn02Rt02GroupA_Dummy.InertiaCmpVelAssiBasdDampgStatY.Ary1D AAACalRegn02Rt02GroupA_Dummy.InertiaCmpVelDampgFilFrq.Ary1D AAACalRegn02Rt02GroupA_Dummy.InertiaCmpVelDampgFilFrqWhlImbRejctnOn.Ary1D AAACalRegn02Rt02GroupA_Dummy.InertiaCmpVelDampgSpdBlndY.Ary1D AAACalRegn02Rt02GroupA_Dummy.InertiaCmpVelDampgWhlImbRejctnBlndX.Ary1D AAACalRegn02Rt02GroupA_Dummy.InertiaCmpVelDampgWhlImbRejctnBlndY.Ary1D /end SUB_GROUP
 /begin FUNCTION_LIST /end FUNCTION_LIST
 /begin REF_CHARACTERISTIC /end REF_CHARACTERISTIC
 /begin REF_MEASUREMENT /end REF_MEASUREMENT
/end GROUP
/begin GROUP AAACalRegn02Rt02GroupA_Dummy.DampgHwTqX.Ary1D "MICROSAR RTE" /begin SUB_GROUP /end SUB_GROUP /begin FUNCTION_LIST /end FUNCTION_LIST /begin REF_CHARACTERISTIC AAACalRegn02Rt02GroupA_Dummy.DampgHwTqX.Ary1D /end REF_CHARACTERISTIC /begin REF_MEASUREMENT /end REF_MEASUREMENT /end GROUP
/begin GROUP AAACalRegn02Rt02GroupA_Dummy.DampgHwTqY.Ary1D "MICROSAR RTE" /begin SUB_GROUP /end SUB_GROUP /begin FUNCTION_LIST /end FUNCTION_LIST /begin REF_CHARACTERISTIC AAACalRegn02Rt02GroupA_Dummy.DampgHwTqY.Ary1D /end REF_CHARACTERISTIC /begin REF_MEASUREMENT /end REF_MEASUREMENT /end GROUP
/begin GROUP AAACalRegn02Rt02GroupA_Dummy.DampgHydCoeff1ScaY.Ary1D "MICROSAR RTE" /begin SUB_GROUP /end SUB_GROUP /begin FUNCTION_LIST /end FUNCTION_LIST /begin REF_CHARACTERISTIC AAACalRegn02Rt02GroupA_Dummy.DampgHydCoeff1ScaY.Ary1D /end REF_CHARACTERISTIC /begin REF_MEASUREMENT /end REF_MEASUREMENT /end GROUP
/begin GROUP AAACalRegn02Rt02GroupA_Dummy.DampgHydCoeff2ScaY.Ary1D "MICROSAR RTE" /begin SUB_GROUP /end SUB_GROUP /begin FUNCTION_LIST /end FUNCTION_LIST /begin REF_CHARACTERISTIC AAACalRegn02Rt02GroupA_Dummy.DampgHydCoeff2ScaY.Ary1D /end REF_CHARACTERISTIC /begin REF_MEASUREMENT /end REF_MEASUREMENT /end GROUP
/begin GROUP AAACalRegn02Rt02GroupA_Dummy.DampgHydCoeff3ScaY.Ary1D "MICROSAR RTE" /begin SUB_GROUP /end SUB_GROUP /begin FUNCTION_LIST /end FUNCTION_LIST /begin REF_CHARACTERISTIC AAACalRegn02Rt02GroupA_Dummy.DampgHydCoeff3ScaY.Ary1D /end REF_CHARACTERISTIC /begin REF_MEASUREMENT /end REF_MEASUREMENT /end GROUP
/begin GROUP AAACalRegn02Rt02GroupA_Dummy.DampgHydCoeff4ScaY.Ary1D "MICROSAR RTE" /begin SUB_GROUP /end SUB_GROUP /begin FUNCTION_LIST /end FUNCTION_LIST /begin REF_CHARACTERISTIC AAACalRegn02Rt02GroupA_Dummy.DampgHydCoeff4ScaY.Ary1D /end REF_CHARACTERISTIC /begin REF_MEASUREMENT /end REF_MEASUREMENT /end GROUP
/begin GROUP AAACalRegn02Rt02GroupA_Dummy.DampgMotVelX.Ary2D "MICROSAR RTE" /begin SUB_GROUP /end SUB_GROUP /begin FUNCTION_LIST /end FUNCTION_LIST /begin REF_CHARACTERISTIC AAACalRegn02Rt02GroupA_Dummy.DampgMotVelX.Ary2D /end REF_CHARACTERISTIC /begin REF_MEASUREMENT /end REF_MEASUREMENT /end GROUP
/begin GROUP AAACalRegn02Rt02GroupA_Dummy.DampgMotVelY.Ary2D "MICROSAR RTE" /begin SUB_GROUP /end SUB_GROUP /begin FUNCTION_LIST /end FUNCTION_LIST /begin REF_CHARACTERISTIC AAACalRegn02Rt02GroupA_Dummy.DampgMotVelY.Ary2D /end REF_CHARACTERISTIC /begin REF_MEASUREMENT /end REF_MEASUREMENT /end GROUP
/begin GROUP AAACalRegn02Rt02GroupA_Dummy.HysCmpEffLossY.Ary1D "MICROSAR RTE" /begin SUB_GROUP /end SUB_GROUP /begin FUNCTION_LIST /end FUNCTION_LIST /begin REF_CHARACTERISTIC AAACalRegn02Rt02GroupA_Dummy.HysCmpEffLossY.Ary1D /end REF_CHARACTERISTIC /begin REF_MEASUREMENT /end REF_MEASUREMENT /end GROUP
/begin GROUP AAACalRegn02Rt02GroupA_Dummy.HysCmpEffOffsY.Ary1D "MICROSAR RTE" /begin SUB_GROUP /end SUB_GROUP /begin FUNCTION_LIST /end FUNCTION_LIST /begin REF_CHARACTERISTIC AAACalRegn02Rt02GroupA_Dummy.HysCmpEffOffsY.Ary1D /end REF_CHARACTERISTIC /begin REF_MEASUREMENT /end REF_MEASUREMENT /end GROUP
/begin GROUP AAACalRegn02Rt02GroupA_Dummy.HysCmpFricWhlImbRejctnBlndX.Ary1D "MICROSAR RTE" /begin SUB_GROUP /end SUB_GROUP /begin FUNCTION_LIST /end FUNCTION_LIST
 /begin REF_CHARACTERISTIC AAACalRegn02Rt02GroupA_Dummy.HysCmpFricWhlImbRejctnBlndX.Ary1D /end REF_CHARACTERISTIC
 /begin REF_MEASUREMENT /end REF_MEASUREMENT
/end GROUP
/begin GROUP AAACalRegn02Rt02GroupA_Dummy.HysCmpFricWhlImbRejctnBlndY.Ary1D "MICROSAR RTE" /begin SUB_GROUP /end SUB_GROUP /begin FUNCTION_LIST /end FUNCTION_LIST
 /begin REF_CHARACTERISTIC AAACalRegn02Rt02GroupA_Dummy.HysCmpFricWhlImbRejctnBlndY.Ary1D /end REF_CHARACTERISTIC
 /begin REF_MEASUREMENT /end REF_MEASUREMENT
/end GROUP
/begin GROUP AAACalRegn02Rt02GroupA_Dummy.HysCmpFricWhlImbRejctnOffY.Ary1D "MICROSAR RTE" /begin SUB_GROUP /end SUB_GROUP /begin FUNCTION_LIST /end FUNCTION_LIST
 /begin REF_CHARACTERISTIC AAACalRegn02Rt02GroupA_Dummy.HysCmpFricWhlImbRejctnOffY.Ary1D /end REF_CHARACTERISTIC
 /begin REF_MEASUREMENT /end REF_MEASUREMENT
/end GROUP
/begin GROUP AAACalRegn02Rt02GroupA_Dummy.HysCmpFricWhlImbRejctnOnY.Ary1D "MICROSAR RTE" /begin SUB_GROUP /end SUB_GROUP /begin FUNCTION_LIST /end FUNCTION_LIST
 /begin REF_CHARACTERISTIC AAACalRegn02Rt02GroupA_Dummy.HysCmpFricWhlImbRejctnOnY.Ary1D /end REF_CHARACTERISTIC
 /begin REF_MEASUREMENT /end REF_MEASUREMENT
/end GROUP
/begin GROUP AAACalRegn02Rt02GroupA_Dummy.HysCmpHwTqScaX.Ary2D "MICROSAR RTE" /begin SUB_GROUP /end SUB_GROUP /begin FUNCTION_LIST /end FUNCTION_LIST /begin REF_CHARACTERISTIC AAACalRegn02Rt02GroupA_Dummy.HysCmpHwTqScaX.Ary2D /end REF_CHARACTERISTIC /begin REF_MEASUREMENT /end REF_MEASUREMENT /end GROUP
/begin GROUP AAACalRegn02Rt02GroupA_Dummy.HysCmpHwTqScaY.Ary2D "MICROSAR RTE" /begin SUB_GROUP /end SUB_GROUP /begin FUNCTION_LIST /end FUNCTION_LIST /begin REF_CHARACTERISTIC AAACalRegn02Rt02GroupA_Dummy.HysCmpHwTqScaY.Ary2D /end REF_CHARACTERISTIC /begin REF_MEASUREMENT /end REF_MEASUREMENT /end GROUP
/begin GROUP AAACalRegn02Rt02GroupA_Dummy.HysCmpHysSatnY.Ary1D "MICROSAR RTE" /begin SUB_GROUP /end SUB_GROUP /begin FUNCTION_LIST /end FUNCTION_LIST /begin REF_CHARACTERISTIC AAACalRegn02Rt02GroupA_Dummy.HysCmpHysSatnY.Ary1D /end REF_CHARACTERISTIC /begin REF_MEASUREMENT /end REF_MEASUREMENT /end GROUP
/begin GROUP AAACalRegn02Rt02GroupA_Dummy.HysCmpNegHysCmpScaX.Ary1D "MICROSAR RTE" /begin SUB_GROUP /end SUB_GROUP /begin FUNCTION_LIST /end FUNCTION_LIST /begin REF_CHARACTERISTIC AAACalRegn02Rt02GroupA_Dummy.HysCmpNegHysCmpScaX.Ary1D /end REF_CHARACTERISTIC /begin REF_MEASUREMENT /end REF_MEASUREMENT /end GROUP
/begin GROUP AAACalRegn02Rt02GroupA_Dummy.HysCmpNegHysCmpScaY.Ary1D "MICROSAR RTE" /begin SUB_GROUP /end SUB_GROUP /begin FUNCTION_LIST /end FUNCTION_LIST /begin REF_CHARACTERISTIC AAACalRegn02Rt02GroupA_Dummy.HysCmpNegHysCmpScaY.Ary1D /end REF_CHARACTERISTIC /begin REF_MEASUREMENT /end REF_MEASUREMENT /end GROUP
/begin GROUP AAACalRegn02Rt02GroupA_Dummy.HysCmpNegHysCmpX.Ary1D "MICROSAR RTE" /begin SUB_GROUP /end SUB_GROUP /begin FUNCTION_LIST /end FUNCTION_LIST /begin REF_CHARACTERISTIC AAACalRegn02Rt02GroupA_Dummy.HysCmpNegHysCmpX.Ary1D /end REF_CHARACTERISTIC /begin REF_MEASUREMENT /end REF_MEASUREMENT /end GROUP
/begin GROUP AAACalRegn02Rt02GroupA_Dummy.HysCmpNegHysCmpY.Ary1D "MICROSAR RTE" /begin SUB_GROUP /end SUB_GROUP /begin FUNCTION_LIST /end FUNCTION_LIST /begin REF_CHARACTERISTIC AAACalRegn02Rt02GroupA_Dummy.HysCmpNegHysCmpY.Ary1D /end REF_CHARACTERISTIC /begin REF_MEASUREMENT /end REF_MEASUREMENT /end GROUP
/begin GROUP AAACalRegn02Rt02GroupA_Dummy.HysCmpOutpLim.Val "MICROSAR RTE" /begin SUB_GROUP /end SUB_GROUP /begin FUNCTION_LIST /end FUNCTION_LIST /begin REF_CHARACTERISTIC AAACalRegn02Rt02GroupA_Dummy.HysCmpOutpLim.Val /end REF_CHARACTERISTIC /begin REF_MEASUREMENT /end REF_MEASUREMENT /end GROUP
/begin GROUP AAACalRegn02Rt02GroupA_Dummy.HysCmpRevGain.Val "MICROSAR RTE" /begin SUB_GROUP /end SUB_GROUP /begin FUNCTION_LIST /end FUNCTION_LIST /begin REF_CHARACTERISTIC AAACalRegn02Rt02GroupA_Dummy.HysCmpRevGain.Val /end REF_CHARACTERISTIC /begin REF_MEASUREMENT /end REF_MEASUREMENT /end GROUP
/begin GROUP AAACalRegn02Rt02GroupA_Dummy.HysCmpRiseX.Ary1D "MICROSAR RTE" /begin SUB_GROUP /end SUB_GROUP /begin FUNCTION_LIST /end FUNCTION_LIST /begin REF_CHARACTERISTIC AAACalRegn02Rt02GroupA_Dummy.HysCmpRiseX.Ary1D /end REF_CHARACTERISTIC /begin REF_MEASUREMENT /end REF_MEASUREMENT /end GROUP
/begin GROUP AAACalRegn02Rt02GroupA_Dummy.HysCmpRiseY.Ary1D "MICROSAR RTE" /begin SUB_GROUP /end SUB_GROUP /begin FUNCTION_LIST /end FUNCTION_LIST /begin REF_CHARACTERISTIC AAACalRegn02Rt02GroupA_Dummy.HysCmpRiseY.Ary1D /end REF_CHARACTERISTIC /begin REF_MEASUREMENT /end REF_MEASUREMENT /end GROUP
/begin GROUP AAACalRegn02Rt02GroupA_Dummy.InertiaCmpVelAssiBasdDampgStatY.Ary1D "MICROSAR RTE" /begin SUB_GROUP /end SUB_GROUP /begin FUNCTION_LIST /end FUNCTION_LIST
 /begin REF_CHARACTERISTIC AAACalRegn02Rt02GroupA_Dummy.InertiaCmpVelAssiBasdDampgStatY.Ary1D /end REF_CHARACTERISTIC
 /begin REF_MEASUREMENT /end REF_MEASUREMENT
/end GROUP
/begin GROUP AAACalRegn02Rt02GroupA_Dummy.InertiaCmpVelDampgFilFrq.Ary1D "MICROSAR RTE" /begin SUB_GROUP /end SUB_GROUP /begin FUNCTION_LIST /end FUNCTION_LIST
 /begin REF_CHARACTERISTIC AAACalRegn02Rt02GroupA_Dummy.InertiaCmpVelDampgFilFrq.Ary1D /end REF_CHARACTERISTIC
 /begin REF_MEASUREMENT /end REF_MEASUREMENT
/end GROUP
/begin GROUP AAACalRegn02Rt02GroupA_Dummy.InertiaCmpVelDampgFilFrqWhlImbRejctnOn.Ary1D "MICROSAR RTE" /begin SUB_GROUP /end SUB_GROUP /begin FUNCTION_LIST /end FUNCTION_LIST
 /begin REF_CHARACTERISTIC AAACalRegn02Rt02GroupA_Dummy.InertiaCmpVelDampgFilFrqWhlImbRejctnOn.Ary1D /end REF_CHARACTERISTIC
 /begin REF_MEASUREMENT /end REF_MEASUREMENT
/end GROUP
/begin GROUP AAACalRegn02Rt02GroupA_Dummy.InertiaCmpVelDampgSpdBlndY.Ary1D "MICROSAR RTE" /begin SUB_GROUP /end SUB_GROUP /begin FUNCTION_LIST /end FUNCTION_LIST
 /begin REF_CHARACTERISTIC AAACalRegn02Rt02GroupA_Dummy.InertiaCmpVelDampgSpdBlndY.Ary1D /end REF_CHARACTERISTIC
 /begin REF_MEASUREMENT /end REF_MEASUREMENT
/end GROUP
/begin GROUP AAACalRegn02Rt02GroupA_Dummy.InertiaCmpVelDampgWhlImbRejctnBlndX.Ary1D "MICROSAR RTE" /begin SUB_GROUP /end SUB_GROUP /begin FUNCTION_LIST /end FUNCTION_LIST
 /begin REF_CHARACTERISTIC AAACalRegn02Rt02GroupA_Dummy.InertiaCmpVelDampgWhlImbRejctnBlndX.Ary1D /end REF_CHARACTERISTIC
 /begin REF_MEASUREMENT /end REF_MEASUREMENT
/end GROUP
/begin GROUP AAACalRegn02Rt02GroupA_Dummy.InertiaCmpVelDampgWhlImbRejctnBlndY.Ary1D "MICROSAR RTE" /begin SUB_GROUP /end SUB_GROUP /begin FUNCTION_LIST /end FUNCTION_LIST
 /begin REF_CHARACTERISTIC AAACalRegn02Rt02GroupA_Dummy.InertiaCmpVelDampgWhlImbRejctnBlndY.Ary1D /end REF_CHARACTERISTIC
 /begin REF_MEASUREMENT /end REF_MEASUREMENT
/end GROUP
/begin GROUP AAACalRegn02Rt02GroupB_Dummy "MICROSAR RTE" /begin SUB_GROUP AAACalRegn02Rt02GroupB_Dummy.CalibrationPorts /end SUB_GROUP /begin FUNCTION_LIST /end FUNCTION_LIST /begin REF_CHARACTERISTIC /end REF_CHARACTERISTIC /begin REF_MEASUREMENT /end REF_MEASUREMENT /end GROUP
/begin GROUP AAACalRegn02Rt02GroupB_Dummy.CalibrationPorts "MICROSAR RTE"
 /begin SUB_GROUP AAACalRegn02Rt02GroupB_Dummy.EotProtnDampgVehSpdTbl.Ary1D AAACalRegn02Rt02GroupB_Dummy.EotProtnDeltaTqThd.Val AAACalRegn02Rt02GroupB_Dummy.EotProtnEntrGainVehSpdTbl.Ary1D AAACalRegn02Rt02GroupB_Dummy.EotProtnEntrGainY.Ary2D AAACalRegn02Rt02GroupB_Dummy.EotProtnLoAuthyEntrGainY.Ary2D AAACalRegn02Rt02GroupB_Dummy.EotProtnMotSpdIncptY.Ary1D AAACalRegn02Rt02GroupB_Dummy.EotProtnNormDampgY.Ary2D AAACalRegn02Rt02GroupB_Dummy.EotProtnSoftEndStopAuthyThd.Val AAACalRegn02Rt02GroupB_Dummy.RtnHwAgOffsCalcdX.Ary2D AAACalRegn02Rt02GroupB_Dummy.RtnHwAgOffsCalcdY.Ary2D AAACalRegn02Rt02GroupB_Dummy.RtnScaTqX.Ary2D AAACalRegn02Rt02GroupB_Dummy.RtnScaTqY.Ary2D AAACalRegn02Rt02GroupB_Dummy.RtnScaVelX.Ary2D AAACalRegn02Rt02GroupB_Dummy.RtnScaVelY.Ary2D AAACalRegn02Rt02GroupB_Dummy.RtnVehSpdSeln.Ary1D /end SUB_GROUP
 /begin FUNCTION_LIST /end FUNCTION_LIST
 /begin REF_CHARACTERISTIC /end REF_CHARACTERISTIC
 /begin REF_MEASUREMENT /end REF_MEASUREMENT
/end GROUP
/begin GROUP AAACalRegn02Rt02GroupB_Dummy.EotProtnDampgVehSpdTbl.Ary1D "MICROSAR RTE" /begin SUB_GROUP /end SUB_GROUP /begin FUNCTION_LIST /end FUNCTION_LIST /begin REF_CHARACTERISTIC AAACalRegn02Rt02GroupB_Dummy.EotProtnDampgVehSpdTbl.Ary1D /end REF_CHARACTERISTIC /begin REF_MEASUREMENT /end REF_MEASUREMENT /end GROUP
/begin GROUP AAACalRegn02Rt02GroupB_Dummy.EotProtnDeltaTqThd.Val "MICROSAR RTE" /begin SUB_GROUP /end SUB_GROUP /begin FUNCTION_LIST /end FUNCTION_LIST /begin REF_CHARACTERISTIC AAACalRegn02Rt02GroupB_Dummy.EotProtnDeltaTqThd.Val /end REF_CHARACTERISTIC /begin REF_MEASUREMENT /end REF_MEASUREMENT /end GROUP
/begin GROUP AAACalRegn02Rt02GroupB_Dummy.EotProtnEntrGainVehSpdTbl.Ary1D "MICROSAR RTE" /begin SUB_GROUP /end SUB_GROUP /begin FUNCTION_LIST /end FUNCTION_LIST
 /begin REF_CHARACTERISTIC AAACalRegn02Rt02GroupB_Dummy.EotProtnEntrGainVehSpdTbl.Ary1D /end REF_CHARACTERISTIC
 /begin REF_MEASUREMENT /end REF_MEASUREMENT
/end GROUP
/begin GROUP AAACalRegn02Rt02GroupB_Dummy.EotProtnEntrGainY.Ary2D "MICROSAR RTE" /begin SUB_GROUP /end SUB_GROUP /begin FUNCTION_LIST /end FUNCTION_LIST /begin REF_CHARACTERISTIC AAACalRegn02Rt02GroupB_Dummy.EotProtnEntrGainY.Ary2D /end REF_CHARACTERISTIC /begin REF_MEASUREMENT /end REF_MEASUREMENT /end GROUP
/begin GROUP AAACalRegn02Rt02GroupB_Dummy.EotProtnLoAuthyEntrGainY.Ary2D "MICROSAR RTE" /begin SUB_GROUP /end SUB_GROUP /begin FUNCTION_LIST /end FUNCTION_LIST
 /begin REF_CHARACTERISTIC AAACalRegn02Rt02GroupB_Dummy.EotProtnLoAuthyEntrGainY.Ary2D /end REF_CHARACTERISTIC
 /begin REF_MEASUREMENT /end REF_MEASUREMENT
/end GROUP
/begin GROUP AAACalRegn02Rt02GroupB_Dummy.EotProtnMotSpdIncptY.Ary1D "MICROSAR RTE" /begin SUB_GROUP /end SUB_GROUP /begin FUNCTION_LIST /end FUNCTION_LIST /begin REF_CHARACTERISTIC AAACalRegn02Rt02GroupB_Dummy.EotProtnMotSpdIncptY.Ary1D /end REF_CHARACTERISTIC /begin REF_MEASUREMENT /end REF_MEASUREMENT /end GROUP
/begin GROUP AAACalRegn02Rt02GroupB_Dummy.EotProtnNormDampgY.Ary2D "MICROSAR RTE" /begin SUB_GROUP /end SUB_GROUP /begin FUNCTION_LIST /end FUNCTION_LIST /begin REF_CHARACTERISTIC AAACalRegn02Rt02GroupB_Dummy.EotProtnNormDampgY.Ary2D /end REF_CHARACTERISTIC /begin REF_MEASUREMENT /end REF_MEASUREMENT /end GROUP
/begin GROUP AAACalRegn02Rt02GroupB_Dummy.EotProtnSoftEndStopAuthyThd.Val "MICROSAR RTE" /begin SUB_GROUP /end SUB_GROUP /begin FUNCTION_LIST /end FUNCTION_LIST
 /begin REF_CHARACTERISTIC AAACalRegn02Rt02GroupB_Dummy.EotProtnSoftEndStopAuthyThd.Val /end REF_CHARACTERISTIC
 /begin REF_MEASUREMENT /end REF_MEASUREMENT
/end GROUP
/begin GROUP AAACalRegn02Rt02GroupB_Dummy.RtnHwAgOffsCalcdX.Ary2D "MICROSAR RTE" /begin SUB_GROUP /end SUB_GROUP /begin FUNCTION_LIST /end FUNCTION_LIST /begin REF_CHARACTERISTIC AAACalRegn02Rt02GroupB_Dummy.RtnHwAgOffsCalcdX.Ary2D /end REF_CHARACTERISTIC /begin REF_MEASUREMENT /end REF_MEASUREMENT /end GROUP
/begin GROUP AAACalRegn02Rt02GroupB_Dummy.RtnHwAgOffsCalcdY.Ary2D "MICROSAR RTE" /begin SUB_GROUP /end SUB_GROUP /begin FUNCTION_LIST /end FUNCTION_LIST /begin REF_CHARACTERISTIC AAACalRegn02Rt02GroupB_Dummy.RtnHwAgOffsCalcdY.Ary2D /end REF_CHARACTERISTIC /begin REF_MEASUREMENT /end REF_MEASUREMENT /end GROUP
/begin GROUP AAACalRegn02Rt02GroupB_Dummy.RtnScaTqX.Ary2D "MICROSAR RTE" /begin SUB_GROUP /end SUB_GROUP /begin FUNCTION_LIST /end FUNCTION_LIST /begin REF_CHARACTERISTIC AAACalRegn02Rt02GroupB_Dummy.RtnScaTqX.Ary2D /end REF_CHARACTERISTIC /begin REF_MEASUREMENT /end REF_MEASUREMENT /end GROUP
/begin GROUP AAACalRegn02Rt02GroupB_Dummy.RtnScaTqY.Ary2D "MICROSAR RTE" /begin SUB_GROUP /end SUB_GROUP /begin FUNCTION_LIST /end FUNCTION_LIST /begin REF_CHARACTERISTIC AAACalRegn02Rt02GroupB_Dummy.RtnScaTqY.Ary2D /end REF_CHARACTERISTIC /begin REF_MEASUREMENT /end REF_MEASUREMENT /end GROUP
/begin GROUP AAACalRegn02Rt02GroupB_Dummy.RtnScaVelX.Ary2D "MICROSAR RTE" /begin SUB_GROUP /end SUB_GROUP /begin FUNCTION_LIST /end FUNCTION_LIST /begin REF_CHARACTERISTIC AAACalRegn02Rt02GroupB_Dummy.RtnScaVelX.Ary2D /end REF_CHARACTERISTIC /begin REF_MEASUREMENT /end REF_MEASUREMENT /end GROUP
/begin GROUP AAACalRegn02Rt02GroupB_Dummy.RtnScaVelY.Ary2D "MICROSAR RTE" /begin SUB_GROUP /end SUB_GROUP /begin FUNCTION_LIST /end FUNCTION_LIST /begin REF_CHARACTERISTIC AAACalRegn02Rt02GroupB_Dummy.RtnScaVelY.Ary2D /end REF_CHARACTERISTIC /begin REF_MEASUREMENT /end REF_MEASUREMENT /end GROUP
/begin GROUP AAACalRegn02Rt02GroupB_Dummy.RtnVehSpdSeln.Ary1D "MICROSAR RTE" /begin SUB_GROUP /end SUB_GROUP /begin FUNCTION_LIST /end FUNCTION_LIST /begin REF_CHARACTERISTIC AAACalRegn02Rt02GroupB_Dummy.RtnVehSpdSeln.Ary1D /end REF_CHARACTERISTIC /begin REF_MEASUREMENT /end REF_MEASUREMENT /end GROUP
/begin GROUP AAACalRegn02Rt03GroupA_Dummy "MICROSAR RTE" /begin SUB_GROUP AAACalRegn02Rt03GroupA_Dummy.CalibrationPorts /end SUB_GROUP /begin FUNCTION_LIST /end FUNCTION_LIST /begin REF_CHARACTERISTIC /end REF_CHARACTERISTIC /begin REF_MEASUREMENT /end REF_MEASUREMENT /end GROUP
/begin GROUP AAACalRegn02Rt03GroupA_Dummy.AssiHiFrqGainY.Ary2D "MICROSAR RTE" /begin SUB_GROUP /end SUB_GROUP /begin FUNCTION_LIST /end FUNCTION_LIST /begin REF_CHARACTERISTIC AAACalRegn02Rt03GroupA_Dummy.AssiHiFrqGainY.Ary2D /end REF_CHARACTERISTIC /begin REF_MEASUREMENT /end REF_MEASUREMENT /end GROUP
/begin GROUP AAACalRegn02Rt03GroupA_Dummy.AssiHiFrqHpFilFrqY.Ary1D "MICROSAR RTE" /begin SUB_GROUP /end SUB_GROUP /begin FUNCTION_LIST /end FUNCTION_LIST /begin REF_CHARACTERISTIC AAACalRegn02Rt03GroupA_Dummy.AssiHiFrqHpFilFrqY.Ary1D /end REF_CHARACTERISTIC /begin REF_MEASUREMENT /end REF_MEASUREMENT /end GROUP
/begin GROUP AAACalRegn02Rt03GroupA_Dummy.AssiHiFrqTqWhlImbRejctnTqX.Ary2D "MICROSAR RTE" /begin SUB_GROUP /end SUB_GROUP /begin FUNCTION_LIST /end FUNCTION_LIST
 /begin REF_CHARACTERISTIC AAACalRegn02Rt03GroupA_Dummy.AssiHiFrqTqWhlImbRejctnTqX.Ary2D /end REF_CHARACTERISTIC
 /begin REF_MEASUREMENT /end REF_MEASUREMENT
/end GROUP
/begin GROUP AAACalRegn02Rt03GroupA_Dummy.AssiHiFrqTqX.Ary2D "MICROSAR RTE" /begin SUB_GROUP /end SUB_GROUP /begin FUNCTION_LIST /end FUNCTION_LIST /begin REF_CHARACTERISTIC AAACalRegn02Rt03GroupA_Dummy.AssiHiFrqTqX.Ary2D /end REF_CHARACTERISTIC /begin REF_MEASUREMENT /end REF_MEASUREMENT /end GROUP
/begin GROUP AAACalRegn02Rt03GroupA_Dummy.AssiHiFrqWhlImbRejctnBlndX.Ary2D "MICROSAR RTE" /begin SUB_GROUP /end SUB_GROUP /begin FUNCTION_LIST /end FUNCTION_LIST
 /begin REF_CHARACTERISTIC AAACalRegn02Rt03GroupA_Dummy.AssiHiFrqWhlImbRejctnBlndX.Ary2D /end REF_CHARACTERISTIC
 /begin REF_MEASUREMENT /end REF_MEASUREMENT
/end GROUP
/begin GROUP AAACalRegn02Rt03GroupA_Dummy.AssiHiFrqWhlImbRejctnBlndY.Ary2D "MICROSAR RTE" /begin SUB_GROUP /end SUB_GROUP /begin FUNCTION_LIST /end FUNCTION_LIST
 /begin REF_CHARACTERISTIC AAACalRegn02Rt03GroupA_Dummy.AssiHiFrqWhlImbRejctnBlndY.Ary2D /end REF_CHARACTERISTIC
 /begin REF_MEASUREMENT /end REF_MEASUREMENT
/end GROUP
/begin GROUP AAACalRegn02Rt03GroupA_Dummy.AssiHiFrqWhlImbRejctnGainY.Ary2D "MICROSAR RTE" /begin SUB_GROUP /end SUB_GROUP /begin FUNCTION_LIST /end FUNCTION_LIST
 /begin REF_CHARACTERISTIC AAACalRegn02Rt03GroupA_Dummy.AssiHiFrqWhlImbRejctnGainY.Ary2D /end REF_CHARACTERISTIC
 /begin REF_MEASUREMENT /end REF_MEASUREMENT
/end GROUP
/begin GROUP AAACalRegn02Rt03GroupA_Dummy.AssiMotTqWhlImbRejctnMaxX.Ary2D "MICROSAR RTE" /begin SUB_GROUP /end SUB_GROUP /begin FUNCTION_LIST /end FUNCTION_LIST
 /begin REF_CHARACTERISTIC AAACalRegn02Rt03GroupA_Dummy.AssiMotTqWhlImbRejctnMaxX.Ary2D /end REF_CHARACTERISTIC
 /begin REF_MEASUREMENT /end REF_MEASUREMENT
/end GROUP
/begin GROUP AAACalRegn02Rt03GroupA_Dummy.AssiMotTqWhlImbRejctnMaxY.Ary2D "MICROSAR RTE" /begin SUB_GROUP /end SUB_GROUP /begin FUNCTION_LIST /end FUNCTION_LIST
 /begin REF_CHARACTERISTIC AAACalRegn02Rt03GroupA_Dummy.AssiMotTqWhlImbRejctnMaxY.Ary2D /end REF_CHARACTERISTIC
 /begin REF_MEASUREMENT /end REF_MEASUREMENT
/end GROUP
/begin GROUP AAACalRegn02Rt03GroupA_Dummy.AssiMotTqWhlImbRejctnMinX.Ary2D "MICROSAR RTE" /begin SUB_GROUP /end SUB_GROUP /begin FUNCTION_LIST /end FUNCTION_LIST
 /begin REF_CHARACTERISTIC AAACalRegn02Rt03GroupA_Dummy.AssiMotTqWhlImbRejctnMinX.Ary2D /end REF_CHARACTERISTIC
 /begin REF_MEASUREMENT /end REF_MEASUREMENT
/end GROUP
/begin GROUP AAACalRegn02Rt03GroupA_Dummy.AssiMotTqWhlImbRejctnMinY.Ary2D "MICROSAR RTE" /begin SUB_GROUP /end SUB_GROUP /begin FUNCTION_LIST /end FUNCTION_LIST
 /begin REF_CHARACTERISTIC AAACalRegn02Rt03GroupA_Dummy.AssiMotTqWhlImbRejctnMinY.Ary2D /end REF_CHARACTERISTIC
 /begin REF_MEASUREMENT /end REF_MEASUREMENT
/end GROUP
/begin GROUP AAACalRegn02Rt03GroupA_Dummy.AssiWhlImbRejctnBlndScaX.Ary2D "MICROSAR RTE" /begin SUB_GROUP /end SUB_GROUP /begin FUNCTION_LIST /end FUNCTION_LIST
 /begin REF_CHARACTERISTIC AAACalRegn02Rt03GroupA_Dummy.AssiWhlImbRejctnBlndScaX.Ary2D /end REF_CHARACTERISTIC
 /begin REF_MEASUREMENT /end REF_MEASUREMENT
/end GROUP
/begin GROUP AAACalRegn02Rt03GroupA_Dummy.AssiWhlImbRejctnBlndScaY.Ary2D "MICROSAR RTE" /begin SUB_GROUP /end SUB_GROUP /begin FUNCTION_LIST /end FUNCTION_LIST
 /begin REF_CHARACTERISTIC AAACalRegn02Rt03GroupA_Dummy.AssiWhlImbRejctnBlndScaY.Ary2D /end REF_CHARACTERISTIC
 /begin REF_MEASUREMENT /end REF_MEASUREMENT
/end GROUP
/begin GROUP AAACalRegn02Rt03GroupA_Dummy.CalibrationPorts "MICROSAR RTE"
 /begin SUB_GROUP AAACalRegn02Rt03GroupA_Dummy.AssiHiFrqGainY.Ary2D AAACalRegn02Rt03GroupA_Dummy.AssiHiFrqHpFilFrqY.Ary1D AAACalRegn02Rt03GroupA_Dummy.AssiHiFrqTqWhlImbRejctnTqX.Ary2D AAACalRegn02Rt03GroupA_Dummy.AssiHiFrqTqX.Ary2D AAACalRegn02Rt03GroupA_Dummy.AssiHiFrqWhlImbRejctnBlndX.Ary2D AAACalRegn02Rt03GroupA_Dummy.AssiHiFrqWhlImbRejctnBlndY.Ary2D AAACalRegn02Rt03GroupA_Dummy.AssiHiFrqWhlImbRejctnGainY.Ary2D AAACalRegn02Rt03GroupA_Dummy.AssiMotTqWhlImbRejctnMaxX.Ary2D AAACalRegn02Rt03GroupA_Dummy.AssiMotTqWhlImbRejctnMaxY.Ary2D AAACalRegn02Rt03GroupA_Dummy.AssiMotTqWhlImbRejctnMinX.Ary2D AAACalRegn02Rt03GroupA_Dummy.AssiMotTqWhlImbRejctnMinY.Ary2D AAACalRegn02Rt03GroupA_Dummy.AssiWhlImbRejctnBlndScaX.Ary2D AAACalRegn02Rt03GroupA_Dummy.AssiWhlImbRejctnBlndScaY.Ary2D AAACalRegn02Rt03GroupA_Dummy.DampgHwTqX.Ary1D AAACalRegn02Rt03GroupA_Dummy.DampgHwTqY.Ary1D AAACalRegn02Rt03GroupA_Dummy.DampgHydCoeff1ScaY.Ary1D AAACalRegn02Rt03GroupA_Dummy.DampgHydCoeff2ScaY.Ary1D AAACalRegn02Rt03GroupA_Dummy.DampgHydCoeff3ScaY.Ary1D AAACalRegn02Rt03GroupA_Dummy.DampgHydCoeff4ScaY.Ary1D AAACalRegn02Rt03GroupA_Dummy.DampgMotVelX.Ary2D AAACalRegn02Rt03GroupA_Dummy.DampgMotVelY.Ary2D AAACalRegn02Rt03GroupA_Dummy.HysCmpEffLossY.Ary1D AAACalRegn02Rt03GroupA_Dummy.HysCmpEffOffsY.Ary1D AAACalRegn02Rt03GroupA_Dummy.HysCmpFricWhlImbRejctnBlndX.Ary1D AAACalRegn02Rt03GroupA_Dummy.HysCmpFricWhlImbRejctnBlndY.Ary1D AAACalRegn02Rt03GroupA_Dummy.HysCmpFricWhlImbRejctnOffY.Ary1D AAACalRegn02Rt03GroupA_Dummy.HysCmpFricWhlImbRejctnOnY.Ary1D AAACalRegn02Rt03GroupA_Dummy.HysCmpHwTqScaX.Ary2D AAACalRegn02Rt03GroupA_Dummy.HysCmpHwTqScaY.Ary2D AAACalRegn02Rt03GroupA_Dummy.HysCmpHysSatnY.Ary1D AAACalRegn02Rt03GroupA_Dummy.HysCmpNegHysCmpScaX.Ary1D AAACalRegn02Rt03GroupA_Dummy.HysCmpNegHysCmpScaY.Ary1D AAACalRegn02Rt03GroupA_Dummy.HysCmpNegHysCmpX.Ary1D AAACalRegn02Rt03GroupA_Dummy.HysCmpNegHysCmpY.Ary1D AAACalRegn02Rt03GroupA_Dummy.HysCmpOutpLim.Val AAACalRegn02Rt03GroupA_Dummy.HysCmpRevGain.Val AAACalRegn02Rt03GroupA_Dummy.HysCmpRiseX.Ary1D AAACalRegn02Rt03GroupA_Dummy.HysCmpRiseY.Ary1D AAACalRegn02Rt03GroupA_Dummy.InertiaCmpVelAssiBasdDampgStatY.Ary1D AAACalRegn02Rt03GroupA_Dummy.InertiaCmpVelDampgFilFrq.Ary1D AAACalRegn02Rt03GroupA_Dummy.InertiaCmpVelDampgFilFrqWhlImbRejctnOn.Ary1D AAACalRegn02Rt03GroupA_Dummy.InertiaCmpVelDampgSpdBlndY.Ary1D AAACalRegn02Rt03GroupA_Dummy.InertiaCmpVelDampgWhlImbRejctnBlndX.Ary1D AAACalRegn02Rt03GroupA_Dummy.InertiaCmpVelDampgWhlImbRejctnBlndY.Ary1D /end SUB_GROUP
 /begin FUNCTION_LIST /end FUNCTION_LIST
 /begin REF_CHARACTERISTIC /end REF_CHARACTERISTIC
 /begin REF_MEASUREMENT /end REF_MEASUREMENT
/end GROUP
/begin GROUP AAACalRegn02Rt03GroupA_Dummy.DampgHwTqX.Ary1D "MICROSAR RTE" /begin SUB_GROUP /end SUB_GROUP /begin FUNCTION_LIST /end FUNCTION_LIST /begin REF_CHARACTERISTIC AAACalRegn02Rt03GroupA_Dummy.DampgHwTqX.Ary1D /end REF_CHARACTERISTIC /begin REF_MEASUREMENT /end REF_MEASUREMENT /end GROUP
/begin GROUP AAACalRegn02Rt03GroupA_Dummy.DampgHwTqY.Ary1D "MICROSAR RTE" /begin SUB_GROUP /end SUB_GROUP /begin FUNCTION_LIST /end FUNCTION_LIST /begin REF_CHARACTERISTIC AAACalRegn02Rt03GroupA_Dummy.DampgHwTqY.Ary1D /end REF_CHARACTERISTIC /begin REF_MEASUREMENT /end REF_MEASUREMENT /end GROUP
/begin GROUP AAACalRegn02Rt03GroupA_Dummy.DampgHydCoeff1ScaY.Ary1D "MICROSAR RTE" /begin SUB_GROUP /end SUB_GROUP /begin FUNCTION_LIST /end FUNCTION_LIST /begin REF_CHARACTERISTIC AAACalRegn02Rt03GroupA_Dummy.DampgHydCoeff1ScaY.Ary1D /end REF_CHARACTERISTIC /begin REF_MEASUREMENT /end REF_MEASUREMENT /end GROUP
/begin GROUP AAACalRegn02Rt03GroupA_Dummy.DampgHydCoeff2ScaY.Ary1D "MICROSAR RTE" /begin SUB_GROUP /end SUB_GROUP /begin FUNCTION_LIST /end FUNCTION_LIST /begin REF_CHARACTERISTIC AAACalRegn02Rt03GroupA_Dummy.DampgHydCoeff2ScaY.Ary1D /end REF_CHARACTERISTIC /begin REF_MEASUREMENT /end REF_MEASUREMENT /end GROUP
/begin GROUP AAACalRegn02Rt03GroupA_Dummy.DampgHydCoeff3ScaY.Ary1D "MICROSAR RTE" /begin SUB_GROUP /end SUB_GROUP /begin FUNCTION_LIST /end FUNCTION_LIST /begin REF_CHARACTERISTIC AAACalRegn02Rt03GroupA_Dummy.DampgHydCoeff3ScaY.Ary1D /end REF_CHARACTERISTIC /begin REF_MEASUREMENT /end REF_MEASUREMENT /end GROUP
/begin GROUP AAACalRegn02Rt03GroupA_Dummy.DampgHydCoeff4ScaY.Ary1D "MICROSAR RTE" /begin SUB_GROUP /end SUB_GROUP /begin FUNCTION_LIST /end FUNCTION_LIST /begin REF_CHARACTERISTIC AAACalRegn02Rt03GroupA_Dummy.DampgHydCoeff4ScaY.Ary1D /end REF_CHARACTERISTIC /begin REF_MEASUREMENT /end REF_MEASUREMENT /end GROUP
/begin GROUP AAACalRegn02Rt03GroupA_Dummy.DampgMotVelX.Ary2D "MICROSAR RTE" /begin SUB_GROUP /end SUB_GROUP /begin FUNCTION_LIST /end FUNCTION_LIST /begin REF_CHARACTERISTIC AAACalRegn02Rt03GroupA_Dummy.DampgMotVelX.Ary2D /end REF_CHARACTERISTIC /begin REF_MEASUREMENT /end REF_MEASUREMENT /end GROUP
/begin GROUP AAACalRegn02Rt03GroupA_Dummy.DampgMotVelY.Ary2D "MICROSAR RTE" /begin SUB_GROUP /end SUB_GROUP /begin FUNCTION_LIST /end FUNCTION_LIST /begin REF_CHARACTERISTIC AAACalRegn02Rt03GroupA_Dummy.DampgMotVelY.Ary2D /end REF_CHARACTERISTIC /begin REF_MEASUREMENT /end REF_MEASUREMENT /end GROUP
/begin GROUP AAACalRegn02Rt03GroupA_Dummy.HysCmpEffLossY.Ary1D "MICROSAR RTE" /begin SUB_GROUP /end SUB_GROUP /begin FUNCTION_LIST /end FUNCTION_LIST /begin REF_CHARACTERISTIC AAACalRegn02Rt03GroupA_Dummy.HysCmpEffLossY.Ary1D /end REF_CHARACTERISTIC /begin REF_MEASUREMENT /end REF_MEASUREMENT /end GROUP
/begin GROUP AAACalRegn02Rt03GroupA_Dummy.HysCmpEffOffsY.Ary1D "MICROSAR RTE" /begin SUB_GROUP /end SUB_GROUP /begin FUNCTION_LIST /end FUNCTION_LIST /begin REF_CHARACTERISTIC AAACalRegn02Rt03GroupA_Dummy.HysCmpEffOffsY.Ary1D /end REF_CHARACTERISTIC /begin REF_MEASUREMENT /end REF_MEASUREMENT /end GROUP
/begin GROUP AAACalRegn02Rt03GroupA_Dummy.HysCmpFricWhlImbRejctnBlndX.Ary1D "MICROSAR RTE" /begin SUB_GROUP /end SUB_GROUP /begin FUNCTION_LIST /end FUNCTION_LIST
 /begin REF_CHARACTERISTIC AAACalRegn02Rt03GroupA_Dummy.HysCmpFricWhlImbRejctnBlndX.Ary1D /end REF_CHARACTERISTIC
 /begin REF_MEASUREMENT /end REF_MEASUREMENT
/end GROUP
/begin GROUP AAACalRegn02Rt03GroupA_Dummy.HysCmpFricWhlImbRejctnBlndY.Ary1D "MICROSAR RTE" /begin SUB_GROUP /end SUB_GROUP /begin FUNCTION_LIST /end FUNCTION_LIST
 /begin REF_CHARACTERISTIC AAACalRegn02Rt03GroupA_Dummy.HysCmpFricWhlImbRejctnBlndY.Ary1D /end REF_CHARACTERISTIC
 /begin REF_MEASUREMENT /end REF_MEASUREMENT
/end GROUP
/begin GROUP AAACalRegn02Rt03GroupA_Dummy.HysCmpFricWhlImbRejctnOffY.Ary1D "MICROSAR RTE" /begin SUB_GROUP /end SUB_GROUP /begin FUNCTION_LIST /end FUNCTION_LIST
 /begin REF_CHARACTERISTIC AAACalRegn02Rt03GroupA_Dummy.HysCmpFricWhlImbRejctnOffY.Ary1D /end REF_CHARACTERISTIC
 /begin REF_MEASUREMENT /end REF_MEASUREMENT
/end GROUP
/begin GROUP AAACalRegn02Rt03GroupA_Dummy.HysCmpFricWhlImbRejctnOnY.Ary1D "MICROSAR RTE" /begin SUB_GROUP /end SUB_GROUP /begin FUNCTION_LIST /end FUNCTION_LIST
 /begin REF_CHARACTERISTIC AAACalRegn02Rt03GroupA_Dummy.HysCmpFricWhlImbRejctnOnY.Ary1D /end REF_CHARACTERISTIC
 /begin REF_MEASUREMENT /end REF_MEASUREMENT
/end GROUP
/begin GROUP AAACalRegn02Rt03GroupA_Dummy.HysCmpHwTqScaX.Ary2D "MICROSAR RTE" /begin SUB_GROUP /end SUB_GROUP /begin FUNCTION_LIST /end FUNCTION_LIST /begin REF_CHARACTERISTIC AAACalRegn02Rt03GroupA_Dummy.HysCmpHwTqScaX.Ary2D /end REF_CHARACTERISTIC /begin REF_MEASUREMENT /end REF_MEASUREMENT /end GROUP
/begin GROUP AAACalRegn02Rt03GroupA_Dummy.HysCmpHwTqScaY.Ary2D "MICROSAR RTE" /begin SUB_GROUP /end SUB_GROUP /begin FUNCTION_LIST /end FUNCTION_LIST /begin REF_CHARACTERISTIC AAACalRegn02Rt03GroupA_Dummy.HysCmpHwTqScaY.Ary2D /end REF_CHARACTERISTIC /begin REF_MEASUREMENT /end REF_MEASUREMENT /end GROUP
/begin GROUP AAACalRegn02Rt03GroupA_Dummy.HysCmpHysSatnY.Ary1D "MICROSAR RTE" /begin SUB_GROUP /end SUB_GROUP /begin FUNCTION_LIST /end FUNCTION_LIST /begin REF_CHARACTERISTIC AAACalRegn02Rt03GroupA_Dummy.HysCmpHysSatnY.Ary1D /end REF_CHARACTERISTIC /begin REF_MEASUREMENT /end REF_MEASUREMENT /end GROUP
/begin GROUP AAACalRegn02Rt03GroupA_Dummy.HysCmpNegHysCmpScaX.Ary1D "MICROSAR RTE" /begin SUB_GROUP /end SUB_GROUP /begin FUNCTION_LIST /end FUNCTION_LIST /begin REF_CHARACTERISTIC AAACalRegn02Rt03GroupA_Dummy.HysCmpNegHysCmpScaX.Ary1D /end REF_CHARACTERISTIC /begin REF_MEASUREMENT /end REF_MEASUREMENT /end GROUP
/begin GROUP AAACalRegn02Rt03GroupA_Dummy.HysCmpNegHysCmpScaY.Ary1D "MICROSAR RTE" /begin SUB_GROUP /end SUB_GROUP /begin FUNCTION_LIST /end FUNCTION_LIST /begin REF_CHARACTERISTIC AAACalRegn02Rt03GroupA_Dummy.HysCmpNegHysCmpScaY.Ary1D /end REF_CHARACTERISTIC /begin REF_MEASUREMENT /end REF_MEASUREMENT /end GROUP
/begin GROUP AAACalRegn02Rt03GroupA_Dummy.HysCmpNegHysCmpX.Ary1D "MICROSAR RTE" /begin SUB_GROUP /end SUB_GROUP /begin FUNCTION_LIST /end FUNCTION_LIST /begin REF_CHARACTERISTIC AAACalRegn02Rt03GroupA_Dummy.HysCmpNegHysCmpX.Ary1D /end REF_CHARACTERISTIC /begin REF_MEASUREMENT /end REF_MEASUREMENT /end GROUP
/begin GROUP AAACalRegn02Rt03GroupA_Dummy.HysCmpNegHysCmpY.Ary1D "MICROSAR RTE" /begin SUB_GROUP /end SUB_GROUP /begin FUNCTION_LIST /end FUNCTION_LIST /begin REF_CHARACTERISTIC AAACalRegn02Rt03GroupA_Dummy.HysCmpNegHysCmpY.Ary1D /end REF_CHARACTERISTIC /begin REF_MEASUREMENT /end REF_MEASUREMENT /end GROUP
/begin GROUP AAACalRegn02Rt03GroupA_Dummy.HysCmpOutpLim.Val "MICROSAR RTE" /begin SUB_GROUP /end SUB_GROUP /begin FUNCTION_LIST /end FUNCTION_LIST /begin REF_CHARACTERISTIC AAACalRegn02Rt03GroupA_Dummy.HysCmpOutpLim.Val /end REF_CHARACTERISTIC /begin REF_MEASUREMENT /end REF_MEASUREMENT /end GROUP
/begin GROUP AAACalRegn02Rt03GroupA_Dummy.HysCmpRevGain.Val "MICROSAR RTE" /begin SUB_GROUP /end SUB_GROUP /begin FUNCTION_LIST /end FUNCTION_LIST /begin REF_CHARACTERISTIC AAACalRegn02Rt03GroupA_Dummy.HysCmpRevGain.Val /end REF_CHARACTERISTIC /begin REF_MEASUREMENT /end REF_MEASUREMENT /end GROUP
/begin GROUP AAACalRegn02Rt03GroupA_Dummy.HysCmpRiseX.Ary1D "MICROSAR RTE" /begin SUB_GROUP /end SUB_GROUP /begin FUNCTION_LIST /end FUNCTION_LIST /begin REF_CHARACTERISTIC AAACalRegn02Rt03GroupA_Dummy.HysCmpRiseX.Ary1D /end REF_CHARACTERISTIC /begin REF_MEASUREMENT /end REF_MEASUREMENT /end GROUP
/begin GROUP AAACalRegn02Rt03GroupA_Dummy.HysCmpRiseY.Ary1D "MICROSAR RTE" /begin SUB_GROUP /end SUB_GROUP /begin FUNCTION_LIST /end FUNCTION_LIST /begin REF_CHARACTERISTIC AAACalRegn02Rt03GroupA_Dummy.HysCmpRiseY.Ary1D /end REF_CHARACTERISTIC /begin REF_MEASUREMENT /end REF_MEASUREMENT /end GROUP
/begin GROUP AAACalRegn02Rt03GroupA_Dummy.InertiaCmpVelAssiBasdDampgStatY.Ary1D "MICROSAR RTE" /begin SUB_GROUP /end SUB_GROUP /begin FUNCTION_LIST /end FUNCTION_LIST
 /begin REF_CHARACTERISTIC AAACalRegn02Rt03GroupA_Dummy.InertiaCmpVelAssiBasdDampgStatY.Ary1D /end REF_CHARACTERISTIC
 /begin REF_MEASUREMENT /end REF_MEASUREMENT
/end GROUP
/begin GROUP AAACalRegn02Rt03GroupA_Dummy.InertiaCmpVelDampgFilFrq.Ary1D "MICROSAR RTE" /begin SUB_GROUP /end SUB_GROUP /begin FUNCTION_LIST /end FUNCTION_LIST
 /begin REF_CHARACTERISTIC AAACalRegn02Rt03GroupA_Dummy.InertiaCmpVelDampgFilFrq.Ary1D /end REF_CHARACTERISTIC
 /begin REF_MEASUREMENT /end REF_MEASUREMENT
/end GROUP
/begin GROUP AAACalRegn02Rt03GroupA_Dummy.InertiaCmpVelDampgFilFrqWhlImbRejctnOn.Ary1D "MICROSAR RTE" /begin SUB_GROUP /end SUB_GROUP /begin FUNCTION_LIST /end FUNCTION_LIST
 /begin REF_CHARACTERISTIC AAACalRegn02Rt03GroupA_Dummy.InertiaCmpVelDampgFilFrqWhlImbRejctnOn.Ary1D /end REF_CHARACTERISTIC
 /begin REF_MEASUREMENT /end REF_MEASUREMENT
/end GROUP
/begin GROUP AAACalRegn02Rt03GroupA_Dummy.InertiaCmpVelDampgSpdBlndY.Ary1D "MICROSAR RTE" /begin SUB_GROUP /end SUB_GROUP /begin FUNCTION_LIST /end FUNCTION_LIST
 /begin REF_CHARACTERISTIC AAACalRegn02Rt03GroupA_Dummy.InertiaCmpVelDampgSpdBlndY.Ary1D /end REF_CHARACTERISTIC
 /begin REF_MEASUREMENT /end REF_MEASUREMENT
/end GROUP
/begin GROUP AAACalRegn02Rt03GroupA_Dummy.InertiaCmpVelDampgWhlImbRejctnBlndX.Ary1D "MICROSAR RTE" /begin SUB_GROUP /end SUB_GROUP /begin FUNCTION_LIST /end FUNCTION_LIST
 /begin REF_CHARACTERISTIC AAACalRegn02Rt03GroupA_Dummy.InertiaCmpVelDampgWhlImbRejctnBlndX.Ary1D /end REF_CHARACTERISTIC
 /begin REF_MEASUREMENT /end REF_MEASUREMENT
/end GROUP
/begin GROUP AAACalRegn02Rt03GroupA_Dummy.InertiaCmpVelDampgWhlImbRejctnBlndY.Ary1D "MICROSAR RTE" /begin SUB_GROUP /end SUB_GROUP /begin FUNCTION_LIST /end FUNCTION_LIST
 /begin REF_CHARACTERISTIC AAACalRegn02Rt03GroupA_Dummy.InertiaCmpVelDampgWhlImbRejctnBlndY.Ary1D /end REF_CHARACTERISTIC
 /begin REF_MEASUREMENT /end REF_MEASUREMENT
/end GROUP
/begin GROUP AAACalRegn02Rt03GroupB_Dummy "MICROSAR RTE" /begin SUB_GROUP AAACalRegn02Rt03GroupB_Dummy.CalibrationPorts /end SUB_GROUP /begin FUNCTION_LIST /end FUNCTION_LIST /begin REF_CHARACTERISTIC /end REF_CHARACTERISTIC /begin REF_MEASUREMENT /end REF_MEASUREMENT /end GROUP
/begin GROUP AAACalRegn02Rt03GroupB_Dummy.CalibrationPorts "MICROSAR RTE"
 /begin SUB_GROUP AAACalRegn02Rt03GroupB_Dummy.EotProtnDampgVehSpdTbl.Ary1D AAACalRegn02Rt03GroupB_Dummy.EotProtnDeltaTqThd.Val AAACalRegn02Rt03GroupB_Dummy.EotProtnEntrGainVehSpdTbl.Ary1D AAACalRegn02Rt03GroupB_Dummy.EotProtnEntrGainY.Ary2D AAACalRegn02Rt03GroupB_Dummy.EotProtnLoAuthyEntrGainY.Ary2D AAACalRegn02Rt03GroupB_Dummy.EotProtnMotSpdIncptY.Ary1D AAACalRegn02Rt03GroupB_Dummy.EotProtnNormDampgY.Ary2D AAACalRegn02Rt03GroupB_Dummy.EotProtnSoftEndStopAuthyThd.Val AAACalRegn02Rt03GroupB_Dummy.RtnHwAgOffsCalcdX.Ary2D AAACalRegn02Rt03GroupB_Dummy.RtnHwAgOffsCalcdY.Ary2D AAACalRegn02Rt03GroupB_Dummy.RtnScaTqX.Ary2D AAACalRegn02Rt03GroupB_Dummy.RtnScaTqY.Ary2D AAACalRegn02Rt03GroupB_Dummy.RtnScaVelX.Ary2D AAACalRegn02Rt03GroupB_Dummy.RtnScaVelY.Ary2D AAACalRegn02Rt03GroupB_Dummy.RtnVehSpdSeln.Ary1D /end SUB_GROUP
 /begin FUNCTION_LIST /end FUNCTION_LIST
 /begin REF_CHARACTERISTIC /end REF_CHARACTERISTIC
 /begin REF_MEASUREMENT /end REF_MEASUREMENT
/end GROUP
/begin GROUP AAACalRegn02Rt03GroupB_Dummy.EotProtnDampgVehSpdTbl.Ary1D "MICROSAR RTE" /begin SUB_GROUP /end SUB_GROUP /begin FUNCTION_LIST /end FUNCTION_LIST /begin REF_CHARACTERISTIC AAACalRegn02Rt03GroupB_Dummy.EotProtnDampgVehSpdTbl.Ary1D /end REF_CHARACTERISTIC /begin REF_MEASUREMENT /end REF_MEASUREMENT /end GROUP
/begin GROUP AAACalRegn02Rt03GroupB_Dummy.EotProtnDeltaTqThd.Val "MICROSAR RTE" /begin SUB_GROUP /end SUB_GROUP /begin FUNCTION_LIST /end FUNCTION_LIST /begin REF_CHARACTERISTIC AAACalRegn02Rt03GroupB_Dummy.EotProtnDeltaTqThd.Val /end REF_CHARACTERISTIC /begin REF_MEASUREMENT /end REF_MEASUREMENT /end GROUP
/begin GROUP AAACalRegn02Rt03GroupB_Dummy.EotProtnEntrGainVehSpdTbl.Ary1D "MICROSAR RTE" /begin SUB_GROUP /end SUB_GROUP /begin FUNCTION_LIST /end FUNCTION_LIST
 /begin REF_CHARACTERISTIC AAACalRegn02Rt03GroupB_Dummy.EotProtnEntrGainVehSpdTbl.Ary1D /end REF_CHARACTERISTIC
 /begin REF_MEASUREMENT /end REF_MEASUREMENT
/end GROUP
/begin GROUP AAACalRegn02Rt03GroupB_Dummy.EotProtnEntrGainY.Ary2D "MICROSAR RTE" /begin SUB_GROUP /end SUB_GROUP /begin FUNCTION_LIST /end FUNCTION_LIST /begin REF_CHARACTERISTIC AAACalRegn02Rt03GroupB_Dummy.EotProtnEntrGainY.Ary2D /end REF_CHARACTERISTIC /begin REF_MEASUREMENT /end REF_MEASUREMENT /end GROUP
/begin GROUP AAACalRegn02Rt03GroupB_Dummy.EotProtnLoAuthyEntrGainY.Ary2D "MICROSAR RTE" /begin SUB_GROUP /end SUB_GROUP /begin FUNCTION_LIST /end FUNCTION_LIST
 /begin REF_CHARACTERISTIC AAACalRegn02Rt03GroupB_Dummy.EotProtnLoAuthyEntrGainY.Ary2D /end REF_CHARACTERISTIC
 /begin REF_MEASUREMENT /end REF_MEASUREMENT
/end GROUP
/begin GROUP AAACalRegn02Rt03GroupB_Dummy.EotProtnMotSpdIncptY.Ary1D "MICROSAR RTE" /begin SUB_GROUP /end SUB_GROUP /begin FUNCTION_LIST /end FUNCTION_LIST /begin REF_CHARACTERISTIC AAACalRegn02Rt03GroupB_Dummy.EotProtnMotSpdIncptY.Ary1D /end REF_CHARACTERISTIC /begin REF_MEASUREMENT /end REF_MEASUREMENT /end GROUP
/begin GROUP AAACalRegn02Rt03GroupB_Dummy.EotProtnNormDampgY.Ary2D "MICROSAR RTE" /begin SUB_GROUP /end SUB_GROUP /begin FUNCTION_LIST /end FUNCTION_LIST /begin REF_CHARACTERISTIC AAACalRegn02Rt03GroupB_Dummy.EotProtnNormDampgY.Ary2D /end REF_CHARACTERISTIC /begin REF_MEASUREMENT /end REF_MEASUREMENT /end GROUP
/begin RECORD_LAYOUT RTE_RL_UWORD FNC_VALUES 1 UWORD ROW_DIR DIRECT /end RECORD_LAYOUT
/begin RECORD_LAYOUT RTE_RL_SWORD FNC_VALUES 1 SWORD ROW_DIR DIRECT /end RECORD_LAYOUT
/begin RECORD_LAYOUT RTE_RL_FLOAT32_IEEE FNC_VALUES 1 FLOAT32_IEEE ROW_DIR DIRECT /end RECORD_LAYOUT
