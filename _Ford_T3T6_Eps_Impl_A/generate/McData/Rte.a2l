/begin CHARACTERISTIC FordMsg077BusHiSpd.FordMsg077BusHiSpdVehYawRateCmpdVldPassdThd.Val "MICROSAR RTE" VALUE 0x0 RTE_RL_UWORD 0 NO_COMPU_METHOD 0 65535 SYMBOL_LINK "Rte_CalprmRom_CalRegn01Cmn_DEFAULT_RTE_CALPRM_GROUP.FordMsg077BusHiSpdVehYawRateCmpdVldPassdThd_Val" 0 DISPLAY_IDENTIFIER FordMsg077BusHiSpd.CalibrationPorts.FordMsg077BusHiSpdVehYawRateCmpdVldPassdThd.Val /end CHARACTERISTIC
/begin CHARACTERISTIC FordMsg077BusHiSpd.FordMsg077BusHiSpdYawRateCmpdInvldSigFaildThd.Val "MICROSAR RTE" VALUE 0x0 RTE_RL_UWORD 0 NO_COMPU_METHOD 0 65535 SYMBOL_LINK "Rte_CalprmRom_CalRegn01Cmn_DEFAULT_RTE_CALPRM_GROUP.FordMsg077BusHiSpdYawRateCmpdInvldSigFaildThd_Val" 0 DISPLAY_IDENTIFIER FordMsg077BusHiSpd.CalibrationPorts.FordMsg077BusHiSpdYawRateCmpdInvldSigFaildThd.Val /end CHARACTERISTIC
/begin CHARACTERISTIC FordMsg077BusHiSpd.FordMsg077BusHiSpdYawRateCmpdInvldSigPassdThd.Val "MICROSAR RTE" VALUE 0x0 RTE_RL_UWORD 0 NO_COMPU_METHOD 0 65535 SYMBOL_LINK "Rte_CalprmRom_CalRegn01Cmn_DEFAULT_RTE_CALPRM_GROUP.FordMsg077BusHiSpdYawRateCmpdInvldSigPassdThd_Val" 0 DISPLAY_IDENTIFIER FordMsg077BusHiSpd.CalibrationPorts.FordMsg077BusHiSpdYawRateCmpdInvldSigPassdThd.Val /end CHARACTERISTIC
/begin CHARACTERISTIC FordMsg077BusHiSpd.FordMsg077BusHiSpdYawRateCmpdVldMissThd.Val "MICROSAR RTE" VALUE 0x0 RTE_RL_UWORD 0 NO_COMPU_METHOD 0 65535 SYMBOL_LINK "Rte_CalprmRom_CalRegn01Cmn_DEFAULT_RTE_CALPRM_GROUP.FordMsg077BusHiSpdYawRateCmpdVldMissThd_Val" 0 DISPLAY_IDENTIFIER FordMsg077BusHiSpd.CalibrationPorts.FordMsg077BusHiSpdYawRateCmpdVldMissThd.Val /end CHARACTERISTIC
/begin CHARACTERISTIC FordMsg07DBusHiSpd.FordMsg07DBusHiSpdActBrkTqSigInvldPassdThd.Val "MICROSAR RTE" VALUE 0x0 RTE_RL_UWORD 0 NO_COMPU_METHOD 0 65535 SYMBOL_LINK "Rte_CalprmRom_CalRegn01Cmn_DEFAULT_RTE_CALPRM_GROUP.FordMsg07DBusHiSpdActBrkTqSigInvldPassdThd_Val" 0 DISPLAY_IDENTIFIER FordMsg07DBusHiSpd.CalibrationPorts.FordMsg07DBusHiSpdActBrkTqSigInvldPassdThd.Val /end CHARACTERISTIC
/begin CHARACTERISTIC FordMsg07DBusHiSpd.FordMsg07DBusHiSpdFordVehActBrkTqInvldThd.Val "MICROSAR RTE" VALUE 0x0 RTE_RL_UWORD 0 NO_COMPU_METHOD 0 65535 SYMBOL_LINK "Rte_CalprmRom_CalRegn01Cmn_DEFAULT_RTE_CALPRM_GROUP.FordMsg07DBusHiSpdFordVehActBrkTqInvldThd_Val" 0 DISPLAY_IDENTIFIER FordMsg07DBusHiSpd.CalibrationPorts.FordMsg07DBusHiSpdFordVehActBrkTqInvldThd.Val /end CHARACTERISTIC
/begin CHARACTERISTIC FordMsg07DBusHiSpd.FordMsg07DBusHiSpdFordVehActBrkTqVldThd.Val "MICROSAR RTE" VALUE 0x0 RTE_RL_UWORD 0 NO_COMPU_METHOD 0 65535 SYMBOL_LINK "Rte_CalprmRom_CalRegn01Cmn_DEFAULT_RTE_CALPRM_GROUP.FordMsg07DBusHiSpdFordVehActBrkTqVldThd_Val" 0 DISPLAY_IDENTIFIER FordMsg07DBusHiSpd.CalibrationPorts.FordMsg07DBusHiSpdFordVehActBrkTqVldThd.Val /end CHARACTERISTIC
/begin CHARACTERISTIC FordMsg07DBusHiSpd.FordMsg07DBusHiSpdFordVehBrkTqVldMissMsgThd.Val "MICROSAR RTE" VALUE 0x0 RTE_RL_UWORD 0 NO_COMPU_METHOD 0 65535 SYMBOL_LINK "Rte_CalprmRom_CalRegn01Cmn_DEFAULT_RTE_CALPRM_GROUP.FordMsg07DBusHiSpdFordVehBrkTqVldMissMsgThd_Val" 0 DISPLAY_IDENTIFIER FordMsg07DBusHiSpd.CalibrationPorts.FordMsg07DBusHiSpdFordVehBrkTqVldMissMsgThd.Val /end CHARACTERISTIC
/begin CHARACTERISTIC FordMsg07DBusHiSpd.FordMsg07DBusHiSpdFordVehVertACmpdSigInvldThd.Val "MICROSAR RTE" VALUE 0x0 RTE_RL_UWORD 0 NO_COMPU_METHOD 0 65535 SYMBOL_LINK "Rte_CalprmRom_CalRegn01Cmn_DEFAULT_RTE_CALPRM_GROUP.FordMsg07DBusHiSpdFordVehVertACmpdSigInvldThd_Val" 0 DISPLAY_IDENTIFIER FordMsg07DBusHiSpd.CalibrationPorts.FordMsg07DBusHiSpdFordVehVertACmpdSigInvldThd.Val /end CHARACTERISTIC
/begin CHARACTERISTIC FordMsg07DBusHiSpd.FordMsg07DBusHiSpdFordVehVertACmpdSigVldThd.Val "MICROSAR RTE" VALUE 0x0 RTE_RL_UWORD 0 NO_COMPU_METHOD 0 65535 SYMBOL_LINK "Rte_CalprmRom_CalRegn01Cmn_DEFAULT_RTE_CALPRM_GROUP.FordMsg07DBusHiSpdFordVehVertACmpdSigVldThd_Val" 0 DISPLAY_IDENTIFIER FordMsg07DBusHiSpd.CalibrationPorts.FordMsg07DBusHiSpdFordVehVertACmpdSigVldThd.Val /end CHARACTERISTIC
/begin CHARACTERISTIC FordMsg07DBusHiSpd.FordMsg07DBusHiSpdFordVehVertAVldMissMsgThd.Val "MICROSAR RTE" VALUE 0x0 RTE_RL_UWORD 0 NO_COMPU_METHOD 0 65535 SYMBOL_LINK "Rte_CalprmRom_CalRegn01Cmn_DEFAULT_RTE_CALPRM_GROUP.FordMsg07DBusHiSpdFordVehVertAVldMissMsgThd_Val" 0 DISPLAY_IDENTIFIER FordMsg07DBusHiSpd.CalibrationPorts.FordMsg07DBusHiSpdFordVehVertAVldMissMsgThd.Val /end CHARACTERISTIC
/begin CHARACTERISTIC FordMsg07DBusHiSpd.FordMsg07DBusHiSpdMissMsgFaildThd.Val "MICROSAR RTE" VALUE 0x0 RTE_RL_UWORD 0 NO_COMPU_METHOD 0 65535 SYMBOL_LINK "Rte_CalprmRom_CalRegn01Cmn_DEFAULT_RTE_CALPRM_GROUP.FordMsg07DBusHiSpdMissMsgFaildThd_Val" 0 DISPLAY_IDENTIFIER FordMsg07DBusHiSpd.CalibrationPorts.FordMsg07DBusHiSpdMissMsgFaildThd.Val /end CHARACTERISTIC
/begin CHARACTERISTIC FordMsg07DBusHiSpd.FordMsg07DBusHiSpdMissMsgPassdThd.Val "MICROSAR RTE" VALUE 0x0 RTE_RL_UWORD 0 NO_COMPU_METHOD 0 65535 SYMBOL_LINK "Rte_CalprmRom_CalRegn01Cmn_DEFAULT_RTE_CALPRM_GROUP.FordMsg07DBusHiSpdMissMsgPassdThd_Val" 0 DISPLAY_IDENTIFIER FordMsg07DBusHiSpd.CalibrationPorts.FordMsg07DBusHiSpdMissMsgPassdThd.Val /end CHARACTERISTIC
/begin CHARACTERISTIC FordMsg07DBusHiSpd.FordMsg07DBusHiSpdVehActTqBrkInvldFaildThd.Val "MICROSAR RTE" VALUE 0x0 RTE_RL_UWORD 0 NO_COMPU_METHOD 0 65535 SYMBOL_LINK "Rte_CalprmRom_CalRegn01Cmn_DEFAULT_RTE_CALPRM_GROUP.FordMsg07DBusHiSpdVehActTqBrkInvldFaildThd_Val" 0 DISPLAY_IDENTIFIER FordMsg07DBusHiSpd.CalibrationPorts.FordMsg07DBusHiSpdVehActTqBrkInvldFaildThd.Val /end CHARACTERISTIC
/begin CHARACTERISTIC FordMsg07DBusHiSpd.FordMsg07DBusHiSpdVertACmpdSigInvldFaildThd.Val "MICROSAR RTE" VALUE 0x0 RTE_RL_UWORD 0 NO_COMPU_METHOD 0 65535 SYMBOL_LINK "Rte_CalprmRom_CalRegn01Cmn_DEFAULT_RTE_CALPRM_GROUP.FordMsg07DBusHiSpdVertACmpdSigInvldFaildThd_Val" 0 DISPLAY_IDENTIFIER FordMsg07DBusHiSpd.CalibrationPorts.FordMsg07DBusHiSpdVertACmpdSigInvldFaildThd.Val /end CHARACTERISTIC
/begin CHARACTERISTIC FordMsg07DBusHiSpd.FordMsg07DBusHiSpdVertACmpdSigInvldPassdThd.Val "MICROSAR RTE" VALUE 0x0 RTE_RL_UWORD 0 NO_COMPU_METHOD 0 65535 SYMBOL_LINK "Rte_CalprmRom_CalRegn01Cmn_DEFAULT_RTE_CALPRM_GROUP.FordMsg07DBusHiSpdVertACmpdSigInvldPassdThd_Val" 0 DISPLAY_IDENTIFIER FordMsg07DBusHiSpd.CalibrationPorts.FordMsg07DBusHiSpdVertACmpdSigInvldPassdThd.Val /end CHARACTERISTIC
/begin CHARACTERISTIC FordMsg083BusHiSpd.FordMsg083BusHiSpdFordVehTurnSigVldThd.Val "MICROSAR RTE" VALUE 0x0 RTE_RL_UWORD 0 NO_COMPU_METHOD 0 65535 SYMBOL_LINK "Rte_CalprmRom_CalRegn01Cmn_DEFAULT_RTE_CALPRM_GROUP.FordMsg083BusHiSpdFordVehTurnSigVldThd_Val" 0 DISPLAY_IDENTIFIER FordMsg083BusHiSpd.CalibrationPorts.FordMsg083BusHiSpdFordVehTurnSigVldThd.Val /end CHARACTERISTIC
/begin CHARACTERISTIC FordMsg083BusHiSpd.FordMsg083BusHiSpdMissMsgFaildThd.Val "MICROSAR RTE" VALUE 0x0 RTE_RL_UWORD 0 NO_COMPU_METHOD 0 65535 SYMBOL_LINK "Rte_CalprmRom_CalRegn01Cmn_DEFAULT_RTE_CALPRM_GROUP.FordMsg083BusHiSpdMissMsgFaildThd_Val" 0 DISPLAY_IDENTIFIER FordMsg083BusHiSpd.CalibrationPorts.FordMsg083BusHiSpdMissMsgFaildThd.Val /end CHARACTERISTIC
/begin CHARACTERISTIC FordMsg083BusHiSpd.FordMsg083BusHiSpdMissMsgPassdThd.Val "MICROSAR RTE" VALUE 0x0 RTE_RL_UWORD 0 NO_COMPU_METHOD 0 65535 SYMBOL_LINK "Rte_CalprmRom_CalRegn01Cmn_DEFAULT_RTE_CALPRM_GROUP.FordMsg083BusHiSpdMissMsgPassdThd_Val" 0 DISPLAY_IDENTIFIER FordMsg083BusHiSpd.CalibrationPorts.FordMsg083BusHiSpdMissMsgPassdThd.Val /end CHARACTERISTIC
/begin CHARACTERISTIC FordMsg083BusHiSpd.FordMsg083BusHiSpdVehTurnSigVldMissMsgThd.Val "MICROSAR RTE" VALUE 0x0 RTE_RL_UWORD 0 NO_COMPU_METHOD 0 65535 SYMBOL_LINK "Rte_CalprmRom_CalRegn01Cmn_DEFAULT_RTE_CALPRM_GROUP.FordMsg083BusHiSpdVehTurnSigVldMissMsgThd_Val" 0 DISPLAY_IDENTIFIER FordMsg083BusHiSpd.CalibrationPorts.FordMsg083BusHiSpdVehTurnSigVldMissMsgThd.Val /end CHARACTERISTIC
/begin CHARACTERISTIC FordMsg091BusHiSpd.FordMsg091BusHiSpdInvldMsgFaildThd.Val "MICROSAR RTE" VALUE 0x0 RTE_RL_UWORD 0 NO_COMPU_METHOD 0 65535 SYMBOL_LINK "Rte_CalprmRom_CalRegn01Cmn_DEFAULT_RTE_CALPRM_GROUP.FordMsg091BusHiSpdInvldMsgFaildThd_Val" 0 DISPLAY_IDENTIFIER FordMsg091BusHiSpd.CalibrationPorts.FordMsg091BusHiSpdInvldMsgFaildThd.Val /end CHARACTERISTIC
/begin CHARACTERISTIC FordMsg091BusHiSpd.FordMsg091BusHiSpdInvldMsgPassdThd.Val "MICROSAR RTE" VALUE 0x0 RTE_RL_UWORD 0 NO_COMPU_METHOD 0 65535 SYMBOL_LINK "Rte_CalprmRom_CalRegn01Cmn_DEFAULT_RTE_CALPRM_GROUP.FordMsg091BusHiSpdInvldMsgPassdThd_Val" 0 DISPLAY_IDENTIFIER FordMsg091BusHiSpd.CalibrationPorts.FordMsg091BusHiSpdInvldMsgPassdThd.Val /end CHARACTERISTIC
/begin CHARACTERISTIC FordMsg091BusHiSpd.FordMsg091BusHiSpdMissMsgFaildThd.Val "MICROSAR RTE" VALUE 0x0 RTE_RL_UWORD 0 NO_COMPU_METHOD 0 65535 SYMBOL_LINK "Rte_CalprmRom_CalRegn01Cmn_DEFAULT_RTE_CALPRM_GROUP.FordMsg091BusHiSpdMissMsgFaildThd_Val" 0 DISPLAY_IDENTIFIER FordMsg091BusHiSpd.CalibrationPorts.FordMsg091BusHiSpdMissMsgFaildThd.Val /end CHARACTERISTIC
/begin CHARACTERISTIC FordMsg091BusHiSpd.FordMsg091BusHiSpdMissMsgPassdThd.Val "MICROSAR RTE" VALUE 0x0 RTE_RL_UWORD 0 NO_COMPU_METHOD 0 65535 SYMBOL_LINK "Rte_CalprmRom_CalRegn01Cmn_DEFAULT_RTE_CALPRM_GROUP.FordMsg091BusHiSpdMissMsgPassdThd_Val" 0 DISPLAY_IDENTIFIER FordMsg091BusHiSpd.CalibrationPorts.FordMsg091BusHiSpdMissMsgPassdThd.Val /end CHARACTERISTIC
/begin CHARACTERISTIC FordMsg091BusHiSpd.FordMsg091BusHiSpdYawRateRawVldMissFaildThd.Val "MICROSAR RTE" VALUE 0x0 RTE_RL_UWORD 0 NO_COMPU_METHOD 0 65535 SYMBOL_LINK "Rte_CalprmRom_CalRegn01Cmn_DEFAULT_RTE_CALPRM_GROUP.FordMsg091BusHiSpdYawRateRawVldMissFaildThd_Val" 0 DISPLAY_IDENTIFIER FordMsg091BusHiSpd.CalibrationPorts.FordMsg091BusHiSpdYawRateRawVldMissFaildThd.Val /end CHARACTERISTIC
/begin CHARACTERISTIC FordMsg091BusHiSpd.FordMsg091BusHiSpdYawRateRawVldSigFaildThd.Val "MICROSAR RTE" VALUE 0x0 RTE_RL_UWORD 0 NO_COMPU_METHOD 0 65535 SYMBOL_LINK "Rte_CalprmRom_CalRegn01Cmn_DEFAULT_RTE_CALPRM_GROUP.FordMsg091BusHiSpdYawRateRawVldSigFaildThd_Val" 0 DISPLAY_IDENTIFIER FordMsg091BusHiSpd.CalibrationPorts.FordMsg091BusHiSpdYawRateRawVldSigFaildThd.Val /end CHARACTERISTIC
/begin CHARACTERISTIC FordMsg091BusHiSpd.FordMsg091BusHiSpdYawRateRawVldSigPassdThd.Val "MICROSAR RTE" VALUE 0x0 RTE_RL_UWORD 0 NO_COMPU_METHOD 0 65535 SYMBOL_LINK "Rte_CalprmRom_CalRegn01Cmn_DEFAULT_RTE_CALPRM_GROUP.FordMsg091BusHiSpdYawRateRawVldSigPassdThd_Val" 0 DISPLAY_IDENTIFIER FordMsg091BusHiSpd.CalibrationPorts.FordMsg091BusHiSpdYawRateRawVldSigPassdThd.Val /end CHARACTERISTIC
/begin CHARACTERISTIC FordMsg167BusHiSpd.FordMsg167BusHiSpdMissMsgFaildTiThd.Val "MICROSAR RTE" VALUE 0x0 RTE_RL_UWORD 0 NO_COMPU_METHOD 0 65535 SYMBOL_LINK "Rte_CalprmRom_CalRegn01Cmn_DEFAULT_RTE_CALPRM_GROUP.FordMsg167BusHiSpdMissMsgFaildTiThd_Val" 0 DISPLAY_IDENTIFIER FordMsg167BusHiSpd.CalibrationPorts.FordMsg167BusHiSpdMissMsgFaildTiThd.Val /end CHARACTERISTIC
/begin CHARACTERISTIC FordMsg167BusHiSpd.FordMsg167BusHiSpdMissMsgPassdTiThd.Val "MICROSAR RTE" VALUE 0x0 RTE_RL_UWORD 0 NO_COMPU_METHOD 0 65535 SYMBOL_LINK "Rte_CalprmRom_CalRegn01Cmn_DEFAULT_RTE_CALPRM_GROUP.FordMsg167BusHiSpdMissMsgPassdTiThd_Val" 0 DISPLAY_IDENTIFIER FordMsg167BusHiSpd.CalibrationPorts.FordMsg167BusHiSpdMissMsgPassdTiThd.Val /end CHARACTERISTIC
/begin CHARACTERISTIC FordMsg167BusHiSpd.FordMsg167BusHiSpdPrpnWhlTqFaildTiThd.Val "MICROSAR RTE" VALUE 0x0 RTE_RL_UWORD 0 NO_COMPU_METHOD 0 65535 SYMBOL_LINK "Rte_CalprmRom_CalRegn01Cmn_DEFAULT_RTE_CALPRM_GROUP.FordMsg167BusHiSpdPrpnWhlTqFaildTiThd_Val" 0 DISPLAY_IDENTIFIER FordMsg167BusHiSpd.CalibrationPorts.FordMsg167BusHiSpdPrpnWhlTqFaildTiThd.Val /end CHARACTERISTIC
/begin CHARACTERISTIC FordMsg167BusHiSpd.FordMsg167BusHiSpdPrpnWhlTqMissTiThd.Val "MICROSAR RTE" VALUE 0x0 RTE_RL_UWORD 0 NO_COMPU_METHOD 0 65535 SYMBOL_LINK "Rte_CalprmRom_CalRegn01Cmn_DEFAULT_RTE_CALPRM_GROUP.FordMsg167BusHiSpdPrpnWhlTqMissTiThd_Val" 0 DISPLAY_IDENTIFIER FordMsg167BusHiSpd.CalibrationPorts.FordMsg167BusHiSpdPrpnWhlTqMissTiThd.Val /end CHARACTERISTIC
/begin CHARACTERISTIC FordMsg167BusHiSpd.FordMsg167BusHiSpdPrpnWhlTqPassdTiThd.Val "MICROSAR RTE" VALUE 0x0 RTE_RL_UWORD 0 NO_COMPU_METHOD 0 65535 SYMBOL_LINK "Rte_CalprmRom_CalRegn01Cmn_DEFAULT_RTE_CALPRM_GROUP.FordMsg167BusHiSpdPrpnWhlTqPassdTiThd_Val" 0 DISPLAY_IDENTIFIER FordMsg167BusHiSpd.CalibrationPorts.FordMsg167BusHiSpdPrpnWhlTqPassdTiThd.Val /end CHARACTERISTIC
/begin CHARACTERISTIC FordMsg167BusHiSpd.FordMsg167BusHiSpdPrpnWhlTqSigInvldFaildTiThd.Val "MICROSAR RTE" VALUE 0x0 RTE_RL_UWORD 0 NO_COMPU_METHOD 0 65535 SYMBOL_LINK "Rte_CalprmRom_CalRegn01Cmn_DEFAULT_RTE_CALPRM_GROUP.FordMsg167BusHiSpdPrpnWhlTqSigInvldFaildTiThd_Val" 0 DISPLAY_IDENTIFIER FordMsg167BusHiSpd.CalibrationPorts.FordMsg167BusHiSpdPrpnWhlTqSigInvldFaildTiThd.Val /end CHARACTERISTIC
/begin CHARACTERISTIC FordMsg167BusHiSpd.FordMsg167BusHiSpdPrpnWhlTqSigInvldPassdTiThd.Val "MICROSAR RTE" VALUE 0x0 RTE_RL_UWORD 0 NO_COMPU_METHOD 0 65535 SYMBOL_LINK "Rte_CalprmRom_CalRegn01Cmn_DEFAULT_RTE_CALPRM_GROUP.FordMsg167BusHiSpdPrpnWhlTqSigInvldPassdTiThd_Val" 0 DISPLAY_IDENTIFIER FordMsg167BusHiSpd.CalibrationPorts.FordMsg167BusHiSpdPrpnWhlTqSigInvldPassdTiThd.Val /end CHARACTERISTIC
/begin CHARACTERISTIC FordMsg202BusHiSpd.FordMsg202BusHiSpdEngModLoQlyVldFaildThd.Val "MICROSAR RTE" VALUE 0x0 RTE_RL_UWORD 0 NO_COMPU_METHOD 0 65535 SYMBOL_LINK "Rte_CalprmRom_CalRegn01Cmn_DEFAULT_RTE_CALPRM_GROUP.FordMsg202BusHiSpdEngModLoQlyVldFaildThd_Val" 0 DISPLAY_IDENTIFIER FordMsg202BusHiSpd.CalibrationPorts.FordMsg202BusHiSpdEngModLoQlyVldFaildThd.Val /end CHARACTERISTIC
/begin CHARACTERISTIC FordMsg202BusHiSpd.FordMsg202BusHiSpdEngModLoQlyVldMissThd.Val "MICROSAR RTE" VALUE 0x0 RTE_RL_UWORD 0 NO_COMPU_METHOD 0 65535 SYMBOL_LINK "Rte_CalprmRom_CalRegn01Cmn_DEFAULT_RTE_CALPRM_GROUP.FordMsg202BusHiSpdEngModLoQlyVldMissThd_Val" 0 DISPLAY_IDENTIFIER FordMsg202BusHiSpd.CalibrationPorts.FordMsg202BusHiSpdEngModLoQlyVldMissThd.Val /end CHARACTERISTIC
/begin CHARACTERISTIC FordMsg202BusHiSpd.FordMsg202BusHiSpdEngModLoQlyVldPassdThd.Val "MICROSAR RTE" VALUE 0x0 RTE_RL_UWORD 0 NO_COMPU_METHOD 0 65535 SYMBOL_LINK "Rte_CalprmRom_CalRegn01Cmn_DEFAULT_RTE_CALPRM_GROUP.FordMsg202BusHiSpdEngModLoQlyVldPassdThd_Val" 0 DISPLAY_IDENTIFIER FordMsg202BusHiSpd.CalibrationPorts.FordMsg202BusHiSpdEngModLoQlyVldPassdThd.Val /end CHARACTERISTIC
/begin CHARACTERISTIC FordMsg202BusHiSpd.FordMsg202BusHiSpdEngModlVldFaildThd.Val "MICROSAR RTE" VALUE 0x0 RTE_RL_UWORD 0 NO_COMPU_METHOD 0 65535 SYMBOL_LINK "Rte_CalprmRom_CalRegn01Cmn_DEFAULT_RTE_CALPRM_GROUP.FordMsg202BusHiSpdEngModlVldFaildThd_Val" 0 DISPLAY_IDENTIFIER FordMsg202BusHiSpd.CalibrationPorts.FordMsg202BusHiSpdEngModlVldFaildThd.Val /end CHARACTERISTIC
/begin CHARACTERISTIC FordMsg202BusHiSpd.FordMsg202BusHiSpdEngModlVldMissThd.Val "MICROSAR RTE" VALUE 0x0 RTE_RL_UWORD 0 NO_COMPU_METHOD 0 65535 SYMBOL_LINK "Rte_CalprmRom_CalRegn01Cmn_DEFAULT_RTE_CALPRM_GROUP.FordMsg202BusHiSpdEngModlVldMissThd_Val" 0 DISPLAY_IDENTIFIER FordMsg202BusHiSpd.CalibrationPorts.FordMsg202BusHiSpdEngModlVldMissThd.Val /end CHARACTERISTIC
/begin CHARACTERISTIC FordMsg202BusHiSpd.FordMsg202BusHiSpdGearRvsStsInvldFaildThd.Val "MICROSAR RTE" VALUE 0x0 RTE_RL_UWORD 0 NO_COMPU_METHOD 0 65535 SYMBOL_LINK "Rte_CalprmRom_CalRegn01Cmn_DEFAULT_RTE_CALPRM_GROUP.FordMsg202BusHiSpdGearRvsStsInvldFaildThd_Val" 0 DISPLAY_IDENTIFIER FordMsg202BusHiSpd.CalibrationPorts.FordMsg202BusHiSpdGearRvsStsInvldFaildThd.Val /end CHARACTERISTIC
/begin CHARACTERISTIC FordMsg202BusHiSpd.FordMsg202BusHiSpdGearRvsStsInvldPassdThd.Val "MICROSAR RTE" VALUE 0x0 RTE_RL_UWORD 0 NO_COMPU_METHOD 0 65535 SYMBOL_LINK "Rte_CalprmRom_CalRegn01Cmn_DEFAULT_RTE_CALPRM_GROUP.FordMsg202BusHiSpdGearRvsStsInvldPassdThd_Val" 0 DISPLAY_IDENTIFIER FordMsg202BusHiSpd.CalibrationPorts.FordMsg202BusHiSpdGearRvsStsInvldPassdThd.Val /end CHARACTERISTIC
/begin CHARACTERISTIC FordMsg202BusHiSpd.FordMsg202BusHiSpdGearRvsStsVldFaildThd.Val "MICROSAR RTE" VALUE 0x0 RTE_RL_UWORD 0 NO_COMPU_METHOD 0 65535 SYMBOL_LINK "Rte_CalprmRom_CalRegn01Cmn_DEFAULT_RTE_CALPRM_GROUP.FordMsg202BusHiSpdGearRvsStsVldFaildThd_Val" 0 DISPLAY_IDENTIFIER FordMsg202BusHiSpd.CalibrationPorts.FordMsg202BusHiSpdGearRvsStsVldFaildThd.Val /end CHARACTERISTIC
/begin CHARACTERISTIC FordMsg202BusHiSpd.FordMsg202BusHiSpdGearRvsStsVldMissThd.Val "MICROSAR RTE" VALUE 0x0 RTE_RL_UWORD 0 NO_COMPU_METHOD 0 65535 SYMBOL_LINK "Rte_CalprmRom_CalRegn01Cmn_DEFAULT_RTE_CALPRM_GROUP.FordMsg202BusHiSpdGearRvsStsVldMissThd_Val" 0 DISPLAY_IDENTIFIER FordMsg202BusHiSpd.CalibrationPorts.FordMsg202BusHiSpdGearRvsStsVldMissThd.Val /end CHARACTERISTIC
/begin CHARACTERISTIC FordMsg202BusHiSpd.FordMsg202BusHiSpdGearRvsStsVldPassdThd.Val "MICROSAR RTE" VALUE 0x0 RTE_RL_UWORD 0 NO_COMPU_METHOD 0 65535 SYMBOL_LINK "Rte_CalprmRom_CalRegn01Cmn_DEFAULT_RTE_CALPRM_GROUP.FordMsg202BusHiSpdGearRvsStsVldPassdThd_Val" 0 DISPLAY_IDENTIFIER FordMsg202BusHiSpd.CalibrationPorts.FordMsg202BusHiSpdGearRvsStsVldPassdThd.Val /end CHARACTERISTIC
/begin CHARACTERISTIC FordMsg202BusHiSpd.FordMsg202BusHiSpdMissMsgFaildAbsPrsntDisadThd.Val "MICROSAR RTE" VALUE 0x0 RTE_RL_UWORD 0 NO_COMPU_METHOD 0 65535 SYMBOL_LINK "Rte_CalprmRom_CalRegn01Cmn_DEFAULT_RTE_CALPRM_GROUP.FordMsg202BusHiSpdMissMsgFaildAbsPrsntDisadThd_Val" 0 DISPLAY_IDENTIFIER FordMsg202BusHiSpd.CalibrationPorts.FordMsg202BusHiSpdMissMsgFaildAbsPrsntDisadThd.Val /end CHARACTERISTIC
/begin CHARACTERISTIC FordMsg202BusHiSpd.FordMsg202BusHiSpdMissMsgFaildAbsPrsntEnadThd.Val "MICROSAR RTE" VALUE 0x0 RTE_RL_UWORD 0 NO_COMPU_METHOD 0 65535 SYMBOL_LINK "Rte_CalprmRom_CalRegn01Cmn_DEFAULT_RTE_CALPRM_GROUP.FordMsg202BusHiSpdMissMsgFaildAbsPrsntEnadThd_Val" 0 DISPLAY_IDENTIFIER FordMsg202BusHiSpd.CalibrationPorts.FordMsg202BusHiSpdMissMsgFaildAbsPrsntEnadThd.Val /end CHARACTERISTIC
/begin CHARACTERISTIC FordMsg202BusHiSpd.FordMsg202BusHiSpdMissMsgPassdThd.Val "MICROSAR RTE" VALUE 0x0 RTE_RL_UWORD 0 NO_COMPU_METHOD 0 65535 SYMBOL_LINK "Rte_CalprmRom_CalRegn01Cmn_DEFAULT_RTE_CALPRM_GROUP.FordMsg202BusHiSpdMissMsgPassdThd_Val" 0 DISPLAY_IDENTIFIER FordMsg202BusHiSpd.CalibrationPorts.FordMsg202BusHiSpdMissMsgPassdThd.Val /end CHARACTERISTIC
/begin CHARACTERISTIC FordMsg202BusHiSpd.FordMsg202BusHiSpdQlyFacEngModInvldFaildThd.Val "MICROSAR RTE" VALUE 0x0 RTE_RL_UWORD 0 NO_COMPU_METHOD 0 65535 SYMBOL_LINK "Rte_CalprmRom_CalRegn01Cmn_DEFAULT_RTE_CALPRM_GROUP.FordMsg202BusHiSpdQlyFacEngModInvldFaildThd_Val" 0 DISPLAY_IDENTIFIER FordMsg202BusHiSpd.CalibrationPorts.FordMsg202BusHiSpdQlyFacEngModInvldFaildThd.Val /end CHARACTERISTIC
/begin CHARACTERISTIC FordMsg202BusHiSpd.FordMsg202BusHiSpdQlyFacEngModInvldPassdThd.Val "MICROSAR RTE" VALUE 0x0 RTE_RL_UWORD 0 NO_COMPU_METHOD 0 65535 SYMBOL_LINK "Rte_CalprmRom_CalRegn01Cmn_DEFAULT_RTE_CALPRM_GROUP.FordMsg202BusHiSpdQlyFacEngModInvldPassdThd_Val" 0 DISPLAY_IDENTIFIER FordMsg202BusHiSpd.CalibrationPorts.FordMsg202BusHiSpdQlyFacEngModInvldPassdThd.Val /end CHARACTERISTIC
/begin CHARACTERISTIC FordMsg202BusHiSpd.FordMsg202BusHiSpdTrlrBackupAssiAvlVldMissThd.Val "MICROSAR RTE" VALUE 0x0 RTE_RL_UWORD 0 NO_COMPU_METHOD 0 65535 SYMBOL_LINK "Rte_CalprmRom_CalRegn01Cmn_DEFAULT_RTE_CALPRM_GROUP.FordMsg202BusHiSpdTrlrBackupAssiAvlVldMissThd_Val" 0 DISPLAY_IDENTIFIER FordMsg202BusHiSpd.CalibrationPorts.FordMsg202BusHiSpdTrlrBackupAssiAvlVldMissThd.Val /end CHARACTERISTIC
/begin CHARACTERISTIC FordMsg202BusHiSpd.FordMsg202BusHiSpdTrlrBackupAssiAvlVldPassdThd.Val "MICROSAR RTE" VALUE 0x0 RTE_RL_UWORD 0 NO_COMPU_METHOD 0 65535 SYMBOL_LINK "Rte_CalprmRom_CalRegn01Cmn_DEFAULT_RTE_CALPRM_GROUP.FordMsg202BusHiSpdTrlrBackupAssiAvlVldPassdThd_Val" 0 DISPLAY_IDENTIFIER FordMsg202BusHiSpd.CalibrationPorts.FordMsg202BusHiSpdTrlrBackupAssiAvlVldPassdThd.Val /end CHARACTERISTIC
/begin MEASUREMENT FordMsg077BusHiSpd.FordPullDriftCmpEnad.Logl "MICROSAR RTE" UBYTE RTE_CM_BOOLEAN 0 0 0 255 ECU_ADDRESS 0 SYMBOL_LINK "Rte_CustDiag_FordPullDriftCmpEnad_Logl" 0 DISPLAY_IDENTIFIER FordMsg077BusHiSpd.ReceiverPorts.FordPullDriftCmpEnad.Logl /end MEASUREMENT
/begin MEASUREMENT FordMsg077BusHiSpd.FordTqSteerCmpEnad.Logl "MICROSAR RTE" UBYTE RTE_CM_BOOLEAN 0 0 0 255 ECU_ADDRESS 0 SYMBOL_LINK "Rte_CustDiag_FordTqSteerCmpEnad_Logl" 0 DISPLAY_IDENTIFIER FordMsg077BusHiSpd.ReceiverPorts.FordTqSteerCmpEnad.Logl /end MEASUREMENT
/begin MEASUREMENT FordMsg077BusHiSpd.FordTrfcJamAssiEnad.Logl "MICROSAR RTE" UBYTE RTE_CM_BOOLEAN 0 0 0 255 ECU_ADDRESS 0 SYMBOL_LINK "Rte_CustDiag_FordTrfcJamAssiEnad_Logl" 0 DISPLAY_IDENTIFIER FordMsg077BusHiSpd.ReceiverPorts.FordTrfcJamAssiEnad.Logl /end MEASUREMENT
/begin MEASUREMENT FordMsg077BusHiSpd.FordTrlrBackUpAssiEnad.Logl "MICROSAR RTE" UBYTE RTE_CM_BOOLEAN 0 0 0 255 ECU_ADDRESS 0 SYMBOL_LINK "Rte_CustDiag_FordTrlrBackupAssiEnad_Logl" 0 DISPLAY_IDENTIFIER FordMsg077BusHiSpd.ReceiverPorts.FordTrlrBackUpAssiEnad.Logl /end MEASUREMENT
/begin MEASUREMENT FordMsg077BusHiSpd.FordVehLatACmpd.Val "MICROSAR RTE" FLOAT32_IEEE NO_COMPU_METHOD 0 0 -3.402823466e+38 3.402823466e+38 ECU_ADDRESS 0 SYMBOL_LINK "Rte_FordMsg077BusHiSpd_FordVehLatACmpd_Val" 0 DISPLAY_IDENTIFIER FordMsg077BusHiSpd.SenderPorts.FordVehLatACmpd.Val /end MEASUREMENT
/begin MEASUREMENT FordMsg077BusHiSpd.FordVehLatACmpdInvldFaildRefTi "MICROSAR RTE" ULONG NO_COMPU_METHOD 0 0 0 4294967295 ECU_ADDRESS 0 SYMBOL_LINK "Rte_FordMsg077BusHiSpd_FordVehLatACmpdInvldFaildRefTi" 0 DISPLAY_IDENTIFIER FordMsg077BusHiSpd.PerInstanceMemories.FordVehLatACmpdInvldFaildRefTi /end MEASUREMENT
/begin MEASUREMENT FordMsg077BusHiSpd.FordVehLatACmpdInvldPassdRefTi "MICROSAR RTE" ULONG NO_COMPU_METHOD 0 0 0 4294967295 ECU_ADDRESS 0 SYMBOL_LINK "Rte_FordMsg077BusHiSpd_FordVehLatACmpdInvldPassdRefTi" 0 DISPLAY_IDENTIFIER FordMsg077BusHiSpd.PerInstanceMemories.FordVehLatACmpdInvldPassdRefTi /end MEASUREMENT
/begin MEASUREMENT FordMsg077BusHiSpd.FordVehLatACmpdPrev "MICROSAR RTE" FLOAT32_IEEE NO_COMPU_METHOD 0 0 -3.402823466e+38 3.402823466e+38 ECU_ADDRESS 0 SYMBOL_LINK "Rte_FordMsg077BusHiSpd_FordVehLatACmpdPrev" 0 DISPLAY_IDENTIFIER FordMsg077BusHiSpd.PerInstanceMemories.FordVehLatACmpdPrev /end MEASUREMENT
/begin MEASUREMENT FordMsg077BusHiSpd.FordVehLatACmpdRaw.Val "MICROSAR RTE" UWORD NO_COMPU_METHOD 0 0 0 65535 ECU_ADDRESS 0 SYMBOL_LINK "Rte_FordMsg077BusHiSpd_FordVehLatACmpdRaw_Val" 0 DISPLAY_IDENTIFIER FordMsg077BusHiSpd.SenderPorts.FordVehLatACmpdRaw.Val /end MEASUREMENT
/begin MEASUREMENT FordMsg077BusHiSpd.FordVehLatACmpdRawPrev "MICROSAR RTE" UWORD NO_COMPU_METHOD 0 0 0 65535 ECU_ADDRESS 0 SYMBOL_LINK "Rte_FordMsg077BusHiSpd_FordVehLatACmpdRawPrev" 0 DISPLAY_IDENTIFIER FordMsg077BusHiSpd.PerInstanceMemories.FordVehLatACmpdRawPrev /end MEASUREMENT
/begin MEASUREMENT FordMsg077BusHiSpd.FordVehLatACmpdVld.Logl "MICROSAR RTE" UBYTE RTE_CM_BOOLEAN 0 0 0 255 ECU_ADDRESS 0 SYMBOL_LINK "Rte_FordMsg077BusHiSpd_FordVehLatACmpdVld_Logl" 0 DISPLAY_IDENTIFIER FordMsg077BusHiSpd.SenderPorts.FordVehLatACmpdVld.Logl /end MEASUREMENT
/begin MEASUREMENT FordMsg077BusHiSpd.FordVehLatACmpdVldFaildRefTi "MICROSAR RTE" ULONG NO_COMPU_METHOD 0 0 0 4294967295 ECU_ADDRESS 0 SYMBOL_LINK "Rte_FordMsg077BusHiSpd_FordVehLatACmpdVldFaildRefTi" 0 DISPLAY_IDENTIFIER FordMsg077BusHiSpd.PerInstanceMemories.FordVehLatACmpdVldFaildRefTi /end MEASUREMENT
/begin MEASUREMENT FordMsg077BusHiSpd.FordVehLatACmpdVldMissRefTi "MICROSAR RTE" ULONG NO_COMPU_METHOD 0 0 0 4294967295 ECU_ADDRESS 0 SYMBOL_LINK "Rte_FordMsg077BusHiSpd_FordVehLatACmpdVldMissRefTi" 0 DISPLAY_IDENTIFIER FordMsg077BusHiSpd.PerInstanceMemories.FordVehLatACmpdVldMissRefTi /end MEASUREMENT
/begin MEASUREMENT FordMsg077BusHiSpd.FordVehLatACmpdVldPassdRefTi "MICROSAR RTE" ULONG NO_COMPU_METHOD 0 0 0 4294967295 ECU_ADDRESS 0 SYMBOL_LINK "Rte_FordMsg077BusHiSpd_FordVehLatACmpdVldPassdRefTi" 0 DISPLAY_IDENTIFIER FordMsg077BusHiSpd.PerInstanceMemories.FordVehLatACmpdVldPassdRefTi /end MEASUREMENT
/begin MEASUREMENT FordMsg077BusHiSpd.FordVehLatACmpdVldPrev "MICROSAR RTE" UBYTE RTE_CM_BOOLEAN 0 0 0 255 ECU_ADDRESS 0 SYMBOL_LINK "Rte_FordMsg077BusHiSpd_FordVehLatACmpdVldPrev" 0 DISPLAY_IDENTIFIER FordMsg077BusHiSpd.PerInstanceMemories.FordVehLatACmpdVldPrev /end MEASUREMENT
/begin MEASUREMENT FordMsg077BusHiSpd.FordVehLgtACmpd.Val "MICROSAR RTE" FLOAT32_IEEE NO_COMPU_METHOD 0 0 -3.402823466e+38 3.402823466e+38 ECU_ADDRESS 0 SYMBOL_LINK "Rte_FordMsg077BusHiSpd_FordVehLgtACmpd_Val" 0 DISPLAY_IDENTIFIER FordMsg077BusHiSpd.SenderPorts.FordVehLgtACmpd.Val /end MEASUREMENT
/begin MEASUREMENT FordMsg077BusHiSpd.FordVehLgtACmpdInvldFaildRefTi "MICROSAR RTE" ULONG NO_COMPU_METHOD 0 0 0 4294967295 ECU_ADDRESS 0 SYMBOL_LINK "Rte_FordMsg077BusHiSpd_FordVehLgtACmpdInvldFaildRefTi" 0 DISPLAY_IDENTIFIER FordMsg077BusHiSpd.PerInstanceMemories.FordVehLgtACmpdInvldFaildRefTi /end MEASUREMENT
/begin MEASUREMENT FordMsg077BusHiSpd.FordVehLgtACmpdInvldPassdRefTi "MICROSAR RTE" ULONG NO_COMPU_METHOD 0 0 0 4294967295 ECU_ADDRESS 0 SYMBOL_LINK "Rte_FordMsg077BusHiSpd_FordVehLgtACmpdInvldPassdRefTi" 0 DISPLAY_IDENTIFIER FordMsg077BusHiSpd.PerInstanceMemories.FordVehLgtACmpdInvldPassdRefTi /end MEASUREMENT
/begin MEASUREMENT FordMsg077BusHiSpd.FordVehLgtACmpdPrev "MICROSAR RTE" FLOAT32_IEEE NO_COMPU_METHOD 0 0 -3.402823466e+38 3.402823466e+38 ECU_ADDRESS 0 SYMBOL_LINK "Rte_FordMsg077BusHiSpd_FordVehLgtACmpdPrev" 0 DISPLAY_IDENTIFIER FordMsg077BusHiSpd.PerInstanceMemories.FordVehLgtACmpdPrev /end MEASUREMENT
/begin MEASUREMENT FordMsg077BusHiSpd.FordVehLgtACmpdRaw.Val "MICROSAR RTE" UWORD NO_COMPU_METHOD 0 0 0 65535 ECU_ADDRESS 0 SYMBOL_LINK "Rte_FordMsg077BusHiSpd_FordVehLgtACmpdRaw_Val" 0 DISPLAY_IDENTIFIER FordMsg077BusHiSpd.SenderPorts.FordVehLgtACmpdRaw.Val /end MEASUREMENT
/begin MEASUREMENT FordMsg077BusHiSpd.FordVehLgtACmpdRawPrev "MICROSAR RTE" UWORD NO_COMPU_METHOD 0 0 0 65535 ECU_ADDRESS 0 SYMBOL_LINK "Rte_FordMsg077BusHiSpd_FordVehLgtACmpdRawPrev" 0 DISPLAY_IDENTIFIER FordMsg077BusHiSpd.PerInstanceMemories.FordVehLgtACmpdRawPrev /end MEASUREMENT
/begin MEASUREMENT FordMsg077BusHiSpd.FordVehLgtACmpdVld.Logl "MICROSAR RTE" UBYTE RTE_CM_BOOLEAN 0 0 0 255 ECU_ADDRESS 0 SYMBOL_LINK "Rte_FordMsg077BusHiSpd_FordVehLgtACmpdVld_Logl" 0 DISPLAY_IDENTIFIER FordMsg077BusHiSpd.SenderPorts.FordVehLgtACmpdVld.Logl /end MEASUREMENT
/begin MEASUREMENT FordMsg077BusHiSpd.FordVehLgtACmpdVldFaildRefTi "MICROSAR RTE" ULONG NO_COMPU_METHOD 0 0 0 4294967295 ECU_ADDRESS 0 SYMBOL_LINK "Rte_FordMsg077BusHiSpd_FordVehLgtACmpdVldFaildRefTi" 0 DISPLAY_IDENTIFIER FordMsg077BusHiSpd.PerInstanceMemories.FordVehLgtACmpdVldFaildRefTi /end MEASUREMENT
/begin MEASUREMENT FordMsg077BusHiSpd.FordVehLgtACmpdVldMissRefTi "MICROSAR RTE" ULONG NO_COMPU_METHOD 0 0 0 4294967295 ECU_ADDRESS 0 SYMBOL_LINK "Rte_FordMsg077BusHiSpd_FordVehLgtACmpdVldMissRefTi" 0 DISPLAY_IDENTIFIER FordMsg077BusHiSpd.PerInstanceMemories.FordVehLgtACmpdVldMissRefTi /end MEASUREMENT
/begin MEASUREMENT FordMsg077BusHiSpd.FordVehLgtACmpdVldPassdRefTi "MICROSAR RTE" ULONG NO_COMPU_METHOD 0 0 0 4294967295 ECU_ADDRESS 0 SYMBOL_LINK "Rte_FordMsg077BusHiSpd_FordVehLgtACmpdVldPassdRefTi" 0 DISPLAY_IDENTIFIER FordMsg077BusHiSpd.PerInstanceMemories.FordVehLgtACmpdVldPassdRefTi /end MEASUREMENT
/begin MEASUREMENT FordMsg077BusHiSpd.FordVehLgtACmpdVldPrev "MICROSAR RTE" UBYTE RTE_CM_BOOLEAN 0 0 0 255 ECU_ADDRESS 0 SYMBOL_LINK "Rte_FordMsg077BusHiSpd_FordVehLgtACmpdVldPrev" 0 DISPLAY_IDENTIFIER FordMsg077BusHiSpd.PerInstanceMemories.FordVehLgtACmpdVldPrev /end MEASUREMENT
/begin MEASUREMENT FordMsg077BusHiSpd.FordVehMsg77Miss "MICROSAR RTE" UBYTE RTE_CM_BOOLEAN 0 0 0 255 ECU_ADDRESS 0 SYMBOL_LINK "Rte_FordMsg077BusHiSpd_FordVehMsg77Miss" 0 DISPLAY_IDENTIFIER FordMsg077BusHiSpd.PerInstanceMemories.FordVehMsg77Miss /end MEASUREMENT
/begin MEASUREMENT FordMsg077BusHiSpd.FordVehSpdOverGnd.Val "MICROSAR RTE" FLOAT32_IEEE NO_COMPU_METHOD 0 0 -3.402823466e+38 3.402823466e+38 ECU_ADDRESS 0 SYMBOL_LINK "Rte_FordMsg077BusHiSpd_FordVehSpdOverGnd_Val" 0 DISPLAY_IDENTIFIER FordMsg077BusHiSpd.SenderPorts.FordVehSpdOverGnd.Val /end MEASUREMENT
/begin MEASUREMENT FordMsg077BusHiSpd.FordVehSpdOverGndInvldFaildRefTi "MICROSAR RTE" ULONG NO_COMPU_METHOD 0 0 0 4294967295 ECU_ADDRESS 0 SYMBOL_LINK "Rte_FordMsg077BusHiSpd_FordVehSpdOverGndInvldFaildRefTi" 0 DISPLAY_IDENTIFIER FordMsg077BusHiSpd.PerInstanceMemories.FordVehSpdOverGndInvldFaildRefTi /end MEASUREMENT
/begin MEASUREMENT FordMsg077BusHiSpd.FordVehSpdOverGndInvldPassdRefTi "MICROSAR RTE" ULONG NO_COMPU_METHOD 0 0 0 4294967295 ECU_ADDRESS 0 SYMBOL_LINK "Rte_FordMsg077BusHiSpd_FordVehSpdOverGndInvldPassdRefTi" 0 DISPLAY_IDENTIFIER FordMsg077BusHiSpd.PerInstanceMemories.FordVehSpdOverGndInvldPassdRefTi /end MEASUREMENT
/begin MEASUREMENT FordMsg077BusHiSpd.FordVehSpdOverGndPrev "MICROSAR RTE" FLOAT32_IEEE NO_COMPU_METHOD 0 0 -3.402823466e+38 3.402823466e+38 ECU_ADDRESS 0 SYMBOL_LINK "Rte_FordMsg077BusHiSpd_FordVehSpdOverGndPrev" 0 DISPLAY_IDENTIFIER FordMsg077BusHiSpd.PerInstanceMemories.FordVehSpdOverGndPrev /end MEASUREMENT
/begin MEASUREMENT FordMsg077BusHiSpd.FordVehSpdOverGndRaw.Val "MICROSAR RTE" UWORD NO_COMPU_METHOD 0 0 0 65535 ECU_ADDRESS 0 SYMBOL_LINK "Rte_FordMsg077BusHiSpd_FordVehSpdOverGndRaw_Val" 0 DISPLAY_IDENTIFIER FordMsg077BusHiSpd.SenderPorts.FordVehSpdOverGndRaw.Val /end MEASUREMENT
/begin MEASUREMENT FordMsg077BusHiSpd.FordVehSpdOverGndRawPrev "MICROSAR RTE" UWORD NO_COMPU_METHOD 0 0 0 65535 ECU_ADDRESS 0 SYMBOL_LINK "Rte_FordMsg077BusHiSpd_FordVehSpdOverGndRawPrev" 0 DISPLAY_IDENTIFIER FordMsg077BusHiSpd.PerInstanceMemories.FordVehSpdOverGndRawPrev /end MEASUREMENT
/begin MEASUREMENT FordMsg077BusHiSpd.FordVehSpdOverGndVld.Logl "MICROSAR RTE" UBYTE RTE_CM_BOOLEAN 0 0 0 255 ECU_ADDRESS 0 SYMBOL_LINK "Rte_FordMsg077BusHiSpd_FordVehSpdOverGndVld_Logl" 0 DISPLAY_IDENTIFIER FordMsg077BusHiSpd.SenderPorts.FordVehSpdOverGndVld.Logl /end MEASUREMENT
/begin MEASUREMENT FordMsg077BusHiSpd.FordVehSpdOverGndVldFaildRefTi "MICROSAR RTE" ULONG NO_COMPU_METHOD 0 0 0 4294967295 ECU_ADDRESS 0 SYMBOL_LINK "Rte_FordMsg077BusHiSpd_FordVehSpdOverGndVldFaildRefTi" 0 DISPLAY_IDENTIFIER FordMsg077BusHiSpd.PerInstanceMemories.FordVehSpdOverGndVldFaildRefTi /end MEASUREMENT
/begin MEASUREMENT FordMsg077BusHiSpd.FordVehSpdOverGndVldMissRefTi "MICROSAR RTE" ULONG NO_COMPU_METHOD 0 0 0 4294967295 ECU_ADDRESS 0 SYMBOL_LINK "Rte_FordMsg077BusHiSpd_FordVehSpdOverGndVldMissRefTi" 0 DISPLAY_IDENTIFIER FordMsg077BusHiSpd.PerInstanceMemories.FordVehSpdOverGndVldMissRefTi /end MEASUREMENT
/begin MEASUREMENT FordMsg077BusHiSpd.FordVehSpdOverGndVldPassdRefTi "MICROSAR RTE" ULONG NO_COMPU_METHOD 0 0 0 4294967295 ECU_ADDRESS 0 SYMBOL_LINK "Rte_FordMsg077BusHiSpd_FordVehSpdOverGndVldPassdRefTi" 0 DISPLAY_IDENTIFIER FordMsg077BusHiSpd.PerInstanceMemories.FordVehSpdOverGndVldPassdRefTi /end MEASUREMENT
/begin MEASUREMENT FordMsg077BusHiSpd.FordVehSpdOverGndVldPrev "MICROSAR RTE" UBYTE RTE_CM_BOOLEAN 0 0 0 255 ECU_ADDRESS 0 SYMBOL_LINK "Rte_FordMsg077BusHiSpd_FordVehSpdOverGndVldPrev" 0 DISPLAY_IDENTIFIER FordMsg077BusHiSpd.PerInstanceMemories.FordVehSpdOverGndVldPrev /end MEASUREMENT
/begin MEASUREMENT FordMsg077BusHiSpd.FordVehYawRateCmpd.Val "MICROSAR RTE" FLOAT32_IEEE NO_COMPU_METHOD 0 0 -3.402823466e+38 3.402823466e+38 ECU_ADDRESS 0 SYMBOL_LINK "Rte_FordMsg077BusHiSpd_FordVehYawRateCmpd_Val" 0 DISPLAY_IDENTIFIER FordMsg077BusHiSpd.SenderPorts.FordVehYawRateCmpd.Val /end MEASUREMENT
/begin MEASUREMENT FordMsg077BusHiSpd.FordVehYawRateCmpdInvldFaildRefTi "MICROSAR RTE" ULONG NO_COMPU_METHOD 0 0 0 4294967295 ECU_ADDRESS 0 SYMBOL_LINK "Rte_FordMsg077BusHiSpd_FordVehYawRateCmpdInvldFaildRefTi" 0 DISPLAY_IDENTIFIER FordMsg077BusHiSpd.PerInstanceMemories.FordVehYawRateCmpdInvldFaildRefTi /end MEASUREMENT
/begin MEASUREMENT FordMsg077BusHiSpd.FordVehYawRateCmpdInvldPassdRefTi "MICROSAR RTE" ULONG NO_COMPU_METHOD 0 0 0 4294967295 ECU_ADDRESS 0 SYMBOL_LINK "Rte_FordMsg077BusHiSpd_FordVehYawRateCmpdInvldPassdRefTi" 0 DISPLAY_IDENTIFIER FordMsg077BusHiSpd.PerInstanceMemories.FordVehYawRateCmpdInvldPassdRefTi /end MEASUREMENT
/begin MEASUREMENT FordMsg077BusHiSpd.FordVehYawRateCmpdPrev "MICROSAR RTE" FLOAT32_IEEE NO_COMPU_METHOD 0 0 -3.402823466e+38 3.402823466e+38 ECU_ADDRESS 0 SYMBOL_LINK "Rte_FordMsg077BusHiSpd_FordVehYawRateCmpdPrev" 0 DISPLAY_IDENTIFIER FordMsg077BusHiSpd.PerInstanceMemories.FordVehYawRateCmpdPrev /end MEASUREMENT
/begin MEASUREMENT FordMsg077BusHiSpd.FordVehYawRateCmpdRaw.Val "MICROSAR RTE" UWORD NO_COMPU_METHOD 0 0 0 65535 ECU_ADDRESS 0 SYMBOL_LINK "Rte_FordMsg077BusHiSpd_FordVehYawRateCmpdRaw_Val" 0 DISPLAY_IDENTIFIER FordMsg077BusHiSpd.SenderPorts.FordVehYawRateCmpdRaw.Val /end MEASUREMENT
/begin MEASUREMENT FordMsg077BusHiSpd.FordVehYawRateCmpdRawPrev "MICROSAR RTE" UWORD NO_COMPU_METHOD 0 0 0 65535 ECU_ADDRESS 0 SYMBOL_LINK "Rte_FordMsg077BusHiSpd_FordVehYawRateCmpdRawPrev" 0 DISPLAY_IDENTIFIER FordMsg077BusHiSpd.PerInstanceMemories.FordVehYawRateCmpdRawPrev /end MEASUREMENT
/begin MEASUREMENT FordMsg077BusHiSpd.FordVehYawRateCmpdVld.Logl "MICROSAR RTE" UBYTE RTE_CM_BOOLEAN 0 0 0 255 ECU_ADDRESS 0 SYMBOL_LINK "Rte_FordMsg077BusHiSpd_FordVehYawRateCmpdVld_Logl" 0 DISPLAY_IDENTIFIER FordMsg077BusHiSpd.SenderPorts.FordVehYawRateCmpdVld.Logl /end MEASUREMENT
/begin MEASUREMENT FordMsg077BusHiSpd.FordVehYawRateCmpdVldFaildRefTi "MICROSAR RTE" ULONG NO_COMPU_METHOD 0 0 0 4294967295 ECU_ADDRESS 0 SYMBOL_LINK "Rte_FordMsg077BusHiSpd_FordVehYawRateCmpdVldFaildRefTi" 0 DISPLAY_IDENTIFIER FordMsg077BusHiSpd.PerInstanceMemories.FordVehYawRateCmpdVldFaildRefTi /end MEASUREMENT
/begin MEASUREMENT FordMsg077BusHiSpd.FordVehYawRateCmpdVldMissRefTi "MICROSAR RTE" ULONG NO_COMPU_METHOD 0 0 0 4294967295 ECU_ADDRESS 0 SYMBOL_LINK "Rte_FordMsg077BusHiSpd_FordVehYawRateCmpdVldMissRefTi" 0 DISPLAY_IDENTIFIER FordMsg077BusHiSpd.PerInstanceMemories.FordVehYawRateCmpdVldMissRefTi /end MEASUREMENT
/begin MEASUREMENT FordMsg077BusHiSpd.FordVehYawRateCmpdVldPassdRefTi "MICROSAR RTE" ULONG NO_COMPU_METHOD 0 0 0 4294967295 ECU_ADDRESS 0 SYMBOL_LINK "Rte_FordMsg077BusHiSpd_FordVehYawRateCmpdVldPassdRefTi" 0 DISPLAY_IDENTIFIER FordMsg077BusHiSpd.PerInstanceMemories.FordVehYawRateCmpdVldPassdRefTi /end MEASUREMENT
/begin MEASUREMENT FordMsg077BusHiSpd.FordVehYawRateCmpdVldPrev "MICROSAR RTE" UBYTE RTE_CM_BOOLEAN 0 0 0 255 ECU_ADDRESS 0 SYMBOL_LINK "Rte_FordMsg077BusHiSpd_FordVehYawRateCmpdVldPrev" 0 DISPLAY_IDENTIFIER FordMsg077BusHiSpd.PerInstanceMemories.FordVehYawRateCmpdVldPrev /end MEASUREMENT
/begin MEASUREMENT FordMsg077BusHiSpd.MissMsgFaildRefTi "MICROSAR RTE" ULONG NO_COMPU_METHOD 0 0 0 4294967295 ECU_ADDRESS 0 SYMBOL_LINK "Rte_FordMsg077BusHiSpd_MissMsgFaildRefTi" 0 DISPLAY_IDENTIFIER FordMsg077BusHiSpd.PerInstanceMemories.MissMsgFaildRefTi /end MEASUREMENT
/begin MEASUREMENT FordMsg077BusHiSpd.MissMsgPassdRefTi "MICROSAR RTE" ULONG NO_COMPU_METHOD 0 0 0 4294967295 ECU_ADDRESS 0 SYMBOL_LINK "Rte_FordMsg077BusHiSpd_MissMsgPassdRefTi" 0 DISPLAY_IDENTIFIER FordMsg077BusHiSpd.PerInstanceMemories.MissMsgPassdRefTi /end MEASUREMENT
/begin MEASUREMENT FordMsg07DBusHiSpd.ClrDiagcFlgProxy.Val "MICROSAR RTE" UBYTE NO_COMPU_METHOD 0 0 0 255 ECU_ADDRESS 0 SYMBOL_LINK "Rte_DiagcMgr_ClrDiagcFlgProxy_Val" 0 DISPLAY_IDENTIFIER FordMsg07DBusHiSpd.ReceiverPorts.ClrDiagcFlgProxy.Val /end MEASUREMENT
/begin MEASUREMENT FordMsg07DBusHiSpd.ClrDiagcFlgProxyPrev "Clear Diagc Flag Proxy" UBYTE NO_COMPU_METHOD 0 0 0 255 ECU_ADDRESS 0 SYMBOL_LINK "Rte_FordMsg07DBusHiSpd_ClrDiagcFlgProxyPrev" 0 DISPLAY_IDENTIFIER FordMsg07DBusHiSpd.PerInstanceMemories.ClrDiagcFlgProxyPrev /end MEASUREMENT
/begin MEASUREMENT FordMsg07DBusHiSpd.FirstTranVldFlg "This flag is used to indicate the reception of first message" UBYTE RTE_CM_BOOLEAN 0 0 0 255 ECU_ADDRESS 0 SYMBOL_LINK "Rte_FordMsg07DBusHiSpd_FirstTranVldFlg" 0 DISPLAY_IDENTIFIER FordMsg07DBusHiSpd.PerInstanceMemories.FirstTranVldFlg /end MEASUREMENT
/begin MEASUREMENT FordMsg07DBusHiSpd.FordBrkOscnRednEnad.Logl "MICROSAR RTE" UBYTE RTE_CM_BOOLEAN 0 0 0 255 ECU_ADDRESS 0 SYMBOL_LINK "Rte_CustDiag_FordBrkPlsRejctnEnad_Logl" 0 DISPLAY_IDENTIFIER FordMsg07DBusHiSpd.ReceiverPorts.FordBrkOscnRednEnad.Logl /end MEASUREMENT
/begin MEASUREMENT FordMsg07DBusHiSpd.FordCanDtcInhb.Logl "MICROSAR RTE" UBYTE RTE_CM_BOOLEAN 0 0 0 255 ECU_ADDRESS 0 SYMBOL_LINK "Rte_FordCanDtcInhb_FordCanDtcInhb_Logl" 0 DISPLAY_IDENTIFIER FordMsg07DBusHiSpd.ReceiverPorts.FordCanDtcInhb.Logl /end MEASUREMENT
/begin MEASUREMENT FordMsg07DBusHiSpd.FordEpsLifeCycMod.Val "MICROSAR RTE" UBYTE NO_COMPU_METHOD 0 0 0 255 ECU_ADDRESS 0 SYMBOL_LINK "Rte_FordCanDtcInhb_FordEpsLifeCycMod_Val" 0 DISPLAY_IDENTIFIER FordMsg07DBusHiSpd.ReceiverPorts.FordEpsLifeCycMod.Val /end MEASUREMENT
/begin MEASUREMENT FordMsg07DBusHiSpd.FordTrlrBackUpAssiEnad.Logl "MICROSAR RTE" UBYTE RTE_CM_BOOLEAN 0 0 0 255 ECU_ADDRESS 0 SYMBOL_LINK "Rte_FordMsg07DBusHiSpd_FordTrlrBackUpAssiEnad_Logl" 0 DISPLAY_IDENTIFIER FordMsg07DBusHiSpd.ReceiverPorts.FordTrlrBackUpAssiEnad.Logl /end MEASUREMENT
/begin MEASUREMENT FordMsg07DBusHiSpd.FordVehActBrkTqRaw.Val "MICROSAR RTE" UWORD NO_COMPU_METHOD 0 0 0 65535 ECU_ADDRESS 0 SYMBOL_LINK "Rte_FordMsg07DBusHiSpd_FordVehActBrkTqRaw_Val" 0 DISPLAY_IDENTIFIER FordMsg07DBusHiSpd.SenderPorts.FordVehActBrkTqRaw.Val /end MEASUREMENT
/begin MEASUREMENT FordMsg07DBusHiSpd.FordVehActBrkTqRawPrev "Holds previous value of FordVehActBrkTqRaw when FordMsg07D message is missing" UWORD NO_COMPU_METHOD 0 0 0 65535 ECU_ADDRESS 0 SYMBOL_LINK "Rte_FordMsg07DBusHiSpd_FordVehActBrkTqRawPrev" 0 DISPLAY_IDENTIFIER FordMsg07DBusHiSpd.PerInstanceMemories.FordVehActBrkTqRawPrev /end MEASUREMENT
/begin MEASUREMENT FordMsg07DBusHiSpd.FordVehActBrkTqSigInvldFaildRefTi "Timer for invalid message will increment or reset based on the conditions for NTC0x110" ULONG NO_COMPU_METHOD 0 0 0 4294967295 ECU_ADDRESS 0 SYMBOL_LINK "Rte_FordMsg07DBusHiSpd_FordVehActBrkTqSigInvldFaildRefTi" 0 DISPLAY_IDENTIFIER FordMsg07DBusHiSpd.PerInstanceMemories.FordVehActBrkTqSigInvldFaildRefTi /end MEASUREMENT
/begin MEASUREMENT FordMsg07DBusHiSpd.FordVehActBrkTqSigInvldPassdRefTi "Timer for invalid message will increment or reset based on the conditions for NTC0x110" ULONG NO_COMPU_METHOD 0 0 0 4294967295 ECU_ADDRESS 0 SYMBOL_LINK "Rte_FordMsg07DBusHiSpd_FordVehActBrkTqSigInvldPassdRefTi" 0 DISPLAY_IDENTIFIER FordMsg07DBusHiSpd.PerInstanceMemories.FordVehActBrkTqSigInvldPassdRefTi /end MEASUREMENT
/begin MEASUREMENT FordMsg07DBusHiSpd.FordVehActBrkTqVldFaildRefTi "Timer for Ford Vehicle Actual Brake Torque Valid Failed Reference Time will increment or reset based on the conditions" ULONG NO_COMPU_METHOD 0 0 0 4294967295 ECU_ADDRESS 0 SYMBOL_LINK "Rte_FordMsg07DBusHiSpd_FordVehActBrkTqVldFaildRefTi" 0 DISPLAY_IDENTIFIER FordMsg07DBusHiSpd.PerInstanceMemories.FordVehActBrkTqVldFaildRefTi /end MEASUREMENT
/begin MEASUREMENT FordMsg07DBusHiSpd.FordVehActBrkTqVldPassdRefTi "Timer for Ford Vehicle Actual Brake Torque Valid Passed Reference Time will increment or reset based on the conditions" ULONG NO_COMPU_METHOD 0 0 0 4294967295 ECU_ADDRESS 0 SYMBOL_LINK "Rte_FordMsg07DBusHiSpd_FordVehActBrkTqVldPassdRefTi" 0 DISPLAY_IDENTIFIER FordMsg07DBusHiSpd.PerInstanceMemories.FordVehActBrkTqVldPassdRefTi /end MEASUREMENT
/begin MEASUREMENT FordMsg07DBusHiSpd.FordVehBrkTqVld.Logl "MICROSAR RTE" UBYTE RTE_CM_BOOLEAN 0 0 0 255 ECU_ADDRESS 0 SYMBOL_LINK "Rte_FordMsg07DBusHiSpd_FordVehBrkTqVld_Logl" 0 DISPLAY_IDENTIFIER FordMsg07DBusHiSpd.SenderPorts.FordVehBrkTqVld.Logl /end MEASUREMENT
/begin MEASUREMENT FordMsg07DBusHiSpd.FordVehBrkTqVldMissMsgRefTi "Timer to update Ford Vehicle Brake Torque Valid signal as true or false when FordMsg07D message is missing" ULONG NO_COMPU_METHOD 0 0 0 4294967295 ECU_ADDRESS 0 SYMBOL_LINK "Rte_FordMsg07DBusHiSpd_FordVehBrkTqVldMissMsgRefTi" 0 DISPLAY_IDENTIFIER FordMsg07DBusHiSpd.PerInstanceMemories.FordVehBrkTqVldMissMsgRefTi /end MEASUREMENT
/begin MEASUREMENT FordMsg07DBusHiSpd.FordVehBrkTqVldPrev "Holds previous value of FordVehBrkTqVld when FordMsg07D message is missing" UBYTE RTE_CM_BOOLEAN 0 0 0 255 ECU_ADDRESS 0 SYMBOL_LINK "Rte_FordMsg07DBusHiSpd_FordVehBrkTqVldPrev" 0 DISPLAY_IDENTIFIER FordMsg07DBusHiSpd.PerInstanceMemories.FordVehBrkTqVldPrev /end MEASUREMENT
/begin MEASUREMENT FordMsg07DBusHiSpd.FordVehMsg07DMiss "Flag for missing message diagnostics, it is true when message is missing" UBYTE RTE_CM_BOOLEAN 0 0 0 255 ECU_ADDRESS 0 SYMBOL_LINK "Rte_FordMsg07DBusHiSpd_FordVehMsg07DMiss" 0 DISPLAY_IDENTIFIER FordMsg07DBusHiSpd.PerInstanceMemories.FordVehMsg07DMiss /end MEASUREMENT
/begin MEASUREMENT FordMsg07DBusHiSpd.FordVehVertACmpdRaw.Val "MICROSAR RTE" UWORD NO_COMPU_METHOD 0 0 0 65535 ECU_ADDRESS 0 SYMBOL_LINK "Rte_FordMsg07DBusHiSpd_FordVehVertACmpdRaw_Val" 0 DISPLAY_IDENTIFIER FordMsg07DBusHiSpd.SenderPorts.FordVehVertACmpdRaw.Val /end MEASUREMENT
/begin MEASUREMENT FordMsg07DBusHiSpd.FordVehVertACmpdRawPrev "Holds previous value of FordVehVertACmpdRaw when FordMsg07D message is missing" UWORD NO_COMPU_METHOD 0 0 0 65535 ECU_ADDRESS 0 SYMBOL_LINK "Rte_FordMsg07DBusHiSpd_FordVehVertACmpdRawPrev" 0 DISPLAY_IDENTIFIER FordMsg07DBusHiSpd.PerInstanceMemories.FordVehVertACmpdRawPrev /end MEASUREMENT
/begin MEASUREMENT FordMsg07DBusHiSpd.FordVehVertACmpdSigInvldFaildRefTi "Timer for invalid message will increment or reset based on the conditions for NTC0x111" ULONG NO_COMPU_METHOD 0 0 0 4294967295 ECU_ADDRESS 0 SYMBOL_LINK "Rte_FordMsg07DBusHiSpd_FordVehVertACmpdSigInvldFaildRefTi" 0 DISPLAY_IDENTIFIER FordMsg07DBusHiSpd.PerInstanceMemories.FordVehVertACmpdSigInvldFaildRefTi /end MEASUREMENT
/begin MEASUREMENT FordMsg07DBusHiSpd.FordVehVertACmpdSigInvldPassdRefTi "Timer for invalid message will increment or reset based on the conditions for NTC0x111" ULONG NO_COMPU_METHOD 0 0 0 4294967295 ECU_ADDRESS 0 SYMBOL_LINK "Rte_FordMsg07DBusHiSpd_FordVehVertACmpdSigInvldPassdRefTi" 0 DISPLAY_IDENTIFIER FordMsg07DBusHiSpd.PerInstanceMemories.FordVehVertACmpdSigInvldPassdRefTi /end MEASUREMENT
/begin MEASUREMENT FordMsg07DBusHiSpd.FordVehVertACmpdSigVldFaildRefTi "Timer for Ford Vehicle Vertical Acceleration Compensated Signal Valid Failed Reference Time will increment or reset based on the conditions" ULONG NO_COMPU_METHOD 0 0 0 4294967295 ECU_ADDRESS 0 SYMBOL_LINK "Rte_FordMsg07DBusHiSpd_FordVehVertACmpdSigVldFaildRefTi" 0 DISPLAY_IDENTIFIER FordMsg07DBusHiSpd.PerInstanceMemories.FordVehVertACmpdSigVldFaildRefTi /end MEASUREMENT
/begin MEASUREMENT FordMsg07DBusHiSpd.FordVehVertACmpdSigVldPassdRefTi "Timer for Ford Vehicle Vertical Acceleration Compensated Signal Valid Passed Reference Time will increment or reset based on the conditions" ULONG NO_COMPU_METHOD 0 0 0 4294967295 ECU_ADDRESS 0 SYMBOL_LINK "Rte_FordMsg07DBusHiSpd_FordVehVertACmpdSigVldPassdRefTi" 0 DISPLAY_IDENTIFIER FordMsg07DBusHiSpd.PerInstanceMemories.FordVehVertACmpdSigVldPassdRefTi /end MEASUREMENT
/begin MEASUREMENT FordMsg07DBusHiSpd.FordVehVertAVld.Logl "MICROSAR RTE" UBYTE RTE_CM_BOOLEAN 0 0 0 255 ECU_ADDRESS 0 SYMBOL_LINK "Rte_FordMsg07DBusHiSpd_FordVehVertAVld_Logl" 0 DISPLAY_IDENTIFIER FordMsg07DBusHiSpd.SenderPorts.FordVehVertAVld.Logl /end MEASUREMENT
/begin MEASUREMENT FordMsg07DBusHiSpd.FordVehVertAVldMissMsgRefTi "Timer for Ford Vehicle Vertical Acceleration Compensated Signal Valid Missing Reference Time will increment or reset based on the conditions" ULONG NO_COMPU_METHOD 0 0 0 4294967295 ECU_ADDRESS 0 SYMBOL_LINK "Rte_FordMsg07DBusHiSpd_FordVehVertAVldMissMsgRefTi" 0 DISPLAY_IDENTIFIER FordMsg07DBusHiSpd.PerInstanceMemories.FordVehVertAVldMissMsgRefTi /end MEASUREMENT
/begin MEASUREMENT FordMsg07DBusHiSpd.FordVehVertAVldPrev "Previous Value of Ford Vehicle Vertical Acceleration Valid" UBYTE RTE_CM_BOOLEAN 0 0 0 255 ECU_ADDRESS 0 SYMBOL_LINK "Rte_FordMsg07DBusHiSpd_FordVehVertAVldPrev" 0 DISPLAY_IDENTIFIER FordMsg07DBusHiSpd.PerInstanceMemories.FordVehVertAVldPrev /end MEASUREMENT
/begin MEASUREMENT FordMsg07DBusHiSpd.MissMsgFaildRefTi "Timer for missing message will increment or reset based on the conditions" ULONG NO_COMPU_METHOD 0 0 0 4294967295 ECU_ADDRESS 0 SYMBOL_LINK "Rte_FordMsg07DBusHiSpd_MissMsgFaildRefTi" 0 DISPLAY_IDENTIFIER FordMsg07DBusHiSpd.PerInstanceMemories.MissMsgFaildRefTi /end MEASUREMENT
/begin MEASUREMENT FordMsg07DBusHiSpd.MissMsgPassdRefTi "Timer for missing message will increment or reset based on the conditions" ULONG NO_COMPU_METHOD 0 0 0 4294967295 ECU_ADDRESS 0 SYMBOL_LINK "Rte_FordMsg07DBusHiSpd_MissMsgPassdRefTi" 0 DISPLAY_IDENTIFIER FordMsg07DBusHiSpd.PerInstanceMemories.MissMsgPassdRefTi /end MEASUREMENT
/begin MEASUREMENT FordMsg07EBusHiSpd.CmpdSteerPinionAg.Val "MICROSAR RTE" FLOAT32_IEEE NO_COMPU_METHOD 0 0 -3.402823466e+38 3.402823466e+38 ECU_ADDRESS 0 SYMBOL_LINK "Rte_FordHwAgArbn_FordCmpdHwPosntoSerlCom_Val" 0 DISPLAY_IDENTIFIER FordMsg07EBusHiSpd.ReceiverPorts.CmpdSteerPinionAg.Val /end MEASUREMENT
/begin MEASUREMENT FordMsg07EBusHiSpd.CmpdSteerPinionAgQlyFac.Ford_StePinCompAnEst_D_Qf "MICROSAR RTE" UBYTE RTE_CM_ENUM_Ford_StePinCompAnEst_D_Qf 0 0 0 3 ECU_ADDRESS 0 SYMBOL_LINK "Rte_FordHwAgArbn_FordCmpdHwPosnQlyFac_Ford_StePinCompAnEst_D_Qf" 0 DISPLAY_IDENTIFIER FordMsg07EBusHiSpd.ReceiverPorts.CmpdSteerPinionAgQlyFac.Ford_StePinCompAnEst_D_Qf /end MEASUREMENT
/begin MEASUREMENT FordMsg07EBusHiSpd.FordVehSteerPwrReq.Ford_StePw_B_Rq "MICROSAR RTE" UBYTE RTE_CM_BOOLEAN 0 0 0 255 ECU_ADDRESS 0 SYMBOL_LINK "Rte_FordMsg07EBusHiSpd_FordVehSteerPwrReq_Ford_StePw_B_Rq" 0 DISPLAY_IDENTIFIER FordMsg07EBusHiSpd.ReceiverPorts.FordVehSteerPwrReq.Ford_StePw_B_Rq /end MEASUREMENT
/begin MEASUREMENT FordMsg07EBusHiSpd.RelSteerPinionAg.Val "MICROSAR RTE" FLOAT32_IEEE NO_COMPU_METHOD 0 0 -3.402823466e+38 3.402823466e+38 ECU_ADDRESS 0 SYMBOL_LINK "Rte_FordHwAgArbn_FordRelHwPosntoSerlCom_Val" 0 DISPLAY_IDENTIFIER FordMsg07EBusHiSpd.ReceiverPorts.RelSteerPinionAg.Val /end MEASUREMENT
/begin MEASUREMENT FordMsg07EBusHiSpd.SteerPinionAgCntrPrev "MICROSAR RTE" UBYTE NO_COMPU_METHOD 0 0 0 255 ECU_ADDRESS 0 SYMBOL_LINK "Rte_FordMsg07EBusHiSpd_SteerPinionAgCntrPrev" 0 DISPLAY_IDENTIFIER FordMsg07EBusHiSpd.PerInstanceMemories.SteerPinionAgCntrPrev /end MEASUREMENT
/begin MEASUREMENT FordMsg082BusHiSpd.ElecPwrSteerCurr.Val "MICROSAR RTE" FLOAT32_IEEE NO_COMPU_METHOD 0 0 -3.402823466e+38 3.402823466e+38 ECU_ADDRESS 0 SYMBOL_LINK "Rte_FordVltgIf_FordEpsCurr_Val" 0 DISPLAY_IDENTIFIER FordMsg082BusHiSpd.ReceiverPorts.ElecPwrSteerCurr.Val /end MEASUREMENT
/begin MEASUREMENT FordMsg082BusHiSpd.ElecPwrSteerVltg.Val "MICROSAR RTE" FLOAT32_IEEE NO_COMPU_METHOD 0 0 -3.402823466e+38 3.402823466e+38 ECU_ADDRESS 0 SYMBOL_LINK "Rte_FordVltgIf_FordEpsVltg_Val" 0 DISPLAY_IDENTIFIER FordMsg082BusHiSpd.ReceiverPorts.ElecPwrSteerVltg.Val /end MEASUREMENT
/begin MEASUREMENT FordMsg082BusHiSpd.FordElecPwrAssidSteerFailr.Ford_EPAS_Failure "MICROSAR RTE" UBYTE RTE_CM_ENUM_Ford_EPAS_Failure 0 0 0 3 ECU_ADDRESS 0 SYMBOL_LINK "Rte_FordSysSt_FordEpsFailr_Ford_EPAS_Failure" 0 DISPLAY_IDENTIFIER FordMsg082BusHiSpd.ReceiverPorts.FordElecPwrAssidSteerFailr.Ford_EPAS_Failure /end MEASUREMENT
/begin MEASUREMENT FordMsg082BusHiSpd.FordSteerModlSts.Ford_SteMdule_D_Stat "MICROSAR RTE" UBYTE RTE_CM_ENUM_Ford_SteMdule_D_Stat 0 0 0 7 ECU_ADDRESS 0 SYMBOL_LINK "Rte_FordSysSt_FordSteerModlSts_Ford_SteMdule_D_Stat" 0 DISPLAY_IDENTIFIER FordMsg082BusHiSpd.ReceiverPorts.FordSteerModlSts.Ford_SteMdule_D_Stat /end MEASUREMENT
/begin MEASUREMENT FordMsg082BusHiSpd.FordVehDrvrSteerActvnSts.Ford_DrvSteActv_B_Stat "MICROSAR RTE" UBYTE RTE_CM_BOOLEAN 0 0 0 255 ECU_ADDRESS 0 SYMBOL_LINK "Rte_FordMsg082BusHiSpd_FordVehDrvrSteerActvnSts_Ford_DrvSteActv_B_Stat" 0 DISPLAY_IDENTIFIER FordMsg082BusHiSpd.ReceiverPorts.FordVehDrvrSteerActvnSts.Ford_DrvSteActv_B_Stat /end MEASUREMENT
/begin MEASUREMENT FordMsg082BusHiSpd.FordVehDrvrSteerTqReq.Val "MICROSAR RTE" FLOAT32_IEEE NO_COMPU_METHOD 0 0 -3.402823466e+38 3.402823466e+38 ECU_ADDRESS 0 SYMBOL_LINK "Rte_FordMsg082BusHiSpd_FordVehDrvrSteerTqReq_Val" 0 DISPLAY_IDENTIFIER FordMsg082BusHiSpd.ReceiverPorts.FordVehDrvrSteerTqReq.Val /end MEASUREMENT
/begin MEASUREMENT FordMsg082BusHiSpd.FordVehReCamrLiSts.Ford_TrlrHitchLamp_D_Rqst "MICROSAR RTE" UBYTE RTE_CM_BOOLEAN 0 0 0 255 ECU_ADDRESS 0 SYMBOL_LINK "Rte_FordMsg082BusHiSpd_FordVehReCamrLiSts_Ford_TrlrHitchLamp_D_Rqst" 0 DISPLAY_IDENTIFIER FordMsg082BusHiSpd.ReceiverPorts.FordVehReCamrLiSts.Ford_TrlrHitchLamp_D_Rqst /end MEASUREMENT
/begin MEASUREMENT FordMsg082BusHiSpd.FordVehSAPPAgCtrlSts1.Ford_SAPPAngleControlStat1 "MICROSAR RTE" UBYTE RTE_CM_ENUM_Ford_SAPPAngleControlStat1 0 0 0 3 ECU_ADDRESS 0 SYMBOL_LINK "Rte_FordMsg082BusHiSpd_FordVehSAPPAgCtrlSts1_Ford_SAPPAngleControlStat1" 0 DISPLAY_IDENTIFIER FordMsg082BusHiSpd.ReceiverPorts.FordVehSAPPAgCtrlSts1.Ford_SAPPAngleControlStat1 /end MEASUREMENT
/begin MEASUREMENT FordMsg082BusHiSpd.FordVehSAPPAgCtrlSts2.Ford_SAPPAngleControlStat2 "MICROSAR RTE" UBYTE RTE_CM_BOOLEAN 0 0 0 255 ECU_ADDRESS 0 SYMBOL_LINK "Rte_FordMsg082BusHiSpd_FordVehSAPPAgCtrlSts2_Ford_SAPPAngleControlStat2" 0 DISPLAY_IDENTIFIER FordMsg082BusHiSpd.ReceiverPorts.FordVehSAPPAgCtrlSts2.Ford_SAPPAngleControlStat2 /end MEASUREMENT
/begin MEASUREMENT FordMsg082BusHiSpd.FordVehSAPPAgCtrlSts3.Ford_SAPPAngleControlStat3 "MICROSAR RTE" UBYTE RTE_CM_BOOLEAN 0 0 0 255 ECU_ADDRESS 0 SYMBOL_LINK "Rte_FordMsg082BusHiSpd_FordVehSAPPAgCtrlSts3_Ford_SAPPAngleControlStat3" 0 DISPLAY_IDENTIFIER FordMsg082BusHiSpd.ReceiverPorts.FordVehSAPPAgCtrlSts3.Ford_SAPPAngleControlStat3 /end MEASUREMENT
/begin MEASUREMENT FordMsg082BusHiSpd.FordVehSAPPAgCtrlSts4.Ford_SAPPAngleControlStat4 "MICROSAR RTE" UBYTE RTE_CM_BOOLEAN 0 0 0 255 ECU_ADDRESS 0 SYMBOL_LINK "Rte_FordMsg082BusHiSpd_FordVehSAPPAgCtrlSts4_Ford_SAPPAngleControlStat4" 0 DISPLAY_IDENTIFIER FordMsg082BusHiSpd.ReceiverPorts.FordVehSAPPAgCtrlSts4.Ford_SAPPAngleControlStat4 /end MEASUREMENT
/begin MEASUREMENT FordMsg082BusHiSpd.FordVehSAPPAgCtrlSts5.Ford_SAPPAngleControlStat5 "MICROSAR RTE" UBYTE RTE_CM_BOOLEAN 0 0 0 255 ECU_ADDRESS 0 SYMBOL_LINK "Rte_FordMsg082BusHiSpd_FordVehSAPPAgCtrlSts5_Ford_SAPPAngleControlStat5" 0 DISPLAY_IDENTIFIER FordMsg082BusHiSpd.ReceiverPorts.FordVehSAPPAgCtrlSts5.Ford_SAPPAngleControlStat5 /end MEASUREMENT
/begin MEASUREMENT FordMsg082BusHiSpd.FordVehSAPPAgCtrlSts6.Ford_SAPPAngleControlStat6 "MICROSAR RTE" UBYTE RTE_CM_BOOLEAN 0 0 0 255 ECU_ADDRESS 0 SYMBOL_LINK "Rte_FordMsg082BusHiSpd_FordVehSAPPAgCtrlSts6_Ford_SAPPAngleControlStat6" 0 DISPLAY_IDENTIFIER FordMsg082BusHiSpd.ReceiverPorts.FordVehSAPPAgCtrlSts6.Ford_SAPPAngleControlStat6 /end MEASUREMENT
/begin MEASUREMENT FordMsg082BusHiSpd.FordVehVelMaxReqTrlrAid.Val "MICROSAR RTE" UBYTE NO_COMPU_METHOD 0 0 0 255 ECU_ADDRESS 0 SYMBOL_LINK "Rte_CDD_FordBlaBoxIfCmp1_FordVehVelMaxReqTrlrAid_Val" 0 DISPLAY_IDENTIFIER FordMsg082BusHiSpd.ReceiverPorts.FordVehVelMaxReqTrlrAid.Val /end MEASUREMENT
/begin MEASUREMENT FordMsg082BusHiSpd.FordVehVelTrlrAidReq.Ford_VehVTrlrAid_B_Rq "MICROSAR RTE" UBYTE RTE_CM_BOOLEAN 0 0 0 255 ECU_ADDRESS 0 SYMBOL_LINK "Rte_FordMsg082BusHiSpd_FordVehVelTrlrAidReq_Ford_VehVTrlrAid_B_Rq" 0 DISPLAY_IDENTIFIER FordMsg082BusHiSpd.ReceiverPorts.FordVehVelTrlrAidReq.Ford_VehVTrlrAid_B_Rq /end MEASUREMENT
/begin MEASUREMENT FordMsg082BusHiSpd.InpTqRaw.Val "MICROSAR RTE" FLOAT32_IEEE NO_COMPU_METHOD 0 0 -3.402823466e+38 3.402823466e+38 ECU_ADDRESS 0 SYMBOL_LINK "Rte_FordMsg082BusHiSpd_InpTqRaw_Val" 0 DISPLAY_IDENTIFIER FordMsg082BusHiSpd.ReceiverPorts.InpTqRaw.Val /end MEASUREMENT
/begin MEASUREMENT FordMsg083BusHiSpd.ClrDiagcFlgProxy.Val "MICROSAR RTE" UBYTE NO_COMPU_METHOD 0 0 0 255 ECU_ADDRESS 0 SYMBOL_LINK "Rte_DiagcMgr_ClrDiagcFlgProxy_Val" 0 DISPLAY_IDENTIFIER FordMsg083BusHiSpd.ReceiverPorts.ClrDiagcFlgProxy.Val /end MEASUREMENT
/begin MEASUREMENT FordMsg083BusHiSpd.ClrDiagcFlgProxyPrev "Clear Diagc Flag Proxy" UBYTE NO_COMPU_METHOD 0 0 0 255 ECU_ADDRESS 0 SYMBOL_LINK "Rte_FordMsg083BusHiSpd_ClrDiagcFlgProxyPrev" 0 DISPLAY_IDENTIFIER FordMsg083BusHiSpd.PerInstanceMemories.ClrDiagcFlgProxyPrev /end MEASUREMENT
/begin MEASUREMENT FordMsg083BusHiSpd.FirstTranVldFlg "This flag is used to indicate the reception of first message" UBYTE RTE_CM_BOOLEAN 0 0 0 255 ECU_ADDRESS 0 SYMBOL_LINK "Rte_FordMsg083BusHiSpd_FirstTranVldFlg" 0 DISPLAY_IDENTIFIER FordMsg083BusHiSpd.PerInstanceMemories.FirstTranVldFlg /end MEASUREMENT
/begin MEASUREMENT FordMsg083BusHiSpd.FordCanDtcInhb.Logl "MICROSAR RTE" UBYTE RTE_CM_BOOLEAN 0 0 0 255 ECU_ADDRESS 0 SYMBOL_LINK "Rte_FordCanDtcInhb_FordCanDtcInhb_Logl" 0 DISPLAY_IDENTIFIER FordMsg083BusHiSpd.ReceiverPorts.FordCanDtcInhb.Logl /end MEASUREMENT
/begin MEASUREMENT FordMsg083BusHiSpd.FordEpsLifeCycMod.Val "MICROSAR RTE" UBYTE NO_COMPU_METHOD 0 0 0 255 ECU_ADDRESS 0 SYMBOL_LINK "Rte_FordCanDtcInhb_FordEpsLifeCycMod_Val" 0 DISPLAY_IDENTIFIER FordMsg083BusHiSpd.ReceiverPorts.FordEpsLifeCycMod.Val /end MEASUREMENT
/begin MEASUREMENT FordMsg083BusHiSpd.FordLaneDetnWarnEnad.Logl "MICROSAR RTE" UBYTE RTE_CM_BOOLEAN 0 0 0 255 ECU_ADDRESS 0 SYMBOL_LINK "Rte_CustDiag_FordLaneDprtrWarnEnad_Logl" 0 DISPLAY_IDENTIFIER FordMsg083BusHiSpd.ReceiverPorts.FordLaneDetnWarnEnad.Logl /end MEASUREMENT
/begin MEASUREMENT FordMsg083BusHiSpd.FordVehMsg083Miss "Flag for missing message diagnostics, it is true when message is missing" UBYTE RTE_CM_BOOLEAN 0 0 0 255 ECU_ADDRESS 0 SYMBOL_LINK "Rte_FordMsg083BusHiSpd_FordVehMsg083Miss" 0 DISPLAY_IDENTIFIER FordMsg083BusHiSpd.PerInstanceMemories.FordVehMsg083Miss /end MEASUREMENT
/begin MEASUREMENT FordMsg083BusHiSpd.FordVehTurnSigSwtStsRaw.Val "MICROSAR RTE" UBYTE NO_COMPU_METHOD 0 0 0 255 ECU_ADDRESS 0 SYMBOL_LINK "Rte_FordMsg083BusHiSpd_FordVehTurnSigSwtStsRaw_Val" 0 DISPLAY_IDENTIFIER FordMsg083BusHiSpd.SenderPorts.FordVehTurnSigSwtStsRaw.Val /end MEASUREMENT
/begin MEASUREMENT FordMsg083BusHiSpd.FordVehTurnSigSwtStsRawPrev "Previous value of Ford Vehicle Turn Signal Switch Status Raw" UBYTE RTE_CM_ENUM_Ford_TurnLghtSwtch_D_Stat 0 0 0 3 ECU_ADDRESS 0 SYMBOL_LINK "Rte_FordMsg083BusHiSpd_FordVehTurnSigSwtStsRawPrev" 0 DISPLAY_IDENTIFIER FordMsg083BusHiSpd.PerInstanceMemories.FordVehTurnSigSwtStsRawPrev /end MEASUREMENT
/begin MEASUREMENT FordMsg083BusHiSpd.FordVehTurnSigVld.Logl "MICROSAR RTE" UBYTE RTE_CM_BOOLEAN 0 0 0 255 ECU_ADDRESS 0 SYMBOL_LINK "Rte_FordMsg083BusHiSpd_FordVehTurnSigVld_Logl" 0 DISPLAY_IDENTIFIER FordMsg083BusHiSpd.SenderPorts.FordVehTurnSigVld.Logl /end MEASUREMENT
/begin MEASUREMENT FordMsg083BusHiSpd.FordVehTurnSigVldMissMsgRefTi "Timer for misisng message will increment or reset based on the conditions" ULONG NO_COMPU_METHOD 0 0 0 4294967295 ECU_ADDRESS 0 SYMBOL_LINK "Rte_FordMsg083BusHiSpd_FordVehTurnSigVldMissMsgRefTi" 0 DISPLAY_IDENTIFIER FordMsg083BusHiSpd.PerInstanceMemories.FordVehTurnSigVldMissMsgRefTi /end MEASUREMENT
/begin MEASUREMENT FordMsg083BusHiSpd.FordVehTurnSigVldPrev "Used to hold previous value of Ford Vehicle Turn Signal Valid" UBYTE RTE_CM_BOOLEAN 0 0 0 255 ECU_ADDRESS 0 SYMBOL_LINK "Rte_FordMsg083BusHiSpd_FordVehTurnSigVldPrev" 0 DISPLAY_IDENTIFIER FordMsg083BusHiSpd.PerInstanceMemories.FordVehTurnSigVldPrev /end MEASUREMENT
/begin MEASUREMENT FordMsg083BusHiSpd.FordVehTurnSigVldRefTi "Timer to update Ford Vehicle Turn Signal Valid as true or false based on calibration threshold" ULONG NO_COMPU_METHOD 0 0 0 4294967295 ECU_ADDRESS 0 SYMBOL_LINK "Rte_FordMsg083BusHiSpd_FordVehTurnSigVldRefTi" 0 DISPLAY_IDENTIFIER FordMsg083BusHiSpd.PerInstanceMemories.FordVehTurnSigVldRefTi /end MEASUREMENT
/begin MEASUREMENT FordMsg083BusHiSpd.MissMsgFaildRefTi "Timer for misisng message will increment or reset based on the message availabilty" ULONG NO_COMPU_METHOD 0 0 0 4294967295 ECU_ADDRESS 0 SYMBOL_LINK "Rte_FordMsg083BusHiSpd_MissMsgFaildRefTi" 0 DISPLAY_IDENTIFIER FordMsg083BusHiSpd.PerInstanceMemories.MissMsgFaildRefTi /end MEASUREMENT
/begin MEASUREMENT FordMsg083BusHiSpd.MissMsgPassdRefTi "Timer for misisng message will increment or reset based on the message availabilty" ULONG NO_COMPU_METHOD 0 0 0 4294967295 ECU_ADDRESS 0 SYMBOL_LINK "Rte_FordMsg083BusHiSpd_MissMsgPassdRefTi" 0 DISPLAY_IDENTIFIER FordMsg083BusHiSpd.PerInstanceMemories.MissMsgPassdRefTi /end MEASUREMENT
/begin MEASUREMENT FordMsg091BusHiSpd.ClrDiagcFlgProxy.Val "MICROSAR RTE" UBYTE NO_COMPU_METHOD 0 0 0 255 ECU_ADDRESS 0 SYMBOL_LINK "Rte_DiagcMgr_ClrDiagcFlgProxy_Val" 0 DISPLAY_IDENTIFIER FordMsg091BusHiSpd.ReceiverPorts.ClrDiagcFlgProxy.Val /end MEASUREMENT
/begin MEASUREMENT FordMsg091BusHiSpd.ClrDiagcFlgProxyPrev "MICROSAR RTE" UBYTE NO_COMPU_METHOD 0 0 0 255 ECU_ADDRESS 0 SYMBOL_LINK "Rte_FordMsg091BusHiSpd_ClrDiagcFlgProxyPrev" 0 DISPLAY_IDENTIFIER FordMsg091BusHiSpd.PerInstanceMemories.ClrDiagcFlgProxyPrev /end MEASUREMENT
/begin MEASUREMENT FordMsg091BusHiSpd.FirstTranVldFlg "MICROSAR RTE" UBYTE RTE_CM_BOOLEAN 0 0 0 255 ECU_ADDRESS 0 SYMBOL_LINK "Rte_FordMsg091BusHiSpd_FirstTranVldFlg" 0 DISPLAY_IDENTIFIER FordMsg091BusHiSpd.PerInstanceMemories.FirstTranVldFlg /end MEASUREMENT
/begin MEASUREMENT FordMsg091BusHiSpd.FordCanDtcInhb.Logl "MICROSAR RTE" UBYTE RTE_CM_BOOLEAN 0 0 0 255 ECU_ADDRESS 0 SYMBOL_LINK "Rte_FordCanDtcInhb_FordCanDtcInhb_Logl" 0 DISPLAY_IDENTIFIER FordMsg091BusHiSpd.ReceiverPorts.FordCanDtcInhb.Logl /end MEASUREMENT
/begin MEASUREMENT FordMsg091BusHiSpd.FordEpsLifeCycMod.Val "MICROSAR RTE" UBYTE NO_COMPU_METHOD 0 0 0 255 ECU_ADDRESS 0 SYMBOL_LINK "Rte_FordCanDtcInhb_FordEpsLifeCycMod_Val" 0 DISPLAY_IDENTIFIER FordMsg091BusHiSpd.ReceiverPorts.FordEpsLifeCycMod.Val /end MEASUREMENT
/begin MEASUREMENT FordMsg091BusHiSpd.FordLaneCentrAssiEnad.Logl "MICROSAR RTE" UBYTE RTE_CM_BOOLEAN 0 0 0 255 ECU_ADDRESS 0 SYMBOL_LINK "Rte_CustDiag_FordLaneCentrAssiEnad_Logl" 0 DISPLAY_IDENTIFIER FordMsg091BusHiSpd.ReceiverPorts.FordLaneCentrAssiEnad.Logl /end MEASUREMENT
/begin MEASUREMENT FordMsg091BusHiSpd.FordTrfcJamAssiEnad.Logl "MICROSAR RTE" UBYTE RTE_CM_BOOLEAN 0 0 0 255 ECU_ADDRESS 0 SYMBOL_LINK "Rte_CustDiag_FordTrfcJamAssiEnad_Logl" 0 DISPLAY_IDENTIFIER FordMsg091BusHiSpd.ReceiverPorts.FordTrfcJamAssiEnad.Logl /end MEASUREMENT
/begin MEASUREMENT FordMsg091BusHiSpd.FordTrlrBackUpAssiEnad.Logl "MICROSAR RTE" UBYTE RTE_CM_BOOLEAN 0 0 0 255 ECU_ADDRESS 0 SYMBOL_LINK "Rte_FordMsg091BusHiSpd_FordTrlrBackUpAssiEnad_Logl" 0 DISPLAY_IDENTIFIER FordMsg091BusHiSpd.ReceiverPorts.FordTrlrBackUpAssiEnad.Logl /end MEASUREMENT
/begin MEASUREMENT FordMsg091BusHiSpd.FordVehMsg091Miss "MICROSAR RTE" UBYTE RTE_CM_BOOLEAN 0 0 0 255 ECU_ADDRESS 0 SYMBOL_LINK "Rte_FordMsg091BusHiSpd_FordVehMsg091Miss" 0 DISPLAY_IDENTIFIER FordMsg091BusHiSpd.PerInstanceMemories.FordVehMsg091Miss /end MEASUREMENT
/begin MEASUREMENT FordMsg091BusHiSpd.FordVehYawRate.Val "MICROSAR RTE" FLOAT32_IEEE NO_COMPU_METHOD 0 0 -3.402823466e+38 3.402823466e+38 ECU_ADDRESS 0 SYMBOL_LINK "Rte_FordMsg091BusHiSpd_FordVehYawRate_Val" 0 DISPLAY_IDENTIFIER FordMsg091BusHiSpd.SenderPorts.FordVehYawRate.Val /end MEASUREMENT
/begin MEASUREMENT FordMsg091BusHiSpd.FordVehYawRatePrev "MICROSAR RTE" FLOAT32_IEEE NO_COMPU_METHOD 0 0 -3.402823466e+38 3.402823466e+38 ECU_ADDRESS 0 SYMBOL_LINK "Rte_FordMsg091BusHiSpd_FordVehYawRatePrev" 0 DISPLAY_IDENTIFIER FordMsg091BusHiSpd.PerInstanceMemories.FordVehYawRatePrev /end MEASUREMENT
/begin MEASUREMENT FordMsg091BusHiSpd.FordVehYawRateRaw.Ford_VehYaw_W_Actl "MICROSAR RTE" UWORD RTE_CM_Ford_VehYaw_W_Actl 0 0 -6.5 6.607 ECU_ADDRESS 0 SYMBOL_LINK "Rte_FordMsg091BusHiSpd_FordVehYawRateRaw_Ford_VehYaw_W_Actl" 0 DISPLAY_IDENTIFIER FordMsg091BusHiSpd.SenderPorts.FordVehYawRateRaw.Ford_VehYaw_W_Actl /end MEASUREMENT
/begin MEASUREMENT FordMsg091BusHiSpd.FordVehYawRateRawPrev "MICROSAR RTE" UWORD NO_COMPU_METHOD 0 0 0 65535 ECU_ADDRESS 0 SYMBOL_LINK "Rte_FordMsg091BusHiSpd_FordVehYawRateRawPrev" 0 DISPLAY_IDENTIFIER FordMsg091BusHiSpd.PerInstanceMemories.FordVehYawRateRawPrev /end MEASUREMENT
/begin MEASUREMENT FordMsg091BusHiSpd.FordVehYawRateRawVld.Logl "MICROSAR RTE" UBYTE RTE_CM_BOOLEAN 0 0 0 255 ECU_ADDRESS 0 SYMBOL_LINK "Rte_FordMsg091BusHiSpd_FordVehYawRateRawVld_Logl" 0 DISPLAY_IDENTIFIER FordMsg091BusHiSpd.SenderPorts.FordVehYawRateRawVld.Logl /end MEASUREMENT
/begin MEASUREMENT FordMsg091BusHiSpd.FordVehYawRateRawVldFaildRefTi "MICROSAR RTE" ULONG NO_COMPU_METHOD 0 0 0 4294967295 ECU_ADDRESS 0 SYMBOL_LINK "Rte_FordMsg091BusHiSpd_FordVehYawRateRawVldFaildRefTi" 0 DISPLAY_IDENTIFIER FordMsg091BusHiSpd.PerInstanceMemories.FordVehYawRateRawVldFaildRefTi /end MEASUREMENT
/begin MEASUREMENT FordMsg091BusHiSpd.FordVehYawRateRawVldMissRefTi "MICROSAR RTE" ULONG NO_COMPU_METHOD 0 0 0 4294967295 ECU_ADDRESS 0 SYMBOL_LINK "Rte_FordMsg091BusHiSpd_FordVehYawRateRawVldMissRefTi" 0 DISPLAY_IDENTIFIER FordMsg091BusHiSpd.PerInstanceMemories.FordVehYawRateRawVldMissRefTi /end MEASUREMENT
/begin MEASUREMENT FordMsg091BusHiSpd.FordVehYawRateRawVldPassdRefTi "MICROSAR RTE" ULONG NO_COMPU_METHOD 0 0 0 4294967295 ECU_ADDRESS 0 SYMBOL_LINK "Rte_FordMsg091BusHiSpd_FordVehYawRateRawVldPassdRefTi" 0 DISPLAY_IDENTIFIER FordMsg091BusHiSpd.PerInstanceMemories.FordVehYawRateRawVldPassdRefTi /end MEASUREMENT
/begin MEASUREMENT FordMsg091BusHiSpd.FordVehYawRateRawVldPrev "MICROSAR RTE" UBYTE RTE_CM_BOOLEAN 0 0 0 255 ECU_ADDRESS 0 SYMBOL_LINK "Rte_FordMsg091BusHiSpd_FordVehYawRateRawVldPrev" 0 DISPLAY_IDENTIFIER FordMsg091BusHiSpd.PerInstanceMemories.FordVehYawRateRawVldPrev /end MEASUREMENT
/begin MEASUREMENT FordMsg091BusHiSpd.InvldMsgFaildRefTi "MICROSAR RTE" ULONG NO_COMPU_METHOD 0 0 0 4294967295 ECU_ADDRESS 0 SYMBOL_LINK "Rte_FordMsg091BusHiSpd_InvldMsgFaildRefTi" 0 DISPLAY_IDENTIFIER FordMsg091BusHiSpd.PerInstanceMemories.InvldMsgFaildRefTi /end MEASUREMENT
/begin MEASUREMENT FordMsg091BusHiSpd.InvldMsgPassdRefTi "MICROSAR RTE" ULONG NO_COMPU_METHOD 0 0 0 4294967295 ECU_ADDRESS 0 SYMBOL_LINK "Rte_FordMsg091BusHiSpd_InvldMsgPassdRefTi" 0 DISPLAY_IDENTIFIER FordMsg091BusHiSpd.PerInstanceMemories.InvldMsgPassdRefTi /end MEASUREMENT
/begin MEASUREMENT FordMsg091BusHiSpd.MissMsgFaildRefTi "MICROSAR RTE" ULONG NO_COMPU_METHOD 0 0 0 4294967295 ECU_ADDRESS 0 SYMBOL_LINK "Rte_FordMsg091BusHiSpd_MissMsgFaildRefTi" 0 DISPLAY_IDENTIFIER FordMsg091BusHiSpd.PerInstanceMemories.MissMsgFaildRefTi /end MEASUREMENT
/begin MEASUREMENT FordMsg091BusHiSpd.MissMsgPassdRefTi "MICROSAR RTE" ULONG NO_COMPU_METHOD 0 0 0 4294967295 ECU_ADDRESS 0 SYMBOL_LINK "Rte_FordMsg091BusHiSpd_MissMsgPassdRefTi" 0 DISPLAY_IDENTIFIER FordMsg091BusHiSpd.PerInstanceMemories.MissMsgPassdRefTi /end MEASUREMENT
/begin MEASUREMENT FordMsg167BusHiSpd.ClrDiagcFlgProxy.Val "MICROSAR RTE" UBYTE NO_COMPU_METHOD 0 0 0 255 ECU_ADDRESS 0 SYMBOL_LINK "Rte_DiagcMgr_ClrDiagcFlgProxy_Val" 0 DISPLAY_IDENTIFIER FordMsg167BusHiSpd.ReceiverPorts.ClrDiagcFlgProxy.Val /end MEASUREMENT
/begin MEASUREMENT FordMsg167BusHiSpd.ClrDiagcFlgProxyPrev "MICROSAR RTE" UBYTE NO_COMPU_METHOD 0 0 0 255 ECU_ADDRESS 0 SYMBOL_LINK "Rte_FordMsg167BusHiSpd_ClrDiagcFlgProxyPrev" 0 DISPLAY_IDENTIFIER FordMsg167BusHiSpd.PerInstanceMemories.ClrDiagcFlgProxyPrev /end MEASUREMENT
/begin MEASUREMENT FordMsg167BusHiSpd.FirstTranVldFlg "MICROSAR RTE" UBYTE RTE_CM_BOOLEAN 0 0 0 255 ECU_ADDRESS 0 SYMBOL_LINK "Rte_FordMsg167BusHiSpd_FirstTranVldFlg" 0 DISPLAY_IDENTIFIER FordMsg167BusHiSpd.PerInstanceMemories.FirstTranVldFlg /end MEASUREMENT
/begin MEASUREMENT FordMsg167BusHiSpd.FordBrkOscnRednEnad.Logl "MICROSAR RTE" UBYTE RTE_CM_BOOLEAN 0 0 0 255 ECU_ADDRESS 0 SYMBOL_LINK "Rte_CustDiag_FordBrkPlsRejctnEnad_Logl" 0 DISPLAY_IDENTIFIER FordMsg167BusHiSpd.ReceiverPorts.FordBrkOscnRednEnad.Logl /end MEASUREMENT
/begin MEASUREMENT FordMsg167BusHiSpd.FordCanDtcInhb.Val "MICROSAR RTE" UBYTE NO_COMPU_METHOD 0 0 0 255 ECU_ADDRESS 0 SYMBOL_LINK "Rte_FordCanDtcInhb_FordCanDtcInhb8_Val" 0 DISPLAY_IDENTIFIER FordMsg167BusHiSpd.ReceiverPorts.FordCanDtcInhb.Val /end MEASUREMENT
/begin MEASUREMENT FordMsg167BusHiSpd.FordEpsLifeCycMod.Val "MICROSAR RTE" UBYTE NO_COMPU_METHOD 0 0 0 255 ECU_ADDRESS 0 SYMBOL_LINK "Rte_FordCanDtcInhb_FordEpsLifeCycMod_Val" 0 DISPLAY_IDENTIFIER FordMsg167BusHiSpd.ReceiverPorts.FordEpsLifeCycMod.Val /end MEASUREMENT
/begin MEASUREMENT FordMsg167BusHiSpd.FordInvldMsgDiagcInhb.Val "MICROSAR RTE" UBYTE NO_COMPU_METHOD 0 0 0 255 ECU_ADDRESS 0 SYMBOL_LINK "Rte_FordMsg167BusHiSpd_FordInvldMsgDiagcInhb_Val" 0 DISPLAY_IDENTIFIER FordMsg167BusHiSpd.ReceiverPorts.FordInvldMsgDiagcInhb.Val /end MEASUREMENT
/begin MEASUREMENT FordMsg167BusHiSpd.FordMfgDiagcInhb.Val "MICROSAR RTE" UBYTE NO_COMPU_METHOD 0 0 0 255 ECU_ADDRESS 0 SYMBOL_LINK "Rte_FordMsg167BusHiSpd_FordMfgDiagcInhb_Val" 0 DISPLAY_IDENTIFIER FordMsg167BusHiSpd.ReceiverPorts.FordMfgDiagcInhb.Val /end MEASUREMENT
/begin MEASUREMENT FordMsg167BusHiSpd.FordMissMsgDiagcInhb.Val "MICROSAR RTE" UBYTE NO_COMPU_METHOD 0 0 0 255 ECU_ADDRESS 0 SYMBOL_LINK "Rte_FordMsg167BusHiSpd_FordMissMsgDiagcInhb_Val" 0 DISPLAY_IDENTIFIER FordMsg167BusHiSpd.ReceiverPorts.FordMissMsgDiagcInhb.Val /end MEASUREMENT
/begin MEASUREMENT FordMsg167BusHiSpd.FordTqSteerCmpEnad.Logl "MICROSAR RTE" UBYTE RTE_CM_BOOLEAN 0 0 0 255 ECU_ADDRESS 0 SYMBOL_LINK "Rte_CustDiag_FordTqSteerCmpEnad_Logl" 0 DISPLAY_IDENTIFIER FordMsg167BusHiSpd.ReceiverPorts.FordTqSteerCmpEnad.Logl /end MEASUREMENT
/begin MEASUREMENT FordMsg167BusHiSpd.FordTrlrBackUpAssiEnad.Logl "MICROSAR RTE" UBYTE RTE_CM_BOOLEAN 0 0 0 255 ECU_ADDRESS 0 SYMBOL_LINK "Rte_FordMsg167BusHiSpd_FordTrlrBackUpAssiEnad_Logl" 0 DISPLAY_IDENTIFIER FordMsg167BusHiSpd.ReceiverPorts.FordTrlrBackUpAssiEnad.Logl /end MEASUREMENT
/begin MEASUREMENT FordMsg167BusHiSpd.FordVehElecPwrStrtStopSts.Ford_ElPw_D_StatStrtStop "MICROSAR RTE" UBYTE RTE_CM_ENUM_Ford_ElPw_D_StatStrtStop 0 0 0 15 ECU_ADDRESS 0 SYMBOL_LINK "Rte_FordMsg167BusHiSpd_FordVehElecPwrStrtStopSts_Ford_ElPw_D_StatStrtStop" 0 DISPLAY_IDENTIFIER FordMsg167BusHiSpd.SenderPorts.FordVehElecPwrStrtStopSts.Ford_ElPw_D_StatStrtStop /end MEASUREMENT
/begin MEASUREMENT FordMsg167BusHiSpd.FordVehElecPwrStrtStopStsPrev "MICROSAR RTE" UBYTE RTE_CM_ENUM_Ford_ElPw_D_StatStrtStop 0 0 0 15 ECU_ADDRESS 0 SYMBOL_LINK "Rte_FordMsg167BusHiSpd_FordVehElecPwrStrtStopStsPrev" 0 DISPLAY_IDENTIFIER FordMsg167BusHiSpd.PerInstanceMemories.FordVehElecPwrStrtStopStsPrev /end MEASUREMENT
/begin MEASUREMENT FordMsg167BusHiSpd.FordVehElecPwrSts.Ford_ElPw_D_Stat "MICROSAR RTE" UBYTE RTE_CM_ENUM_Ford_ElPw_D_Stat 0 0 0 7 ECU_ADDRESS 0 SYMBOL_LINK "Rte_FordMsg167BusHiSpd_FordVehElecPwrSts_Ford_ElPw_D_Stat" 0 DISPLAY_IDENTIFIER FordMsg167BusHiSpd.SenderPorts.FordVehElecPwrSts.Ford_ElPw_D_Stat /end MEASUREMENT
/begin MEASUREMENT FordMsg167BusHiSpd.FordVehElecPwrStsPrev "MICROSAR RTE" UBYTE RTE_CM_ENUM_Ford_ElPw_D_Stat 0 0 0 7 ECU_ADDRESS 0 SYMBOL_LINK "Rte_FordMsg167BusHiSpd_FordVehElecPwrStsPrev" 0 DISPLAY_IDENTIFIER FordMsg167BusHiSpd.PerInstanceMemories.FordVehElecPwrStsPrev /end MEASUREMENT
/begin MEASUREMENT FordMsg167BusHiSpd.FordVehMsg167Miss "MICROSAR RTE" UBYTE RTE_CM_BOOLEAN 0 0 0 255 ECU_ADDRESS 0 SYMBOL_LINK "Rte_FordMsg167BusHiSpd_FordVehMsg167Miss" 0 DISPLAY_IDENTIFIER FordMsg167BusHiSpd.PerInstanceMemories.FordVehMsg167Miss /end MEASUREMENT
/begin MEASUREMENT FordMsg167BusHiSpd.FordVehMsg167Rxd "MICROSAR RTE" UBYTE RTE_CM_BOOLEAN 0 0 0 255 ECU_ADDRESS 0 SYMBOL_LINK "Rte_FordMsg167BusHiSpd_FordVehMsg167Rxd" 0 DISPLAY_IDENTIFIER FordMsg167BusHiSpd.PerInstanceMemories.FordVehMsg167Rxd /end MEASUREMENT
/begin MEASUREMENT FordMsg167BusHiSpd.FordVehPrpnWhlTq.Val "MICROSAR RTE" FLOAT32_IEEE NO_COMPU_METHOD 0 0 -3.402823466e+38 3.402823466e+38 ECU_ADDRESS 0 SYMBOL_LINK "Rte_FordMsg167BusHiSpd_FordVehPrpnWhlTq_Val" 0 DISPLAY_IDENTIFIER FordMsg167BusHiSpd.SenderPorts.FordVehPrpnWhlTq.Val /end MEASUREMENT
/begin MEASUREMENT FordMsg167BusHiSpd.FordVehPrpnWhlTqPrev "MICROSAR RTE" FLOAT32_IEEE NO_COMPU_METHOD 0 0 -3.402823466e+38 3.402823466e+38 ECU_ADDRESS 0 SYMBOL_LINK "Rte_FordMsg167BusHiSpd_FordVehPrpnWhlTqPrev" 0 DISPLAY_IDENTIFIER FordMsg167BusHiSpd.PerInstanceMemories.FordVehPrpnWhlTqPrev /end MEASUREMENT
/begin MEASUREMENT FordMsg167BusHiSpd.FordVehPrpnWhlTqRaw.Val "MICROSAR RTE" UWORD NO_COMPU_METHOD 0 0 0 65535 ECU_ADDRESS 0 SYMBOL_LINK "Rte_FordMsg167BusHiSpd_FordVehPrpnWhlTqRaw_Val" 0 DISPLAY_IDENTIFIER FordMsg167BusHiSpd.SenderPorts.FordVehPrpnWhlTqRaw.Val /end MEASUREMENT
/begin MEASUREMENT FordMsg167BusHiSpd.FordVehPrpnWhlTqRawPrev "MICROSAR RTE" UWORD NO_COMPU_METHOD 0 0 0 65535 ECU_ADDRESS 0 SYMBOL_LINK "Rte_FordMsg167BusHiSpd_FordVehPrpnWhlTqRawPrev" 0 DISPLAY_IDENTIFIER FordMsg167BusHiSpd.PerInstanceMemories.FordVehPrpnWhlTqRawPrev /end MEASUREMENT
/begin MEASUREMENT FordMsg167BusHiSpd.FordVehPrpnWhlTqSigInvldFaildRefTi "MICROSAR RTE" ULONG NO_COMPU_METHOD 0 0 0 4294967295 ECU_ADDRESS 0 SYMBOL_LINK "Rte_FordMsg167BusHiSpd_FordVehPrpnWhlTqSigInvldFaildRefTi" 0 DISPLAY_IDENTIFIER FordMsg167BusHiSpd.PerInstanceMemories.FordVehPrpnWhlTqSigInvldFaildRefTi /end MEASUREMENT
/begin MEASUREMENT FordMsg167BusHiSpd.FordVehPrpnWhlTqSigInvldPassdRefTi "MICROSAR RTE" ULONG NO_COMPU_METHOD 0 0 0 4294967295 ECU_ADDRESS 0 SYMBOL_LINK "Rte_FordMsg167BusHiSpd_FordVehPrpnWhlTqSigInvldPassdRefTi" 0 DISPLAY_IDENTIFIER FordMsg167BusHiSpd.PerInstanceMemories.FordVehPrpnWhlTqSigInvldPassdRefTi /end MEASUREMENT
/begin MEASUREMENT FordMsg167BusHiSpd.FordVehPrpnWhlTqVld.Logl "MICROSAR RTE" UBYTE RTE_CM_BOOLEAN 0 0 0 255 ECU_ADDRESS 0 SYMBOL_LINK "Rte_FordMsg167BusHiSpd_FordVehPrpnWhlTqVld_Logl" 0 DISPLAY_IDENTIFIER FordMsg167BusHiSpd.SenderPorts.FordVehPrpnWhlTqVld.Logl /end MEASUREMENT
/begin MEASUREMENT FordMsg167BusHiSpd.FordVehPrpnWhlTqVldPrev "MICROSAR RTE" UBYTE RTE_CM_BOOLEAN 0 0 0 255 ECU_ADDRESS 0 SYMBOL_LINK "Rte_FordMsg167BusHiSpd_FordVehPrpnWhlTqVldPrev" 0 DISPLAY_IDENTIFIER FordMsg167BusHiSpd.PerInstanceMemories.FordVehPrpnWhlTqVldPrev /end MEASUREMENT
/begin MEASUREMENT FordMsg167BusHiSpd.FordVehPwrpkTqSts.Ford_PwPckTq_D_Stat "MICROSAR RTE" UBYTE RTE_CM_ENUM_Ford_PwPckTq_D_Stat 0 0 0 3 ECU_ADDRESS 0 SYMBOL_LINK "Rte_FordMsg167BusHiSpd_FordVehPwrpkTqSts_Ford_PwPckTq_D_Stat" 0 DISPLAY_IDENTIFIER FordMsg167BusHiSpd.SenderPorts.FordVehPwrpkTqSts.Ford_PwPckTq_D_Stat /end MEASUREMENT
/begin MEASUREMENT FordMsg167BusHiSpd.FordVehPwrpkTqStsPrev "MICROSAR RTE" UBYTE RTE_CM_ENUM_Ford_PwPckTq_D_Stat 0 0 0 3 ECU_ADDRESS 0 SYMBOL_LINK "Rte_FordMsg167BusHiSpd_FordVehPwrpkTqStsPrev" 0 DISPLAY_IDENTIFIER FordMsg167BusHiSpd.PerInstanceMemories.FordVehPwrpkTqStsPrev /end MEASUREMENT
/begin MEASUREMENT FordMsg167BusHiSpd.MissMsgFaildRefTi "MICROSAR RTE" ULONG NO_COMPU_METHOD 0 0 0 4294967295 ECU_ADDRESS 0 SYMBOL_LINK "Rte_FordMsg167BusHiSpd_MissMsgFaildRefTi" 0 DISPLAY_IDENTIFIER FordMsg167BusHiSpd.PerInstanceMemories.MissMsgFaildRefTi /end MEASUREMENT
/begin MEASUREMENT FordMsg167BusHiSpd.MissMsgPassdRefTi "MICROSAR RTE" ULONG NO_COMPU_METHOD 0 0 0 4294967295 ECU_ADDRESS 0 SYMBOL_LINK "Rte_FordMsg167BusHiSpd_MissMsgPassdRefTi" 0 DISPLAY_IDENTIFIER FordMsg167BusHiSpd.PerInstanceMemories.MissMsgPassdRefTi /end MEASUREMENT
/begin MEASUREMENT FordMsg167BusHiSpd.PrpnWhlTqVldFaildRefTi "MICROSAR RTE" ULONG NO_COMPU_METHOD 0 0 0 4294967295 ECU_ADDRESS 0 SYMBOL_LINK "Rte_FordMsg167BusHiSpd_PrpnWhlTqVldFaildRefTi" 0 DISPLAY_IDENTIFIER FordMsg167BusHiSpd.PerInstanceMemories.PrpnWhlTqVldFaildRefTi /end MEASUREMENT
/begin MEASUREMENT FordMsg167BusHiSpd.PrpnWhlTqVldMissRefTi "MICROSAR RTE" ULONG NO_COMPU_METHOD 0 0 0 4294967295 ECU_ADDRESS 0 SYMBOL_LINK "Rte_FordMsg167BusHiSpd_PrpnWhlTqVldMissRefTi" 0 DISPLAY_IDENTIFIER FordMsg167BusHiSpd.PerInstanceMemories.PrpnWhlTqVldMissRefTi /end MEASUREMENT
/begin MEASUREMENT FordMsg167BusHiSpd.PrpnWhlTqVldPassdRefTi "MICROSAR RTE" ULONG NO_COMPU_METHOD 0 0 0 4294967295 ECU_ADDRESS 0 SYMBOL_LINK "Rte_FordMsg167BusHiSpd_PrpnWhlTqVldPassdRefTi" 0 DISPLAY_IDENTIFIER FordMsg167BusHiSpd.PerInstanceMemories.PrpnWhlTqVldPassdRefTi /end MEASUREMENT
/begin MEASUREMENT FordMsg202BusHiSpd.ClrDiagcFlgProxy.Val "MICROSAR RTE" UBYTE NO_COMPU_METHOD 0 0 0 255 ECU_ADDRESS 0 SYMBOL_LINK "Rte_DiagcMgr_ClrDiagcFlgProxy_Val" 0 DISPLAY_IDENTIFIER FordMsg202BusHiSpd.ReceiverPorts.ClrDiagcFlgProxy.Val /end MEASUREMENT
/begin MEASUREMENT FordMsg202BusHiSpd.ClrDiagcFlgProxyPrev "MICROSAR RTE" UBYTE NO_COMPU_METHOD 0 0 0 255 ECU_ADDRESS 0 SYMBOL_LINK "Rte_FordMsg202BusHiSpd_ClrDiagcFlgProxyPrev" 0 DISPLAY_IDENTIFIER FordMsg202BusHiSpd.PerInstanceMemories.ClrDiagcFlgProxyPrev /end MEASUREMENT
/begin MEASUREMENT FordMsg202BusHiSpd.FirstTranVldFlg "MICROSAR RTE" UBYTE RTE_CM_BOOLEAN 0 0 0 255 ECU_ADDRESS 0 SYMBOL_LINK "Rte_FordMsg202BusHiSpd_FirstTranVldFlg" 0 DISPLAY_IDENTIFIER FordMsg202BusHiSpd.PerInstanceMemories.FirstTranVldFlg /end MEASUREMENT
/begin MEASUREMENT FordMsg202BusHiSpd.FordAbsPrsnt.Logl "MICROSAR RTE" UBYTE RTE_CM_BOOLEAN 0 0 0 255 ECU_ADDRESS 0 SYMBOL_LINK "Rte_CustDiag_FordAbsPrsnt_Logl" 0 DISPLAY_IDENTIFIER FordMsg202BusHiSpd.ReceiverPorts.FordAbsPrsnt.Logl /end MEASUREMENT
/begin MEASUREMENT FordMsg202BusHiSpd.FordBrkOscnRednEnad.Logl "MICROSAR RTE" UBYTE RTE_CM_BOOLEAN 0 0 0 255 ECU_ADDRESS 0 SYMBOL_LINK "Rte_CustDiag_FordBrkPlsRejctnEnad_Logl" 0 DISPLAY_IDENTIFIER FordMsg202BusHiSpd.ReceiverPorts.FordBrkOscnRednEnad.Logl /end MEASUREMENT
/begin MEASUREMENT FordMsg202BusHiSpd.FordCanDtcInhb.Val "MICROSAR RTE" UBYTE NO_COMPU_METHOD 0 0 0 255 ECU_ADDRESS 0 SYMBOL_LINK "Rte_FordCanDtcInhb_FordCanDtcInhb8_Val" 0 DISPLAY_IDENTIFIER FordMsg202BusHiSpd.ReceiverPorts.FordCanDtcInhb.Val /end MEASUREMENT
/begin MEASUREMENT FordMsg202BusHiSpd.FordEpsLifeCycMod.Val "MICROSAR RTE" UBYTE NO_COMPU_METHOD 0 0 0 255 ECU_ADDRESS 0 SYMBOL_LINK "Rte_FordCanDtcInhb_FordEpsLifeCycMod_Val" 0 DISPLAY_IDENTIFIER FordMsg202BusHiSpd.ReceiverPorts.FordEpsLifeCycMod.Val /end MEASUREMENT
/begin MEASUREMENT FordMsg202BusHiSpd.FordInvldMsgDiagcInhb.Val "MICROSAR RTE" UBYTE NO_COMPU_METHOD 0 0 0 255 ECU_ADDRESS 0 SYMBOL_LINK "Rte_FordMsg202BusHiSpd_FordInvldMsgDiagcInhb_Val" 0 DISPLAY_IDENTIFIER FordMsg202BusHiSpd.ReceiverPorts.FordInvldMsgDiagcInhb.Val /end MEASUREMENT
/begin MEASUREMENT FordMsg202BusHiSpd.FordMfgDiagcInhb.Val "MICROSAR RTE" UBYTE NO_COMPU_METHOD 0 0 0 255 ECU_ADDRESS 0 SYMBOL_LINK "Rte_FordMsg202BusHiSpd_FordMfgDiagcInhb_Val" 0 DISPLAY_IDENTIFIER FordMsg202BusHiSpd.ReceiverPorts.FordMfgDiagcInhb.Val /end MEASUREMENT
/begin MEASUREMENT FordMsg202BusHiSpd.FordMissMsgDiagcInhb.Val "MICROSAR RTE" UBYTE NO_COMPU_METHOD 0 0 0 255 ECU_ADDRESS 0 SYMBOL_LINK "Rte_FordMsg202BusHiSpd_FordMissMsgDiagcInhb_Val" 0 DISPLAY_IDENTIFIER FordMsg202BusHiSpd.ReceiverPorts.FordMissMsgDiagcInhb.Val /end MEASUREMENT
/begin MEASUREMENT FordMsg202BusHiSpd.FordTqSteerCmpEnad.Logl "MICROSAR RTE" UBYTE RTE_CM_BOOLEAN 0 0 0 255 ECU_ADDRESS 0 SYMBOL_LINK "Rte_CustDiag_FordTqSteerCmpEnad_Logl" 0 DISPLAY_IDENTIFIER FordMsg202BusHiSpd.ReceiverPorts.FordTqSteerCmpEnad.Logl /end MEASUREMENT
/begin MEASUREMENT FordMsg202BusHiSpd.FordTrlrBackupAssiEnad.Logl "MICROSAR RTE" UBYTE RTE_CM_BOOLEAN 0 0 0 255 ECU_ADDRESS 0 SYMBOL_LINK "Rte_FordMsg202BusHiSpd_FordTrlrBackupAssiEnad_Logl" 0 DISPLAY_IDENTIFIER FordMsg202BusHiSpd.ReceiverPorts.FordTrlrBackupAssiEnad.Logl /end MEASUREMENT
/begin MEASUREMENT FordMsg202BusHiSpd.FordVehGearRvsSts.Ford_GearRvrse_D_Actl "MICROSAR RTE" UBYTE RTE_CM_ENUM_Ford_GearRvrse_D_Actl 0 0 0 7 ECU_ADDRESS 0 SYMBOL_LINK "Rte_FordMsg202BusHiSpd_FordVehGearRvsSts_Ford_GearRvrse_D_Actl" 0 DISPLAY_IDENTIFIER FordMsg202BusHiSpd.SenderPorts.FordVehGearRvsSts.Ford_GearRvrse_D_Actl /end MEASUREMENT
/begin MEASUREMENT FordMsg202BusHiSpd.FordVehGearRvsStsInvldFaildRefTi "MICROSAR RTE" ULONG NO_COMPU_METHOD 0 0 0 4294967295 ECU_ADDRESS 0 SYMBOL_LINK "Rte_FordMsg202BusHiSpd_FordVehGearRvsStsInvldFaildRefTi" 0 DISPLAY_IDENTIFIER FordMsg202BusHiSpd.PerInstanceMemories.FordVehGearRvsStsInvldFaildRefTi /end MEASUREMENT
/begin MEASUREMENT FordMsg202BusHiSpd.FordVehGearRvsStsInvldPassdRefTi "MICROSAR RTE" ULONG NO_COMPU_METHOD 0 0 0 4294967295 ECU_ADDRESS 0 SYMBOL_LINK "Rte_FordMsg202BusHiSpd_FordVehGearRvsStsInvldPassdRefTi" 0 DISPLAY_IDENTIFIER FordMsg202BusHiSpd.PerInstanceMemories.FordVehGearRvsStsInvldPassdRefTi /end MEASUREMENT
/begin MEASUREMENT FordMsg202BusHiSpd.FordVehGearRvsStsPrev "MICROSAR RTE" UBYTE RTE_CM_ENUM_Ford_GearRvrse_D_Actl 0 0 0 7 ECU_ADDRESS 0 SYMBOL_LINK "Rte_FordMsg202BusHiSpd_FordVehGearRvsStsPrev" 0 DISPLAY_IDENTIFIER FordMsg202BusHiSpd.PerInstanceMemories.FordVehGearRvsStsPrev /end MEASUREMENT
/begin MEASUREMENT FordMsg202BusHiSpd.FordVehGearRvsStsRaw.Val "MICROSAR RTE" UBYTE NO_COMPU_METHOD 0 0 0 255 ECU_ADDRESS 0 SYMBOL_LINK "Rte_FordMsg202BusHiSpd_FordVehGearRvsStsRaw_Val" 0 DISPLAY_IDENTIFIER FordMsg202BusHiSpd.SenderPorts.FordVehGearRvsStsRaw.Val /end MEASUREMENT
/begin MEASUREMENT FordMsg202BusHiSpd.FordVehGearRvsStsRawPrev "MICROSAR RTE" UBYTE NO_COMPU_METHOD 0 0 0 255 ECU_ADDRESS 0 SYMBOL_LINK "Rte_FordMsg202BusHiSpd_FordVehGearRvsStsRawPrev" 0 DISPLAY_IDENTIFIER FordMsg202BusHiSpd.PerInstanceMemories.FordVehGearRvsStsRawPrev /end MEASUREMENT
/begin MEASUREMENT FordMsg202BusHiSpd.FordVehGearRvsStsVld.Logl "MICROSAR RTE" UBYTE RTE_CM_BOOLEAN 0 0 0 255 ECU_ADDRESS 0 SYMBOL_LINK "Rte_FordMsg202BusHiSpd_FordVehGearRvsStsVld_Logl" 0 DISPLAY_IDENTIFIER FordMsg202BusHiSpd.SenderPorts.FordVehGearRvsStsVld.Logl /end MEASUREMENT
/begin MEASUREMENT FordMsg202BusHiSpd.FordVehGearRvsStsVldFaildRefTi "MICROSAR RTE" ULONG NO_COMPU_METHOD 0 0 0 4294967295 ECU_ADDRESS 0 SYMBOL_LINK "Rte_FordMsg202BusHiSpd_FordVehGearRvsStsVldFaildRefTi" 0 DISPLAY_IDENTIFIER FordMsg202BusHiSpd.PerInstanceMemories.FordVehGearRvsStsVldFaildRefTi /end MEASUREMENT
/begin MEASUREMENT FordMsg202BusHiSpd.FordVehGearRvsStsVldMissRefTi "MICROSAR RTE" ULONG NO_COMPU_METHOD 0 0 0 4294967295 ECU_ADDRESS 0 SYMBOL_LINK "Rte_FordMsg202BusHiSpd_FordVehGearRvsStsVldMissRefTi" 0 DISPLAY_IDENTIFIER FordMsg202BusHiSpd.PerInstanceMemories.FordVehGearRvsStsVldMissRefTi /end MEASUREMENT
/begin MEASUREMENT FordMsg202BusHiSpd.FordVehGearRvsStsVldPassdRefTi "MICROSAR RTE" ULONG NO_COMPU_METHOD 0 0 0 4294967295 ECU_ADDRESS 0 SYMBOL_LINK "Rte_FordMsg202BusHiSpd_FordVehGearRvsStsVldPassdRefTi" 0 DISPLAY_IDENTIFIER FordMsg202BusHiSpd.PerInstanceMemories.FordVehGearRvsStsVldPassdRefTi /end MEASUREMENT
/begin MEASUREMENT FordMsg202BusHiSpd.FordVehGearRvsStsVldPrev "MICROSAR RTE" UBYTE RTE_CM_BOOLEAN 0 0 0 255 ECU_ADDRESS 0 SYMBOL_LINK "Rte_FordMsg202BusHiSpd_FordVehGearRvsStsVldPrev" 0 DISPLAY_IDENTIFIER FordMsg202BusHiSpd.PerInstanceMemories.FordVehGearRvsStsVldPrev /end MEASUREMENT
/begin MEASUREMENT FordMsg202BusHiSpd.FordVehMsg202Miss "MICROSAR RTE" UBYTE RTE_CM_BOOLEAN 0 0 0 255 ECU_ADDRESS 0 SYMBOL_LINK "Rte_FordMsg202BusHiSpd_FordVehMsg202Miss" 0 DISPLAY_IDENTIFIER FordMsg202BusHiSpd.PerInstanceMemories.FordVehMsg202Miss /end MEASUREMENT
/begin MEASUREMENT FordMsg202BusHiSpd.FordVehMsg202Rxd "MICROSAR RTE" UBYTE RTE_CM_BOOLEAN 0 0 0 255 ECU_ADDRESS 0 SYMBOL_LINK "Rte_FordMsg202BusHiSpd_FordVehMsg202Rxd" 0 DISPLAY_IDENTIFIER FordMsg202BusHiSpd.PerInstanceMemories.FordVehMsg202Rxd /end MEASUREMENT
/begin MEASUREMENT FordMsg202BusHiSpd.FordVehSpdChksEngModl.Val "MICROSAR RTE" UBYTE NO_COMPU_METHOD 0 0 0 255 ECU_ADDRESS 0 SYMBOL_LINK "Rte_FordMsg202BusHiSpd_FordVehSpdChksEngModl_Val" 0 DISPLAY_IDENTIFIER FordMsg202BusHiSpd.SenderPorts.FordVehSpdChksEngModl.Val /end MEASUREMENT
/begin MEASUREMENT FordMsg202BusHiSpd.FordVehSpdChksEngModlPrev "MICROSAR RTE" UBYTE NO_COMPU_METHOD 0 0 0 255 ECU_ADDRESS 0 SYMBOL_LINK "Rte_FordMsg202BusHiSpd_FordVehSpdChksEngModlPrev" 0 DISPLAY_IDENTIFIER FordMsg202BusHiSpd.PerInstanceMemories.FordVehSpdChksEngModlPrev /end MEASUREMENT
/begin MEASUREMENT FordMsg202BusHiSpd.FordVehSpdCntrEngModl.Val "MICROSAR RTE" UBYTE NO_COMPU_METHOD 0 0 0 255 ECU_ADDRESS 0 SYMBOL_LINK "Rte_FordMsg202BusHiSpd_FordVehSpdCntrEngModl_Val" 0 DISPLAY_IDENTIFIER FordMsg202BusHiSpd.SenderPorts.FordVehSpdCntrEngModl.Val /end MEASUREMENT
/begin MEASUREMENT FordMsg202BusHiSpd.FordVehSpdCntrEngModlPrev "MICROSAR RTE" UBYTE NO_COMPU_METHOD 0 0 0 255 ECU_ADDRESS 0 SYMBOL_LINK "Rte_FordMsg202BusHiSpd_FordVehSpdCntrEngModlPrev" 0 DISPLAY_IDENTIFIER FordMsg202BusHiSpd.PerInstanceMemories.FordVehSpdCntrEngModlPrev /end MEASUREMENT
/begin MEASUREMENT FordMsg202BusHiSpd.FordVehSpdEngModLoQlyVld.Logl "MICROSAR RTE" UBYTE RTE_CM_BOOLEAN 0 0 0 255 ECU_ADDRESS 0 SYMBOL_LINK "Rte_FordMsg202BusHiSpd_FordVehSpdEngModLoQlyVld_Logl" 0 DISPLAY_IDENTIFIER FordMsg202BusHiSpd.SenderPorts.FordVehSpdEngModLoQlyVld.Logl /end MEASUREMENT
/begin MEASUREMENT FordMsg202BusHiSpd.FordVehSpdEngModLoQlyVldFaildRefTi "MICROSAR RTE" ULONG NO_COMPU_METHOD 0 0 0 4294967295 ECU_ADDRESS 0 SYMBOL_LINK "Rte_FordMsg202BusHiSpd_FordVehSpdEngModLoQlyVldFaildRefTi" 0 DISPLAY_IDENTIFIER FordMsg202BusHiSpd.PerInstanceMemories.FordVehSpdEngModLoQlyVldFaildRefTi /end MEASUREMENT
/begin MEASUREMENT FordMsg202BusHiSpd.FordVehSpdEngModLoQlyVldMissRefTi "MICROSAR RTE" ULONG NO_COMPU_METHOD 0 0 0 4294967295 ECU_ADDRESS 0 SYMBOL_LINK "Rte_FordMsg202BusHiSpd_FordVehSpdEngModLoQlyVldMissRefTi" 0 DISPLAY_IDENTIFIER FordMsg202BusHiSpd.PerInstanceMemories.FordVehSpdEngModLoQlyVldMissRefTi /end MEASUREMENT
/begin MEASUREMENT FordMsg202BusHiSpd.FordVehSpdEngModLoQlyVldPassdRefTi "MICROSAR RTE" ULONG NO_COMPU_METHOD 0 0 0 4294967295 ECU_ADDRESS 0 SYMBOL_LINK "Rte_FordMsg202BusHiSpd_FordVehSpdEngModLoQlyVldPassdRefTi" 0 DISPLAY_IDENTIFIER FordMsg202BusHiSpd.PerInstanceMemories.FordVehSpdEngModLoQlyVldPassdRefTi /end MEASUREMENT
/begin MEASUREMENT FordMsg202BusHiSpd.FordVehSpdEngModLoQlyVldPrev "MICROSAR RTE" UBYTE RTE_CM_BOOLEAN 0 0 0 255 ECU_ADDRESS 0 SYMBOL_LINK "Rte_FordMsg202BusHiSpd_FordVehSpdEngModLoQlyVldPrev" 0 DISPLAY_IDENTIFIER FordMsg202BusHiSpd.PerInstanceMemories.FordVehSpdEngModLoQlyVldPrev /end MEASUREMENT
/begin MEASUREMENT FordMsg202BusHiSpd.FordVehSpdEngModl.Val "MICROSAR RTE" FLOAT32_IEEE NO_COMPU_METHOD 0 0 -3.402823466e+38 3.402823466e+38 ECU_ADDRESS 0 SYMBOL_LINK "Rte_FordMsg202BusHiSpd_FordVehSpdEngModl_Val" 0 DISPLAY_IDENTIFIER FordMsg202BusHiSpd.SenderPorts.FordVehSpdEngModl.Val /end MEASUREMENT
/begin MEASUREMENT FordMsg202BusHiSpd.FordVehSpdEngModlPrev "MICROSAR RTE" FLOAT32_IEEE NO_COMPU_METHOD 0 0 -3.402823466e+38 3.402823466e+38 ECU_ADDRESS 0 SYMBOL_LINK "Rte_FordMsg202BusHiSpd_FordVehSpdEngModlPrev" 0 DISPLAY_IDENTIFIER FordMsg202BusHiSpd.PerInstanceMemories.FordVehSpdEngModlPrev /end MEASUREMENT
/begin MEASUREMENT FordMsg202BusHiSpd.FordVehSpdEngModlRaw.Val "MICROSAR RTE" UWORD NO_COMPU_METHOD 0 0 0 65535 ECU_ADDRESS 0 SYMBOL_LINK "Rte_FordMsg202BusHiSpd_FordVehSpdEngModlRaw_Val" 0 DISPLAY_IDENTIFIER FordMsg202BusHiSpd.SenderPorts.FordVehSpdEngModlRaw.Val /end MEASUREMENT
/begin GROUP FordMsg077BusHiSpd.FordMsg077BusHiSpdVehYawRateCmpdVldPassdThd.Val "MICROSAR RTE" /begin SUB_GROUP /end SUB_GROUP /begin FUNCTION_LIST /end FUNCTION_LIST
 /begin REF_CHARACTERISTIC FordMsg077BusHiSpd.FordMsg077BusHiSpdVehYawRateCmpdVldPassdThd.Val /end REF_CHARACTERISTIC
 /begin REF_MEASUREMENT /end REF_MEASUREMENT
/end GROUP
/begin GROUP FordMsg077BusHiSpd.FordMsg077BusHiSpdYawRateCmpdInvldSigFaildThd.Val "MICROSAR RTE" /begin SUB_GROUP /end SUB_GROUP /begin FUNCTION_LIST /end FUNCTION_LIST
 /begin REF_CHARACTERISTIC FordMsg077BusHiSpd.FordMsg077BusHiSpdYawRateCmpdInvldSigFaildThd.Val /end REF_CHARACTERISTIC
 /begin REF_MEASUREMENT /end REF_MEASUREMENT
/end GROUP
/begin GROUP FordMsg077BusHiSpd.FordMsg077BusHiSpdYawRateCmpdInvldSigPassdThd.Val "MICROSAR RTE" /begin SUB_GROUP /end SUB_GROUP /begin FUNCTION_LIST /end FUNCTION_LIST
 /begin REF_CHARACTERISTIC FordMsg077BusHiSpd.FordMsg077BusHiSpdYawRateCmpdInvldSigPassdThd.Val /end REF_CHARACTERISTIC
 /begin REF_MEASUREMENT /end REF_MEASUREMENT
/end GROUP
/begin GROUP FordMsg077BusHiSpd.FordMsg077BusHiSpdYawRateCmpdVldMissThd.Val "MICROSAR RTE" /begin SUB_GROUP /end SUB_GROUP /begin FUNCTION_LIST /end FUNCTION_LIST
 /begin REF_CHARACTERISTIC FordMsg077BusHiSpd.FordMsg077BusHiSpdYawRateCmpdVldMissThd.Val /end REF_CHARACTERISTIC
 /begin REF_MEASUREMENT /end REF_MEASUREMENT
/end GROUP
/begin GROUP FordMsg077BusHiSpd.FordPullDriftCmpEnad.Logl "MICROSAR RTE" /begin SUB_GROUP /end SUB_GROUP /begin FUNCTION_LIST /end FUNCTION_LIST /begin REF_CHARACTERISTIC /end REF_CHARACTERISTIC /begin REF_MEASUREMENT FordMsg077BusHiSpd.FordPullDriftCmpEnad.Logl /end REF_MEASUREMENT /end GROUP
/begin GROUP FordMsg077BusHiSpd.FordTqSteerCmpEnad.Logl "MICROSAR RTE" /begin SUB_GROUP /end SUB_GROUP /begin FUNCTION_LIST /end FUNCTION_LIST /begin REF_CHARACTERISTIC /end REF_CHARACTERISTIC /begin REF_MEASUREMENT FordMsg077BusHiSpd.FordTqSteerCmpEnad.Logl /end REF_MEASUREMENT /end GROUP
/begin GROUP FordMsg077BusHiSpd.FordTrfcJamAssiEnad.Logl "MICROSAR RTE" /begin SUB_GROUP /end SUB_GROUP /begin FUNCTION_LIST /end FUNCTION_LIST /begin REF_CHARACTERISTIC /end REF_CHARACTERISTIC /begin REF_MEASUREMENT FordMsg077BusHiSpd.FordTrfcJamAssiEnad.Logl /end REF_MEASUREMENT /end GROUP
/begin GROUP FordMsg077BusHiSpd.FordTrlrBackUpAssiEnad.Logl "MICROSAR RTE" /begin SUB_GROUP /end SUB_GROUP /begin FUNCTION_LIST /end FUNCTION_LIST /begin REF_CHARACTERISTIC /end REF_CHARACTERISTIC /begin REF_MEASUREMENT FordMsg077BusHiSpd.FordTrlrBackUpAssiEnad.Logl /end REF_MEASUREMENT /end GROUP
/begin GROUP FordMsg077BusHiSpd.FordVehLatACmpd.Val "MICROSAR RTE" /begin SUB_GROUP /end SUB_GROUP /begin FUNCTION_LIST /end FUNCTION_LIST /begin REF_CHARACTERISTIC /end REF_CHARACTERISTIC /begin REF_MEASUREMENT FordMsg077BusHiSpd.FordVehLatACmpd.Val /end REF_MEASUREMENT /end GROUP
/begin GROUP FordMsg077BusHiSpd.FordVehLatACmpdInvldFaildRefTi "MICROSAR RTE" /begin SUB_GROUP /end SUB_GROUP /begin FUNCTION_LIST /end FUNCTION_LIST /begin REF_CHARACTERISTIC /end REF_CHARACTERISTIC /begin REF_MEASUREMENT FordMsg077BusHiSpd.FordVehLatACmpdInvldFaildRefTi /end REF_MEASUREMENT /end GROUP
/begin GROUP FordMsg077BusHiSpd.FordVehLatACmpdInvldPassdRefTi "MICROSAR RTE" /begin SUB_GROUP /end SUB_GROUP /begin FUNCTION_LIST /end FUNCTION_LIST /begin REF_CHARACTERISTIC /end REF_CHARACTERISTIC /begin REF_MEASUREMENT FordMsg077BusHiSpd.FordVehLatACmpdInvldPassdRefTi /end REF_MEASUREMENT /end GROUP
/begin GROUP FordMsg077BusHiSpd.FordVehLatACmpdPrev "MICROSAR RTE" /begin SUB_GROUP /end SUB_GROUP /begin FUNCTION_LIST /end FUNCTION_LIST /begin REF_CHARACTERISTIC /end REF_CHARACTERISTIC /begin REF_MEASUREMENT FordMsg077BusHiSpd.FordVehLatACmpdPrev /end REF_MEASUREMENT /end GROUP
/begin GROUP FordMsg077BusHiSpd.FordVehLatACmpdRaw.Val "MICROSAR RTE" /begin SUB_GROUP /end SUB_GROUP /begin FUNCTION_LIST /end FUNCTION_LIST /begin REF_CHARACTERISTIC /end REF_CHARACTERISTIC /begin REF_MEASUREMENT FordMsg077BusHiSpd.FordVehLatACmpdRaw.Val /end REF_MEASUREMENT /end GROUP
/begin GROUP FordMsg077BusHiSpd.FordVehLatACmpdRawPrev "MICROSAR RTE" /begin SUB_GROUP /end SUB_GROUP /begin FUNCTION_LIST /end FUNCTION_LIST /begin REF_CHARACTERISTIC /end REF_CHARACTERISTIC /begin REF_MEASUREMENT FordMsg077BusHiSpd.FordVehLatACmpdRawPrev /end REF_MEASUREMENT /end GROUP
/begin GROUP FordMsg077BusHiSpd.FordVehLatACmpdVld.Logl "MICROSAR RTE" /begin SUB_GROUP /end SUB_GROUP /begin FUNCTION_LIST /end FUNCTION_LIST /begin REF_CHARACTERISTIC /end REF_CHARACTERISTIC /begin REF_MEASUREMENT FordMsg077BusHiSpd.FordVehLatACmpdVld.Logl /end REF_MEASUREMENT /end GROUP
/begin GROUP FordMsg077BusHiSpd.FordVehLatACmpdVldFaildRefTi "MICROSAR RTE" /begin SUB_GROUP /end SUB_GROUP /begin FUNCTION_LIST /end FUNCTION_LIST /begin REF_CHARACTERISTIC /end REF_CHARACTERISTIC /begin REF_MEASUREMENT FordMsg077BusHiSpd.FordVehLatACmpdVldFaildRefTi /end REF_MEASUREMENT /end GROUP
/begin GROUP FordMsg077BusHiSpd.FordVehLatACmpdVldMissRefTi "MICROSAR RTE" /begin SUB_GROUP /end SUB_GROUP /begin FUNCTION_LIST /end FUNCTION_LIST /begin REF_CHARACTERISTIC /end REF_CHARACTERISTIC /begin REF_MEASUREMENT FordMsg077BusHiSpd.FordVehLatACmpdVldMissRefTi /end REF_MEASUREMENT /end GROUP
/begin GROUP FordMsg077BusHiSpd.FordVehLatACmpdVldPassdRefTi "MICROSAR RTE" /begin SUB_GROUP /end SUB_GROUP /begin FUNCTION_LIST /end FUNCTION_LIST /begin REF_CHARACTERISTIC /end REF_CHARACTERISTIC /begin REF_MEASUREMENT FordMsg077BusHiSpd.FordVehLatACmpdVldPassdRefTi /end REF_MEASUREMENT /end GROUP
/begin GROUP FordMsg077BusHiSpd.FordVehLatACmpdVldPrev "MICROSAR RTE" /begin SUB_GROUP /end SUB_GROUP /begin FUNCTION_LIST /end FUNCTION_LIST /begin REF_CHARACTERISTIC /end REF_CHARACTERISTIC /begin REF_MEASUREMENT FordMsg077BusHiSpd.FordVehLatACmpdVldPrev /end REF_MEASUREMENT /end GROUP
/begin GROUP FordMsg077BusHiSpd.FordVehLgtACmpd.Val "MICROSAR RTE" /begin SUB_GROUP /end SUB_GROUP /begin FUNCTION_LIST /end FUNCTION_LIST /begin REF_CHARACTERISTIC /end REF_CHARACTERISTIC /begin REF_MEASUREMENT FordMsg077BusHiSpd.FordVehLgtACmpd.Val /end REF_MEASUREMENT /end GROUP
/begin GROUP FordMsg077BusHiSpd.FordVehLgtACmpdInvldFaildRefTi "MICROSAR RTE" /begin SUB_GROUP /end SUB_GROUP /begin FUNCTION_LIST /end FUNCTION_LIST /begin REF_CHARACTERISTIC /end REF_CHARACTERISTIC /begin REF_MEASUREMENT FordMsg077BusHiSpd.FordVehLgtACmpdInvldFaildRefTi /end REF_MEASUREMENT /end GROUP
/begin GROUP FordMsg077BusHiSpd.FordVehLgtACmpdInvldPassdRefTi "MICROSAR RTE" /begin SUB_GROUP /end SUB_GROUP /begin FUNCTION_LIST /end FUNCTION_LIST /begin REF_CHARACTERISTIC /end REF_CHARACTERISTIC /begin REF_MEASUREMENT FordMsg077BusHiSpd.FordVehLgtACmpdInvldPassdRefTi /end REF_MEASUREMENT /end GROUP
/begin GROUP FordMsg077BusHiSpd.FordVehLgtACmpdPrev "MICROSAR RTE" /begin SUB_GROUP /end SUB_GROUP /begin FUNCTION_LIST /end FUNCTION_LIST /begin REF_CHARACTERISTIC /end REF_CHARACTERISTIC /begin REF_MEASUREMENT FordMsg077BusHiSpd.FordVehLgtACmpdPrev /end REF_MEASUREMENT /end GROUP
/begin GROUP FordMsg077BusHiSpd.FordVehLgtACmpdRaw.Val "MICROSAR RTE" /begin SUB_GROUP /end SUB_GROUP /begin FUNCTION_LIST /end FUNCTION_LIST /begin REF_CHARACTERISTIC /end REF_CHARACTERISTIC /begin REF_MEASUREMENT FordMsg077BusHiSpd.FordVehLgtACmpdRaw.Val /end REF_MEASUREMENT /end GROUP
/begin GROUP FordMsg077BusHiSpd.FordVehLgtACmpdRawPrev "MICROSAR RTE" /begin SUB_GROUP /end SUB_GROUP /begin FUNCTION_LIST /end FUNCTION_LIST /begin REF_CHARACTERISTIC /end REF_CHARACTERISTIC /begin REF_MEASUREMENT FordMsg077BusHiSpd.FordVehLgtACmpdRawPrev /end REF_MEASUREMENT /end GROUP
/begin GROUP FordMsg077BusHiSpd.FordVehLgtACmpdVld.Logl "MICROSAR RTE" /begin SUB_GROUP /end SUB_GROUP /begin FUNCTION_LIST /end FUNCTION_LIST /begin REF_CHARACTERISTIC /end REF_CHARACTERISTIC /begin REF_MEASUREMENT FordMsg077BusHiSpd.FordVehLgtACmpdVld.Logl /end REF_MEASUREMENT /end GROUP
/begin GROUP FordMsg077BusHiSpd.FordVehLgtACmpdVldFaildRefTi "MICROSAR RTE" /begin SUB_GROUP /end SUB_GROUP /begin FUNCTION_LIST /end FUNCTION_LIST /begin REF_CHARACTERISTIC /end REF_CHARACTERISTIC /begin REF_MEASUREMENT FordMsg077BusHiSpd.FordVehLgtACmpdVldFaildRefTi /end REF_MEASUREMENT /end GROUP
/begin GROUP FordMsg077BusHiSpd.FordVehLgtACmpdVldMissRefTi "MICROSAR RTE" /begin SUB_GROUP /end SUB_GROUP /begin FUNCTION_LIST /end FUNCTION_LIST /begin REF_CHARACTERISTIC /end REF_CHARACTERISTIC /begin REF_MEASUREMENT FordMsg077BusHiSpd.FordVehLgtACmpdVldMissRefTi /end REF_MEASUREMENT /end GROUP
/begin GROUP FordMsg077BusHiSpd.FordVehLgtACmpdVldPassdRefTi "MICROSAR RTE" /begin SUB_GROUP /end SUB_GROUP /begin FUNCTION_LIST /end FUNCTION_LIST /begin REF_CHARACTERISTIC /end REF_CHARACTERISTIC /begin REF_MEASUREMENT FordMsg077BusHiSpd.FordVehLgtACmpdVldPassdRefTi /end REF_MEASUREMENT /end GROUP
/begin GROUP FordMsg077BusHiSpd.FordVehLgtACmpdVldPrev "MICROSAR RTE" /begin SUB_GROUP /end SUB_GROUP /begin FUNCTION_LIST /end FUNCTION_LIST /begin REF_CHARACTERISTIC /end REF_CHARACTERISTIC /begin REF_MEASUREMENT FordMsg077BusHiSpd.FordVehLgtACmpdVldPrev /end REF_MEASUREMENT /end GROUP
/begin GROUP FordMsg077BusHiSpd.FordVehMsg77Miss "MICROSAR RTE" /begin SUB_GROUP /end SUB_GROUP /begin FUNCTION_LIST /end FUNCTION_LIST /begin REF_CHARACTERISTIC /end REF_CHARACTERISTIC /begin REF_MEASUREMENT FordMsg077BusHiSpd.FordVehMsg77Miss /end REF_MEASUREMENT /end GROUP
/begin GROUP FordMsg077BusHiSpd.FordVehSpdOverGnd.Val "MICROSAR RTE" /begin SUB_GROUP /end SUB_GROUP /begin FUNCTION_LIST /end FUNCTION_LIST /begin REF_CHARACTERISTIC /end REF_CHARACTERISTIC /begin REF_MEASUREMENT FordMsg077BusHiSpd.FordVehSpdOverGnd.Val /end REF_MEASUREMENT /end GROUP
/begin GROUP FordMsg077BusHiSpd.FordVehSpdOverGndInvldFaildRefTi "MICROSAR RTE" /begin SUB_GROUP /end SUB_GROUP /begin FUNCTION_LIST /end FUNCTION_LIST /begin REF_CHARACTERISTIC /end REF_CHARACTERISTIC /begin REF_MEASUREMENT FordMsg077BusHiSpd.FordVehSpdOverGndInvldFaildRefTi /end REF_MEASUREMENT /end GROUP
/begin GROUP FordMsg077BusHiSpd.FordVehSpdOverGndInvldPassdRefTi "MICROSAR RTE" /begin SUB_GROUP /end SUB_GROUP /begin FUNCTION_LIST /end FUNCTION_LIST /begin REF_CHARACTERISTIC /end REF_CHARACTERISTIC /begin REF_MEASUREMENT FordMsg077BusHiSpd.FordVehSpdOverGndInvldPassdRefTi /end REF_MEASUREMENT /end GROUP
/begin GROUP FordMsg077BusHiSpd.FordVehSpdOverGndPrev "MICROSAR RTE" /begin SUB_GROUP /end SUB_GROUP /begin FUNCTION_LIST /end FUNCTION_LIST /begin REF_CHARACTERISTIC /end REF_CHARACTERISTIC /begin REF_MEASUREMENT FordMsg077BusHiSpd.FordVehSpdOverGndPrev /end REF_MEASUREMENT /end GROUP
/begin GROUP FordMsg077BusHiSpd.FordVehSpdOverGndRaw.Val "MICROSAR RTE" /begin SUB_GROUP /end SUB_GROUP /begin FUNCTION_LIST /end FUNCTION_LIST /begin REF_CHARACTERISTIC /end REF_CHARACTERISTIC /begin REF_MEASUREMENT FordMsg077BusHiSpd.FordVehSpdOverGndRaw.Val /end REF_MEASUREMENT /end GROUP
/begin GROUP FordMsg077BusHiSpd.FordVehSpdOverGndRawPrev "MICROSAR RTE" /begin SUB_GROUP /end SUB_GROUP /begin FUNCTION_LIST /end FUNCTION_LIST /begin REF_CHARACTERISTIC /end REF_CHARACTERISTIC /begin REF_MEASUREMENT FordMsg077BusHiSpd.FordVehSpdOverGndRawPrev /end REF_MEASUREMENT /end GROUP
/begin GROUP FordMsg077BusHiSpd.FordVehSpdOverGndVld.Logl "MICROSAR RTE" /begin SUB_GROUP /end SUB_GROUP /begin FUNCTION_LIST /end FUNCTION_LIST /begin REF_CHARACTERISTIC /end REF_CHARACTERISTIC /begin REF_MEASUREMENT FordMsg077BusHiSpd.FordVehSpdOverGndVld.Logl /end REF_MEASUREMENT /end GROUP
/begin GROUP FordMsg077BusHiSpd.FordVehSpdOverGndVldFaildRefTi "MICROSAR RTE" /begin SUB_GROUP /end SUB_GROUP /begin FUNCTION_LIST /end FUNCTION_LIST /begin REF_CHARACTERISTIC /end REF_CHARACTERISTIC /begin REF_MEASUREMENT FordMsg077BusHiSpd.FordVehSpdOverGndVldFaildRefTi /end REF_MEASUREMENT /end GROUP
/begin GROUP FordMsg077BusHiSpd.FordVehSpdOverGndVldMissRefTi "MICROSAR RTE" /begin SUB_GROUP /end SUB_GROUP /begin FUNCTION_LIST /end FUNCTION_LIST /begin REF_CHARACTERISTIC /end REF_CHARACTERISTIC /begin REF_MEASUREMENT FordMsg077BusHiSpd.FordVehSpdOverGndVldMissRefTi /end REF_MEASUREMENT /end GROUP
/begin GROUP FordMsg077BusHiSpd.FordVehSpdOverGndVldPassdRefTi "MICROSAR RTE" /begin SUB_GROUP /end SUB_GROUP /begin FUNCTION_LIST /end FUNCTION_LIST /begin REF_CHARACTERISTIC /end REF_CHARACTERISTIC /begin REF_MEASUREMENT FordMsg077BusHiSpd.FordVehSpdOverGndVldPassdRefTi /end REF_MEASUREMENT /end GROUP
/begin GROUP FordMsg077BusHiSpd.FordVehSpdOverGndVldPrev "MICROSAR RTE" /begin SUB_GROUP /end SUB_GROUP /begin FUNCTION_LIST /end FUNCTION_LIST /begin REF_CHARACTERISTIC /end REF_CHARACTERISTIC /begin REF_MEASUREMENT FordMsg077BusHiSpd.FordVehSpdOverGndVldPrev /end REF_MEASUREMENT /end GROUP
/begin GROUP FordMsg077BusHiSpd.FordVehYawRateCmpd.Val "MICROSAR RTE" /begin SUB_GROUP /end SUB_GROUP /begin FUNCTION_LIST /end FUNCTION_LIST /begin REF_CHARACTERISTIC /end REF_CHARACTERISTIC /begin REF_MEASUREMENT FordMsg077BusHiSpd.FordVehYawRateCmpd.Val /end REF_MEASUREMENT /end GROUP
/begin GROUP FordMsg077BusHiSpd.FordVehYawRateCmpdInvldFaildRefTi "MICROSAR RTE" /begin SUB_GROUP /end SUB_GROUP /begin FUNCTION_LIST /end FUNCTION_LIST /begin REF_CHARACTERISTIC /end REF_CHARACTERISTIC /begin REF_MEASUREMENT FordMsg077BusHiSpd.FordVehYawRateCmpdInvldFaildRefTi /end REF_MEASUREMENT /end GROUP
/begin GROUP FordMsg077BusHiSpd.FordVehYawRateCmpdInvldPassdRefTi "MICROSAR RTE" /begin SUB_GROUP /end SUB_GROUP /begin FUNCTION_LIST /end FUNCTION_LIST /begin REF_CHARACTERISTIC /end REF_CHARACTERISTIC /begin REF_MEASUREMENT FordMsg077BusHiSpd.FordVehYawRateCmpdInvldPassdRefTi /end REF_MEASUREMENT /end GROUP
/begin GROUP FordMsg077BusHiSpd.FordVehYawRateCmpdPrev "MICROSAR RTE" /begin SUB_GROUP /end SUB_GROUP /begin FUNCTION_LIST /end FUNCTION_LIST /begin REF_CHARACTERISTIC /end REF_CHARACTERISTIC /begin REF_MEASUREMENT FordMsg077BusHiSpd.FordVehYawRateCmpdPrev /end REF_MEASUREMENT /end GROUP
/begin GROUP FordMsg077BusHiSpd.FordVehYawRateCmpdRaw.Val "MICROSAR RTE" /begin SUB_GROUP /end SUB_GROUP /begin FUNCTION_LIST /end FUNCTION_LIST /begin REF_CHARACTERISTIC /end REF_CHARACTERISTIC /begin REF_MEASUREMENT FordMsg077BusHiSpd.FordVehYawRateCmpdRaw.Val /end REF_MEASUREMENT /end GROUP
/begin GROUP FordMsg077BusHiSpd.FordVehYawRateCmpdRawPrev "MICROSAR RTE" /begin SUB_GROUP /end SUB_GROUP /begin FUNCTION_LIST /end FUNCTION_LIST /begin REF_CHARACTERISTIC /end REF_CHARACTERISTIC /begin REF_MEASUREMENT FordMsg077BusHiSpd.FordVehYawRateCmpdRawPrev /end REF_MEASUREMENT /end GROUP
/begin GROUP FordMsg077BusHiSpd.FordVehYawRateCmpdVld.Logl "MICROSAR RTE" /begin SUB_GROUP /end SUB_GROUP /begin FUNCTION_LIST /end FUNCTION_LIST /begin REF_CHARACTERISTIC /end REF_CHARACTERISTIC /begin REF_MEASUREMENT FordMsg077BusHiSpd.FordVehYawRateCmpdVld.Logl /end REF_MEASUREMENT /end GROUP
/begin GROUP FordMsg077BusHiSpd.FordVehYawRateCmpdVldFaildRefTi "MICROSAR RTE" /begin SUB_GROUP /end SUB_GROUP /begin FUNCTION_LIST /end FUNCTION_LIST /begin REF_CHARACTERISTIC /end REF_CHARACTERISTIC /begin REF_MEASUREMENT FordMsg077BusHiSpd.FordVehYawRateCmpdVldFaildRefTi /end REF_MEASUREMENT /end GROUP
/begin GROUP FordMsg077BusHiSpd.FordVehYawRateCmpdVldMissRefTi "MICROSAR RTE" /begin SUB_GROUP /end SUB_GROUP /begin FUNCTION_LIST /end FUNCTION_LIST /begin REF_CHARACTERISTIC /end REF_CHARACTERISTIC /begin REF_MEASUREMENT FordMsg077BusHiSpd.FordVehYawRateCmpdVldMissRefTi /end REF_MEASUREMENT /end GROUP
/begin GROUP FordMsg077BusHiSpd.FordVehYawRateCmpdVldPassdRefTi "MICROSAR RTE" /begin SUB_GROUP /end SUB_GROUP /begin FUNCTION_LIST /end FUNCTION_LIST /begin REF_CHARACTERISTIC /end REF_CHARACTERISTIC /begin REF_MEASUREMENT FordMsg077BusHiSpd.FordVehYawRateCmpdVldPassdRefTi /end REF_MEASUREMENT /end GROUP
/begin GROUP FordMsg077BusHiSpd.FordVehYawRateCmpdVldPrev "MICROSAR RTE" /begin SUB_GROUP /end SUB_GROUP /begin FUNCTION_LIST /end FUNCTION_LIST /begin REF_CHARACTERISTIC /end REF_CHARACTERISTIC /begin REF_MEASUREMENT FordMsg077BusHiSpd.FordVehYawRateCmpdVldPrev /end REF_MEASUREMENT /end GROUP
/begin GROUP FordMsg077BusHiSpd.MissMsgFaildRefTi "MICROSAR RTE" /begin SUB_GROUP /end SUB_GROUP /begin FUNCTION_LIST /end FUNCTION_LIST /begin REF_CHARACTERISTIC /end REF_CHARACTERISTIC /begin REF_MEASUREMENT FordMsg077BusHiSpd.MissMsgFaildRefTi /end REF_MEASUREMENT /end GROUP
/begin GROUP FordMsg077BusHiSpd.MissMsgPassdRefTi "MICROSAR RTE" /begin SUB_GROUP /end SUB_GROUP /begin FUNCTION_LIST /end FUNCTION_LIST /begin REF_CHARACTERISTIC /end REF_CHARACTERISTIC /begin REF_MEASUREMENT FordMsg077BusHiSpd.MissMsgPassdRefTi /end REF_MEASUREMENT /end GROUP
/begin GROUP FordMsg077BusHiSpd.PerInstanceMemories "MICROSAR RTE"
 /begin SUB_GROUP FordMsg077BusHiSpd.CanDtcInhbRefTi FordMsg077BusHiSpd.DiagcClrProxyFlgPrev FordMsg077BusHiSpd.FirstTranVldFlg FordMsg077BusHiSpd.FordVehLatACmpdInvldFaildRefTi FordMsg077BusHiSpd.FordVehLatACmpdInvldPassdRefTi FordMsg077BusHiSpd.FordVehLatACmpdPrev FordMsg077BusHiSpd.FordVehLatACmpdRawPrev FordMsg077BusHiSpd.FordVehLatACmpdVldFaildRefTi FordMsg077BusHiSpd.FordVehLatACmpdVldMissRefTi FordMsg077BusHiSpd.FordVehLatACmpdVldPassdRefTi FordMsg077BusHiSpd.FordVehLatACmpdVldPrev FordMsg077BusHiSpd.FordVehLgtACmpdInvldFaildRefTi FordMsg077BusHiSpd.FordVehLgtACmpdInvldPassdRefTi FordMsg077BusHiSpd.FordVehLgtACmpdPrev FordMsg077BusHiSpd.FordVehLgtACmpdRawPrev FordMsg077BusHiSpd.FordVehLgtACmpdVldFaildRefTi FordMsg077BusHiSpd.FordVehLgtACmpdVldMissRefTi FordMsg077BusHiSpd.FordVehLgtACmpdVldPassdRefTi FordMsg077BusHiSpd.FordVehLgtACmpdVldPrev FordMsg077BusHiSpd.FordVehMsg77Miss FordMsg077BusHiSpd.FordVehSpdOverGndInvldFaildRefTi FordMsg077BusHiSpd.FordVehSpdOverGndInvldPassdRefTi FordMsg077BusHiSpd.FordVehSpdOverGndPrev FordMsg077BusHiSpd.FordVehSpdOverGndRawPrev FordMsg077BusHiSpd.FordVehSpdOverGndVldFaildRefTi FordMsg077BusHiSpd.FordVehSpdOverGndVldMissRefTi FordMsg077BusHiSpd.FordVehSpdOverGndVldPassdRefTi FordMsg077BusHiSpd.FordVehSpdOverGndVldPrev FordMsg077BusHiSpd.FordVehYawRateCmpdInvldFaildRefTi FordMsg077BusHiSpd.FordVehYawRateCmpdInvldPassdRefTi FordMsg077BusHiSpd.FordVehYawRateCmpdPrev FordMsg077BusHiSpd.FordVehYawRateCmpdRawPrev FordMsg077BusHiSpd.FordVehYawRateCmpdVldFaildRefTi FordMsg077BusHiSpd.FordVehYawRateCmpdVldMissRefTi FordMsg077BusHiSpd.FordVehYawRateCmpdVldPassdRefTi FordMsg077BusHiSpd.FordVehYawRateCmpdVldPrev FordMsg077BusHiSpd.MissMsgFaildRefTi FordMsg077BusHiSpd.MissMsgPassdRefTi /end SUB_GROUP
 /begin FUNCTION_LIST /end FUNCTION_LIST
 /begin REF_CHARACTERISTIC /end REF_CHARACTERISTIC
 /begin REF_MEASUREMENT /end REF_MEASUREMENT
/end GROUP
/begin GROUP FordMsg077BusHiSpd.ReceiverPorts "MICROSAR RTE"
 /begin SUB_GROUP FordMsg077BusHiSpd.FordBrkOscnRednEnad.Logl FordMsg077BusHiSpd.FordCanDtcInhb.Logl FordMsg077BusHiSpd.FordClrDiagcFlgProxy.Logl FordMsg077BusHiSpd.FordEpsLifeCycMod.Val FordMsg077BusHiSpd.FordEvasSteerAssiEnad.Logl FordMsg077BusHiSpd.FordLaneCentrAssiEnad.Logl FordMsg077BusHiSpd.FordLaneKeepAssiEnad.Logl FordMsg077BusHiSpd.FordPullDriftCmpEnad.Logl FordMsg077BusHiSpd.FordTqSteerCmpEnad.Logl FordMsg077BusHiSpd.FordTrfcJamAssiEnad.Logl FordMsg077BusHiSpd.FordTrlrBackUpAssiEnad.Logl /end SUB_GROUP
 /begin FUNCTION_LIST /end FUNCTION_LIST
 /begin REF_CHARACTERISTIC /end REF_CHARACTERISTIC
 /begin REF_MEASUREMENT /end REF_MEASUREMENT
/end GROUP
/begin GROUP FordMsg077BusHiSpd.SenderPorts "MICROSAR RTE"
 /begin SUB_GROUP FordMsg077BusHiSpd.FordVehLatACmpd.Val FordMsg077BusHiSpd.FordVehLatACmpdRaw.Val FordMsg077BusHiSpd.FordVehLatACmpdVld.Logl FordMsg077BusHiSpd.FordVehLgtACmpd.Val FordMsg077BusHiSpd.FordVehLgtACmpdRaw.Val FordMsg077BusHiSpd.FordVehLgtACmpdVld.Logl FordMsg077BusHiSpd.FordVehSpdOverGnd.Val FordMsg077BusHiSpd.FordVehSpdOverGndRaw.Val FordMsg077BusHiSpd.FordVehSpdOverGndVld.Logl FordMsg077BusHiSpd.FordVehYawRateCmpd.Val FordMsg077BusHiSpd.FordVehYawRateCmpdRaw.Val FordMsg077BusHiSpd.FordVehYawRateCmpdVld.Logl /end SUB_GROUP
 /begin FUNCTION_LIST /end FUNCTION_LIST
 /begin REF_CHARACTERISTIC /end REF_CHARACTERISTIC
 /begin REF_MEASUREMENT /end REF_MEASUREMENT
/end GROUP
/begin GROUP FordMsg07DBusHiSpd "MICROSAR RTE"
 /begin SUB_GROUP FordMsg07DBusHiSpd.CalibrationPorts FordMsg07DBusHiSpd.PerInstanceMemories FordMsg07DBusHiSpd.ReceiverPorts FordMsg07DBusHiSpd.SenderPorts /end SUB_GROUP
 /begin FUNCTION_LIST /end FUNCTION_LIST
 /begin REF_CHARACTERISTIC /end REF_CHARACTERISTIC
 /begin REF_MEASUREMENT /end REF_MEASUREMENT
/end GROUP
/begin GROUP FordMsg07DBusHiSpd.CalibrationPorts "MICROSAR RTE"
 /begin SUB_GROUP FordMsg07DBusHiSpd.FordMsg07DBusHiSpdActBrkTqSigInvldPassdThd.Val FordMsg07DBusHiSpd.FordMsg07DBusHiSpdFordVehActBrkTqInvldThd.Val FordMsg07DBusHiSpd.FordMsg07DBusHiSpdFordVehActBrkTqVldThd.Val FordMsg07DBusHiSpd.FordMsg07DBusHiSpdFordVehBrkTqVldMissMsgThd.Val FordMsg07DBusHiSpd.FordMsg07DBusHiSpdFordVehVertACmpdSigInvldThd.Val FordMsg07DBusHiSpd.FordMsg07DBusHiSpdFordVehVertACmpdSigVldThd.Val FordMsg07DBusHiSpd.FordMsg07DBusHiSpdFordVehVertAVldMissMsgThd.Val FordMsg07DBusHiSpd.FordMsg07DBusHiSpdMissMsgFaildThd.Val FordMsg07DBusHiSpd.FordMsg07DBusHiSpdMissMsgPassdThd.Val FordMsg07DBusHiSpd.FordMsg07DBusHiSpdVehActTqBrkInvldFaildThd.Val FordMsg07DBusHiSpd.FordMsg07DBusHiSpdVertACmpdSigInvldFaildThd.Val FordMsg07DBusHiSpd.FordMsg07DBusHiSpdVertACmpdSigInvldPassdThd.Val /end SUB_GROUP
 /begin FUNCTION_LIST /end FUNCTION_LIST
 /begin REF_CHARACTERISTIC /end REF_CHARACTERISTIC
 /begin REF_MEASUREMENT /end REF_MEASUREMENT
/end GROUP
/begin GROUP FordMsg07DBusHiSpd.ClrDiagcFlgProxy.Val "MICROSAR RTE" /begin SUB_GROUP /end SUB_GROUP /begin FUNCTION_LIST /end FUNCTION_LIST /begin REF_CHARACTERISTIC /end REF_CHARACTERISTIC /begin REF_MEASUREMENT FordMsg07DBusHiSpd.ClrDiagcFlgProxy.Val /end REF_MEASUREMENT /end GROUP
/begin GROUP FordMsg07DBusHiSpd.ClrDiagcFlgProxyPrev "MICROSAR RTE" /begin SUB_GROUP /end SUB_GROUP /begin FUNCTION_LIST /end FUNCTION_LIST /begin REF_CHARACTERISTIC /end REF_CHARACTERISTIC /begin REF_MEASUREMENT FordMsg07DBusHiSpd.ClrDiagcFlgProxyPrev /end REF_MEASUREMENT /end GROUP
/begin GROUP FordMsg07DBusHiSpd.FirstTranVldFlg "MICROSAR RTE" /begin SUB_GROUP /end SUB_GROUP /begin FUNCTION_LIST /end FUNCTION_LIST /begin REF_CHARACTERISTIC /end REF_CHARACTERISTIC /begin REF_MEASUREMENT FordMsg07DBusHiSpd.FirstTranVldFlg /end REF_MEASUREMENT /end GROUP
/begin GROUP FordMsg07DBusHiSpd.FordBrkOscnRednEnad.Logl "MICROSAR RTE" /begin SUB_GROUP /end SUB_GROUP /begin FUNCTION_LIST /end FUNCTION_LIST /begin REF_CHARACTERISTIC /end REF_CHARACTERISTIC /begin REF_MEASUREMENT FordMsg07DBusHiSpd.FordBrkOscnRednEnad.Logl /end REF_MEASUREMENT /end GROUP
/begin GROUP FordMsg07DBusHiSpd.FordCanDtcInhb.Logl "MICROSAR RTE" /begin SUB_GROUP /end SUB_GROUP /begin FUNCTION_LIST /end FUNCTION_LIST /begin REF_CHARACTERISTIC /end REF_CHARACTERISTIC /begin REF_MEASUREMENT FordMsg07DBusHiSpd.FordCanDtcInhb.Logl /end REF_MEASUREMENT /end GROUP
/begin GROUP FordMsg07DBusHiSpd.FordEpsLifeCycMod.Val "MICROSAR RTE" /begin SUB_GROUP /end SUB_GROUP /begin FUNCTION_LIST /end FUNCTION_LIST /begin REF_CHARACTERISTIC /end REF_CHARACTERISTIC /begin REF_MEASUREMENT FordMsg07DBusHiSpd.FordEpsLifeCycMod.Val /end REF_MEASUREMENT /end GROUP
/begin GROUP FordMsg07DBusHiSpd.FordMsg07DBusHiSpdActBrkTqSigInvldPassdThd.Val "MICROSAR RTE" /begin SUB_GROUP /end SUB_GROUP /begin FUNCTION_LIST /end FUNCTION_LIST
 /begin REF_CHARACTERISTIC FordMsg07DBusHiSpd.FordMsg07DBusHiSpdActBrkTqSigInvldPassdThd.Val /end REF_CHARACTERISTIC
 /begin REF_MEASUREMENT /end REF_MEASUREMENT
/end GROUP
/begin GROUP FordMsg07DBusHiSpd.FordMsg07DBusHiSpdFordVehActBrkTqInvldThd.Val "MICROSAR RTE" /begin SUB_GROUP /end SUB_GROUP /begin FUNCTION_LIST /end FUNCTION_LIST
 /begin REF_CHARACTERISTIC FordMsg07DBusHiSpd.FordMsg07DBusHiSpdFordVehActBrkTqInvldThd.Val /end REF_CHARACTERISTIC
 /begin REF_MEASUREMENT /end REF_MEASUREMENT
/end GROUP
/begin GROUP FordMsg07DBusHiSpd.FordMsg07DBusHiSpdFordVehActBrkTqVldThd.Val "MICROSAR RTE" /begin SUB_GROUP /end SUB_GROUP /begin FUNCTION_LIST /end FUNCTION_LIST
 /begin REF_CHARACTERISTIC FordMsg07DBusHiSpd.FordMsg07DBusHiSpdFordVehActBrkTqVldThd.Val /end REF_CHARACTERISTIC
 /begin REF_MEASUREMENT /end REF_MEASUREMENT
/end GROUP
/begin GROUP FordMsg07DBusHiSpd.FordMsg07DBusHiSpdFordVehBrkTqVldMissMsgThd.Val "MICROSAR RTE" /begin SUB_GROUP /end SUB_GROUP /begin FUNCTION_LIST /end FUNCTION_LIST
 /begin REF_CHARACTERISTIC FordMsg07DBusHiSpd.FordMsg07DBusHiSpdFordVehBrkTqVldMissMsgThd.Val /end REF_CHARACTERISTIC
 /begin REF_MEASUREMENT /end REF_MEASUREMENT
/end GROUP
/begin GROUP FordMsg07DBusHiSpd.FordMsg07DBusHiSpdFordVehVertACmpdSigInvldThd.Val "MICROSAR RTE" /begin SUB_GROUP /end SUB_GROUP /begin FUNCTION_LIST /end FUNCTION_LIST
 /begin REF_CHARACTERISTIC FordMsg07DBusHiSpd.FordMsg07DBusHiSpdFordVehVertACmpdSigInvldThd.Val /end REF_CHARACTERISTIC
 /begin REF_MEASUREMENT /end REF_MEASUREMENT
/end GROUP
/begin GROUP FordMsg07DBusHiSpd.FordMsg07DBusHiSpdFordVehVertACmpdSigVldThd.Val "MICROSAR RTE" /begin SUB_GROUP /end SUB_GROUP /begin FUNCTION_LIST /end FUNCTION_LIST
 /begin REF_CHARACTERISTIC FordMsg07DBusHiSpd.FordMsg07DBusHiSpdFordVehVertACmpdSigVldThd.Val /end REF_CHARACTERISTIC
 /begin REF_MEASUREMENT /end REF_MEASUREMENT
/end GROUP
/begin GROUP FordMsg07DBusHiSpd.FordMsg07DBusHiSpdFordVehVertAVldMissMsgThd.Val "MICROSAR RTE" /begin SUB_GROUP /end SUB_GROUP /begin FUNCTION_LIST /end FUNCTION_LIST
 /begin REF_CHARACTERISTIC FordMsg07DBusHiSpd.FordMsg07DBusHiSpdFordVehVertAVldMissMsgThd.Val /end REF_CHARACTERISTIC
 /begin REF_MEASUREMENT /end REF_MEASUREMENT
/end GROUP
/begin GROUP FordMsg07DBusHiSpd.FordMsg07DBusHiSpdMissMsgFaildThd.Val "MICROSAR RTE" /begin SUB_GROUP /end SUB_GROUP /begin FUNCTION_LIST /end FUNCTION_LIST /begin REF_CHARACTERISTIC FordMsg07DBusHiSpd.FordMsg07DBusHiSpdMissMsgFaildThd.Val /end REF_CHARACTERISTIC /begin REF_MEASUREMENT /end REF_MEASUREMENT /end GROUP
/begin GROUP FordMsg07DBusHiSpd.FordMsg07DBusHiSpdMissMsgPassdThd.Val "MICROSAR RTE" /begin SUB_GROUP /end SUB_GROUP /begin FUNCTION_LIST /end FUNCTION_LIST /begin REF_CHARACTERISTIC FordMsg07DBusHiSpd.FordMsg07DBusHiSpdMissMsgPassdThd.Val /end REF_CHARACTERISTIC /begin REF_MEASUREMENT /end REF_MEASUREMENT /end GROUP
/begin GROUP FordMsg07DBusHiSpd.FordMsg07DBusHiSpdVehActTqBrkInvldFaildThd.Val "MICROSAR RTE" /begin SUB_GROUP /end SUB_GROUP /begin FUNCTION_LIST /end FUNCTION_LIST
 /begin REF_CHARACTERISTIC FordMsg07DBusHiSpd.FordMsg07DBusHiSpdVehActTqBrkInvldFaildThd.Val /end REF_CHARACTERISTIC
 /begin REF_MEASUREMENT /end REF_MEASUREMENT
/end GROUP
/begin GROUP FordMsg07DBusHiSpd.FordMsg07DBusHiSpdVertACmpdSigInvldFaildThd.Val "MICROSAR RTE" /begin SUB_GROUP /end SUB_GROUP /begin FUNCTION_LIST /end FUNCTION_LIST
 /begin REF_CHARACTERISTIC FordMsg07DBusHiSpd.FordMsg07DBusHiSpdVertACmpdSigInvldFaildThd.Val /end REF_CHARACTERISTIC
 /begin REF_MEASUREMENT /end REF_MEASUREMENT
/end GROUP
/begin GROUP FordMsg07DBusHiSpd.FordMsg07DBusHiSpdVertACmpdSigInvldPassdThd.Val "MICROSAR RTE" /begin SUB_GROUP /end SUB_GROUP /begin FUNCTION_LIST /end FUNCTION_LIST
 /begin REF_CHARACTERISTIC FordMsg07DBusHiSpd.FordMsg07DBusHiSpdVertACmpdSigInvldPassdThd.Val /end REF_CHARACTERISTIC
 /begin REF_MEASUREMENT /end REF_MEASUREMENT
/end GROUP
/begin GROUP FordMsg07DBusHiSpd.FordTrlrBackUpAssiEnad.Logl "MICROSAR RTE" /begin SUB_GROUP /end SUB_GROUP /begin FUNCTION_LIST /end FUNCTION_LIST /begin REF_CHARACTERISTIC /end REF_CHARACTERISTIC /begin REF_MEASUREMENT FordMsg07DBusHiSpd.FordTrlrBackUpAssiEnad.Logl /end REF_MEASUREMENT /end GROUP
/begin GROUP FordMsg07DBusHiSpd.FordVehActBrkTqRaw.Val "MICROSAR RTE" /begin SUB_GROUP /end SUB_GROUP /begin FUNCTION_LIST /end FUNCTION_LIST /begin REF_CHARACTERISTIC /end REF_CHARACTERISTIC /begin REF_MEASUREMENT FordMsg07DBusHiSpd.FordVehActBrkTqRaw.Val /end REF_MEASUREMENT /end GROUP
/begin GROUP FordMsg07DBusHiSpd.FordVehActBrkTqRawPrev "MICROSAR RTE" /begin SUB_GROUP /end SUB_GROUP /begin FUNCTION_LIST /end FUNCTION_LIST /begin REF_CHARACTERISTIC /end REF_CHARACTERISTIC /begin REF_MEASUREMENT FordMsg07DBusHiSpd.FordVehActBrkTqRawPrev /end REF_MEASUREMENT /end GROUP
/begin GROUP FordMsg07DBusHiSpd.FordVehActBrkTqSigInvldFaildRefTi "MICROSAR RTE" /begin SUB_GROUP /end SUB_GROUP /begin FUNCTION_LIST /end FUNCTION_LIST /begin REF_CHARACTERISTIC /end REF_CHARACTERISTIC /begin REF_MEASUREMENT FordMsg07DBusHiSpd.FordVehActBrkTqSigInvldFaildRefTi /end REF_MEASUREMENT /end GROUP
/begin GROUP FordMsg07DBusHiSpd.FordVehActBrkTqSigInvldPassdRefTi "MICROSAR RTE" /begin SUB_GROUP /end SUB_GROUP /begin FUNCTION_LIST /end FUNCTION_LIST /begin REF_CHARACTERISTIC /end REF_CHARACTERISTIC /begin REF_MEASUREMENT FordMsg07DBusHiSpd.FordVehActBrkTqSigInvldPassdRefTi /end REF_MEASUREMENT /end GROUP
/begin GROUP FordMsg07DBusHiSpd.FordVehActBrkTqVldFaildRefTi "MICROSAR RTE" /begin SUB_GROUP /end SUB_GROUP /begin FUNCTION_LIST /end FUNCTION_LIST /begin REF_CHARACTERISTIC /end REF_CHARACTERISTIC /begin REF_MEASUREMENT FordMsg07DBusHiSpd.FordVehActBrkTqVldFaildRefTi /end REF_MEASUREMENT /end GROUP
/begin GROUP FordMsg07DBusHiSpd.FordVehActBrkTqVldPassdRefTi "MICROSAR RTE" /begin SUB_GROUP /end SUB_GROUP /begin FUNCTION_LIST /end FUNCTION_LIST /begin REF_CHARACTERISTIC /end REF_CHARACTERISTIC /begin REF_MEASUREMENT FordMsg07DBusHiSpd.FordVehActBrkTqVldPassdRefTi /end REF_MEASUREMENT /end GROUP
/begin GROUP FordMsg07DBusHiSpd.FordVehBrkTqVld.Logl "MICROSAR RTE" /begin SUB_GROUP /end SUB_GROUP /begin FUNCTION_LIST /end FUNCTION_LIST /begin REF_CHARACTERISTIC /end REF_CHARACTERISTIC /begin REF_MEASUREMENT FordMsg07DBusHiSpd.FordVehBrkTqVld.Logl /end REF_MEASUREMENT /end GROUP
/begin GROUP FordMsg07DBusHiSpd.FordVehBrkTqVldMissMsgRefTi "MICROSAR RTE" /begin SUB_GROUP /end SUB_GROUP /begin FUNCTION_LIST /end FUNCTION_LIST /begin REF_CHARACTERISTIC /end REF_CHARACTERISTIC /begin REF_MEASUREMENT FordMsg07DBusHiSpd.FordVehBrkTqVldMissMsgRefTi /end REF_MEASUREMENT /end GROUP
/begin GROUP FordMsg07DBusHiSpd.FordVehBrkTqVldPrev "MICROSAR RTE" /begin SUB_GROUP /end SUB_GROUP /begin FUNCTION_LIST /end FUNCTION_LIST /begin REF_CHARACTERISTIC /end REF_CHARACTERISTIC /begin REF_MEASUREMENT FordMsg07DBusHiSpd.FordVehBrkTqVldPrev /end REF_MEASUREMENT /end GROUP
/begin GROUP FordMsg07DBusHiSpd.FordVehMsg07DMiss "MICROSAR RTE" /begin SUB_GROUP /end SUB_GROUP /begin FUNCTION_LIST /end FUNCTION_LIST /begin REF_CHARACTERISTIC /end REF_CHARACTERISTIC /begin REF_MEASUREMENT FordMsg07DBusHiSpd.FordVehMsg07DMiss /end REF_MEASUREMENT /end GROUP
/begin GROUP FordMsg07DBusHiSpd.FordVehVertACmpdRaw.Val "MICROSAR RTE" /begin SUB_GROUP /end SUB_GROUP /begin FUNCTION_LIST /end FUNCTION_LIST /begin REF_CHARACTERISTIC /end REF_CHARACTERISTIC /begin REF_MEASUREMENT FordMsg07DBusHiSpd.FordVehVertACmpdRaw.Val /end REF_MEASUREMENT /end GROUP
/begin GROUP FordMsg07DBusHiSpd.FordVehVertACmpdRawPrev "MICROSAR RTE" /begin SUB_GROUP /end SUB_GROUP /begin FUNCTION_LIST /end FUNCTION_LIST /begin REF_CHARACTERISTIC /end REF_CHARACTERISTIC /begin REF_MEASUREMENT FordMsg07DBusHiSpd.FordVehVertACmpdRawPrev /end REF_MEASUREMENT /end GROUP
/begin GROUP FordMsg07DBusHiSpd.FordVehVertACmpdSigInvldFaildRefTi "MICROSAR RTE" /begin SUB_GROUP /end SUB_GROUP /begin FUNCTION_LIST /end FUNCTION_LIST /begin REF_CHARACTERISTIC /end REF_CHARACTERISTIC /begin REF_MEASUREMENT FordMsg07DBusHiSpd.FordVehVertACmpdSigInvldFaildRefTi /end REF_MEASUREMENT /end GROUP
/begin GROUP FordMsg07DBusHiSpd.FordVehVertACmpdSigInvldPassdRefTi "MICROSAR RTE" /begin SUB_GROUP /end SUB_GROUP /begin FUNCTION_LIST /end FUNCTION_LIST /begin REF_CHARACTERISTIC /end REF_CHARACTERISTIC /begin REF_MEASUREMENT FordMsg07DBusHiSpd.FordVehVertACmpdSigInvldPassdRefTi /end REF_MEASUREMENT /end GROUP
/begin GROUP FordMsg07DBusHiSpd.FordVehVertACmpdSigVldFaildRefTi "MICROSAR RTE" /begin SUB_GROUP /end SUB_GROUP /begin FUNCTION_LIST /end FUNCTION_LIST /begin REF_CHARACTERISTIC /end REF_CHARACTERISTIC /begin REF_MEASUREMENT FordMsg07DBusHiSpd.FordVehVertACmpdSigVldFaildRefTi /end REF_MEASUREMENT /end GROUP
/begin GROUP FordMsg07DBusHiSpd.FordVehVertACmpdSigVldPassdRefTi "MICROSAR RTE" /begin SUB_GROUP /end SUB_GROUP /begin FUNCTION_LIST /end FUNCTION_LIST /begin REF_CHARACTERISTIC /end REF_CHARACTERISTIC /begin REF_MEASUREMENT FordMsg07DBusHiSpd.FordVehVertACmpdSigVldPassdRefTi /end REF_MEASUREMENT /end GROUP
/begin GROUP FordMsg07DBusHiSpd.FordVehVertAVld.Logl "MICROSAR RTE" /begin SUB_GROUP /end SUB_GROUP /begin FUNCTION_LIST /end FUNCTION_LIST /begin REF_CHARACTERISTIC /end REF_CHARACTERISTIC /begin REF_MEASUREMENT FordMsg07DBusHiSpd.FordVehVertAVld.Logl /end REF_MEASUREMENT /end GROUP
/begin GROUP FordMsg07DBusHiSpd.FordVehVertAVldMissMsgRefTi "MICROSAR RTE" /begin SUB_GROUP /end SUB_GROUP /begin FUNCTION_LIST /end FUNCTION_LIST /begin REF_CHARACTERISTIC /end REF_CHARACTERISTIC /begin REF_MEASUREMENT FordMsg07DBusHiSpd.FordVehVertAVldMissMsgRefTi /end REF_MEASUREMENT /end GROUP
/begin GROUP FordMsg07DBusHiSpd.FordVehVertAVldPrev "MICROSAR RTE" /begin SUB_GROUP /end SUB_GROUP /begin FUNCTION_LIST /end FUNCTION_LIST /begin REF_CHARACTERISTIC /end REF_CHARACTERISTIC /begin REF_MEASUREMENT FordMsg07DBusHiSpd.FordVehVertAVldPrev /end REF_MEASUREMENT /end GROUP
/begin GROUP FordMsg07DBusHiSpd.MissMsgFaildRefTi "MICROSAR RTE" /begin SUB_GROUP /end SUB_GROUP /begin FUNCTION_LIST /end FUNCTION_LIST /begin REF_CHARACTERISTIC /end REF_CHARACTERISTIC /begin REF_MEASUREMENT FordMsg07DBusHiSpd.MissMsgFaildRefTi /end REF_MEASUREMENT /end GROUP
/begin GROUP FordMsg07DBusHiSpd.MissMsgPassdRefTi "MICROSAR RTE" /begin SUB_GROUP /end SUB_GROUP /begin FUNCTION_LIST /end FUNCTION_LIST /begin REF_CHARACTERISTIC /end REF_CHARACTERISTIC /begin REF_MEASUREMENT FordMsg07DBusHiSpd.MissMsgPassdRefTi /end REF_MEASUREMENT /end GROUP
/begin GROUP FordMsg07DBusHiSpd.PerInstanceMemories "MICROSAR RTE"
 /begin SUB_GROUP FordMsg07DBusHiSpd.ClrDiagcFlgProxyPrev FordMsg07DBusHiSpd.FirstTranVldFlg FordMsg07DBusHiSpd.FordVehActBrkTqRawPrev FordMsg07DBusHiSpd.FordVehActBrkTqSigInvldFaildRefTi FordMsg07DBusHiSpd.FordVehActBrkTqSigInvldPassdRefTi FordMsg07DBusHiSpd.FordVehActBrkTqVldFaildRefTi FordMsg07DBusHiSpd.FordVehActBrkTqVldPassdRefTi FordMsg07DBusHiSpd.FordVehBrkTqVldMissMsgRefTi FordMsg07DBusHiSpd.FordVehBrkTqVldPrev FordMsg07DBusHiSpd.FordVehMsg07DMiss FordMsg07DBusHiSpd.FordVehVertACmpdRawPrev FordMsg07DBusHiSpd.FordVehVertACmpdSigInvldFaildRefTi FordMsg07DBusHiSpd.FordVehVertACmpdSigInvldPassdRefTi FordMsg07DBusHiSpd.FordVehVertACmpdSigVldFaildRefTi FordMsg07DBusHiSpd.FordVehVertACmpdSigVldPassdRefTi FordMsg07DBusHiSpd.FordVehVertAVldMissMsgRefTi FordMsg07DBusHiSpd.FordVehVertAVldPrev FordMsg07DBusHiSpd.MissMsgFaildRefTi FordMsg07DBusHiSpd.MissMsgPassdRefTi /end SUB_GROUP
 /begin FUNCTION_LIST /end FUNCTION_LIST
 /begin REF_CHARACTERISTIC /end REF_CHARACTERISTIC
 /begin REF_MEASUREMENT /end REF_MEASUREMENT
/end GROUP
/begin GROUP FordMsg07DBusHiSpd.ReceiverPorts "MICROSAR RTE"
 /begin SUB_GROUP FordMsg07DBusHiSpd.ClrDiagcFlgProxy.Val FordMsg07DBusHiSpd.FordBrkOscnRednEnad.Logl FordMsg07DBusHiSpd.FordCanDtcInhb.Logl FordMsg07DBusHiSpd.FordEpsLifeCycMod.Val FordMsg07DBusHiSpd.FordTrlrBackUpAssiEnad.Logl /end SUB_GROUP
 /begin FUNCTION_LIST /end FUNCTION_LIST
 /begin REF_CHARACTERISTIC /end REF_CHARACTERISTIC
 /begin REF_MEASUREMENT /end REF_MEASUREMENT
/end GROUP
/begin GROUP FordMsg07DBusHiSpd.SenderPorts "MICROSAR RTE"
 /begin SUB_GROUP FordMsg07DBusHiSpd.FordVehActBrkTqRaw.Val FordMsg07DBusHiSpd.FordVehBrkTqVld.Logl FordMsg07DBusHiSpd.FordVehVertACmpdRaw.Val FordMsg07DBusHiSpd.FordVehVertAVld.Logl /end SUB_GROUP
 /begin FUNCTION_LIST /end FUNCTION_LIST
 /begin REF_CHARACTERISTIC /end REF_CHARACTERISTIC
 /begin REF_MEASUREMENT /end REF_MEASUREMENT
/end GROUP
/begin GROUP FordMsg07EBusHiSpd "MICROSAR RTE"
 /begin SUB_GROUP FordMsg07EBusHiSpd.PerInstanceMemories FordMsg07EBusHiSpd.ReceiverPorts /end SUB_GROUP
 /begin FUNCTION_LIST /end FUNCTION_LIST
 /begin REF_CHARACTERISTIC /end REF_CHARACTERISTIC
 /begin REF_MEASUREMENT /end REF_MEASUREMENT
/end GROUP
/begin GROUP FordMsg07EBusHiSpd.CmpdSteerPinionAg.Val "MICROSAR RTE" /begin SUB_GROUP /end SUB_GROUP /begin FUNCTION_LIST /end FUNCTION_LIST /begin REF_CHARACTERISTIC /end REF_CHARACTERISTIC /begin REF_MEASUREMENT FordMsg07EBusHiSpd.CmpdSteerPinionAg.Val /end REF_MEASUREMENT /end GROUP
/begin GROUP FordMsg07EBusHiSpd.CmpdSteerPinionAgQlyFac.Ford_StePinCompAnEst_D_Qf "MICROSAR RTE" /begin SUB_GROUP /end SUB_GROUP /begin FUNCTION_LIST /end FUNCTION_LIST /begin REF_CHARACTERISTIC /end REF_CHARACTERISTIC
 /begin REF_MEASUREMENT FordMsg07EBusHiSpd.CmpdSteerPinionAgQlyFac.Ford_StePinCompAnEst_D_Qf /end REF_MEASUREMENT
/end GROUP
/begin GROUP FordMsg07EBusHiSpd.FordVehSteerPwrReq.Ford_StePw_B_Rq "MICROSAR RTE" /begin SUB_GROUP /end SUB_GROUP /begin FUNCTION_LIST /end FUNCTION_LIST /begin REF_CHARACTERISTIC /end REF_CHARACTERISTIC /begin REF_MEASUREMENT FordMsg07EBusHiSpd.FordVehSteerPwrReq.Ford_StePw_B_Rq /end REF_MEASUREMENT /end GROUP
/begin GROUP FordMsg07EBusHiSpd.PerInstanceMemories "MICROSAR RTE" /begin SUB_GROUP FordMsg07EBusHiSpd.SteerPinionAgCntrPrev /end SUB_GROUP /begin FUNCTION_LIST /end FUNCTION_LIST /begin REF_CHARACTERISTIC /end REF_CHARACTERISTIC /begin REF_MEASUREMENT /end REF_MEASUREMENT /end GROUP
/begin GROUP FordMsg07EBusHiSpd.ReceiverPorts "MICROSAR RTE"
 /begin SUB_GROUP FordMsg07EBusHiSpd.CmpdSteerPinionAg.Val FordMsg07EBusHiSpd.CmpdSteerPinionAgQlyFac.Ford_StePinCompAnEst_D_Qf FordMsg07EBusHiSpd.FordVehSteerPwrReq.Ford_StePw_B_Rq FordMsg07EBusHiSpd.RelSteerPinionAg.Val /end SUB_GROUP
 /begin FUNCTION_LIST /end FUNCTION_LIST
 /begin REF_CHARACTERISTIC /end REF_CHARACTERISTIC
 /begin REF_MEASUREMENT /end REF_MEASUREMENT
/end GROUP
/begin GROUP FordMsg07EBusHiSpd.RelSteerPinionAg.Val "MICROSAR RTE" /begin SUB_GROUP /end SUB_GROUP /begin FUNCTION_LIST /end FUNCTION_LIST /begin REF_CHARACTERISTIC /end REF_CHARACTERISTIC /begin REF_MEASUREMENT FordMsg07EBusHiSpd.RelSteerPinionAg.Val /end REF_MEASUREMENT /end GROUP
/begin GROUP FordMsg07EBusHiSpd.SteerPinionAgCntrPrev "MICROSAR RTE" /begin SUB_GROUP /end SUB_GROUP /begin FUNCTION_LIST /end FUNCTION_LIST /begin REF_CHARACTERISTIC /end REF_CHARACTERISTIC /begin REF_MEASUREMENT FordMsg07EBusHiSpd.SteerPinionAgCntrPrev /end REF_MEASUREMENT /end GROUP
/begin GROUP FordMsg082BusHiSpd "MICROSAR RTE" /begin SUB_GROUP FordMsg082BusHiSpd.ReceiverPorts /end SUB_GROUP /begin FUNCTION_LIST /end FUNCTION_LIST /begin REF_CHARACTERISTIC /end REF_CHARACTERISTIC /begin REF_MEASUREMENT /end REF_MEASUREMENT /end GROUP
/begin GROUP FordMsg082BusHiSpd.ElecPwrSteerCurr.Val "MICROSAR RTE" /begin SUB_GROUP /end SUB_GROUP /begin FUNCTION_LIST /end FUNCTION_LIST /begin REF_CHARACTERISTIC /end REF_CHARACTERISTIC /begin REF_MEASUREMENT FordMsg082BusHiSpd.ElecPwrSteerCurr.Val /end REF_MEASUREMENT /end GROUP
/begin GROUP FordMsg082BusHiSpd.ElecPwrSteerVltg.Val "MICROSAR RTE" /begin SUB_GROUP /end SUB_GROUP /begin FUNCTION_LIST /end FUNCTION_LIST /begin REF_CHARACTERISTIC /end REF_CHARACTERISTIC /begin REF_MEASUREMENT FordMsg082BusHiSpd.ElecPwrSteerVltg.Val /end REF_MEASUREMENT /end GROUP
/begin GROUP FordMsg082BusHiSpd.FordElecPwrAssidSteerFailr.Ford_EPAS_Failure "MICROSAR RTE" /begin SUB_GROUP /end SUB_GROUP /begin FUNCTION_LIST /end FUNCTION_LIST /begin REF_CHARACTERISTIC /end REF_CHARACTERISTIC
 /begin REF_MEASUREMENT FordMsg082BusHiSpd.FordElecPwrAssidSteerFailr.Ford_EPAS_Failure /end REF_MEASUREMENT
/end GROUP
/begin GROUP FordMsg082BusHiSpd.FordSteerModlSts.Ford_SteMdule_D_Stat "MICROSAR RTE" /begin SUB_GROUP /end SUB_GROUP /begin FUNCTION_LIST /end FUNCTION_LIST /begin REF_CHARACTERISTIC /end REF_CHARACTERISTIC /begin REF_MEASUREMENT FordMsg082BusHiSpd.FordSteerModlSts.Ford_SteMdule_D_Stat /end REF_MEASUREMENT /end GROUP
/begin GROUP FordMsg082BusHiSpd.FordVehDrvrSteerActvnSts.Ford_DrvSteActv_B_Stat "MICROSAR RTE" /begin SUB_GROUP /end SUB_GROUP /begin FUNCTION_LIST /end FUNCTION_LIST /begin REF_CHARACTERISTIC /end REF_CHARACTERISTIC
 /begin REF_MEASUREMENT FordMsg082BusHiSpd.FordVehDrvrSteerActvnSts.Ford_DrvSteActv_B_Stat /end REF_MEASUREMENT
/end GROUP
/begin GROUP FordMsg082BusHiSpd.FordVehDrvrSteerTqReq.Val "MICROSAR RTE" /begin SUB_GROUP /end SUB_GROUP /begin FUNCTION_LIST /end FUNCTION_LIST /begin REF_CHARACTERISTIC /end REF_CHARACTERISTIC /begin REF_MEASUREMENT FordMsg082BusHiSpd.FordVehDrvrSteerTqReq.Val /end REF_MEASUREMENT /end GROUP
/begin GROUP FordMsg082BusHiSpd.FordVehReCamrLiSts.Ford_TrlrHitchLamp_D_Rqst "MICROSAR RTE" /begin SUB_GROUP /end SUB_GROUP /begin FUNCTION_LIST /end FUNCTION_LIST /begin REF_CHARACTERISTIC /end REF_CHARACTERISTIC
 /begin REF_MEASUREMENT FordMsg082BusHiSpd.FordVehReCamrLiSts.Ford_TrlrHitchLamp_D_Rqst /end REF_MEASUREMENT
/end GROUP
/begin GROUP FordMsg082BusHiSpd.FordVehSAPPAgCtrlSts1.Ford_SAPPAngleControlStat1 "MICROSAR RTE" /begin SUB_GROUP /end SUB_GROUP /begin FUNCTION_LIST /end FUNCTION_LIST /begin REF_CHARACTERISTIC /end REF_CHARACTERISTIC
 /begin REF_MEASUREMENT FordMsg082BusHiSpd.FordVehSAPPAgCtrlSts1.Ford_SAPPAngleControlStat1 /end REF_MEASUREMENT
/end GROUP
/begin GROUP FordMsg082BusHiSpd.FordVehSAPPAgCtrlSts2.Ford_SAPPAngleControlStat2 "MICROSAR RTE" /begin SUB_GROUP /end SUB_GROUP /begin FUNCTION_LIST /end FUNCTION_LIST /begin REF_CHARACTERISTIC /end REF_CHARACTERISTIC
 /begin REF_MEASUREMENT FordMsg082BusHiSpd.FordVehSAPPAgCtrlSts2.Ford_SAPPAngleControlStat2 /end REF_MEASUREMENT
/end GROUP
/begin GROUP FordMsg082BusHiSpd.FordVehSAPPAgCtrlSts3.Ford_SAPPAngleControlStat3 "MICROSAR RTE" /begin SUB_GROUP /end SUB_GROUP /begin FUNCTION_LIST /end FUNCTION_LIST /begin REF_CHARACTERISTIC /end REF_CHARACTERISTIC
 /begin REF_MEASUREMENT FordMsg082BusHiSpd.FordVehSAPPAgCtrlSts3.Ford_SAPPAngleControlStat3 /end REF_MEASUREMENT
/end GROUP
/begin GROUP FordMsg082BusHiSpd.FordVehSAPPAgCtrlSts4.Ford_SAPPAngleControlStat4 "MICROSAR RTE" /begin SUB_GROUP /end SUB_GROUP /begin FUNCTION_LIST /end FUNCTION_LIST /begin REF_CHARACTERISTIC /end REF_CHARACTERISTIC
 /begin REF_MEASUREMENT FordMsg082BusHiSpd.FordVehSAPPAgCtrlSts4.Ford_SAPPAngleControlStat4 /end REF_MEASUREMENT
/end GROUP
/begin GROUP FordMsg082BusHiSpd.FordVehSAPPAgCtrlSts5.Ford_SAPPAngleControlStat5 "MICROSAR RTE" /begin SUB_GROUP /end SUB_GROUP /begin FUNCTION_LIST /end FUNCTION_LIST /begin REF_CHARACTERISTIC /end REF_CHARACTERISTIC
 /begin REF_MEASUREMENT FordMsg082BusHiSpd.FordVehSAPPAgCtrlSts5.Ford_SAPPAngleControlStat5 /end REF_MEASUREMENT
/end GROUP
/begin GROUP FordMsg082BusHiSpd.FordVehSAPPAgCtrlSts6.Ford_SAPPAngleControlStat6 "MICROSAR RTE" /begin SUB_GROUP /end SUB_GROUP /begin FUNCTION_LIST /end FUNCTION_LIST /begin REF_CHARACTERISTIC /end REF_CHARACTERISTIC
 /begin REF_MEASUREMENT FordMsg082BusHiSpd.FordVehSAPPAgCtrlSts6.Ford_SAPPAngleControlStat6 /end REF_MEASUREMENT
/end GROUP
/begin GROUP FordMsg082BusHiSpd.FordVehVelMaxReqTrlrAid.Val "MICROSAR RTE" /begin SUB_GROUP /end SUB_GROUP /begin FUNCTION_LIST /end FUNCTION_LIST /begin REF_CHARACTERISTIC /end REF_CHARACTERISTIC /begin REF_MEASUREMENT FordMsg082BusHiSpd.FordVehVelMaxReqTrlrAid.Val /end REF_MEASUREMENT /end GROUP
/begin GROUP FordMsg082BusHiSpd.FordVehVelTrlrAidReq.Ford_VehVTrlrAid_B_Rq "MICROSAR RTE" /begin SUB_GROUP /end SUB_GROUP /begin FUNCTION_LIST /end FUNCTION_LIST /begin REF_CHARACTERISTIC /end REF_CHARACTERISTIC
 /begin REF_MEASUREMENT FordMsg082BusHiSpd.FordVehVelTrlrAidReq.Ford_VehVTrlrAid_B_Rq /end REF_MEASUREMENT
/end GROUP
/begin GROUP FordMsg082BusHiSpd.InpTqRaw.Val "MICROSAR RTE" /begin SUB_GROUP /end SUB_GROUP /begin FUNCTION_LIST /end FUNCTION_LIST /begin REF_CHARACTERISTIC /end REF_CHARACTERISTIC /begin REF_MEASUREMENT FordMsg082BusHiSpd.InpTqRaw.Val /end REF_MEASUREMENT /end GROUP
/begin GROUP FordMsg082BusHiSpd.ReceiverPorts "MICROSAR RTE"
 /begin SUB_GROUP FordMsg082BusHiSpd.ElecPwrSteerCurr.Val FordMsg082BusHiSpd.ElecPwrSteerVltg.Val FordMsg082BusHiSpd.FordElecPwrAssidSteerFailr.Ford_EPAS_Failure FordMsg082BusHiSpd.FordSteerModlSts.Ford_SteMdule_D_Stat FordMsg082BusHiSpd.FordVehDrvrSteerActvnSts.Ford_DrvSteActv_B_Stat FordMsg082BusHiSpd.FordVehDrvrSteerTqReq.Val FordMsg082BusHiSpd.FordVehReCamrLiSts.Ford_TrlrHitchLamp_D_Rqst FordMsg082BusHiSpd.FordVehSAPPAgCtrlSts1.Ford_SAPPAngleControlStat1 FordMsg082BusHiSpd.FordVehSAPPAgCtrlSts2.Ford_SAPPAngleControlStat2 FordMsg082BusHiSpd.FordVehSAPPAgCtrlSts3.Ford_SAPPAngleControlStat3 FordMsg082BusHiSpd.FordVehSAPPAgCtrlSts4.Ford_SAPPAngleControlStat4 FordMsg082BusHiSpd.FordVehSAPPAgCtrlSts5.Ford_SAPPAngleControlStat5 FordMsg082BusHiSpd.FordVehSAPPAgCtrlSts6.Ford_SAPPAngleControlStat6 FordMsg082BusHiSpd.FordVehVelMaxReqTrlrAid.Val FordMsg082BusHiSpd.FordVehVelTrlrAidReq.Ford_VehVTrlrAid_B_Rq FordMsg082BusHiSpd.InpTqRaw.Val /end SUB_GROUP
 /begin FUNCTION_LIST /end FUNCTION_LIST
 /begin REF_CHARACTERISTIC /end REF_CHARACTERISTIC
 /begin REF_MEASUREMENT /end REF_MEASUREMENT
/end GROUP
/begin GROUP FordMsg083BusHiSpd "MICROSAR RTE"
 /begin SUB_GROUP FordMsg083BusHiSpd.CalibrationPorts FordMsg083BusHiSpd.PerInstanceMemories FordMsg083BusHiSpd.ReceiverPorts FordMsg083BusHiSpd.SenderPorts /end SUB_GROUP
 /begin FUNCTION_LIST /end FUNCTION_LIST
 /begin REF_CHARACTERISTIC /end REF_CHARACTERISTIC
 /begin REF_MEASUREMENT /end REF_MEASUREMENT
/end GROUP
/begin GROUP FordMsg083BusHiSpd.CalibrationPorts "MICROSAR RTE"
 /begin SUB_GROUP FordMsg083BusHiSpd.FordMsg083BusHiSpdFordVehTurnSigVldThd.Val FordMsg083BusHiSpd.FordMsg083BusHiSpdMissMsgFaildThd.Val FordMsg083BusHiSpd.FordMsg083BusHiSpdMissMsgPassdThd.Val FordMsg083BusHiSpd.FordMsg083BusHiSpdVehTurnSigVldMissMsgThd.Val /end SUB_GROUP
 /begin FUNCTION_LIST /end FUNCTION_LIST
 /begin REF_CHARACTERISTIC /end REF_CHARACTERISTIC
 /begin REF_MEASUREMENT /end REF_MEASUREMENT
/end GROUP
/begin GROUP FordMsg083BusHiSpd.ClrDiagcFlgProxy.Val "MICROSAR RTE" /begin SUB_GROUP /end SUB_GROUP /begin FUNCTION_LIST /end FUNCTION_LIST /begin REF_CHARACTERISTIC /end REF_CHARACTERISTIC /begin REF_MEASUREMENT FordMsg083BusHiSpd.ClrDiagcFlgProxy.Val /end REF_MEASUREMENT /end GROUP
/begin GROUP FordMsg083BusHiSpd.ClrDiagcFlgProxyPrev "MICROSAR RTE" /begin SUB_GROUP /end SUB_GROUP /begin FUNCTION_LIST /end FUNCTION_LIST /begin REF_CHARACTERISTIC /end REF_CHARACTERISTIC /begin REF_MEASUREMENT FordMsg083BusHiSpd.ClrDiagcFlgProxyPrev /end REF_MEASUREMENT /end GROUP
/begin GROUP FordMsg083BusHiSpd.FirstTranVldFlg "MICROSAR RTE" /begin SUB_GROUP /end SUB_GROUP /begin FUNCTION_LIST /end FUNCTION_LIST /begin REF_CHARACTERISTIC /end REF_CHARACTERISTIC /begin REF_MEASUREMENT FordMsg083BusHiSpd.FirstTranVldFlg /end REF_MEASUREMENT /end GROUP
/begin GROUP FordMsg083BusHiSpd.FordCanDtcInhb.Logl "MICROSAR RTE" /begin SUB_GROUP /end SUB_GROUP /begin FUNCTION_LIST /end FUNCTION_LIST /begin REF_CHARACTERISTIC /end REF_CHARACTERISTIC /begin REF_MEASUREMENT FordMsg083BusHiSpd.FordCanDtcInhb.Logl /end REF_MEASUREMENT /end GROUP
/begin GROUP FordMsg083BusHiSpd.FordEpsLifeCycMod.Val "MICROSAR RTE" /begin SUB_GROUP /end SUB_GROUP /begin FUNCTION_LIST /end FUNCTION_LIST /begin REF_CHARACTERISTIC /end REF_CHARACTERISTIC /begin REF_MEASUREMENT FordMsg083BusHiSpd.FordEpsLifeCycMod.Val /end REF_MEASUREMENT /end GROUP
/begin GROUP FordMsg083BusHiSpd.FordLaneDetnWarnEnad.Logl "MICROSAR RTE" /begin SUB_GROUP /end SUB_GROUP /begin FUNCTION_LIST /end FUNCTION_LIST /begin REF_CHARACTERISTIC /end REF_CHARACTERISTIC /begin REF_MEASUREMENT FordMsg083BusHiSpd.FordLaneDetnWarnEnad.Logl /end REF_MEASUREMENT /end GROUP
/begin GROUP FordMsg083BusHiSpd.FordMsg083BusHiSpdFordVehTurnSigVldThd.Val "MICROSAR RTE" /begin SUB_GROUP /end SUB_GROUP /begin FUNCTION_LIST /end FUNCTION_LIST
 /begin REF_CHARACTERISTIC FordMsg083BusHiSpd.FordMsg083BusHiSpdFordVehTurnSigVldThd.Val /end REF_CHARACTERISTIC
 /begin REF_MEASUREMENT /end REF_MEASUREMENT
/end GROUP
/begin GROUP FordMsg083BusHiSpd.FordMsg083BusHiSpdMissMsgFaildThd.Val "MICROSAR RTE" /begin SUB_GROUP /end SUB_GROUP /begin FUNCTION_LIST /end FUNCTION_LIST /begin REF_CHARACTERISTIC FordMsg083BusHiSpd.FordMsg083BusHiSpdMissMsgFaildThd.Val /end REF_CHARACTERISTIC /begin REF_MEASUREMENT /end REF_MEASUREMENT /end GROUP
/begin GROUP FordMsg083BusHiSpd.FordMsg083BusHiSpdMissMsgPassdThd.Val "MICROSAR RTE" /begin SUB_GROUP /end SUB_GROUP /begin FUNCTION_LIST /end FUNCTION_LIST /begin REF_CHARACTERISTIC FordMsg083BusHiSpd.FordMsg083BusHiSpdMissMsgPassdThd.Val /end REF_CHARACTERISTIC /begin REF_MEASUREMENT /end REF_MEASUREMENT /end GROUP
/begin GROUP FordMsg083BusHiSpd.FordMsg083BusHiSpdVehTurnSigVldMissMsgThd.Val "MICROSAR RTE" /begin SUB_GROUP /end SUB_GROUP /begin FUNCTION_LIST /end FUNCTION_LIST
 /begin REF_CHARACTERISTIC FordMsg083BusHiSpd.FordMsg083BusHiSpdVehTurnSigVldMissMsgThd.Val /end REF_CHARACTERISTIC
 /begin REF_MEASUREMENT /end REF_MEASUREMENT
/end GROUP
/begin GROUP FordMsg083BusHiSpd.FordVehMsg083Miss "MICROSAR RTE" /begin SUB_GROUP /end SUB_GROUP /begin FUNCTION_LIST /end FUNCTION_LIST /begin REF_CHARACTERISTIC /end REF_CHARACTERISTIC /begin REF_MEASUREMENT FordMsg083BusHiSpd.FordVehMsg083Miss /end REF_MEASUREMENT /end GROUP
/begin GROUP FordMsg083BusHiSpd.FordVehTurnSigSwtStsRaw.Val "MICROSAR RTE" /begin SUB_GROUP /end SUB_GROUP /begin FUNCTION_LIST /end FUNCTION_LIST /begin REF_CHARACTERISTIC /end REF_CHARACTERISTIC /begin REF_MEASUREMENT FordMsg083BusHiSpd.FordVehTurnSigSwtStsRaw.Val /end REF_MEASUREMENT /end GROUP
/begin GROUP FordMsg083BusHiSpd.FordVehTurnSigSwtStsRawPrev "MICROSAR RTE" /begin SUB_GROUP /end SUB_GROUP /begin FUNCTION_LIST /end FUNCTION_LIST /begin REF_CHARACTERISTIC /end REF_CHARACTERISTIC /begin REF_MEASUREMENT FordMsg083BusHiSpd.FordVehTurnSigSwtStsRawPrev /end REF_MEASUREMENT /end GROUP
/begin GROUP FordMsg083BusHiSpd.FordVehTurnSigVld.Logl "MICROSAR RTE" /begin SUB_GROUP /end SUB_GROUP /begin FUNCTION_LIST /end FUNCTION_LIST /begin REF_CHARACTERISTIC /end REF_CHARACTERISTIC /begin REF_MEASUREMENT FordMsg083BusHiSpd.FordVehTurnSigVld.Logl /end REF_MEASUREMENT /end GROUP
/begin GROUP FordMsg083BusHiSpd.FordVehTurnSigVldMissMsgRefTi "MICROSAR RTE" /begin SUB_GROUP /end SUB_GROUP /begin FUNCTION_LIST /end FUNCTION_LIST /begin REF_CHARACTERISTIC /end REF_CHARACTERISTIC /begin REF_MEASUREMENT FordMsg083BusHiSpd.FordVehTurnSigVldMissMsgRefTi /end REF_MEASUREMENT /end GROUP
/begin GROUP FordMsg083BusHiSpd.FordVehTurnSigVldPrev "MICROSAR RTE" /begin SUB_GROUP /end SUB_GROUP /begin FUNCTION_LIST /end FUNCTION_LIST /begin REF_CHARACTERISTIC /end REF_CHARACTERISTIC /begin REF_MEASUREMENT FordMsg083BusHiSpd.FordVehTurnSigVldPrev /end REF_MEASUREMENT /end GROUP
/begin GROUP FordMsg083BusHiSpd.FordVehTurnSigVldRefTi "MICROSAR RTE" /begin SUB_GROUP /end SUB_GROUP /begin FUNCTION_LIST /end FUNCTION_LIST /begin REF_CHARACTERISTIC /end REF_CHARACTERISTIC /begin REF_MEASUREMENT FordMsg083BusHiSpd.FordVehTurnSigVldRefTi /end REF_MEASUREMENT /end GROUP
/begin GROUP FordMsg083BusHiSpd.MissMsgFaildRefTi "MICROSAR RTE" /begin SUB_GROUP /end SUB_GROUP /begin FUNCTION_LIST /end FUNCTION_LIST /begin REF_CHARACTERISTIC /end REF_CHARACTERISTIC /begin REF_MEASUREMENT FordMsg083BusHiSpd.MissMsgFaildRefTi /end REF_MEASUREMENT /end GROUP
/begin GROUP FordMsg083BusHiSpd.MissMsgPassdRefTi "MICROSAR RTE" /begin SUB_GROUP /end SUB_GROUP /begin FUNCTION_LIST /end FUNCTION_LIST /begin REF_CHARACTERISTIC /end REF_CHARACTERISTIC /begin REF_MEASUREMENT FordMsg083BusHiSpd.MissMsgPassdRefTi /end REF_MEASUREMENT /end GROUP
/begin GROUP FordMsg083BusHiSpd.PerInstanceMemories "MICROSAR RTE"
 /begin SUB_GROUP FordMsg083BusHiSpd.ClrDiagcFlgProxyPrev FordMsg083BusHiSpd.FirstTranVldFlg FordMsg083BusHiSpd.FordVehMsg083Miss FordMsg083BusHiSpd.FordVehTurnSigSwtStsRawPrev FordMsg083BusHiSpd.FordVehTurnSigVldMissMsgRefTi FordMsg083BusHiSpd.FordVehTurnSigVldPrev FordMsg083BusHiSpd.FordVehTurnSigVldRefTi FordMsg083BusHiSpd.MissMsgFaildRefTi FordMsg083BusHiSpd.MissMsgPassdRefTi /end SUB_GROUP
 /begin FUNCTION_LIST /end FUNCTION_LIST
 /begin REF_CHARACTERISTIC /end REF_CHARACTERISTIC
 /begin REF_MEASUREMENT /end REF_MEASUREMENT
/end GROUP
/begin GROUP FordMsg083BusHiSpd.ReceiverPorts "MICROSAR RTE"
 /begin SUB_GROUP FordMsg083BusHiSpd.ClrDiagcFlgProxy.Val FordMsg083BusHiSpd.FordCanDtcInhb.Logl FordMsg083BusHiSpd.FordEpsLifeCycMod.Val FordMsg083BusHiSpd.FordLaneDetnWarnEnad.Logl /end SUB_GROUP
 /begin FUNCTION_LIST /end FUNCTION_LIST
 /begin REF_CHARACTERISTIC /end REF_CHARACTERISTIC
 /begin REF_MEASUREMENT /end REF_MEASUREMENT
/end GROUP
/begin GROUP FordMsg083BusHiSpd.SenderPorts "MICROSAR RTE"
 /begin SUB_GROUP FordMsg083BusHiSpd.FordVehTurnSigSwtStsRaw.Val FordMsg083BusHiSpd.FordVehTurnSigVld.Logl /end SUB_GROUP
 /begin FUNCTION_LIST /end FUNCTION_LIST
 /begin REF_CHARACTERISTIC /end REF_CHARACTERISTIC
 /begin REF_MEASUREMENT /end REF_MEASUREMENT
/end GROUP
/begin GROUP FordMsg091BusHiSpd "MICROSAR RTE"
 /begin SUB_GROUP FordMsg091BusHiSpd.CalibrationPorts FordMsg091BusHiSpd.PerInstanceMemories FordMsg091BusHiSpd.ReceiverPorts FordMsg091BusHiSpd.SenderPorts /end SUB_GROUP
 /begin FUNCTION_LIST /end FUNCTION_LIST
 /begin REF_CHARACTERISTIC /end REF_CHARACTERISTIC
 /begin REF_MEASUREMENT /end REF_MEASUREMENT
/end GROUP
/begin GROUP FordMsg091BusHiSpd.CalibrationPorts "MICROSAR RTE"
 /begin SUB_GROUP FordMsg091BusHiSpd.FordMsg091BusHiSpdInvldMsgFaildThd.Val FordMsg091BusHiSpd.FordMsg091BusHiSpdInvldMsgPassdThd.Val FordMsg091BusHiSpd.FordMsg091BusHiSpdMissMsgFaildThd.Val FordMsg091BusHiSpd.FordMsg091BusHiSpdMissMsgPassdThd.Val FordMsg091BusHiSpd.FordMsg091BusHiSpdYawRateRawVldMissFaildThd.Val FordMsg091BusHiSpd.FordMsg091BusHiSpdYawRateRawVldSigFaildThd.Val FordMsg091BusHiSpd.FordMsg091BusHiSpdYawRateRawVldSigPassdThd.Val /end SUB_GROUP
 /begin FUNCTION_LIST /end FUNCTION_LIST
 /begin REF_CHARACTERISTIC /end REF_CHARACTERISTIC
 /begin REF_MEASUREMENT /end REF_MEASUREMENT
/end GROUP
/begin GROUP FordMsg091BusHiSpd.ClrDiagcFlgProxy.Val "MICROSAR RTE" /begin SUB_GROUP /end SUB_GROUP /begin FUNCTION_LIST /end FUNCTION_LIST /begin REF_CHARACTERISTIC /end REF_CHARACTERISTIC /begin REF_MEASUREMENT FordMsg091BusHiSpd.ClrDiagcFlgProxy.Val /end REF_MEASUREMENT /end GROUP
/begin GROUP FordMsg091BusHiSpd.ClrDiagcFlgProxyPrev "MICROSAR RTE" /begin SUB_GROUP /end SUB_GROUP /begin FUNCTION_LIST /end FUNCTION_LIST /begin REF_CHARACTERISTIC /end REF_CHARACTERISTIC /begin REF_MEASUREMENT FordMsg091BusHiSpd.ClrDiagcFlgProxyPrev /end REF_MEASUREMENT /end GROUP
/begin GROUP FordMsg091BusHiSpd.FirstTranVldFlg "MICROSAR RTE" /begin SUB_GROUP /end SUB_GROUP /begin FUNCTION_LIST /end FUNCTION_LIST /begin REF_CHARACTERISTIC /end REF_CHARACTERISTIC /begin REF_MEASUREMENT FordMsg091BusHiSpd.FirstTranVldFlg /end REF_MEASUREMENT /end GROUP
/begin GROUP FordMsg091BusHiSpd.FordCanDtcInhb.Logl "MICROSAR RTE" /begin SUB_GROUP /end SUB_GROUP /begin FUNCTION_LIST /end FUNCTION_LIST /begin REF_CHARACTERISTIC /end REF_CHARACTERISTIC /begin REF_MEASUREMENT FordMsg091BusHiSpd.FordCanDtcInhb.Logl /end REF_MEASUREMENT /end GROUP
/begin GROUP FordMsg091BusHiSpd.FordEpsLifeCycMod.Val "MICROSAR RTE" /begin SUB_GROUP /end SUB_GROUP /begin FUNCTION_LIST /end FUNCTION_LIST /begin REF_CHARACTERISTIC /end REF_CHARACTERISTIC /begin REF_MEASUREMENT FordMsg091BusHiSpd.FordEpsLifeCycMod.Val /end REF_MEASUREMENT /end GROUP
/begin GROUP FordMsg091BusHiSpd.FordLaneCentrAssiEnad.Logl "MICROSAR RTE" /begin SUB_GROUP /end SUB_GROUP /begin FUNCTION_LIST /end FUNCTION_LIST /begin REF_CHARACTERISTIC /end REF_CHARACTERISTIC /begin REF_MEASUREMENT FordMsg091BusHiSpd.FordLaneCentrAssiEnad.Logl /end REF_MEASUREMENT /end GROUP
/begin GROUP FordMsg091BusHiSpd.FordMsg091BusHiSpdInvldMsgFaildThd.Val "MICROSAR RTE" /begin SUB_GROUP /end SUB_GROUP /begin FUNCTION_LIST /end FUNCTION_LIST /begin REF_CHARACTERISTIC FordMsg091BusHiSpd.FordMsg091BusHiSpdInvldMsgFaildThd.Val /end REF_CHARACTERISTIC /begin REF_MEASUREMENT /end REF_MEASUREMENT /end GROUP
/begin GROUP FordMsg091BusHiSpd.FordMsg091BusHiSpdInvldMsgPassdThd.Val "MICROSAR RTE" /begin SUB_GROUP /end SUB_GROUP /begin FUNCTION_LIST /end FUNCTION_LIST /begin REF_CHARACTERISTIC FordMsg091BusHiSpd.FordMsg091BusHiSpdInvldMsgPassdThd.Val /end REF_CHARACTERISTIC /begin REF_MEASUREMENT /end REF_MEASUREMENT /end GROUP
/begin GROUP FordMsg091BusHiSpd.FordMsg091BusHiSpdMissMsgFaildThd.Val "MICROSAR RTE" /begin SUB_GROUP /end SUB_GROUP /begin FUNCTION_LIST /end FUNCTION_LIST /begin REF_CHARACTERISTIC FordMsg091BusHiSpd.FordMsg091BusHiSpdMissMsgFaildThd.Val /end REF_CHARACTERISTIC /begin REF_MEASUREMENT /end REF_MEASUREMENT /end GROUP
/begin GROUP FordMsg091BusHiSpd.FordMsg091BusHiSpdMissMsgPassdThd.Val "MICROSAR RTE" /begin SUB_GROUP /end SUB_GROUP /begin FUNCTION_LIST /end FUNCTION_LIST /begin REF_CHARACTERISTIC FordMsg091BusHiSpd.FordMsg091BusHiSpdMissMsgPassdThd.Val /end REF_CHARACTERISTIC /begin REF_MEASUREMENT /end REF_MEASUREMENT /end GROUP
/begin GROUP FordMsg091BusHiSpd.FordMsg091BusHiSpdYawRateRawVldMissFaildThd.Val "MICROSAR RTE" /begin SUB_GROUP /end SUB_GROUP /begin FUNCTION_LIST /end FUNCTION_LIST
 /begin REF_CHARACTERISTIC FordMsg091BusHiSpd.FordMsg091BusHiSpdYawRateRawVldMissFaildThd.Val /end REF_CHARACTERISTIC
 /begin REF_MEASUREMENT /end REF_MEASUREMENT
/end GROUP
/begin GROUP FordMsg091BusHiSpd.FordMsg091BusHiSpdYawRateRawVldSigFaildThd.Val "MICROSAR RTE" /begin SUB_GROUP /end SUB_GROUP /begin FUNCTION_LIST /end FUNCTION_LIST
 /begin REF_CHARACTERISTIC FordMsg091BusHiSpd.FordMsg091BusHiSpdYawRateRawVldSigFaildThd.Val /end REF_CHARACTERISTIC
 /begin REF_MEASUREMENT /end REF_MEASUREMENT
/end GROUP
/begin GROUP FordMsg091BusHiSpd.FordMsg091BusHiSpdYawRateRawVldSigPassdThd.Val "MICROSAR RTE" /begin SUB_GROUP /end SUB_GROUP /begin FUNCTION_LIST /end FUNCTION_LIST
 /begin REF_CHARACTERISTIC FordMsg091BusHiSpd.FordMsg091BusHiSpdYawRateRawVldSigPassdThd.Val /end REF_CHARACTERISTIC
 /begin REF_MEASUREMENT /end REF_MEASUREMENT
/end GROUP
/begin GROUP FordMsg091BusHiSpd.FordTrfcJamAssiEnad.Logl "MICROSAR RTE" /begin SUB_GROUP /end SUB_GROUP /begin FUNCTION_LIST /end FUNCTION_LIST /begin REF_CHARACTERISTIC /end REF_CHARACTERISTIC /begin REF_MEASUREMENT FordMsg091BusHiSpd.FordTrfcJamAssiEnad.Logl /end REF_MEASUREMENT /end GROUP
/begin GROUP FordMsg091BusHiSpd.FordTrlrBackUpAssiEnad.Logl "MICROSAR RTE" /begin SUB_GROUP /end SUB_GROUP /begin FUNCTION_LIST /end FUNCTION_LIST /begin REF_CHARACTERISTIC /end REF_CHARACTERISTIC /begin REF_MEASUREMENT FordMsg091BusHiSpd.FordTrlrBackUpAssiEnad.Logl /end REF_MEASUREMENT /end GROUP
/begin GROUP FordMsg091BusHiSpd.FordVehMsg091Miss "MICROSAR RTE" /begin SUB_GROUP /end SUB_GROUP /begin FUNCTION_LIST /end FUNCTION_LIST /begin REF_CHARACTERISTIC /end REF_CHARACTERISTIC /begin REF_MEASUREMENT FordMsg091BusHiSpd.FordVehMsg091Miss /end REF_MEASUREMENT /end GROUP
/begin GROUP FordMsg091BusHiSpd.FordVehYawRate.Val "MICROSAR RTE" /begin SUB_GROUP /end SUB_GROUP /begin FUNCTION_LIST /end FUNCTION_LIST /begin REF_CHARACTERISTIC /end REF_CHARACTERISTIC /begin REF_MEASUREMENT FordMsg091BusHiSpd.FordVehYawRate.Val /end REF_MEASUREMENT /end GROUP
/begin GROUP FordMsg091BusHiSpd.FordVehYawRatePrev "MICROSAR RTE" /begin SUB_GROUP /end SUB_GROUP /begin FUNCTION_LIST /end FUNCTION_LIST /begin REF_CHARACTERISTIC /end REF_CHARACTERISTIC /begin REF_MEASUREMENT FordMsg091BusHiSpd.FordVehYawRatePrev /end REF_MEASUREMENT /end GROUP
/begin GROUP FordMsg091BusHiSpd.FordVehYawRateRaw.Ford_VehYaw_W_Actl "MICROSAR RTE" /begin SUB_GROUP /end SUB_GROUP /begin FUNCTION_LIST /end FUNCTION_LIST /begin REF_CHARACTERISTIC /end REF_CHARACTERISTIC /begin REF_MEASUREMENT FordMsg091BusHiSpd.FordVehYawRateRaw.Ford_VehYaw_W_Actl /end REF_MEASUREMENT /end GROUP
/begin GROUP FordMsg091BusHiSpd.FordVehYawRateRawPrev "MICROSAR RTE" /begin SUB_GROUP /end SUB_GROUP /begin FUNCTION_LIST /end FUNCTION_LIST /begin REF_CHARACTERISTIC /end REF_CHARACTERISTIC /begin REF_MEASUREMENT FordMsg091BusHiSpd.FordVehYawRateRawPrev /end REF_MEASUREMENT /end GROUP
/begin GROUP FordMsg091BusHiSpd.FordVehYawRateRawVld.Logl "MICROSAR RTE" /begin SUB_GROUP /end SUB_GROUP /begin FUNCTION_LIST /end FUNCTION_LIST /begin REF_CHARACTERISTIC /end REF_CHARACTERISTIC /begin REF_MEASUREMENT FordMsg091BusHiSpd.FordVehYawRateRawVld.Logl /end REF_MEASUREMENT /end GROUP
/begin GROUP FordMsg091BusHiSpd.FordVehYawRateRawVldFaildRefTi "MICROSAR RTE" /begin SUB_GROUP /end SUB_GROUP /begin FUNCTION_LIST /end FUNCTION_LIST /begin REF_CHARACTERISTIC /end REF_CHARACTERISTIC /begin REF_MEASUREMENT FordMsg091BusHiSpd.FordVehYawRateRawVldFaildRefTi /end REF_MEASUREMENT /end GROUP
/begin GROUP FordMsg091BusHiSpd.FordVehYawRateRawVldMissRefTi "MICROSAR RTE" /begin SUB_GROUP /end SUB_GROUP /begin FUNCTION_LIST /end FUNCTION_LIST /begin REF_CHARACTERISTIC /end REF_CHARACTERISTIC /begin REF_MEASUREMENT FordMsg091BusHiSpd.FordVehYawRateRawVldMissRefTi /end REF_MEASUREMENT /end GROUP
/begin GROUP FordMsg091BusHiSpd.FordVehYawRateRawVldPassdRefTi "MICROSAR RTE" /begin SUB_GROUP /end SUB_GROUP /begin FUNCTION_LIST /end FUNCTION_LIST /begin REF_CHARACTERISTIC /end REF_CHARACTERISTIC /begin REF_MEASUREMENT FordMsg091BusHiSpd.FordVehYawRateRawVldPassdRefTi /end REF_MEASUREMENT /end GROUP
/begin GROUP FordMsg091BusHiSpd.FordVehYawRateRawVldPrev "MICROSAR RTE" /begin SUB_GROUP /end SUB_GROUP /begin FUNCTION_LIST /end FUNCTION_LIST /begin REF_CHARACTERISTIC /end REF_CHARACTERISTIC /begin REF_MEASUREMENT FordMsg091BusHiSpd.FordVehYawRateRawVldPrev /end REF_MEASUREMENT /end GROUP
/begin GROUP FordMsg091BusHiSpd.InvldMsgFaildRefTi "MICROSAR RTE" /begin SUB_GROUP /end SUB_GROUP /begin FUNCTION_LIST /end FUNCTION_LIST /begin REF_CHARACTERISTIC /end REF_CHARACTERISTIC /begin REF_MEASUREMENT FordMsg091BusHiSpd.InvldMsgFaildRefTi /end REF_MEASUREMENT /end GROUP
/begin GROUP FordMsg091BusHiSpd.InvldMsgPassdRefTi "MICROSAR RTE" /begin SUB_GROUP /end SUB_GROUP /begin FUNCTION_LIST /end FUNCTION_LIST /begin REF_CHARACTERISTIC /end REF_CHARACTERISTIC /begin REF_MEASUREMENT FordMsg091BusHiSpd.InvldMsgPassdRefTi /end REF_MEASUREMENT /end GROUP
/begin GROUP FordMsg091BusHiSpd.MissMsgFaildRefTi "MICROSAR RTE" /begin SUB_GROUP /end SUB_GROUP /begin FUNCTION_LIST /end FUNCTION_LIST /begin REF_CHARACTERISTIC /end REF_CHARACTERISTIC /begin REF_MEASUREMENT FordMsg091BusHiSpd.MissMsgFaildRefTi /end REF_MEASUREMENT /end GROUP
/begin GROUP FordMsg091BusHiSpd.MissMsgPassdRefTi "MICROSAR RTE" /begin SUB_GROUP /end SUB_GROUP /begin FUNCTION_LIST /end FUNCTION_LIST /begin REF_CHARACTERISTIC /end REF_CHARACTERISTIC /begin REF_MEASUREMENT FordMsg091BusHiSpd.MissMsgPassdRefTi /end REF_MEASUREMENT /end GROUP
/begin GROUP FordMsg091BusHiSpd.PerInstanceMemories "MICROSAR RTE"
 /begin SUB_GROUP FordMsg091BusHiSpd.ClrDiagcFlgProxyPrev FordMsg091BusHiSpd.FirstTranVldFlg FordMsg091BusHiSpd.FordVehMsg091Miss FordMsg091BusHiSpd.FordVehYawRatePrev FordMsg091BusHiSpd.FordVehYawRateRawPrev FordMsg091BusHiSpd.FordVehYawRateRawVldFaildRefTi FordMsg091BusHiSpd.FordVehYawRateRawVldMissRefTi FordMsg091BusHiSpd.FordVehYawRateRawVldPassdRefTi FordMsg091BusHiSpd.FordVehYawRateRawVldPrev FordMsg091BusHiSpd.InvldMsgFaildRefTi FordMsg091BusHiSpd.InvldMsgPassdRefTi FordMsg091BusHiSpd.MissMsgFaildRefTi FordMsg091BusHiSpd.MissMsgPassdRefTi /end SUB_GROUP
 /begin FUNCTION_LIST /end FUNCTION_LIST
 /begin REF_CHARACTERISTIC /end REF_CHARACTERISTIC
 /begin REF_MEASUREMENT /end REF_MEASUREMENT
/end GROUP
/begin GROUP FordMsg091BusHiSpd.ReceiverPorts "MICROSAR RTE"
 /begin SUB_GROUP FordMsg091BusHiSpd.ClrDiagcFlgProxy.Val FordMsg091BusHiSpd.FordCanDtcInhb.Logl FordMsg091BusHiSpd.FordEpsLifeCycMod.Val FordMsg091BusHiSpd.FordLaneCentrAssiEnad.Logl FordMsg091BusHiSpd.FordTrfcJamAssiEnad.Logl FordMsg091BusHiSpd.FordTrlrBackUpAssiEnad.Logl /end SUB_GROUP
 /begin FUNCTION_LIST /end FUNCTION_LIST
 /begin REF_CHARACTERISTIC /end REF_CHARACTERISTIC
 /begin REF_MEASUREMENT /end REF_MEASUREMENT
/end GROUP
/begin GROUP FordMsg091BusHiSpd.SenderPorts "MICROSAR RTE"
 /begin SUB_GROUP FordMsg091BusHiSpd.FordVehYawRate.Val FordMsg091BusHiSpd.FordVehYawRateRaw.Ford_VehYaw_W_Actl FordMsg091BusHiSpd.FordVehYawRateRawVld.Logl /end SUB_GROUP
 /begin FUNCTION_LIST /end FUNCTION_LIST
 /begin REF_CHARACTERISTIC /end REF_CHARACTERISTIC
 /begin REF_MEASUREMENT /end REF_MEASUREMENT
/end GROUP
/begin GROUP FordMsg167BusHiSpd "MICROSAR RTE"
 /begin SUB_GROUP FordMsg167BusHiSpd.CalibrationPorts FordMsg167BusHiSpd.PerInstanceMemories FordMsg167BusHiSpd.ReceiverPorts FordMsg167BusHiSpd.SenderPorts /end SUB_GROUP
 /begin FUNCTION_LIST /end FUNCTION_LIST
 /begin REF_CHARACTERISTIC /end REF_CHARACTERISTIC
 /begin REF_MEASUREMENT /end REF_MEASUREMENT
/end GROUP
/begin GROUP FordMsg167BusHiSpd.CalibrationPorts "MICROSAR RTE"
 /begin SUB_GROUP FordMsg167BusHiSpd.FordMsg167BusHiSpdMissMsgFaildTiThd.Val FordMsg167BusHiSpd.FordMsg167BusHiSpdMissMsgPassdTiThd.Val FordMsg167BusHiSpd.FordMsg167BusHiSpdPrpnWhlTqFaildTiThd.Val FordMsg167BusHiSpd.FordMsg167BusHiSpdPrpnWhlTqMissTiThd.Val FordMsg167BusHiSpd.FordMsg167BusHiSpdPrpnWhlTqPassdTiThd.Val FordMsg167BusHiSpd.FordMsg167BusHiSpdPrpnWhlTqSigInvldFaildTiThd.Val FordMsg167BusHiSpd.FordMsg167BusHiSpdPrpnWhlTqSigInvldPassdTiThd.Val /end SUB_GROUP
 /begin FUNCTION_LIST /end FUNCTION_LIST
 /begin REF_CHARACTERISTIC /end REF_CHARACTERISTIC
 /begin REF_MEASUREMENT /end REF_MEASUREMENT
/end GROUP
/begin GROUP FordMsg167BusHiSpd.ClrDiagcFlgProxy.Val "MICROSAR RTE" /begin SUB_GROUP /end SUB_GROUP /begin FUNCTION_LIST /end FUNCTION_LIST /begin REF_CHARACTERISTIC /end REF_CHARACTERISTIC /begin REF_MEASUREMENT FordMsg167BusHiSpd.ClrDiagcFlgProxy.Val /end REF_MEASUREMENT /end GROUP
/begin GROUP FordMsg167BusHiSpd.ClrDiagcFlgProxyPrev "MICROSAR RTE" /begin SUB_GROUP /end SUB_GROUP /begin FUNCTION_LIST /end FUNCTION_LIST /begin REF_CHARACTERISTIC /end REF_CHARACTERISTIC /begin REF_MEASUREMENT FordMsg167BusHiSpd.ClrDiagcFlgProxyPrev /end REF_MEASUREMENT /end GROUP
/begin GROUP FordMsg167BusHiSpd.FirstTranVldFlg "MICROSAR RTE" /begin SUB_GROUP /end SUB_GROUP /begin FUNCTION_LIST /end FUNCTION_LIST /begin REF_CHARACTERISTIC /end REF_CHARACTERISTIC /begin REF_MEASUREMENT FordMsg167BusHiSpd.FirstTranVldFlg /end REF_MEASUREMENT /end GROUP
/begin GROUP FordMsg167BusHiSpd.FordBrkOscnRednEnad.Logl "MICROSAR RTE" /begin SUB_GROUP /end SUB_GROUP /begin FUNCTION_LIST /end FUNCTION_LIST /begin REF_CHARACTERISTIC /end REF_CHARACTERISTIC /begin REF_MEASUREMENT FordMsg167BusHiSpd.FordBrkOscnRednEnad.Logl /end REF_MEASUREMENT /end GROUP
/begin GROUP FordMsg167BusHiSpd.FordCanDtcInhb.Val "MICROSAR RTE" /begin SUB_GROUP /end SUB_GROUP /begin FUNCTION_LIST /end FUNCTION_LIST /begin REF_CHARACTERISTIC /end REF_CHARACTERISTIC /begin REF_MEASUREMENT FordMsg167BusHiSpd.FordCanDtcInhb.Val /end REF_MEASUREMENT /end GROUP
/begin GROUP FordMsg167BusHiSpd.FordEpsLifeCycMod.Val "MICROSAR RTE" /begin SUB_GROUP /end SUB_GROUP /begin FUNCTION_LIST /end FUNCTION_LIST /begin REF_CHARACTERISTIC /end REF_CHARACTERISTIC /begin REF_MEASUREMENT FordMsg167BusHiSpd.FordEpsLifeCycMod.Val /end REF_MEASUREMENT /end GROUP
/begin GROUP FordMsg167BusHiSpd.FordInvldMsgDiagcInhb.Val "MICROSAR RTE" /begin SUB_GROUP /end SUB_GROUP /begin FUNCTION_LIST /end FUNCTION_LIST /begin REF_CHARACTERISTIC /end REF_CHARACTERISTIC /begin REF_MEASUREMENT FordMsg167BusHiSpd.FordInvldMsgDiagcInhb.Val /end REF_MEASUREMENT /end GROUP
/begin GROUP FordMsg167BusHiSpd.FordMfgDiagcInhb.Val "MICROSAR RTE" /begin SUB_GROUP /end SUB_GROUP /begin FUNCTION_LIST /end FUNCTION_LIST /begin REF_CHARACTERISTIC /end REF_CHARACTERISTIC /begin REF_MEASUREMENT FordMsg167BusHiSpd.FordMfgDiagcInhb.Val /end REF_MEASUREMENT /end GROUP
/begin GROUP FordMsg167BusHiSpd.FordMissMsgDiagcInhb.Val "MICROSAR RTE" /begin SUB_GROUP /end SUB_GROUP /begin FUNCTION_LIST /end FUNCTION_LIST /begin REF_CHARACTERISTIC /end REF_CHARACTERISTIC /begin REF_MEASUREMENT FordMsg167BusHiSpd.FordMissMsgDiagcInhb.Val /end REF_MEASUREMENT /end GROUP
/begin GROUP FordMsg167BusHiSpd.FordMsg167BusHiSpdMissMsgFaildTiThd.Val "MICROSAR RTE" /begin SUB_GROUP /end SUB_GROUP /begin FUNCTION_LIST /end FUNCTION_LIST /begin REF_CHARACTERISTIC FordMsg167BusHiSpd.FordMsg167BusHiSpdMissMsgFaildTiThd.Val /end REF_CHARACTERISTIC /begin REF_MEASUREMENT /end REF_MEASUREMENT /end GROUP
/begin GROUP FordMsg167BusHiSpd.FordMsg167BusHiSpdMissMsgPassdTiThd.Val "MICROSAR RTE" /begin SUB_GROUP /end SUB_GROUP /begin FUNCTION_LIST /end FUNCTION_LIST /begin REF_CHARACTERISTIC FordMsg167BusHiSpd.FordMsg167BusHiSpdMissMsgPassdTiThd.Val /end REF_CHARACTERISTIC /begin REF_MEASUREMENT /end REF_MEASUREMENT /end GROUP
/begin GROUP FordMsg167BusHiSpd.FordMsg167BusHiSpdPrpnWhlTqFaildTiThd.Val "MICROSAR RTE" /begin SUB_GROUP /end SUB_GROUP /begin FUNCTION_LIST /end FUNCTION_LIST
 /begin REF_CHARACTERISTIC FordMsg167BusHiSpd.FordMsg167BusHiSpdPrpnWhlTqFaildTiThd.Val /end REF_CHARACTERISTIC
 /begin REF_MEASUREMENT /end REF_MEASUREMENT
/end GROUP
/begin GROUP FordMsg167BusHiSpd.FordMsg167BusHiSpdPrpnWhlTqMissTiThd.Val "MICROSAR RTE" /begin SUB_GROUP /end SUB_GROUP /begin FUNCTION_LIST /end FUNCTION_LIST
 /begin REF_CHARACTERISTIC FordMsg167BusHiSpd.FordMsg167BusHiSpdPrpnWhlTqMissTiThd.Val /end REF_CHARACTERISTIC
 /begin REF_MEASUREMENT /end REF_MEASUREMENT
/end GROUP
/begin GROUP FordMsg167BusHiSpd.FordMsg167BusHiSpdPrpnWhlTqPassdTiThd.Val "MICROSAR RTE" /begin SUB_GROUP /end SUB_GROUP /begin FUNCTION_LIST /end FUNCTION_LIST
 /begin REF_CHARACTERISTIC FordMsg167BusHiSpd.FordMsg167BusHiSpdPrpnWhlTqPassdTiThd.Val /end REF_CHARACTERISTIC
 /begin REF_MEASUREMENT /end REF_MEASUREMENT
/end GROUP
/begin GROUP FordMsg167BusHiSpd.FordMsg167BusHiSpdPrpnWhlTqSigInvldFaildTiThd.Val "MICROSAR RTE" /begin SUB_GROUP /end SUB_GROUP /begin FUNCTION_LIST /end FUNCTION_LIST
 /begin REF_CHARACTERISTIC FordMsg167BusHiSpd.FordMsg167BusHiSpdPrpnWhlTqSigInvldFaildTiThd.Val /end REF_CHARACTERISTIC
 /begin REF_MEASUREMENT /end REF_MEASUREMENT
/end GROUP
/begin GROUP FordMsg167BusHiSpd.FordMsg167BusHiSpdPrpnWhlTqSigInvldPassdTiThd.Val "MICROSAR RTE" /begin SUB_GROUP /end SUB_GROUP /begin FUNCTION_LIST /end FUNCTION_LIST
 /begin REF_CHARACTERISTIC FordMsg167BusHiSpd.FordMsg167BusHiSpdPrpnWhlTqSigInvldPassdTiThd.Val /end REF_CHARACTERISTIC
 /begin REF_MEASUREMENT /end REF_MEASUREMENT
/end GROUP
/begin GROUP FordMsg167BusHiSpd.FordTqSteerCmpEnad.Logl "MICROSAR RTE" /begin SUB_GROUP /end SUB_GROUP /begin FUNCTION_LIST /end FUNCTION_LIST /begin REF_CHARACTERISTIC /end REF_CHARACTERISTIC /begin REF_MEASUREMENT FordMsg167BusHiSpd.FordTqSteerCmpEnad.Logl /end REF_MEASUREMENT /end GROUP
/begin GROUP FordMsg167BusHiSpd.FordTrlrBackUpAssiEnad.Logl "MICROSAR RTE" /begin SUB_GROUP /end SUB_GROUP /begin FUNCTION_LIST /end FUNCTION_LIST /begin REF_CHARACTERISTIC /end REF_CHARACTERISTIC /begin REF_MEASUREMENT FordMsg167BusHiSpd.FordTrlrBackUpAssiEnad.Logl /end REF_MEASUREMENT /end GROUP
/begin GROUP FordMsg167BusHiSpd.FordVehElecPwrStrtStopSts.Ford_ElPw_D_StatStrtStop "MICROSAR RTE" /begin SUB_GROUP /end SUB_GROUP /begin FUNCTION_LIST /end FUNCTION_LIST /begin REF_CHARACTERISTIC /end REF_CHARACTERISTIC
 /begin REF_MEASUREMENT FordMsg167BusHiSpd.FordVehElecPwrStrtStopSts.Ford_ElPw_D_StatStrtStop /end REF_MEASUREMENT
/end GROUP
/begin GROUP FordMsg167BusHiSpd.FordVehElecPwrStrtStopStsPrev "MICROSAR RTE" /begin SUB_GROUP /end SUB_GROUP /begin FUNCTION_LIST /end FUNCTION_LIST /begin REF_CHARACTERISTIC /end REF_CHARACTERISTIC /begin REF_MEASUREMENT FordMsg167BusHiSpd.FordVehElecPwrStrtStopStsPrev /end REF_MEASUREMENT /end GROUP
/begin GROUP FordMsg167BusHiSpd.FordVehElecPwrSts.Ford_ElPw_D_Stat "MICROSAR RTE" /begin SUB_GROUP /end SUB_GROUP /begin FUNCTION_LIST /end FUNCTION_LIST /begin REF_CHARACTERISTIC /end REF_CHARACTERISTIC /begin REF_MEASUREMENT FordMsg167BusHiSpd.FordVehElecPwrSts.Ford_ElPw_D_Stat /end REF_MEASUREMENT /end GROUP
/begin GROUP FordMsg167BusHiSpd.FordVehElecPwrStsPrev "MICROSAR RTE" /begin SUB_GROUP /end SUB_GROUP /begin FUNCTION_LIST /end FUNCTION_LIST /begin REF_CHARACTERISTIC /end REF_CHARACTERISTIC /begin REF_MEASUREMENT FordMsg167BusHiSpd.FordVehElecPwrStsPrev /end REF_MEASUREMENT /end GROUP
/begin GROUP FordMsg167BusHiSpd.FordVehMsg167Miss "MICROSAR RTE" /begin SUB_GROUP /end SUB_GROUP /begin FUNCTION_LIST /end FUNCTION_LIST /begin REF_CHARACTERISTIC /end REF_CHARACTERISTIC /begin REF_MEASUREMENT FordMsg167BusHiSpd.FordVehMsg167Miss /end REF_MEASUREMENT /end GROUP
/begin GROUP FordMsg167BusHiSpd.FordVehMsg167Rxd "MICROSAR RTE" /begin SUB_GROUP /end SUB_GROUP /begin FUNCTION_LIST /end FUNCTION_LIST /begin REF_CHARACTERISTIC /end REF_CHARACTERISTIC /begin REF_MEASUREMENT FordMsg167BusHiSpd.FordVehMsg167Rxd /end REF_MEASUREMENT /end GROUP
/begin GROUP FordMsg167BusHiSpd.FordVehPrpnWhlTq.Val "MICROSAR RTE" /begin SUB_GROUP /end SUB_GROUP /begin FUNCTION_LIST /end FUNCTION_LIST /begin REF_CHARACTERISTIC /end REF_CHARACTERISTIC /begin REF_MEASUREMENT FordMsg167BusHiSpd.FordVehPrpnWhlTq.Val /end REF_MEASUREMENT /end GROUP
/begin GROUP FordMsg167BusHiSpd.FordVehPrpnWhlTqPrev "MICROSAR RTE" /begin SUB_GROUP /end SUB_GROUP /begin FUNCTION_LIST /end FUNCTION_LIST /begin REF_CHARACTERISTIC /end REF_CHARACTERISTIC /begin REF_MEASUREMENT FordMsg167BusHiSpd.FordVehPrpnWhlTqPrev /end REF_MEASUREMENT /end GROUP
/begin GROUP FordMsg167BusHiSpd.FordVehPrpnWhlTqRaw.Val "MICROSAR RTE" /begin SUB_GROUP /end SUB_GROUP /begin FUNCTION_LIST /end FUNCTION_LIST /begin REF_CHARACTERISTIC /end REF_CHARACTERISTIC /begin REF_MEASUREMENT FordMsg167BusHiSpd.FordVehPrpnWhlTqRaw.Val /end REF_MEASUREMENT /end GROUP
/begin GROUP FordMsg167BusHiSpd.FordVehPrpnWhlTqRawPrev "MICROSAR RTE" /begin SUB_GROUP /end SUB_GROUP /begin FUNCTION_LIST /end FUNCTION_LIST /begin REF_CHARACTERISTIC /end REF_CHARACTERISTIC /begin REF_MEASUREMENT FordMsg167BusHiSpd.FordVehPrpnWhlTqRawPrev /end REF_MEASUREMENT /end GROUP
/begin GROUP FordMsg167BusHiSpd.FordVehPrpnWhlTqSigInvldFaildRefTi "MICROSAR RTE" /begin SUB_GROUP /end SUB_GROUP /begin FUNCTION_LIST /end FUNCTION_LIST /begin REF_CHARACTERISTIC /end REF_CHARACTERISTIC /begin REF_MEASUREMENT FordMsg167BusHiSpd.FordVehPrpnWhlTqSigInvldFaildRefTi /end REF_MEASUREMENT /end GROUP
/begin GROUP FordMsg167BusHiSpd.FordVehPrpnWhlTqSigInvldPassdRefTi "MICROSAR RTE" /begin SUB_GROUP /end SUB_GROUP /begin FUNCTION_LIST /end FUNCTION_LIST /begin REF_CHARACTERISTIC /end REF_CHARACTERISTIC /begin REF_MEASUREMENT FordMsg167BusHiSpd.FordVehPrpnWhlTqSigInvldPassdRefTi /end REF_MEASUREMENT /end GROUP
/begin GROUP FordMsg167BusHiSpd.FordVehPrpnWhlTqVld.Logl "MICROSAR RTE" /begin SUB_GROUP /end SUB_GROUP /begin FUNCTION_LIST /end FUNCTION_LIST /begin REF_CHARACTERISTIC /end REF_CHARACTERISTIC /begin REF_MEASUREMENT FordMsg167BusHiSpd.FordVehPrpnWhlTqVld.Logl /end REF_MEASUREMENT /end GROUP
/begin GROUP FordMsg167BusHiSpd.FordVehPrpnWhlTqVldPrev "MICROSAR RTE" /begin SUB_GROUP /end SUB_GROUP /begin FUNCTION_LIST /end FUNCTION_LIST /begin REF_CHARACTERISTIC /end REF_CHARACTERISTIC /begin REF_MEASUREMENT FordMsg167BusHiSpd.FordVehPrpnWhlTqVldPrev /end REF_MEASUREMENT /end GROUP
/begin GROUP FordMsg167BusHiSpd.FordVehPwrpkTqSts.Ford_PwPckTq_D_Stat "MICROSAR RTE" /begin SUB_GROUP /end SUB_GROUP /begin FUNCTION_LIST /end FUNCTION_LIST /begin REF_CHARACTERISTIC /end REF_CHARACTERISTIC /begin REF_MEASUREMENT FordMsg167BusHiSpd.FordVehPwrpkTqSts.Ford_PwPckTq_D_Stat /end REF_MEASUREMENT /end GROUP
/begin GROUP FordMsg167BusHiSpd.FordVehPwrpkTqStsPrev "MICROSAR RTE" /begin SUB_GROUP /end SUB_GROUP /begin FUNCTION_LIST /end FUNCTION_LIST /begin REF_CHARACTERISTIC /end REF_CHARACTERISTIC /begin REF_MEASUREMENT FordMsg167BusHiSpd.FordVehPwrpkTqStsPrev /end REF_MEASUREMENT /end GROUP
/begin GROUP FordMsg167BusHiSpd.MissMsgFaildRefTi "MICROSAR RTE" /begin SUB_GROUP /end SUB_GROUP /begin FUNCTION_LIST /end FUNCTION_LIST /begin REF_CHARACTERISTIC /end REF_CHARACTERISTIC /begin REF_MEASUREMENT FordMsg167BusHiSpd.MissMsgFaildRefTi /end REF_MEASUREMENT /end GROUP
/begin GROUP FordMsg167BusHiSpd.MissMsgPassdRefTi "MICROSAR RTE" /begin SUB_GROUP /end SUB_GROUP /begin FUNCTION_LIST /end FUNCTION_LIST /begin REF_CHARACTERISTIC /end REF_CHARACTERISTIC /begin REF_MEASUREMENT FordMsg167BusHiSpd.MissMsgPassdRefTi /end REF_MEASUREMENT /end GROUP
/begin GROUP FordMsg167BusHiSpd.PerInstanceMemories "MICROSAR RTE"
 /begin SUB_GROUP FordMsg167BusHiSpd.ClrDiagcFlgProxyPrev FordMsg167BusHiSpd.FirstTranVldFlg FordMsg167BusHiSpd.FordVehElecPwrStrtStopStsPrev FordMsg167BusHiSpd.FordVehElecPwrStsPrev FordMsg167BusHiSpd.FordVehMsg167Miss FordMsg167BusHiSpd.FordVehMsg167Rxd FordMsg167BusHiSpd.FordVehPrpnWhlTqPrev FordMsg167BusHiSpd.FordVehPrpnWhlTqRawPrev FordMsg167BusHiSpd.FordVehPrpnWhlTqSigInvldFaildRefTi FordMsg167BusHiSpd.FordVehPrpnWhlTqSigInvldPassdRefTi FordMsg167BusHiSpd.FordVehPrpnWhlTqVldPrev FordMsg167BusHiSpd.FordVehPwrpkTqStsPrev FordMsg167BusHiSpd.MissMsgFaildRefTi FordMsg167BusHiSpd.MissMsgPassdRefTi FordMsg167BusHiSpd.PrpnWhlTqVldFaildRefTi FordMsg167BusHiSpd.PrpnWhlTqVldMissRefTi FordMsg167BusHiSpd.PrpnWhlTqVldPassdRefTi /end SUB_GROUP
 /begin FUNCTION_LIST /end FUNCTION_LIST
 /begin REF_CHARACTERISTIC /end REF_CHARACTERISTIC
 /begin REF_MEASUREMENT /end REF_MEASUREMENT
/end GROUP
/begin GROUP FordMsg167BusHiSpd.PrpnWhlTqVldFaildRefTi "MICROSAR RTE" /begin SUB_GROUP /end SUB_GROUP /begin FUNCTION_LIST /end FUNCTION_LIST /begin REF_CHARACTERISTIC /end REF_CHARACTERISTIC /begin REF_MEASUREMENT FordMsg167BusHiSpd.PrpnWhlTqVldFaildRefTi /end REF_MEASUREMENT /end GROUP
/begin GROUP FordMsg167BusHiSpd.PrpnWhlTqVldMissRefTi "MICROSAR RTE" /begin SUB_GROUP /end SUB_GROUP /begin FUNCTION_LIST /end FUNCTION_LIST /begin REF_CHARACTERISTIC /end REF_CHARACTERISTIC /begin REF_MEASUREMENT FordMsg167BusHiSpd.PrpnWhlTqVldMissRefTi /end REF_MEASUREMENT /end GROUP
/begin GROUP FordMsg167BusHiSpd.PrpnWhlTqVldPassdRefTi "MICROSAR RTE" /begin SUB_GROUP /end SUB_GROUP /begin FUNCTION_LIST /end FUNCTION_LIST /begin REF_CHARACTERISTIC /end REF_CHARACTERISTIC /begin REF_MEASUREMENT FordMsg167BusHiSpd.PrpnWhlTqVldPassdRefTi /end REF_MEASUREMENT /end GROUP
/begin GROUP FordMsg167BusHiSpd.ReceiverPorts "MICROSAR RTE"
 /begin SUB_GROUP FordMsg167BusHiSpd.ClrDiagcFlgProxy.Val FordMsg167BusHiSpd.FordBrkOscnRednEnad.Logl FordMsg167BusHiSpd.FordCanDtcInhb.Val FordMsg167BusHiSpd.FordEpsLifeCycMod.Val FordMsg167BusHiSpd.FordInvldMsgDiagcInhb.Val FordMsg167BusHiSpd.FordMfgDiagcInhb.Val FordMsg167BusHiSpd.FordMissMsgDiagcInhb.Val FordMsg167BusHiSpd.FordTqSteerCmpEnad.Logl FordMsg167BusHiSpd.FordTrlrBackUpAssiEnad.Logl /end SUB_GROUP
 /begin FUNCTION_LIST /end FUNCTION_LIST
 /begin REF_CHARACTERISTIC /end REF_CHARACTERISTIC
 /begin REF_MEASUREMENT /end REF_MEASUREMENT
/end GROUP
/begin GROUP FordMsg167BusHiSpd.SenderPorts "MICROSAR RTE"
 /begin SUB_GROUP FordMsg167BusHiSpd.FordVehElecPwrStrtStopSts.Ford_ElPw_D_StatStrtStop FordMsg167BusHiSpd.FordVehElecPwrSts.Ford_ElPw_D_Stat FordMsg167BusHiSpd.FordVehPrpnWhlTq.Val FordMsg167BusHiSpd.FordVehPrpnWhlTqRaw.Val FordMsg167BusHiSpd.FordVehPrpnWhlTqVld.Logl FordMsg167BusHiSpd.FordVehPwrpkTqSts.Ford_PwPckTq_D_Stat /end SUB_GROUP
 /begin FUNCTION_LIST /end FUNCTION_LIST
 /begin REF_CHARACTERISTIC /end REF_CHARACTERISTIC
 /begin REF_MEASUREMENT /end REF_MEASUREMENT
/end GROUP
/begin GROUP FordMsg202BusHiSpd "MICROSAR RTE"
 /begin SUB_GROUP FordMsg202BusHiSpd.CalibrationPorts FordMsg202BusHiSpd.PerInstanceMemories FordMsg202BusHiSpd.ReceiverPorts FordMsg202BusHiSpd.SenderPorts /end SUB_GROUP
 /begin FUNCTION_LIST /end FUNCTION_LIST
 /begin REF_CHARACTERISTIC /end REF_CHARACTERISTIC
 /begin REF_MEASUREMENT /end REF_MEASUREMENT
/end GROUP
/begin GROUP FordMsg202BusHiSpd.CalibrationPorts "MICROSAR RTE"
 /begin SUB_GROUP FordMsg202BusHiSpd.FordMsg202BusHiSpdEngModLoQlyVldFaildThd.Val FordMsg202BusHiSpd.FordMsg202BusHiSpdEngModLoQlyVldMissThd.Val FordMsg202BusHiSpd.FordMsg202BusHiSpdEngModLoQlyVldPassdThd.Val FordMsg202BusHiSpd.FordMsg202BusHiSpdEngModlVldFaildThd.Val FordMsg202BusHiSpd.FordMsg202BusHiSpdEngModlVldMissThd.Val FordMsg202BusHiSpd.FordMsg202BusHiSpdGearRvsStsInvldFaildThd.Val FordMsg202BusHiSpd.FordMsg202BusHiSpdGearRvsStsInvldPassdThd.Val FordMsg202BusHiSpd.FordMsg202BusHiSpdGearRvsStsVldFaildThd.Val FordMsg202BusHiSpd.FordMsg202BusHiSpdGearRvsStsVldMissThd.Val FordMsg202BusHiSpd.FordMsg202BusHiSpdGearRvsStsVldPassdThd.Val FordMsg202BusHiSpd.FordMsg202BusHiSpdMissMsgFaildAbsPrsntDisadThd.Val FordMsg202BusHiSpd.FordMsg202BusHiSpdMissMsgFaildAbsPrsntEnadThd.Val FordMsg202BusHiSpd.FordMsg202BusHiSpdMissMsgPassdThd.Val FordMsg202BusHiSpd.FordMsg202BusHiSpdQlyFacEngModInvldFaildThd.Val FordMsg202BusHiSpd.FordMsg202BusHiSpdQlyFacEngModInvldPassdThd.Val FordMsg202BusHiSpd.FordMsg202BusHiSpdTrlrBackupAssiAvlVldMissThd.Val FordMsg202BusHiSpd.FordMsg202BusHiSpdTrlrBackupAssiAvlVldPassdThd.Val /end SUB_GROUP
 /begin FUNCTION_LIST /end FUNCTION_LIST
 /begin REF_CHARACTERISTIC /end REF_CHARACTERISTIC
 /begin REF_MEASUREMENT /end REF_MEASUREMENT
/end GROUP
/begin GROUP FordMsg202BusHiSpd.ClrDiagcFlgProxy.Val "MICROSAR RTE" /begin SUB_GROUP /end SUB_GROUP /begin FUNCTION_LIST /end FUNCTION_LIST /begin REF_CHARACTERISTIC /end REF_CHARACTERISTIC /begin REF_MEASUREMENT FordMsg202BusHiSpd.ClrDiagcFlgProxy.Val /end REF_MEASUREMENT /end GROUP
/begin GROUP FordMsg202BusHiSpd.ClrDiagcFlgProxyPrev "MICROSAR RTE" /begin SUB_GROUP /end SUB_GROUP /begin FUNCTION_LIST /end FUNCTION_LIST /begin REF_CHARACTERISTIC /end REF_CHARACTERISTIC /begin REF_MEASUREMENT FordMsg202BusHiSpd.ClrDiagcFlgProxyPrev /end REF_MEASUREMENT /end GROUP
/begin GROUP FordMsg202BusHiSpd.FirstTranVldFlg "MICROSAR RTE" /begin SUB_GROUP /end SUB_GROUP /begin FUNCTION_LIST /end FUNCTION_LIST /begin REF_CHARACTERISTIC /end REF_CHARACTERISTIC /begin REF_MEASUREMENT FordMsg202BusHiSpd.FirstTranVldFlg /end REF_MEASUREMENT /end GROUP
/begin GROUP FordMsg202BusHiSpd.FordAbsPrsnt.Logl "MICROSAR RTE" /begin SUB_GROUP /end SUB_GROUP /begin FUNCTION_LIST /end FUNCTION_LIST /begin REF_CHARACTERISTIC /end REF_CHARACTERISTIC /begin REF_MEASUREMENT FordMsg202BusHiSpd.FordAbsPrsnt.Logl /end REF_MEASUREMENT /end GROUP
/begin GROUP FordMsg202BusHiSpd.FordBrkOscnRednEnad.Logl "MICROSAR RTE" /begin SUB_GROUP /end SUB_GROUP /begin FUNCTION_LIST /end FUNCTION_LIST /begin REF_CHARACTERISTIC /end REF_CHARACTERISTIC /begin REF_MEASUREMENT FordMsg202BusHiSpd.FordBrkOscnRednEnad.Logl /end REF_MEASUREMENT /end GROUP
/begin GROUP FordMsg202BusHiSpd.FordCanDtcInhb.Val "MICROSAR RTE" /begin SUB_GROUP /end SUB_GROUP /begin FUNCTION_LIST /end FUNCTION_LIST /begin REF_CHARACTERISTIC /end REF_CHARACTERISTIC /begin REF_MEASUREMENT FordMsg202BusHiSpd.FordCanDtcInhb.Val /end REF_MEASUREMENT /end GROUP
/begin GROUP FordMsg202BusHiSpd.FordEpsLifeCycMod.Val "MICROSAR RTE" /begin SUB_GROUP /end SUB_GROUP /begin FUNCTION_LIST /end FUNCTION_LIST /begin REF_CHARACTERISTIC /end REF_CHARACTERISTIC /begin REF_MEASUREMENT FordMsg202BusHiSpd.FordEpsLifeCycMod.Val /end REF_MEASUREMENT /end GROUP
/begin GROUP FordMsg202BusHiSpd.FordInvldMsgDiagcInhb.Val "MICROSAR RTE" /begin SUB_GROUP /end SUB_GROUP /begin FUNCTION_LIST /end FUNCTION_LIST /begin REF_CHARACTERISTIC /end REF_CHARACTERISTIC /begin REF_MEASUREMENT FordMsg202BusHiSpd.FordInvldMsgDiagcInhb.Val /end REF_MEASUREMENT /end GROUP
/begin GROUP FordMsg202BusHiSpd.FordMfgDiagcInhb.Val "MICROSAR RTE" /begin SUB_GROUP /end SUB_GROUP /begin FUNCTION_LIST /end FUNCTION_LIST /begin REF_CHARACTERISTIC /end REF_CHARACTERISTIC /begin REF_MEASUREMENT FordMsg202BusHiSpd.FordMfgDiagcInhb.Val /end REF_MEASUREMENT /end GROUP
/begin GROUP FordMsg202BusHiSpd.FordMissMsgDiagcInhb.Val "MICROSAR RTE" /begin SUB_GROUP /end SUB_GROUP /begin FUNCTION_LIST /end FUNCTION_LIST /begin REF_CHARACTERISTIC /end REF_CHARACTERISTIC /begin REF_MEASUREMENT FordMsg202BusHiSpd.FordMissMsgDiagcInhb.Val /end REF_MEASUREMENT /end GROUP
/begin GROUP FordMsg202BusHiSpd.FordMsg202BusHiSpdEngModLoQlyVldFaildThd.Val "MICROSAR RTE" /begin SUB_GROUP /end SUB_GROUP /begin FUNCTION_LIST /end FUNCTION_LIST
 /begin REF_CHARACTERISTIC FordMsg202BusHiSpd.FordMsg202BusHiSpdEngModLoQlyVldFaildThd.Val /end REF_CHARACTERISTIC
 /begin REF_MEASUREMENT /end REF_MEASUREMENT
/end GROUP
/begin GROUP FordMsg202BusHiSpd.FordMsg202BusHiSpdEngModLoQlyVldMissThd.Val "MICROSAR RTE" /begin SUB_GROUP /end SUB_GROUP /begin FUNCTION_LIST /end FUNCTION_LIST
 /begin REF_CHARACTERISTIC FordMsg202BusHiSpd.FordMsg202BusHiSpdEngModLoQlyVldMissThd.Val /end REF_CHARACTERISTIC
 /begin REF_MEASUREMENT /end REF_MEASUREMENT
/end GROUP
/begin GROUP FordMsg202BusHiSpd.FordMsg202BusHiSpdEngModLoQlyVldPassdThd.Val "MICROSAR RTE" /begin SUB_GROUP /end SUB_GROUP /begin FUNCTION_LIST /end FUNCTION_LIST
 /begin REF_CHARACTERISTIC FordMsg202BusHiSpd.FordMsg202BusHiSpdEngModLoQlyVldPassdThd.Val /end REF_CHARACTERISTIC
 /begin REF_MEASUREMENT /end REF_MEASUREMENT
/end GROUP
/begin GROUP FordMsg202BusHiSpd.FordMsg202BusHiSpdEngModlVldFaildThd.Val "MICROSAR RTE" /begin SUB_GROUP /end SUB_GROUP /begin FUNCTION_LIST /end FUNCTION_LIST
 /begin REF_CHARACTERISTIC FordMsg202BusHiSpd.FordMsg202BusHiSpdEngModlVldFaildThd.Val /end REF_CHARACTERISTIC
 /begin REF_MEASUREMENT /end REF_MEASUREMENT
/end GROUP
/begin GROUP FordMsg202BusHiSpd.FordMsg202BusHiSpdEngModlVldMissThd.Val "MICROSAR RTE" /begin SUB_GROUP /end SUB_GROUP /begin FUNCTION_LIST /end FUNCTION_LIST /begin REF_CHARACTERISTIC FordMsg202BusHiSpd.FordMsg202BusHiSpdEngModlVldMissThd.Val /end REF_CHARACTERISTIC /begin REF_MEASUREMENT /end REF_MEASUREMENT /end GROUP
/begin GROUP FordMsg202BusHiSpd.FordMsg202BusHiSpdGearRvsStsInvldFaildThd.Val "MICROSAR RTE" /begin SUB_GROUP /end SUB_GROUP /begin FUNCTION_LIST /end FUNCTION_LIST
 /begin REF_CHARACTERISTIC FordMsg202BusHiSpd.FordMsg202BusHiSpdGearRvsStsInvldFaildThd.Val /end REF_CHARACTERISTIC
 /begin REF_MEASUREMENT /end REF_MEASUREMENT
/end GROUP
/begin GROUP FordMsg202BusHiSpd.FordMsg202BusHiSpdGearRvsStsInvldPassdThd.Val "MICROSAR RTE" /begin SUB_GROUP /end SUB_GROUP /begin FUNCTION_LIST /end FUNCTION_LIST
 /begin REF_CHARACTERISTIC FordMsg202BusHiSpd.FordMsg202BusHiSpdGearRvsStsInvldPassdThd.Val /end REF_CHARACTERISTIC
 /begin REF_MEASUREMENT /end REF_MEASUREMENT
/end GROUP
/begin GROUP FordMsg202BusHiSpd.FordMsg202BusHiSpdGearRvsStsVldFaildThd.Val "MICROSAR RTE" /begin SUB_GROUP /end SUB_GROUP /begin FUNCTION_LIST /end FUNCTION_LIST
 /begin REF_CHARACTERISTIC FordMsg202BusHiSpd.FordMsg202BusHiSpdGearRvsStsVldFaildThd.Val /end REF_CHARACTERISTIC
 /begin REF_MEASUREMENT /end REF_MEASUREMENT
/end GROUP
/begin GROUP FordMsg202BusHiSpd.FordMsg202BusHiSpdGearRvsStsVldMissThd.Val "MICROSAR RTE" /begin SUB_GROUP /end SUB_GROUP /begin FUNCTION_LIST /end FUNCTION_LIST
 /begin REF_CHARACTERISTIC FordMsg202BusHiSpd.FordMsg202BusHiSpdGearRvsStsVldMissThd.Val /end REF_CHARACTERISTIC
 /begin REF_MEASUREMENT /end REF_MEASUREMENT
/end GROUP
/begin GROUP FordMsg202BusHiSpd.FordMsg202BusHiSpdGearRvsStsVldPassdThd.Val "MICROSAR RTE" /begin SUB_GROUP /end SUB_GROUP /begin FUNCTION_LIST /end FUNCTION_LIST
 /begin REF_CHARACTERISTIC FordMsg202BusHiSpd.FordMsg202BusHiSpdGearRvsStsVldPassdThd.Val /end REF_CHARACTERISTIC
 /begin REF_MEASUREMENT /end REF_MEASUREMENT
/end GROUP
/begin GROUP FordMsg202BusHiSpd.FordMsg202BusHiSpdMissMsgFaildAbsPrsntDisadThd.Val "MICROSAR RTE" /begin SUB_GROUP /end SUB_GROUP /begin FUNCTION_LIST /end FUNCTION_LIST
 /begin REF_CHARACTERISTIC FordMsg202BusHiSpd.FordMsg202BusHiSpdMissMsgFaildAbsPrsntDisadThd.Val /end REF_CHARACTERISTIC
 /begin REF_MEASUREMENT /end REF_MEASUREMENT
/end GROUP
/begin GROUP FordMsg202BusHiSpd.FordMsg202BusHiSpdMissMsgFaildAbsPrsntEnadThd.Val "MICROSAR RTE" /begin SUB_GROUP /end SUB_GROUP /begin FUNCTION_LIST /end FUNCTION_LIST
 /begin REF_CHARACTERISTIC FordMsg202BusHiSpd.FordMsg202BusHiSpdMissMsgFaildAbsPrsntEnadThd.Val /end REF_CHARACTERISTIC
 /begin REF_MEASUREMENT /end REF_MEASUREMENT
/end GROUP
/begin GROUP FordMsg202BusHiSpd.FordMsg202BusHiSpdMissMsgPassdThd.Val "MICROSAR RTE" /begin SUB_GROUP /end SUB_GROUP /begin FUNCTION_LIST /end FUNCTION_LIST /begin REF_CHARACTERISTIC FordMsg202BusHiSpd.FordMsg202BusHiSpdMissMsgPassdThd.Val /end REF_CHARACTERISTIC /begin REF_MEASUREMENT /end REF_MEASUREMENT /end GROUP
/begin GROUP FordMsg202BusHiSpd.FordMsg202BusHiSpdQlyFacEngModInvldFaildThd.Val "MICROSAR RTE" /begin SUB_GROUP /end SUB_GROUP /begin FUNCTION_LIST /end FUNCTION_LIST
 /begin REF_CHARACTERISTIC FordMsg202BusHiSpd.FordMsg202BusHiSpdQlyFacEngModInvldFaildThd.Val /end REF_CHARACTERISTIC
 /begin REF_MEASUREMENT /end REF_MEASUREMENT
/end GROUP
/begin GROUP FordMsg202BusHiSpd.FordMsg202BusHiSpdQlyFacEngModInvldPassdThd.Val "MICROSAR RTE" /begin SUB_GROUP /end SUB_GROUP /begin FUNCTION_LIST /end FUNCTION_LIST
 /begin REF_CHARACTERISTIC FordMsg202BusHiSpd.FordMsg202BusHiSpdQlyFacEngModInvldPassdThd.Val /end REF_CHARACTERISTIC
 /begin REF_MEASUREMENT /end REF_MEASUREMENT
/end GROUP
/begin GROUP FordMsg202BusHiSpd.FordMsg202BusHiSpdTrlrBackupAssiAvlVldMissThd.Val "MICROSAR RTE" /begin SUB_GROUP /end SUB_GROUP /begin FUNCTION_LIST /end FUNCTION_LIST
 /begin REF_CHARACTERISTIC FordMsg202BusHiSpd.FordMsg202BusHiSpdTrlrBackupAssiAvlVldMissThd.Val /end REF_CHARACTERISTIC
 /begin REF_MEASUREMENT /end REF_MEASUREMENT
/end GROUP
/begin GROUP FordMsg202BusHiSpd.FordMsg202BusHiSpdTrlrBackupAssiAvlVldPassdThd.Val "MICROSAR RTE" /begin SUB_GROUP /end SUB_GROUP /begin FUNCTION_LIST /end FUNCTION_LIST
 /begin REF_CHARACTERISTIC FordMsg202BusHiSpd.FordMsg202BusHiSpdTrlrBackupAssiAvlVldPassdThd.Val /end REF_CHARACTERISTIC
 /begin REF_MEASUREMENT /end REF_MEASUREMENT
/end GROUP
/begin GROUP FordMsg202BusHiSpd.FordTqSteerCmpEnad.Logl "MICROSAR RTE" /begin SUB_GROUP /end SUB_GROUP /begin FUNCTION_LIST /end FUNCTION_LIST /begin REF_CHARACTERISTIC /end REF_CHARACTERISTIC /begin REF_MEASUREMENT FordMsg202BusHiSpd.FordTqSteerCmpEnad.Logl /end REF_MEASUREMENT /end GROUP
/begin GROUP FordMsg202BusHiSpd.FordTrlrBackupAssiEnad.Logl "MICROSAR RTE" /begin SUB_GROUP /end SUB_GROUP /begin FUNCTION_LIST /end FUNCTION_LIST /begin REF_CHARACTERISTIC /end REF_CHARACTERISTIC /begin REF_MEASUREMENT FordMsg202BusHiSpd.FordTrlrBackupAssiEnad.Logl /end REF_MEASUREMENT /end GROUP
/begin GROUP FordMsg202BusHiSpd.FordVehGearRvsSts.Ford_GearRvrse_D_Actl "MICROSAR RTE" /begin SUB_GROUP /end SUB_GROUP /begin FUNCTION_LIST /end FUNCTION_LIST /begin REF_CHARACTERISTIC /end REF_CHARACTERISTIC /begin REF_MEASUREMENT FordMsg202BusHiSpd.FordVehGearRvsSts.Ford_GearRvrse_D_Actl /end REF_MEASUREMENT /end GROUP
/begin GROUP FordMsg202BusHiSpd.FordVehGearRvsStsInvldFaildRefTi "MICROSAR RTE" /begin SUB_GROUP /end SUB_GROUP /begin FUNCTION_LIST /end FUNCTION_LIST /begin REF_CHARACTERISTIC /end REF_CHARACTERISTIC /begin REF_MEASUREMENT FordMsg202BusHiSpd.FordVehGearRvsStsInvldFaildRefTi /end REF_MEASUREMENT /end GROUP
/begin GROUP FordMsg202BusHiSpd.FordVehGearRvsStsInvldPassdRefTi "MICROSAR RTE" /begin SUB_GROUP /end SUB_GROUP /begin FUNCTION_LIST /end FUNCTION_LIST /begin REF_CHARACTERISTIC /end REF_CHARACTERISTIC /begin REF_MEASUREMENT FordMsg202BusHiSpd.FordVehGearRvsStsInvldPassdRefTi /end REF_MEASUREMENT /end GROUP
/begin GROUP FordMsg202BusHiSpd.FordVehGearRvsStsPrev "MICROSAR RTE" /begin SUB_GROUP /end SUB_GROUP /begin FUNCTION_LIST /end FUNCTION_LIST /begin REF_CHARACTERISTIC /end REF_CHARACTERISTIC /begin REF_MEASUREMENT FordMsg202BusHiSpd.FordVehGearRvsStsPrev /end REF_MEASUREMENT /end GROUP
/begin GROUP FordMsg202BusHiSpd.FordVehGearRvsStsRaw.Val "MICROSAR RTE" /begin SUB_GROUP /end SUB_GROUP /begin FUNCTION_LIST /end FUNCTION_LIST /begin REF_CHARACTERISTIC /end REF_CHARACTERISTIC /begin REF_MEASUREMENT FordMsg202BusHiSpd.FordVehGearRvsStsRaw.Val /end REF_MEASUREMENT /end GROUP
/begin GROUP FordMsg202BusHiSpd.FordVehGearRvsStsRawPrev "MICROSAR RTE" /begin SUB_GROUP /end SUB_GROUP /begin FUNCTION_LIST /end FUNCTION_LIST /begin REF_CHARACTERISTIC /end REF_CHARACTERISTIC /begin REF_MEASUREMENT FordMsg202BusHiSpd.FordVehGearRvsStsRawPrev /end REF_MEASUREMENT /end GROUP
/begin GROUP FordMsg202BusHiSpd.FordVehGearRvsStsVld.Logl "MICROSAR RTE" /begin SUB_GROUP /end SUB_GROUP /begin FUNCTION_LIST /end FUNCTION_LIST /begin REF_CHARACTERISTIC /end REF_CHARACTERISTIC /begin REF_MEASUREMENT FordMsg202BusHiSpd.FordVehGearRvsStsVld.Logl /end REF_MEASUREMENT /end GROUP
/begin GROUP FordMsg202BusHiSpd.FordVehGearRvsStsVldFaildRefTi "MICROSAR RTE" /begin SUB_GROUP /end SUB_GROUP /begin FUNCTION_LIST /end FUNCTION_LIST /begin REF_CHARACTERISTIC /end REF_CHARACTERISTIC /begin REF_MEASUREMENT FordMsg202BusHiSpd.FordVehGearRvsStsVldFaildRefTi /end REF_MEASUREMENT /end GROUP
/begin GROUP FordMsg202BusHiSpd.FordVehGearRvsStsVldMissRefTi "MICROSAR RTE" /begin SUB_GROUP /end SUB_GROUP /begin FUNCTION_LIST /end FUNCTION_LIST /begin REF_CHARACTERISTIC /end REF_CHARACTERISTIC /begin REF_MEASUREMENT FordMsg202BusHiSpd.FordVehGearRvsStsVldMissRefTi /end REF_MEASUREMENT /end GROUP
/begin GROUP FordMsg202BusHiSpd.FordVehGearRvsStsVldPassdRefTi "MICROSAR RTE" /begin SUB_GROUP /end SUB_GROUP /begin FUNCTION_LIST /end FUNCTION_LIST /begin REF_CHARACTERISTIC /end REF_CHARACTERISTIC /begin REF_MEASUREMENT FordMsg202BusHiSpd.FordVehGearRvsStsVldPassdRefTi /end REF_MEASUREMENT /end GROUP
/begin GROUP FordMsg202BusHiSpd.FordVehGearRvsStsVldPrev "MICROSAR RTE" /begin SUB_GROUP /end SUB_GROUP /begin FUNCTION_LIST /end FUNCTION_LIST /begin REF_CHARACTERISTIC /end REF_CHARACTERISTIC /begin REF_MEASUREMENT FordMsg202BusHiSpd.FordVehGearRvsStsVldPrev /end REF_MEASUREMENT /end GROUP
/begin GROUP FordMsg202BusHiSpd.FordVehMsg202Miss "MICROSAR RTE" /begin SUB_GROUP /end SUB_GROUP /begin FUNCTION_LIST /end FUNCTION_LIST /begin REF_CHARACTERISTIC /end REF_CHARACTERISTIC /begin REF_MEASUREMENT FordMsg202BusHiSpd.FordVehMsg202Miss /end REF_MEASUREMENT /end GROUP
/begin GROUP FordMsg202BusHiSpd.FordVehMsg202Rxd "MICROSAR RTE" /begin SUB_GROUP /end SUB_GROUP /begin FUNCTION_LIST /end FUNCTION_LIST /begin REF_CHARACTERISTIC /end REF_CHARACTERISTIC /begin REF_MEASUREMENT FordMsg202BusHiSpd.FordVehMsg202Rxd /end REF_MEASUREMENT /end GROUP
/begin GROUP FordMsg202BusHiSpd.FordVehSpdChksEngModl.Val "MICROSAR RTE" /begin SUB_GROUP /end SUB_GROUP /begin FUNCTION_LIST /end FUNCTION_LIST /begin REF_CHARACTERISTIC /end REF_CHARACTERISTIC /begin REF_MEASUREMENT FordMsg202BusHiSpd.FordVehSpdChksEngModl.Val /end REF_MEASUREMENT /end GROUP
/begin GROUP FordMsg202BusHiSpd.FordVehSpdChksEngModlPrev "MICROSAR RTE" /begin SUB_GROUP /end SUB_GROUP /begin FUNCTION_LIST /end FUNCTION_LIST /begin REF_CHARACTERISTIC /end REF_CHARACTERISTIC /begin REF_MEASUREMENT FordMsg202BusHiSpd.FordVehSpdChksEngModlPrev /end REF_MEASUREMENT /end GROUP
/begin GROUP FordMsg202BusHiSpd.FordVehSpdCntrEngModl.Val "MICROSAR RTE" /begin SUB_GROUP /end SUB_GROUP /begin FUNCTION_LIST /end FUNCTION_LIST /begin REF_CHARACTERISTIC /end REF_CHARACTERISTIC /begin REF_MEASUREMENT FordMsg202BusHiSpd.FordVehSpdCntrEngModl.Val /end REF_MEASUREMENT /end GROUP
/begin GROUP FordMsg202BusHiSpd.FordVehSpdCntrEngModlPrev "MICROSAR RTE" /begin SUB_GROUP /end SUB_GROUP /begin FUNCTION_LIST /end FUNCTION_LIST /begin REF_CHARACTERISTIC /end REF_CHARACTERISTIC /begin REF_MEASUREMENT FordMsg202BusHiSpd.FordVehSpdCntrEngModlPrev /end REF_MEASUREMENT /end GROUP
/begin GROUP FordMsg202BusHiSpd.FordVehSpdEngModLoQlyVld.Logl "MICROSAR RTE" /begin SUB_GROUP /end SUB_GROUP /begin FUNCTION_LIST /end FUNCTION_LIST /begin REF_CHARACTERISTIC /end REF_CHARACTERISTIC /begin REF_MEASUREMENT FordMsg202BusHiSpd.FordVehSpdEngModLoQlyVld.Logl /end REF_MEASUREMENT /end GROUP
/begin GROUP FordMsg202BusHiSpd.FordVehSpdEngModLoQlyVldFaildRefTi "MICROSAR RTE" /begin SUB_GROUP /end SUB_GROUP /begin FUNCTION_LIST /end FUNCTION_LIST /begin REF_CHARACTERISTIC /end REF_CHARACTERISTIC /begin REF_MEASUREMENT FordMsg202BusHiSpd.FordVehSpdEngModLoQlyVldFaildRefTi /end REF_MEASUREMENT /end GROUP
/begin GROUP FordMsg202BusHiSpd.FordVehSpdEngModLoQlyVldMissRefTi "MICROSAR RTE" /begin SUB_GROUP /end SUB_GROUP /begin FUNCTION_LIST /end FUNCTION_LIST /begin REF_CHARACTERISTIC /end REF_CHARACTERISTIC /begin REF_MEASUREMENT FordMsg202BusHiSpd.FordVehSpdEngModLoQlyVldMissRefTi /end REF_MEASUREMENT /end GROUP
/begin GROUP FordMsg202BusHiSpd.FordVehSpdEngModLoQlyVldPassdRefTi "MICROSAR RTE" /begin SUB_GROUP /end SUB_GROUP /begin FUNCTION_LIST /end FUNCTION_LIST /begin REF_CHARACTERISTIC /end REF_CHARACTERISTIC /begin REF_MEASUREMENT FordMsg202BusHiSpd.FordVehSpdEngModLoQlyVldPassdRefTi /end REF_MEASUREMENT /end GROUP
/begin GROUP FordMsg202BusHiSpd.FordVehSpdEngModLoQlyVldPrev "MICROSAR RTE" /begin SUB_GROUP /end SUB_GROUP /begin FUNCTION_LIST /end FUNCTION_LIST /begin REF_CHARACTERISTIC /end REF_CHARACTERISTIC /begin REF_MEASUREMENT FordMsg202BusHiSpd.FordVehSpdEngModLoQlyVldPrev /end REF_MEASUREMENT /end GROUP
/begin GROUP FordMsg202BusHiSpd.FordVehSpdEngModl.Val "MICROSAR RTE" /begin SUB_GROUP /end SUB_GROUP /begin FUNCTION_LIST /end FUNCTION_LIST /begin REF_CHARACTERISTIC /end REF_CHARACTERISTIC /begin REF_MEASUREMENT FordMsg202BusHiSpd.FordVehSpdEngModl.Val /end REF_MEASUREMENT /end GROUP
/begin GROUP FordMsg202BusHiSpd.FordVehSpdEngModlPrev "MICROSAR RTE" /begin SUB_GROUP /end SUB_GROUP /begin FUNCTION_LIST /end FUNCTION_LIST /begin REF_CHARACTERISTIC /end REF_CHARACTERISTIC /begin REF_MEASUREMENT FordMsg202BusHiSpd.FordVehSpdEngModlPrev /end REF_MEASUREMENT /end GROUP
/begin GROUP FordMsg202BusHiSpd.FordVehSpdEngModlRaw.Val "MICROSAR RTE" /begin SUB_GROUP /end SUB_GROUP /begin FUNCTION_LIST /end FUNCTION_LIST /begin REF_CHARACTERISTIC /end REF_CHARACTERISTIC /begin REF_MEASUREMENT FordMsg202BusHiSpd.FordVehSpdEngModlRaw.Val /end REF_MEASUREMENT /end GROUP
/begin RECORD_LAYOUT RTE_RL_UWORD FNC_VALUES 1 UWORD ROW_DIR DIRECT /end RECORD_LAYOUT
/**********************************************************************************************************************
* COMPU_METHOD / COMPU_VTAB_RANGE
*********************************************************************************************************************/
/begin COMPU_METHOD RTE_CM_BOOLEAN "" TAB_VERB "%3.1" "" COMPU_TAB_REF RTE_CM_BOOLEAN /end COMPU_METHOD
/begin COMPU_VTAB_RANGE RTE_CM_BOOLEAN "" 2 0 0 "false" 1 255 "true" /end COMPU_VTAB_RANGE
/begin COMPU_METHOD RTE_CM_Ford_VehYaw_W_Actl "" RAT_FUNC "%.1" "rad/s" COEFFS 0 5000 32500 0 0 1 STATUS_STRING_REF RTE_CM_ENUM_Ford_VehYaw_W_Actl /end COMPU_METHOD
/begin COMPU_VTAB_RANGE RTE_CM_ENUM_Ford_VehYaw_W_Actl "" 2 65534 65534 "CxFFFE_NoDataExists" 65535 65535 "CxFFFF_Faulty" /end COMPU_VTAB_RANGE
/begin COMPU_METHOD RTE_CM_ENUM_Ford_ElPw_D_Stat "" TAB_VERB "%.1" "" COMPU_TAB_REF RTE_CM_ENUM_Ford_ElPw_D_Stat /end COMPU_METHOD
/begin COMPU_VTAB_RANGE RTE_CM_ENUM_Ford_ElPw_D_Stat "" 9 0 7 "RANGE" 0 0 "Cx0_Not_Supported" 1 1 "Cx1_Supported" 2 2 "Cx2_Not_Supported_Imminent" 3 3 "Cx3_LV_Event_In_Progress" 4 4 "Cx4_Fault_Limited" 5 5 "Cx5_NotUsed_1" 6 6 "Cx6_NotUsed_2" 7 7 "Cx7_NotUsed_3" /end COMPU_VTAB_RANGE
/begin COMPU_METHOD RTE_CM_ENUM_Ford_PwPckTq_D_Stat "" TAB_VERB "%.1" "" COMPU_TAB_REF RTE_CM_ENUM_Ford_PwPckTq_D_Stat /end COMPU_METHOD
/begin COMPU_VTAB_RANGE RTE_CM_ENUM_Ford_PwPckTq_D_Stat "" 5 0 3 "RANGE" 0 0 "Cx0_PwPckOff_TqNotAvailable" 1 1 "Cx1_PwPckOn_TqNotAvailable" 2 2 "Cx2_StartInPrgrss_TqNotAvail" 3 3 "Cx3_PwPckOn_TqAvailable" /end COMPU_VTAB_RANGE
/begin COMPU_METHOD RTE_CM_ENUM_Ford_StePinCompAnEst_D_Qf "" TAB_VERB "%.1" "" COMPU_TAB_REF RTE_CM_ENUM_Ford_StePinCompAnEst_D_Qf /end COMPU_METHOD
/begin COMPU_VTAB_RANGE RTE_CM_ENUM_Ford_StePinCompAnEst_D_Qf "" 5 0 3 "RANGE" 0 0 "Cx0_Faulty" 1 1 "Cx1_No_Data_Exists" 2 2 "Cx2_Degraded" 3 3 "Cx3_OK" /end COMPU_VTAB_RANGE
/begin COMPU_METHOD RTE_CM_ENUM_Ford_EPAS_Failure "" TAB_VERB "%.1" "" COMPU_TAB_REF RTE_CM_ENUM_Ford_EPAS_Failure /end COMPU_METHOD
/begin COMPU_VTAB_RANGE RTE_CM_ENUM_Ford_EPAS_Failure "" 5 0 3 "RANGE" 0 0 "Cx0_EPAS_OK_NO_MESSAGE" 1 1 "Cx1_POWER_STRG_ASSIST_FAULT" 2 2 "Cx2_SERVICE_POWER_STEERING" 3 3 "Cx3_SERVICE_POWER_STEERING_NOW" /end COMPU_VTAB_RANGE
/begin COMPU_METHOD RTE_CM_ENUM_Ford_SteMdule_D_Stat "" TAB_VERB "%.1" "" COMPU_TAB_REF RTE_CM_ENUM_Ford_SteMdule_D_Stat /end COMPU_METHOD
/begin COMPU_VTAB_RANGE RTE_CM_ENUM_Ford_SteMdule_D_Stat "" 9 0 7 "RANGE" 0 0 "Cx0_EPAS_Initialization" 1 1 "Cx1_Normal_Op_Limited_Assist" 2 2 "Cx2_Normal_Op_Full_Assist" 3 3 "Cx3_EPAS_Shutdown" 4 4 "Cx4_System_Failure" 5 5 "Cx5_EPAS_Failure2" 6 6 "Cx6_EPAS_Failure3" 7 7 "Cx7_NotUsed" /end COMPU_VTAB_RANGE
/begin COMPU_METHOD RTE_CM_ENUM_Ford_SAPPAngleControlStat1 "" TAB_VERB "%.1" "" COMPU_TAB_REF RTE_CM_ENUM_Ford_SAPPAngleControlStat1 /end COMPU_METHOD
/begin COMPU_VTAB_RANGE RTE_CM_ENUM_Ford_SAPPAngleControlStat1 "" 5 0 3 "RANGE" 0 0 "Cx0_Closed" 1 1 "Cx1_Open" 2 2 "Cx2_Active" 3 3 "Cx3_Fault" /end COMPU_VTAB_RANGE
/begin COMPU_METHOD RTE_CM_ENUM_Ford_TurnLghtSwtch_D_Stat "" TAB_VERB "%.1" "" COMPU_TAB_REF RTE_CM_ENUM_Ford_TurnLghtSwtch_D_Stat /end COMPU_METHOD
/begin COMPU_VTAB_RANGE RTE_CM_ENUM_Ford_TurnLghtSwtch_D_Stat "" 5 0 3 "RANGE" 0 0 "Cx0_Off" 1 1 "Cx1_Left" 2 2 "Cx2_Right" 3 3 "Cx3_Unused_Treat_As_Off" /end COMPU_VTAB_RANGE
/begin COMPU_METHOD RTE_CM_ENUM_Ford_ElPw_D_StatStrtStop "" TAB_VERB "%.1" "" COMPU_TAB_REF RTE_CM_ENUM_Ford_ElPw_D_StatStrtStop /end COMPU_METHOD
/begin COMPU_VTAB_RANGE RTE_CM_ENUM_Ford_ElPw_D_StatStrtStop "" 17 0 15 "RANGE" 0 0 "Cx0_Not_Supported" 1 1 "Cx1_Supported_All" 2 2 "Cx2_Not_Supported_Imminent" 3 3 "Cx3_LV_Event_in_Progress" 4 4 "Cx4_Fault_Limited" 5 5 "Cx5_Limited_Support" 6 6 "Cx6_Supported_Level_1" 7 7 "Cx7_Supported_Level_2" 8 8 "Cx8_Supported_Level_3" 9 9 "Cx9_Supported_Level_4" 10 10 "CxA_NotUsed1" 11 11 "CxB_NotUsed2" 12 12 "CxC_NotUsed3" 13 13 "CxD_NotUsed4" 14 14 "CxE_NotUsed5" 15 15 "CxF_NotUsed6" /end COMPU_VTAB_RANGE
/begin COMPU_METHOD RTE_CM_ENUM_Ford_GearRvrse_D_Actl "" TAB_VERB "%.1" "" COMPU_TAB_REF RTE_CM_ENUM_Ford_GearRvrse_D_Actl /end COMPU_METHOD
/begin COMPU_VTAB_RANGE RTE_CM_ENUM_Ford_GearRvrse_D_Actl "" 9 0 7 "RANGE" 0 0 "Cx0_Inactive_not_confirmed" 1 1 "Cx1_Inactive_confirmed" 2 2 "Cx2_Active_not_confirmed" 3 3 "Cx3_Active_confirmed" 4 4 "Cx4_NotUsed_1" 5 5 "Cx5_NotUsed_2" 6 6 "Cx6_NotUsed_3" 7 7 "Cx7_Fault" /end COMPU_VTAB_RANGE
