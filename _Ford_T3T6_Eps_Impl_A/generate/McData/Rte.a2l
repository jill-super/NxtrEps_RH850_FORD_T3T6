/begin CHARACTERISTIC HwAg1Meas.HwAg1MeasHwAg1Snsr0PrtclFltPassStep.Val "MICROSAR RTE" VALUE 0x0 RTE_RL_UWORD 0 NO_COMPU_METHOD 0 65535 SYMBOL_LINK "Rte_CalprmRom_CalRegn01Inin00_DEFAULT_RTE_CALPRM_GROUP.HwAg1MeasHwAg1Snsr0PrtclFltPassStep_Val" 0 DISPLAY_IDENTIFIER HwAg1Meas.CalibrationPorts.HwAg1MeasHwAg1Snsr0PrtclFltPassStep.Val /end CHARACTERISTIC
/begin CHARACTERISTIC HwAg1Meas.HwAg1MeasHwAg1Snsr1PrtclFltFailStep.Val "MICROSAR RTE" VALUE 0x0 RTE_RL_UWORD 0 NO_COMPU_METHOD 0 65535 SYMBOL_LINK "Rte_CalprmRom_CalRegn01Inin00_DEFAULT_RTE_CALPRM_GROUP.HwAg1MeasHwAg1Snsr1PrtclFltFailStep_Val" 0 DISPLAY_IDENTIFIER HwAg1Meas.CalibrationPorts.HwAg1MeasHwAg1Snsr1PrtclFltFailStep.Val /end CHARACTERISTIC
/begin CHARACTERISTIC HwAg1Meas.HwAg1MeasHwAg1Snsr1PrtclFltPassStep.Val "MICROSAR RTE" VALUE 0x0 RTE_RL_UWORD 0 NO_COMPU_METHOD 0 65535 SYMBOL_LINK "Rte_CalprmRom_CalRegn01Inin00_DEFAULT_RTE_CALPRM_GROUP.HwAg1MeasHwAg1Snsr1PrtclFltPassStep_Val" 0 DISPLAY_IDENTIFIER HwAg1Meas.CalibrationPorts.HwAg1MeasHwAg1Snsr1PrtclFltPassStep.Val /end CHARACTERISTIC
/begin CHARACTERISTIC HwAg1Meas.HwAg1MeasSnsr0Rev.Ary1D "MICROSAR RTE" VAL_BLK 0x0 RTE_RL_UBYTE 0 NO_COMPU_METHOD 0 255 MATRIX_DIM 22 1 1 SYMBOL_LINK "Rte_CalprmRom_CalRegn01Inin00_DEFAULT_RTE_CALPRM_GROUP.HwAg1MeasSnsr0Rev_Ary1D" 0 DISPLAY_IDENTIFIER HwAg1Meas.CalibrationPorts.HwAg1MeasSnsr0Rev.Ary1D /end CHARACTERISTIC
/begin CHARACTERISTIC HwAg1Meas.HwAg1MeasSnsr1Rev.Ary1D "MICROSAR RTE" VAL_BLK 0x0 RTE_RL_UBYTE 0 NO_COMPU_METHOD 0 255 MATRIX_DIM 22 1 1 SYMBOL_LINK "Rte_CalprmRom_CalRegn01Inin00_DEFAULT_RTE_CALPRM_GROUP.HwAg1MeasSnsr1Rev_Ary1D" 0 DISPLAY_IDENTIFIER HwAg1Meas.CalibrationPorts.HwAg1MeasSnsr1Rev.Ary1D /end CHARACTERISTIC
/begin CHARACTERISTIC HwAg1Meas.HwAg1MeasStep.Ary1D "MICROSAR RTE" VAL_BLK 0x0 RTE_RL_SWORD 0 NO_COMPU_METHOD -32768 32767 MATRIX_DIM 22 1 1 SYMBOL_LINK "Rte_CalprmRom_CalRegn01Inin00_DEFAULT_RTE_CALPRM_GROUP.HwAg1MeasStep_Ary1D" 0 DISPLAY_IDENTIFIER HwAg1Meas.CalibrationPorts.HwAg1MeasStep.Ary1D /end CHARACTERISTIC
/begin CHARACTERISTIC HwAg1Meas.HwAg1MeasVrnrErrThd.Val "MICROSAR RTE" VALUE 0x0 RTE_RL_UBYTE 0 NO_COMPU_METHOD 0 255 SYMBOL_LINK "Rte_CalprmRom_CalRegn01Inin00_DEFAULT_RTE_CALPRM_GROUP.HwAg1MeasVrnrErrThd_Val" 0 DISPLAY_IDENTIFIER HwAg1Meas.CalibrationPorts.HwAg1MeasVrnrErrThd.Val /end CHARACTERISTIC
/begin CHARACTERISTIC HwAgSnsrls.HwAgSnsrlsCorrdPinionAgConfThd.Val "MICROSAR RTE" VALUE 0x0 RTE_RL_FLOAT32_IEEE 0 NO_COMPU_METHOD -3.402823466e+38 3.402823466e+38 SYMBOL_LINK "Rte_CalprmRom_CalRegn01Cmn_DEFAULT_RTE_CALPRM_GROUP.HwAgSnsrlsCorrdPinionAgConfThd_Val" 0 DISPLAY_IDENTIFIER HwAgSnsrls.CalibrationPorts.HwAgSnsrlsCorrdPinionAgConfThd.Val /end CHARACTERISTIC
/begin CHARACTERISTIC HwAgSnsrls.HwAgSnsrlsCorrdPinionAgHwConf.Val "MICROSAR RTE" VALUE 0x0 RTE_RL_FLOAT32_IEEE 0 NO_COMPU_METHOD -3.402823466e+38 3.402823466e+38 SYMBOL_LINK "Rte_CalprmRom_CalRegn01Cmn_DEFAULT_RTE_CALPRM_GROUP.HwAgSnsrlsCorrdPinionAgHwConf_Val" 0 DISPLAY_IDENTIFIER HwAgSnsrls.CalibrationPorts.HwAgSnsrlsCorrdPinionAgHwConf.Val /end CHARACTERISTIC
/begin CHARACTERISTIC HwAgSnsrls.HwAgSnsrlsFCentrHwConf.Val "MICROSAR RTE" VALUE 0x0 RTE_RL_FLOAT32_IEEE 0 NO_COMPU_METHOD -3.402823466e+38 3.402823466e+38 SYMBOL_LINK "Rte_CalprmRom_CalRegn01Cmn_DEFAULT_RTE_CALPRM_GROUP.HwAgSnsrlsFCentrHwConf_Val" 0 DISPLAY_IDENTIFIER HwAgSnsrls.CalibrationPorts.HwAgSnsrlsFCentrHwConf.Val /end CHARACTERISTIC
/begin CHARACTERISTIC HwAgSnsrls.HwAgSnsrlsFeatEna.Logl "MICROSAR RTE" VALUE 0x0 RTE_RL_BOOLEAN 0 RTE_CM_BOOLEAN 0 255 SYMBOL_LINK "Rte_CalprmRom_CalRegn01Inin00_DEFAULT_RTE_CALPRM_GROUP.HwAgSnsrlsFeatEna_Logl" 0 DISPLAY_IDENTIFIER HwAgSnsrls.CalibrationPorts.HwAgSnsrlsFeatEna.Logl /end CHARACTERISTIC
/begin CHARACTERISTIC HwAgSnsrls.HwAgSnsrlsMotAgIdptSigThd.Val "MICROSAR RTE" VALUE 0x0 RTE_RL_UBYTE 0 NO_COMPU_METHOD 0 255 SYMBOL_LINK "Rte_CalprmRom_CalRegn01Cmn_DEFAULT_RTE_CALPRM_GROUP.HwAgSnsrlsMotAgIdptSigThd_Val" 0 DISPLAY_IDENTIFIER HwAgSnsrls.CalibrationPorts.HwAgSnsrlsMotAgIdptSigThd.Val /end CHARACTERISTIC
/begin CHARACTERISTIC HwAgSnsrls.HwAgSnsrlsPinionTqFilFrq.Val "MICROSAR RTE" VALUE 0x0 RTE_RL_FLOAT32_IEEE 0 NO_COMPU_METHOD -3.402823466e+38 3.402823466e+38 SYMBOL_LINK "Rte_CalprmRom_CalRegn01Cmn_DEFAULT_RTE_CALPRM_GROUP.HwAgSnsrlsPinionTqFilFrq_Val" 0 DISPLAY_IDENTIFIER HwAgSnsrls.CalibrationPorts.HwAgSnsrlsPinionTqFilFrq.Val /end CHARACTERISTIC
/begin CHARACTERISTIC HwAgSnsrls.HwAgSnsrlsRelHwAgFil1Frq.Val "MICROSAR RTE" VALUE 0x0 RTE_RL_FLOAT32_IEEE 0 NO_COMPU_METHOD -3.402823466e+38 3.402823466e+38 SYMBOL_LINK "Rte_CalprmRom_CalRegn01Cmn_DEFAULT_RTE_CALPRM_GROUP.HwAgSnsrlsRelHwAgFil1Frq_Val" 0 DISPLAY_IDENTIFIER HwAgSnsrls.CalibrationPorts.HwAgSnsrlsRelHwAgFil1Frq.Val /end CHARACTERISTIC
/begin CHARACTERISTIC HwAgSnsrls.HwAgSnsrlsRelHwAgFil2Frq.Val "MICROSAR RTE" VALUE 0x0 RTE_RL_FLOAT32_IEEE 0 NO_COMPU_METHOD -3.402823466e+38 3.402823466e+38 SYMBOL_LINK "Rte_CalprmRom_CalRegn01Cmn_DEFAULT_RTE_CALPRM_GROUP.HwAgSnsrlsRelHwAgFil2Frq_Val" 0 DISPLAY_IDENTIFIER HwAgSnsrls.CalibrationPorts.HwAgSnsrlsRelHwAgFil2Frq.Val /end CHARACTERISTIC
/begin CHARACTERISTIC HwAgSnsrls.HwAgSnsrlsSmotngCoeff.Val "MICROSAR RTE" VALUE 0x0 RTE_RL_FLOAT32_IEEE 0 NO_COMPU_METHOD -3.402823466e+38 3.402823466e+38 SYMBOL_LINK "Rte_CalprmRom_CalRegn01Cmn_DEFAULT_RTE_CALPRM_GROUP.HwAgSnsrlsSmotngCoeff_Val" 0 DISPLAY_IDENTIFIER HwAgSnsrls.CalibrationPorts.HwAgSnsrlsSmotngCoeff.Val /end CHARACTERISTIC
/begin CHARACTERISTIC HwAgSnsrls.HwAgSnsrlsSmotngStepThd.Val "MICROSAR RTE" VALUE 0x0 RTE_RL_FLOAT32_IEEE 0 NO_COMPU_METHOD -3.402823466e+38 3.402823466e+38 SYMBOL_LINK "Rte_CalprmRom_CalRegn01Cmn_DEFAULT_RTE_CALPRM_GROUP.HwAgSnsrlsSmotngStepThd_Val" 0 DISPLAY_IDENTIFIER HwAgSnsrls.CalibrationPorts.HwAgSnsrlsSmotngStepThd.Val /end CHARACTERISTIC
/begin CHARACTERISTIC HwAgSnsrls.HwAgSnsrlsStordPinionConf.Val "MICROSAR RTE" VALUE 0x0 RTE_RL_FLOAT32_IEEE 0 NO_COMPU_METHOD -3.402823466e+38 3.402823466e+38 SYMBOL_LINK "Rte_CalprmRom_CalRegn01Cmn_DEFAULT_RTE_CALPRM_GROUP.HwAgSnsrlsStordPinionConf_Val" 0 DISPLAY_IDENTIFIER HwAgSnsrls.CalibrationPorts.HwAgSnsrlsStordPinionConf.Val /end CHARACTERISTIC
/begin CHARACTERISTIC HwAgSnsrls.HwAgSnsrlsStordPinionConfThd.Val "MICROSAR RTE" VALUE 0x0 RTE_RL_FLOAT32_IEEE 0 NO_COMPU_METHOD -3.402823466e+38 3.402823466e+38 SYMBOL_LINK "Rte_CalprmRom_CalRegn01Cmn_DEFAULT_RTE_CALPRM_GROUP.HwAgSnsrlsStordPinionConfThd_Val" 0 DISPLAY_IDENTIFIER HwAgSnsrls.CalibrationPorts.HwAgSnsrlsStordPinionConfThd.Val /end CHARACTERISTIC
/begin CHARACTERISTIC HwAgSnsrls.HwAgSnsrlsVehDynDifThd.Val "MICROSAR RTE" VALUE 0x0 RTE_RL_FLOAT32_IEEE 0 NO_COMPU_METHOD -3.402823466e+38 3.402823466e+38 SYMBOL_LINK "Rte_CalprmRom_CalRegn01Cmn_DEFAULT_RTE_CALPRM_GROUP.HwAgSnsrlsVehDynDifThd_Val" 0 DISPLAY_IDENTIFIER HwAgSnsrls.CalibrationPorts.HwAgSnsrlsVehDynDifThd.Val /end CHARACTERISTIC
/begin CHARACTERISTIC HwAgSnsrls.HwAgSnsrlsVehDynHwConf.Val "MICROSAR RTE" VALUE 0x0 RTE_RL_FLOAT32_IEEE 0 NO_COMPU_METHOD -3.402823466e+38 3.402823466e+38 SYMBOL_LINK "Rte_CalprmRom_CalRegn01Cmn_DEFAULT_RTE_CALPRM_GROUP.HwAgSnsrlsVehDynHwConf_Val" 0 DISPLAY_IDENTIFIER HwAgSnsrls.CalibrationPorts.HwAgSnsrlsVehDynHwConf.Val /end CHARACTERISTIC
/begin CHARACTERISTIC HwAgSnsrls.HwAgSnsrlsVehDynMotVelThd.Val "MICROSAR RTE" VALUE 0x0 RTE_RL_FLOAT32_IEEE 0 NO_COMPU_METHOD -3.402823466e+38 3.402823466e+38 SYMBOL_LINK "Rte_CalprmRom_CalRegn01Cmn_DEFAULT_RTE_CALPRM_GROUP.HwAgSnsrlsVehDynMotVelThd_Val" 0 DISPLAY_IDENTIFIER HwAgSnsrls.CalibrationPorts.HwAgSnsrlsVehDynMotVelThd.Val /end CHARACTERISTIC
/begin CHARACTERISTIC HwAgSnsrls.HwAgSnsrlsVehDynPinionTqThd.Val "MICROSAR RTE" VALUE 0x0 RTE_RL_FLOAT32_IEEE 0 NO_COMPU_METHOD -3.402823466e+38 3.402823466e+38 SYMBOL_LINK "Rte_CalprmRom_CalRegn01Cmn_DEFAULT_RTE_CALPRM_GROUP.HwAgSnsrlsVehDynPinionTqThd_Val" 0 DISPLAY_IDENTIFIER HwAgSnsrls.CalibrationPorts.HwAgSnsrlsVehDynPinionTqThd.Val /end CHARACTERISTIC
/begin CHARACTERISTIC HwAgSnsrls.HwAgSnsrlsVehDynTmr1Thd.Val "MICROSAR RTE" VALUE 0x0 RTE_RL_ULONG 0 NO_COMPU_METHOD 0 4294967295 SYMBOL_LINK "Rte_CalprmRom_CalRegn01Cmn_DEFAULT_RTE_CALPRM_GROUP.HwAgSnsrlsVehDynTmr1Thd_Val" 0 DISPLAY_IDENTIFIER HwAgSnsrls.CalibrationPorts.HwAgSnsrlsVehDynTmr1Thd.Val /end CHARACTERISTIC
/begin CHARACTERISTIC HwAgSnsrls.HwAgSnsrlsVehDynTmr2Thd.Val "MICROSAR RTE" VALUE 0x0 RTE_RL_ULONG 0 NO_COMPU_METHOD 0 4294967295 SYMBOL_LINK "Rte_CalprmRom_CalRegn01Cmn_DEFAULT_RTE_CALPRM_GROUP.HwAgSnsrlsVehDynTmr2Thd_Val" 0 DISPLAY_IDENTIFIER HwAgSnsrls.CalibrationPorts.HwAgSnsrlsVehDynTmr2Thd.Val /end CHARACTERISTIC
/begin CHARACTERISTIC HwAgSnsrls.HwAgSnsrlsVehDynVehSpdThd.Val "MICROSAR RTE" VALUE 0x0 RTE_RL_FLOAT32_IEEE 0 NO_COMPU_METHOD -3.402823466e+38 3.402823466e+38 SYMBOL_LINK "Rte_CalprmRom_CalRegn01Inin00_DEFAULT_RTE_CALPRM_GROUP.HwAgSnsrlsVehDynVehSpdThd_Val" 0 DISPLAY_IDENTIFIER HwAgSnsrls.CalibrationPorts.HwAgSnsrlsVehDynVehSpdThd.Val /end CHARACTERISTIC
/begin CHARACTERISTIC HwAgSnsrls.HwAgSnsrlsVehDynYawRateThd.Val "MICROSAR RTE" VALUE 0x0 RTE_RL_FLOAT32_IEEE 0 NO_COMPU_METHOD -3.402823466e+38 3.402823466e+38 SYMBOL_LINK "Rte_CalprmRom_CalRegn01Inin00_DEFAULT_RTE_CALPRM_GROUP.HwAgSnsrlsVehDynYawRateThd_Val" 0 DISPLAY_IDENTIFIER HwAgSnsrls.CalibrationPorts.HwAgSnsrlsVehDynYawRateThd.Val /end CHARACTERISTIC
/begin CHARACTERISTIC HwAgSnsrls.HwAgSnsrlsWhlFrqThd.Val "MICROSAR RTE" VALUE 0x0 RTE_RL_FLOAT32_IEEE 0 NO_COMPU_METHOD -3.402823466e+38 3.402823466e+38 SYMBOL_LINK "Rte_CalprmRom_CalRegn01Cmn_DEFAULT_RTE_CALPRM_GROUP.HwAgSnsrlsWhlFrqThd_Val" 0 DISPLAY_IDENTIFIER HwAgSnsrls.CalibrationPorts.HwAgSnsrlsWhlFrqThd.Val /end CHARACTERISTIC
/begin CHARACTERISTIC HwAgSnsrls.HwAgSnsrlsWhlSpdHwAgCoeff1.Val "MICROSAR RTE" VALUE 0x0 RTE_RL_FLOAT32_IEEE 0 NO_COMPU_METHOD -3.402823466e+38 3.402823466e+38 SYMBOL_LINK "Rte_CalprmRom_CalRegn01Cmn_DEFAULT_RTE_CALPRM_GROUP.HwAgSnsrlsWhlSpdHwAgCoeff1_Val" 0 DISPLAY_IDENTIFIER HwAgSnsrls.CalibrationPorts.HwAgSnsrlsWhlSpdHwAgCoeff1.Val /end CHARACTERISTIC
/begin CHARACTERISTIC HwAgSnsrls.HwAgSnsrlsWhlSpdHwAgCoeff2.Val "MICROSAR RTE" VALUE 0x0 RTE_RL_FLOAT32_IEEE 0 NO_COMPU_METHOD -3.402823466e+38 3.402823466e+38 SYMBOL_LINK "Rte_CalprmRom_CalRegn01Cmn_DEFAULT_RTE_CALPRM_GROUP.HwAgSnsrlsWhlSpdHwAgCoeff2_Val" 0 DISPLAY_IDENTIFIER HwAgSnsrls.CalibrationPorts.HwAgSnsrlsWhlSpdHwAgCoeff2.Val /end CHARACTERISTIC
/begin CHARACTERISTIC HwAgSnsrls.HwAgSnsrlsWhlSpdHwAgThd.Val "MICROSAR RTE" VALUE 0x0 RTE_RL_FLOAT32_IEEE 0 NO_COMPU_METHOD -3.402823466e+38 3.402823466e+38 SYMBOL_LINK "Rte_CalprmRom_CalRegn01Cmn_DEFAULT_RTE_CALPRM_GROUP.HwAgSnsrlsWhlSpdHwAgThd_Val" 0 DISPLAY_IDENTIFIER HwAgSnsrls.CalibrationPorts.HwAgSnsrlsWhlSpdHwAgThd.Val /end CHARACTERISTIC
/begin CHARACTERISTIC HwAgSnsrls.HwAgSnsrlsWhlSpdHwConf.Val "MICROSAR RTE" VALUE 0x0 RTE_RL_FLOAT32_IEEE 0 NO_COMPU_METHOD -3.402823466e+38 3.402823466e+38 SYMBOL_LINK "Rte_CalprmRom_CalRegn01Cmn_DEFAULT_RTE_CALPRM_GROUP.HwAgSnsrlsWhlSpdHwConf_Val" 0 DISPLAY_IDENTIFIER HwAgSnsrls.CalibrationPorts.HwAgSnsrlsWhlSpdHwConf.Val /end CHARACTERISTIC
/begin CHARACTERISTIC HwAgSnsrls.HwAgSnsrlsWhlSpdRatThd.Val "MICROSAR RTE" VALUE 0x0 RTE_RL_FLOAT32_IEEE 0 NO_COMPU_METHOD -3.402823466e+38 3.402823466e+38 SYMBOL_LINK "Rte_CalprmRom_CalRegn01Cmn_DEFAULT_RTE_CALPRM_GROUP.HwAgSnsrlsWhlSpdRatThd_Val" 0 DISPLAY_IDENTIFIER HwAgSnsrls.CalibrationPorts.HwAgSnsrlsWhlSpdRatThd.Val /end CHARACTERISTIC
/begin CHARACTERISTIC HwAgSnsrls.HwAgSnsrlsWhlSpdTmrThd.Val "MICROSAR RTE" VALUE 0x0 RTE_RL_ULONG 0 NO_COMPU_METHOD 0 4294967295 SYMBOL_LINK "Rte_CalprmRom_CalRegn01Cmn_DEFAULT_RTE_CALPRM_GROUP.HwAgSnsrlsWhlSpdTmrThd_Val" 0 DISPLAY_IDENTIFIER HwAgSnsrls.CalibrationPorts.HwAgSnsrlsWhlSpdTmrThd.Val /end CHARACTERISTIC
/begin CHARACTERISTIC HwAgSnsrls.HwAgSnsrlsWhlSpdVehSpdThd.Val "MICROSAR RTE" VALUE 0x0 RTE_RL_FLOAT32_IEEE 0 NO_COMPU_METHOD -3.402823466e+38 3.402823466e+38 SYMBOL_LINK "Rte_CalprmRom_CalRegn01Cmn_DEFAULT_RTE_CALPRM_GROUP.HwAgSnsrlsWhlSpdVehSpdThd_Val" 0 DISPLAY_IDENTIFIER HwAgSnsrls.CalibrationPorts.HwAgSnsrlsWhlSpdVehSpdThd.Val /end CHARACTERISTIC
/begin CHARACTERISTIC HwAgSnsrls.HwAgSnsrlsYawRateFilFrq.Val "MICROSAR RTE" VALUE 0x0 RTE_RL_FLOAT32_IEEE 0 NO_COMPU_METHOD -3.402823466e+38 3.402823466e+38 SYMBOL_LINK "Rte_CalprmRom_CalRegn01Inin00_DEFAULT_RTE_CALPRM_GROUP.HwAgSnsrlsYawRateFilFrq_Val" 0 DISPLAY_IDENTIFIER HwAgSnsrls.CalibrationPorts.HwAgSnsrlsYawRateFilFrq.Val /end CHARACTERISTIC
/begin CHARACTERISTIC HwAgSnsrls.StordLstPrmDft.PinionAg "MICROSAR RTE" VALUE 0x0 RTE_RL_FLOAT32_IEEE 0 NO_COMPU_METHOD -3.402823466e+38 3.402823466e+38 SYMBOL_LINK "Rte_CalprmRom_HwAgSnsrls_DEFAULT_RTE_CDATA_GROUP.StordLstPrmDft.PinionAg" 0 DISPLAY_IDENTIFIER HwAgSnsrls.CalibrationParameters.StordLstPrmDft.PinionAg /end CHARACTERISTIC
/begin CHARACTERISTIC HwAgSnsrls.StordLstPrmDft.PinionAgVld "MICROSAR RTE" VALUE 0x0 RTE_RL_BOOLEAN 0 RTE_CM_BOOLEAN 0 255 SYMBOL_LINK "Rte_CalprmRom_HwAgSnsrls_DEFAULT_RTE_CDATA_GROUP.StordLstPrmDft.PinionAgVld" 0 DISPLAY_IDENTIFIER HwAgSnsrls.CalibrationParameters.StordLstPrmDft.PinionAgVld /end CHARACTERISTIC
/begin CHARACTERISTIC HwAgSnsrls.SysGlbPrmSysKineRat.Val "MICROSAR RTE" VALUE 0x0 RTE_RL_FLOAT32_IEEE 0 NO_COMPU_METHOD -3.402823466e+38 3.402823466e+38 SYMBOL_LINK "Rte_CalprmRom_CalRegn02Inin00_DEFAULT_RTE_CALPRM_GROUP.SysGlbPrmSysKineRat_Val" 0 DISPLAY_IDENTIFIER HwAgSnsrls.CalibrationPorts.SysGlbPrmSysKineRat.Val /end CHARACTERISTIC
/begin CHARACTERISTIC HwAgSnsrls.SysGlbPrmSysTqRat.Val "MICROSAR RTE" VALUE 0x0 RTE_RL_FLOAT32_IEEE 0 NO_COMPU_METHOD -3.402823466e+38 3.402823466e+38 SYMBOL_LINK "Rte_CalprmRom_CalRegn01Inin00_DEFAULT_RTE_CALPRM_GROUP.SysGlbPrmSysTqRat_Val" 0 DISPLAY_IDENTIFIER HwAgSnsrls.CalibrationPorts.SysGlbPrmSysTqRat.Val /end CHARACTERISTIC
/begin CHARACTERISTIC HwAgSysArbn.HwAgSysArbn2PinionPosSnsrAvl.Logl "MICROSAR RTE" VALUE 0x0 RTE_RL_BOOLEAN 0 RTE_CM_BOOLEAN 0 255 SYMBOL_LINK "Rte_CalprmRom_CalRegn01Inin00_DEFAULT_RTE_CALPRM_GROUP.HwAgSysArbn2PinionPosSnsrAvl_Logl" 0 DISPLAY_IDENTIFIER HwAgSysArbn.CalibrationPorts.HwAgSysArbn2PinionPosSnsrAvl.Logl /end CHARACTERISTIC
/begin CHARACTERISTIC HwAgSysArbn.HwAgSysArbnHwAgConf1Snsr.Val "MICROSAR RTE" VALUE 0x0 RTE_RL_FLOAT32_IEEE 0 NO_COMPU_METHOD -3.402823466e+38 3.402823466e+38 SYMBOL_LINK "Rte_CalprmRom_CalRegn01Cmn_DEFAULT_RTE_CALPRM_GROUP.HwAgSysArbnHwAgConf1Snsr_Val" 0 DISPLAY_IDENTIFIER HwAgSysArbn.CalibrationPorts.HwAgSysArbnHwAgConf1Snsr.Val /end CHARACTERISTIC
/begin CHARACTERISTIC HwAgSysArbn.HwAgSysArbnHwAgConf1SnsrHwAgTrimNotPrfmd.Val "MICROSAR RTE" VALUE 0x0 RTE_RL_FLOAT32_IEEE 0 NO_COMPU_METHOD -3.402823466e+38 3.402823466e+38 SYMBOL_LINK "Rte_CalprmRom_CalRegn01Cmn_DEFAULT_RTE_CALPRM_GROUP.HwAgSysArbnHwAgConf1SnsrHwAgTrimNotPrfmd_Val" 0 DISPLAY_IDENTIFIER HwAgSysArbn.CalibrationPorts.HwAgSysArbnHwAgConf1SnsrHwAgTrimNotPrfmd.Val /end CHARACTERISTIC
/begin CHARACTERISTIC HwAgSysArbn.HwAgSysArbnHwAgConf2Snsr.Val "MICROSAR RTE" VALUE 0x0 RTE_RL_FLOAT32_IEEE 0 NO_COMPU_METHOD -3.402823466e+38 3.402823466e+38 SYMBOL_LINK "Rte_CalprmRom_CalRegn01Cmn_DEFAULT_RTE_CALPRM_GROUP.HwAgSysArbnHwAgConf2Snsr_Val" 0 DISPLAY_IDENTIFIER HwAgSysArbn.CalibrationPorts.HwAgSysArbnHwAgConf2Snsr.Val /end CHARACTERISTIC
/begin CHARACTERISTIC HwAgSysArbn.HwAgSysArbnHwAgConf2SnsrHwAgTrimNotPrfmd.Val "MICROSAR RTE" VALUE 0x0 RTE_RL_FLOAT32_IEEE 0 NO_COMPU_METHOD -3.402823466e+38 3.402823466e+38 SYMBOL_LINK "Rte_CalprmRom_CalRegn01Cmn_DEFAULT_RTE_CALPRM_GROUP.HwAgSysArbnHwAgConf2SnsrHwAgTrimNotPrfmd_Val" 0 DISPLAY_IDENTIFIER HwAgSysArbn.CalibrationPorts.HwAgSysArbnHwAgConf2SnsrHwAgTrimNotPrfmd.Val /end CHARACTERISTIC
/begin CHARACTERISTIC HwAgSysArbn.HwAgSysArbnHwAgConfNoSnsr.Val "MICROSAR RTE" VALUE 0x0 RTE_RL_FLOAT32_IEEE 0 NO_COMPU_METHOD -3.402823466e+38 3.402823466e+38 SYMBOL_LINK "Rte_CalprmRom_CalRegn01Cmn_DEFAULT_RTE_CALPRM_GROUP.HwAgSysArbnHwAgConfNoSnsr_Val" 0 DISPLAY_IDENTIFIER HwAgSysArbn.CalibrationPorts.HwAgSysArbnHwAgConfNoSnsr.Val /end CHARACTERISTIC
/begin CHARACTERISTIC HwAgSysArbn.HwAgSysArbnHwAgConfTiThd.Val "MICROSAR RTE" VALUE 0x0 RTE_RL_UWORD 0 NO_COMPU_METHOD 0 65535 SYMBOL_LINK "Rte_CalprmRom_CalRegn01Cmn_DEFAULT_RTE_CALPRM_GROUP.HwAgSysArbnHwAgConfTiThd_Val" 0 DISPLAY_IDENTIFIER HwAgSysArbn.CalibrationPorts.HwAgSysArbnHwAgConfTiThd.Val /end CHARACTERISTIC
/begin CHARACTERISTIC HwAgSysArbn.HwAgSysArbnHwAgCorrdCorrlnThd.Val "MICROSAR RTE" VALUE 0x0 RTE_RL_FLOAT32_IEEE 0 NO_COMPU_METHOD -3.402823466e+38 3.402823466e+38 SYMBOL_LINK "Rte_CalprmRom_CalRegn01Cmn_DEFAULT_RTE_CALPRM_GROUP.HwAgSysArbnHwAgCorrdCorrlnThd_Val" 0 DISPLAY_IDENTIFIER HwAgSysArbn.CalibrationPorts.HwAgSysArbnHwAgCorrdCorrlnThd.Val /end CHARACTERISTIC
/begin CHARACTERISTIC HwAgSysArbn.HwAgSysArbnHwAgCorrlnFailDebStep.Val "MICROSAR RTE" VALUE 0x0 RTE_RL_UWORD 0 NO_COMPU_METHOD 0 65535 SYMBOL_LINK "Rte_CalprmRom_CalRegn01Cmn_DEFAULT_RTE_CALPRM_GROUP.HwAgSysArbnHwAgCorrlnFailDebStep_Val" 0 DISPLAY_IDENTIFIER HwAgSysArbn.CalibrationPorts.HwAgSysArbnHwAgCorrlnFailDebStep.Val /end CHARACTERISTIC
/begin CHARACTERISTIC HwAgSysArbn.HwAgSysArbnHwAgCorrlnPassDebStep.Val "MICROSAR RTE" VALUE 0x0 RTE_RL_UWORD 0 NO_COMPU_METHOD 0 65535 SYMBOL_LINK "Rte_CalprmRom_CalRegn01Cmn_DEFAULT_RTE_CALPRM_GROUP.HwAgSysArbnHwAgCorrlnPassDebStep_Val" 0 DISPLAY_IDENTIFIER HwAgSysArbn.CalibrationPorts.HwAgSysArbnHwAgCorrlnPassDebStep.Val /end CHARACTERISTIC
/begin CHARACTERISTIC HwAgSysArbn.HwAgSysArbnHwAgCorrlnRng.Val "MICROSAR RTE" VALUE 0x0 RTE_RL_FLOAT32_IEEE 0 NO_COMPU_METHOD -3.402823466e+38 3.402823466e+38 SYMBOL_LINK "Rte_CalprmRom_CalRegn01Cmn_DEFAULT_RTE_CALPRM_GROUP.HwAgSysArbnHwAgCorrlnRng_Val" 0 DISPLAY_IDENTIFIER HwAgSysArbn.CalibrationPorts.HwAgSysArbnHwAgCorrlnRng.Val /end CHARACTERISTIC
/begin CHARACTERISTIC HwAgSysArbn.HwAgSysArbnHwAgIdptSigLim.Val "MICROSAR RTE" VALUE 0x0 RTE_RL_UBYTE 0 NO_COMPU_METHOD 0 255 SYMBOL_LINK "Rte_CalprmRom_CalRegn01Cmn_DEFAULT_RTE_CALPRM_GROUP.HwAgSysArbnHwAgIdptSigLim_Val" 0 DISPLAY_IDENTIFIER HwAgSysArbn.CalibrationPorts.HwAgSysArbnHwAgIdptSigLim.Val /end CHARACTERISTIC
/begin CHARACTERISTIC HwAgSysArbn.HwAgSysArbnHwAgSlewRate.Val "MICROSAR RTE" VALUE 0x0 RTE_RL_FLOAT32_IEEE 0 NO_COMPU_METHOD -3.402823466e+38 3.402823466e+38 SYMBOL_LINK "Rte_CalprmRom_CalRegn01Cmn_DEFAULT_RTE_CALPRM_GROUP.HwAgSysArbnHwAgSlewRate_Val" 0 DISPLAY_IDENTIFIER HwAgSysArbn.CalibrationPorts.HwAgSysArbnHwAgSlewRate.Val /end CHARACTERISTIC
/begin CHARACTERISTIC HwAgSysArbn.HwAgSysArbnHwAgSnsrlsCorrlnThd.Val "MICROSAR RTE" VALUE 0x0 RTE_RL_FLOAT32_IEEE 0 NO_COMPU_METHOD -3.402823466e+38 3.402823466e+38 SYMBOL_LINK "Rte_CalprmRom_CalRegn01Cmn_DEFAULT_RTE_CALPRM_GROUP.HwAgSysArbnHwAgSnsrlsCorrlnThd_Val" 0 DISPLAY_IDENTIFIER HwAgSysArbn.CalibrationPorts.HwAgSysArbnHwAgSnsrlsCorrlnThd.Val /end CHARACTERISTIC
/begin CHARACTERISTIC HwAgSysArbn.HwAgSysArbnHwAgSnsrlsKineThd.Val "MICROSAR RTE" VALUE 0x0 RTE_RL_FLOAT32_IEEE 0 NO_COMPU_METHOD -3.402823466e+38 3.402823466e+38 SYMBOL_LINK "Rte_CalprmRom_CalRegn01Cmn_DEFAULT_RTE_CALPRM_GROUP.HwAgSysArbnHwAgSnsrlsKineThd_Val" 0 DISPLAY_IDENTIFIER HwAgSysArbn.CalibrationPorts.HwAgSysArbnHwAgSnsrlsKineThd.Val /end CHARACTERISTIC
/begin CHARACTERISTIC HwAgSysArbn.HwAgSysArbnImcHwAgCorrlnRng.Val "MICROSAR RTE" VALUE 0x0 RTE_RL_FLOAT32_IEEE 0 NO_COMPU_METHOD -3.402823466e+38 3.402823466e+38 SYMBOL_LINK "Rte_CalprmRom_CalRegn01Cmn_DEFAULT_RTE_CALPRM_GROUP.HwAgSysArbnImcHwAgCorrlnRng_Val" 0 DISPLAY_IDENTIFIER HwAgSysArbn.CalibrationPorts.HwAgSysArbnImcHwAgCorrlnRng.Val /end CHARACTERISTIC
/begin CHARACTERISTIC HwAgSysArbn.HwAgSysArbnPinionAgConfThd.Val "MICROSAR RTE" VALUE 0x0 RTE_RL_FLOAT32_IEEE 0 NO_COMPU_METHOD -3.402823466e+38 3.402823466e+38 SYMBOL_LINK "Rte_CalprmRom_CalRegn01Cmn_DEFAULT_RTE_CALPRM_GROUP.HwAgSysArbnPinionAgConfThd_Val" 0 DISPLAY_IDENTIFIER HwAgSysArbn.CalibrationPorts.HwAgSysArbnPinionAgConfThd.Val /end CHARACTERISTIC
/begin CHARACTERISTIC HwAgSysArbn.HwAgSysArbnSerlComHwAgCorrdConf.Val "MICROSAR RTE" VALUE 0x0 RTE_RL_FLOAT32_IEEE 0 NO_COMPU_METHOD -3.402823466e+38 3.402823466e+38 SYMBOL_LINK "Rte_CalprmRom_CalRegn01Cmn_DEFAULT_RTE_CALPRM_GROUP.HwAgSysArbnSerlComHwAgCorrdConf_Val" 0 DISPLAY_IDENTIFIER HwAgSysArbn.CalibrationPorts.HwAgSysArbnSerlComHwAgCorrdConf.Val /end CHARACTERISTIC
/begin CHARACTERISTIC HwAgSysArbn.HwAgSysArbnSerlComHwAgSnsrlsConf.Val "MICROSAR RTE" VALUE 0x0 RTE_RL_FLOAT32_IEEE 0 NO_COMPU_METHOD -3.402823466e+38 3.402823466e+38 SYMBOL_LINK "Rte_CalprmRom_CalRegn01Cmn_DEFAULT_RTE_CALPRM_GROUP.HwAgSysArbnSerlComHwAgSnsrlsConf_Val" 0 DISPLAY_IDENTIFIER HwAgSysArbn.CalibrationPorts.HwAgSysArbnSerlComHwAgSnsrlsConf.Val /end CHARACTERISTIC
/begin CHARACTERISTIC HwAgSysArbn.HwAgSysArbnSlewRateTmr.Val "MICROSAR RTE" VALUE 0x0 RTE_RL_FLOAT32_IEEE 0 NO_COMPU_METHOD -3.402823466e+38 3.402823466e+38 SYMBOL_LINK "Rte_CalprmRom_CalRegn01Cmn_DEFAULT_RTE_CALPRM_GROUP.HwAgSysArbnSlewRateTmr_Val" 0 DISPLAY_IDENTIFIER HwAgSysArbn.CalibrationPorts.HwAgSysArbnSlewRateTmr.Val /end CHARACTERISTIC
/begin CHARACTERISTIC HwAgSysArbn.HwAgSysArbnTqSnsrVelFilFrq.Val "MICROSAR RTE" VALUE 0x0 RTE_RL_FLOAT32_IEEE 0 NO_COMPU_METHOD -3.402823466e+38 3.402823466e+38 SYMBOL_LINK "Rte_CalprmRom_CalRegn01Inin00_DEFAULT_RTE_CALPRM_GROUP.HwAgSysArbnTqSnsrVelFilFrq_Val" 0 DISPLAY_IDENTIFIER HwAgSysArbn.CalibrationPorts.HwAgSysArbnTqSnsrVelFilFrq.Val /end CHARACTERISTIC
/begin CHARACTERISTIC HwAgSysArbn.SysGlbPrmSysKineRat.Val "MICROSAR RTE" VALUE 0x0 RTE_RL_FLOAT32_IEEE 0 NO_COMPU_METHOD -3.402823466e+38 3.402823466e+38 SYMBOL_LINK "Rte_CalprmRom_CalRegn02Inin00_DEFAULT_RTE_CALPRM_GROUP.SysGlbPrmSysKineRat_Val" 0 DISPLAY_IDENTIFIER HwAgSysArbn.CalibrationPorts.SysGlbPrmSysKineRat.Val /end CHARACTERISTIC
/begin CHARACTERISTIC HwAgSysArbn.SysGlbPrmTorsBarStfn.Val "MICROSAR RTE" VALUE 0x0 RTE_RL_FLOAT32_IEEE 0 NO_COMPU_METHOD -3.402823466e+38 3.402823466e+38 SYMBOL_LINK "Rte_CalprmRom_CalRegn01Inin00_DEFAULT_RTE_CALPRM_GROUP.SysGlbPrmTorsBarStfn_Val" 0 DISPLAY_IDENTIFIER HwAgSysArbn.CalibrationPorts.SysGlbPrmTorsBarStfn.Val /end CHARACTERISTIC
/begin CHARACTERISTIC HwTqArbn.HwTqArbnHwTqMaxStallCnt.Val "MICROSAR RTE" VALUE 0x0 RTE_RL_UBYTE 0 NO_COMPU_METHOD 0 255 SYMBOL_LINK "Rte_CalprmRom_CalRegn01Cmn_DEFAULT_RTE_CALPRM_GROUP.HwTqArbnHwTqMaxStallCnt_Val" 0 DISPLAY_IDENTIFIER HwTqArbn.CalibrationPorts.HwTqArbnHwTqMaxStallCnt.Val /end CHARACTERISTIC
/begin CHARACTERISTIC HwTqCorrln.HwTqArbnHwTqMaxStallCnt.Val "MICROSAR RTE" VALUE 0x0 RTE_RL_UBYTE 0 NO_COMPU_METHOD 0 255 SYMBOL_LINK "Rte_CalprmRom_CalRegn01Cmn_DEFAULT_RTE_CALPRM_GROUP.HwTqArbnHwTqMaxStallCnt_Val" 0 DISPLAY_IDENTIFIER HwTqCorrln.CalibrationPorts.HwTqArbnHwTqMaxStallCnt.Val /end CHARACTERISTIC
/begin CHARACTERISTIC HwTqCorrln.HwTqCorrlnImdtCorrlnChkFailThd.Val "MICROSAR RTE" VALUE 0x0 RTE_RL_FLOAT32_IEEE 0 NO_COMPU_METHOD -3.402823466e+38 3.402823466e+38 SYMBOL_LINK "Rte_CalprmRom_CalRegn01Cmn_DEFAULT_RTE_CALPRM_GROUP.HwTqCorrlnImdtCorrlnChkFailThd_Val" 0 DISPLAY_IDENTIFIER HwTqCorrln.CalibrationPorts.HwTqCorrlnImdtCorrlnChkFailThd.Val /end CHARACTERISTIC
/begin CHARACTERISTIC HwTqCorrln.HwTqCorrlnNtcFailStep.Val "MICROSAR RTE" VALUE 0x0 RTE_RL_UWORD 0 NO_COMPU_METHOD 0 65535 SYMBOL_LINK "Rte_CalprmRom_CalRegn01Cmn_DEFAULT_RTE_CALPRM_GROUP.HwTqCorrlnNtcFailStep_Val" 0 DISPLAY_IDENTIFIER HwTqCorrln.CalibrationPorts.HwTqCorrlnNtcFailStep.Val /end CHARACTERISTIC
/begin CHARACTERISTIC HwTqCorrln.HwTqCorrlnNtcPassStep.Val "MICROSAR RTE" VALUE 0x0 RTE_RL_UWORD 0 NO_COMPU_METHOD 0 65535 SYMBOL_LINK "Rte_CalprmRom_CalRegn01Cmn_DEFAULT_RTE_CALPRM_GROUP.HwTqCorrlnNtcPassStep_Val" 0 DISPLAY_IDENTIFIER HwTqCorrln.CalibrationPorts.HwTqCorrlnNtcPassStep.Val /end CHARACTERISTIC
/begin CHARACTERISTIC HysCmp.HysCmpAssiCmdLpFilFrq.Val "MICROSAR RTE" VALUE 0x0 RTE_RL_FLOAT32_IEEE 0 NO_COMPU_METHOD -3.402823466e+38 3.402823466e+38 SYMBOL_LINK "Rte_CalprmRom_CalRegn02Inin00GroupA_DEFAULT_RTE_CALPRM_GROUP.HysCmpAssiCmdLpFilFrq_Val" 0 DISPLAY_IDENTIFIER HysCmp.CalibrationPorts.HysCmpAssiCmdLpFilFrq.Val /end CHARACTERISTIC
/begin CHARACTERISTIC HysCmp.HysCmpAssiInpLim.Val "MICROSAR RTE" VALUE 0x0 RTE_RL_UWORD 0 NO_COMPU_METHOD 0 65535 SYMBOL_LINK "Rte_CalprmRom_CalRegn02Inin00GroupA_DEFAULT_RTE_CALPRM_GROUP.HysCmpAssiInpLim_Val" 0 DISPLAY_IDENTIFIER HysCmp.CalibrationPorts.HysCmpAssiInpLim.Val /end CHARACTERISTIC
/begin CHARACTERISTIC HysCmp.HysCmpEffLossY.Ary1D "MICROSAR RTE" VAL_BLK 0x0 RTE_RL_UWORD 0 NO_COMPU_METHOD 0 65535 MATRIX_DIM 12 1 1 SYMBOL_LINK "Rte_CalprmRom_CalRegn02Rt00GroupA_DEFAULT_RTE_CALPRM_GROUP.HysCmpEffLossY_Ary1D" 0 DISPLAY_IDENTIFIER HysCmp.CalibrationPorts.HysCmpEffLossY.Ary1D /end CHARACTERISTIC
/begin MEASUREMENT HwAg1Meas.HwAg1Offs.OffsTrim "MICROSAR RTE" FLOAT32_IEEE NO_COMPU_METHOD 0 0 -3.402823466e+38 3.402823466e+38 ECU_ADDRESS 0 SYMBOL_LINK "Rte_HwAg1Meas_HwAg1Offs.OffsTrim" 0 DISPLAY_IDENTIFIER HwAg1Meas.PerInstanceMemories.HwAg1Offs.OffsTrim /end MEASUREMENT
/begin MEASUREMENT HwAg1Meas.HwAg1Offs.OffsTrimPrfmdSts "MICROSAR RTE" UBYTE RTE_CM_BOOLEAN 0 0 0 255 ECU_ADDRESS 0 SYMBOL_LINK "Rte_HwAg1Meas_HwAg1Offs.OffsTrimPrfmdSts" 0 DISPLAY_IDENTIFIER HwAg1Meas.PerInstanceMemories.HwAg1Offs.OffsTrimPrfmdSts /end MEASUREMENT
/begin MEASUREMENT HwAg1Meas.HwAg1Polarity.Val "MICROSAR RTE" SBYTE NO_COMPU_METHOD 0 0 -128 127 ECU_ADDRESS 0 SYMBOL_LINK "Rte_PolarityCfg_HwAg1Polarity_Val" 0 DISPLAY_IDENTIFIER HwAg1Meas.ReceiverPorts.HwAg1Polarity.Val /end MEASUREMENT
/begin MEASUREMENT HwAg1Meas.HwAg1PrevHwAg1 "MICROSAR RTE" FLOAT32_IEEE NO_COMPU_METHOD 0 0 -3.402823466e+38 3.402823466e+38 ECU_ADDRESS 0 SYMBOL_LINK "Rte_HwAg1Meas_HwAg1PrevHwAg1" 0 DISPLAY_IDENTIFIER HwAg1Meas.PerInstanceMemories.HwAg1PrevHwAg1 /end MEASUREMENT
/begin MEASUREMENT HwAg1Meas.HwAg1PrevRollCnt "MICROSAR RTE" UBYTE NO_COMPU_METHOD 0 0 0 255 ECU_ADDRESS 0 SYMBOL_LINK "Rte_HwAg1Meas_HwAg1PrevRollCnt" 0 DISPLAY_IDENTIFIER HwAg1Meas.PerInstanceMemories.HwAg1PrevRollCnt /end MEASUREMENT
/begin MEASUREMENT HwAg1Meas.HwAg1PrevStepSeqNr "MICROSAR RTE" UBYTE NO_COMPU_METHOD 0 0 0 255 ECU_ADDRESS 0 SYMBOL_LINK "Rte_HwAg1Meas_HwAg1PrevStepSeqNr" 0 DISPLAY_IDENTIFIER HwAg1Meas.PerInstanceMemories.HwAg1PrevStepSeqNr /end MEASUREMENT
/begin MEASUREMENT HwAg1Meas.HwAg1Qlfr.Val "MICROSAR RTE" UBYTE RTE_CM_ENUM_SigQlfr1 0 0 0 255 ECU_ADDRESS 0 SYMBOL_LINK "Rte_HwAg1Meas_HwAg1Qlfr_Val" 0 DISPLAY_IDENTIFIER HwAg1Meas.SenderPorts.HwAg1Qlfr.Val /end MEASUREMENT
/begin MEASUREMENT HwAg1Meas.HwAg1RawDataAvlStrtTi "MICROSAR RTE" ULONG NO_COMPU_METHOD 0 0 0 4294967295 ECU_ADDRESS 0 SYMBOL_LINK "Rte_HwAg1Meas_HwAg1RawDataAvlStrtTi" 0 DISPLAY_IDENTIFIER HwAg1Meas.PerInstanceMemories.HwAg1RawDataAvlStrtTi /end MEASUREMENT
/begin MEASUREMENT HwAg1Meas.HwAg1RollgCntr.Val "MICROSAR RTE" UBYTE NO_COMPU_METHOD 0 0 0 255 ECU_ADDRESS 0 SYMBOL_LINK "Rte_HwAg1Meas_HwAg1RollgCntr_Val" 0 DISPLAY_IDENTIFIER HwAg1Meas.SenderPorts.HwAg1RollgCntr.Val /end MEASUREMENT
/begin MEASUREMENT HwAg1Meas.HwAg1Snsr0ComStsErrCntr "MICROSAR RTE" UBYTE NO_COMPU_METHOD 0 0 0 255 ECU_ADDRESS 0 SYMBOL_LINK "Rte_HwAg1Meas_HwAg1Snsr0ComStsErrCntr" 0 DISPLAY_IDENTIFIER HwAg1Meas.PerInstanceMemories.HwAg1Snsr0ComStsErrCntr /end MEASUREMENT
/begin MEASUREMENT HwAg1Meas.HwAg1Snsr0IdErrCntr "MICROSAR RTE" UBYTE NO_COMPU_METHOD 0 0 0 255 ECU_ADDRESS 0 SYMBOL_LINK "Rte_HwAg1Meas_HwAg1Snsr0IdErrCntr" 0 DISPLAY_IDENTIFIER HwAg1Meas.PerInstanceMemories.HwAg1Snsr0IdErrCntr /end MEASUREMENT
/begin MEASUREMENT HwAg1Meas.HwAg1Snsr0IntSnsrErrCntr "MICROSAR RTE" UBYTE NO_COMPU_METHOD 0 0 0 255 ECU_ADDRESS 0 SYMBOL_LINK "Rte_HwAg1Meas_HwAg1Snsr0IntSnsrErrCntr" 0 DISPLAY_IDENTIFIER HwAg1Meas.PerInstanceMemories.HwAg1Snsr0IntSnsrErrCntr /end MEASUREMENT
/begin MEASUREMENT HwAg1Meas.HwAg1Snsr0NoMsgErrCntr "MICROSAR RTE" UBYTE NO_COMPU_METHOD 0 0 0 255 ECU_ADDRESS 0 SYMBOL_LINK "Rte_HwAg1Meas_HwAg1Snsr0NoMsgErrCntr" 0 DISPLAY_IDENTIFIER HwAg1Meas.PerInstanceMemories.HwAg1Snsr0NoMsgErrCntr /end MEASUREMENT
/begin MEASUREMENT HwAg1Meas.HwAg1Snsr1ComStsErrCntr "MICROSAR RTE" UBYTE NO_COMPU_METHOD 0 0 0 255 ECU_ADDRESS 0 SYMBOL_LINK "Rte_HwAg1Meas_HwAg1Snsr1ComStsErrCntr" 0 DISPLAY_IDENTIFIER HwAg1Meas.PerInstanceMemories.HwAg1Snsr1ComStsErrCntr /end MEASUREMENT
/begin MEASUREMENT HwAg1Meas.HwAg1Snsr1IdErrCntr "MICROSAR RTE" UBYTE NO_COMPU_METHOD 0 0 0 255 ECU_ADDRESS 0 SYMBOL_LINK "Rte_HwAg1Meas_HwAg1Snsr1IdErrCntr" 0 DISPLAY_IDENTIFIER HwAg1Meas.PerInstanceMemories.HwAg1Snsr1IdErrCntr /end MEASUREMENT
/begin MEASUREMENT HwAg1Meas.HwAg1Snsr1IntSnsrErrCntr "MICROSAR RTE" UBYTE NO_COMPU_METHOD 0 0 0 255 ECU_ADDRESS 0 SYMBOL_LINK "Rte_HwAg1Meas_HwAg1Snsr1IntSnsrErrCntr" 0 DISPLAY_IDENTIFIER HwAg1Meas.PerInstanceMemories.HwAg1Snsr1IntSnsrErrCntr /end MEASUREMENT
/begin MEASUREMENT HwAg1Meas.HwAg1Snsr1NoMsgErrCntr "MICROSAR RTE" UBYTE NO_COMPU_METHOD 0 0 0 255 ECU_ADDRESS 0 SYMBOL_LINK "Rte_HwAg1Meas_HwAg1Snsr1NoMsgErrCntr" 0 DISPLAY_IDENTIFIER HwAg1Meas.PerInstanceMemories.HwAg1Snsr1NoMsgErrCntr /end MEASUREMENT
/begin MEASUREMENT HwAg1Meas.HwAg1SnsrTrigNr "MICROSAR RTE" UBYTE NO_COMPU_METHOD 0 0 0 255 ECU_ADDRESS 0 SYMBOL_LINK "Rte_HwAg1Meas_HwAg1SnsrTrigNr" 0 DISPLAY_IDENTIFIER HwAg1Meas.PerInstanceMemories.HwAg1SnsrTrigNr /end MEASUREMENT
/begin MEASUREMENT HwAg1Meas.HwAg1SnsrTyp.Val "MICROSAR RTE" UBYTE RTE_CM_ENUM_HwAgSnsrTyp1 0 0 0 255 ECU_ADDRESS 0 SYMBOL_LINK "Rte_CDD_FordT3T6McuCfg_HwAg1SnsrTyp_Val" 0 DISPLAY_IDENTIFIER HwAg1Meas.ReceiverPorts.HwAg1SnsrTyp.Val /end MEASUREMENT
/begin MEASUREMENT HwAg1Meas.PrevHwAg1 "MICROSAR RTE" FLOAT32_IEEE NO_COMPU_METHOD 0 0 -3.402823466e+38 3.402823466e+38 ECU_ADDRESS 0 SYMBOL_LINK "Rte_HwAg1Meas_PrevHwAg1" 0 DISPLAY_IDENTIFIER HwAg1Meas.PerInstanceMemories.PrevHwAg1 /end MEASUREMENT
/begin MEASUREMENT HwAg1Meas.PrevHwAg1Qlfr "MICROSAR RTE" UBYTE RTE_CM_ENUM_SigQlfr1 0 0 0 255 ECU_ADDRESS 0 SYMBOL_LINK "Rte_HwAg1Meas_PrevHwAg1Qlfr" 0 DISPLAY_IDENTIFIER HwAg1Meas.PerInstanceMemories.PrevHwAg1Qlfr /end MEASUREMENT
/begin MEASUREMENT HwAg1Meas.PrevHwAg1Snsr0Raw "MICROSAR RTE" UWORD NO_COMPU_METHOD 0 0 0 65535 ECU_ADDRESS 0 SYMBOL_LINK "Rte_HwAg1Meas_PrevHwAg1Snsr0Raw" 0 DISPLAY_IDENTIFIER HwAg1Meas.PerInstanceMemories.PrevHwAg1Snsr0Raw /end MEASUREMENT
/begin MEASUREMENT HwAg1Meas.PrevHwAg1Snsr0TestOk "MICROSAR RTE" UBYTE NO_COMPU_METHOD 0 0 0 255 ECU_ADDRESS 0 SYMBOL_LINK "Rte_HwAg1Meas_PrevHwAg1Snsr0TestOk" 0 DISPLAY_IDENTIFIER HwAg1Meas.PerInstanceMemories.PrevHwAg1Snsr0TestOk /end MEASUREMENT
/begin MEASUREMENT HwAg1Meas.PrevHwAg1Snsr1Raw "MICROSAR RTE" UWORD NO_COMPU_METHOD 0 0 0 65535 ECU_ADDRESS 0 SYMBOL_LINK "Rte_HwAg1Meas_PrevHwAg1Snsr1Raw" 0 DISPLAY_IDENTIFIER HwAg1Meas.PerInstanceMemories.PrevHwAg1Snsr1Raw /end MEASUREMENT
/begin MEASUREMENT HwAg1Meas.PrevHwAg1Snsr1TestOk "MICROSAR RTE" UBYTE NO_COMPU_METHOD 0 0 0 255 ECU_ADDRESS 0 SYMBOL_LINK "Rte_HwAg1Meas_PrevHwAg1Snsr1TestOk" 0 DISPLAY_IDENTIFIER HwAg1Meas.PerInstanceMemories.PrevHwAg1Snsr1TestOk /end MEASUREMENT
/begin MEASUREMENT HwAg1Meas.dHwAg1MeasSnsr0Abs "MICROSAR RTE" FLOAT32_IEEE NO_COMPU_METHOD 0 0 -3.402823466e+38 3.402823466e+38 ECU_ADDRESS 0 SYMBOL_LINK "Rte_HwAg1Meas_dHwAg1MeasSnsr0Abs" 0 DISPLAY_IDENTIFIER HwAg1Meas.PerInstanceMemories.dHwAg1MeasSnsr0Abs /end MEASUREMENT
/begin MEASUREMENT HwAg1Meas.dHwAg1MeasSnsr0CS "MICROSAR RTE" ULONG NO_COMPU_METHOD 0 0 0 4294967295 ECU_ADDRESS 0 SYMBOL_LINK "Rte_HwAg1Meas_dHwAg1MeasSnsr0CS" 0 DISPLAY_IDENTIFIER HwAg1Meas.PerInstanceMemories.dHwAg1MeasSnsr0CS /end MEASUREMENT
/begin MEASUREMENT HwAg1Meas.dHwAg1MeasSnsr0FRXD "MICROSAR RTE" ULONG NO_COMPU_METHOD 0 0 0 4294967295 ECU_ADDRESS 0 SYMBOL_LINK "Rte_HwAg1Meas_dHwAg1MeasSnsr0FRXD" 0 DISPLAY_IDENTIFIER HwAg1Meas.PerInstanceMemories.dHwAg1MeasSnsr0FRXD /end MEASUREMENT
/begin MEASUREMENT HwAg1Meas.dHwAg1MeasSnsr0Rel "MICROSAR RTE" FLOAT32_IEEE NO_COMPU_METHOD 0 0 -3.402823466e+38 3.402823466e+38 ECU_ADDRESS 0 SYMBOL_LINK "Rte_HwAg1Meas_dHwAg1MeasSnsr0Rel" 0 DISPLAY_IDENTIFIER HwAg1Meas.PerInstanceMemories.dHwAg1MeasSnsr0Rel /end MEASUREMENT
/begin MEASUREMENT HwAg1Meas.dHwAg1MeasSnsr1Abs "MICROSAR RTE" FLOAT32_IEEE NO_COMPU_METHOD 0 0 -3.402823466e+38 3.402823466e+38 ECU_ADDRESS 0 SYMBOL_LINK "Rte_HwAg1Meas_dHwAg1MeasSnsr1Abs" 0 DISPLAY_IDENTIFIER HwAg1Meas.PerInstanceMemories.dHwAg1MeasSnsr1Abs /end MEASUREMENT
/begin MEASUREMENT HwAg1Meas.dHwAg1MeasSnsr1CS "MICROSAR RTE" ULONG NO_COMPU_METHOD 0 0 0 4294967295 ECU_ADDRESS 0 SYMBOL_LINK "Rte_HwAg1Meas_dHwAg1MeasSnsr1CS" 0 DISPLAY_IDENTIFIER HwAg1Meas.PerInstanceMemories.dHwAg1MeasSnsr1CS /end MEASUREMENT
/begin MEASUREMENT HwAg1Meas.dHwAg1MeasSnsr1FRXD "MICROSAR RTE" ULONG NO_COMPU_METHOD 0 0 0 4294967295 ECU_ADDRESS 0 SYMBOL_LINK "Rte_HwAg1Meas_dHwAg1MeasSnsr1FRXD" 0 DISPLAY_IDENTIFIER HwAg1Meas.PerInstanceMemories.dHwAg1MeasSnsr1FRXD /end MEASUREMENT
/begin MEASUREMENT HwAg1Meas.dHwAg1MeasSnsr1Rel "MICROSAR RTE" FLOAT32_IEEE NO_COMPU_METHOD 0 0 -3.402823466e+38 3.402823466e+38 ECU_ADDRESS 0 SYMBOL_LINK "Rte_HwAg1Meas_dHwAg1MeasSnsr1Rel" 0 DISPLAY_IDENTIFIER HwAg1Meas.PerInstanceMemories.dHwAg1MeasSnsr1Rel /end MEASUREMENT
/begin MEASUREMENT HwAgArbn.HwAg.Val "MICROSAR RTE" FLOAT32_IEEE NO_COMPU_METHOD 0 0 -3.402823466e+38 3.402823466e+38 ECU_ADDRESS 0 SYMBOL_LINK "Rte_HwAgArbn_HwAg_Val" 0 DISPLAY_IDENTIFIER HwAgArbn.SenderPorts.HwAg.Val /end MEASUREMENT
/begin MEASUREMENT HwAgArbn.HwAgA.Val "MICROSAR RTE" FLOAT32_IEEE NO_COMPU_METHOD 0 0 -3.402823466e+38 3.402823466e+38 ECU_ADDRESS 0 SYMBOL_LINK "Rte_HwAg1Meas_HwAg1_Val" 0 DISPLAY_IDENTIFIER HwAgArbn.ReceiverPorts.HwAgA.Val /end MEASUREMENT
/begin MEASUREMENT HwAgArbn.HwAgAQlfr.Val "MICROSAR RTE" UBYTE RTE_CM_ENUM_SigQlfr1 0 0 0 255 ECU_ADDRESS 0 SYMBOL_LINK "Rte_HwAg1Meas_HwAg1Qlfr_Val" 0 DISPLAY_IDENTIFIER HwAgArbn.ReceiverPorts.HwAgAQlfr.Val /end MEASUREMENT
/begin MEASUREMENT HwAgArbn.HwAgARollgCntr.Val "MICROSAR RTE" UBYTE NO_COMPU_METHOD 0 0 0 255 ECU_ADDRESS 0 SYMBOL_LINK "Rte_HwAg1Meas_HwAg1RollgCntr_Val" 0 DISPLAY_IDENTIFIER HwAgArbn.ReceiverPorts.HwAgARollgCntr.Val /end MEASUREMENT
/begin MEASUREMENT HwAgArbn.HwAgARollgCntrPrev "MICROSAR RTE" UBYTE NO_COMPU_METHOD 0 0 0 255 ECU_ADDRESS 0 SYMBOL_LINK "Rte_HwAgArbn_HwAgARollgCntrPrev" 0 DISPLAY_IDENTIFIER HwAgArbn.PerInstanceMemories.HwAgARollgCntrPrev /end MEASUREMENT
/begin MEASUREMENT HwAgArbn.HwAgAStallCntrPrev "MICROSAR RTE" UBYTE NO_COMPU_METHOD 0 0 0 255 ECU_ADDRESS 0 SYMBOL_LINK "Rte_HwAgArbn_HwAgAStallCntrPrev" 0 DISPLAY_IDENTIFIER HwAgArbn.PerInstanceMemories.HwAgAStallCntrPrev /end MEASUREMENT
/begin MEASUREMENT HwAgArbn.HwAgCorrlnSt.Val "MICROSAR RTE" UBYTE NO_COMPU_METHOD 0 0 0 255 ECU_ADDRESS 0 SYMBOL_LINK "Rte_HwAgCorrln_HwAgCorrlnSt_Val" 0 DISPLAY_IDENTIFIER HwAgArbn.ReceiverPorts.HwAgCorrlnSt.Val /end MEASUREMENT
/begin MEASUREMENT HwAgArbn.HwAgPrev "MICROSAR RTE" FLOAT32_IEEE NO_COMPU_METHOD 0 0 -3.402823466e+38 3.402823466e+38 ECU_ADDRESS 0 SYMBOL_LINK "Rte_HwAgArbn_HwAgPrev" 0 DISPLAY_IDENTIFIER HwAgArbn.PerInstanceMemories.HwAgPrev /end MEASUREMENT
/begin MEASUREMENT HwAgArbn.dHwAgArbnAgAAvl "MICROSAR RTE" UBYTE RTE_CM_BOOLEAN 0 0 0 255 ECU_ADDRESS 0 SYMBOL_LINK "Rte_HwAgArbn_dHwAgArbnAgAAvl" 0 DISPLAY_IDENTIFIER HwAgArbn.PerInstanceMemories.dHwAgArbnAgAAvl /end MEASUREMENT
/begin MEASUREMENT HwAgCorrln.HwAgAQlfr.Val "MICROSAR RTE" UBYTE RTE_CM_ENUM_SigQlfr1 0 0 0 255 ECU_ADDRESS 0 SYMBOL_LINK "Rte_HwAg1Meas_HwAg1Qlfr_Val" 0 DISPLAY_IDENTIFIER HwAgCorrln.ReceiverPorts.HwAgAQlfr.Val /end MEASUREMENT
/begin MEASUREMENT HwAgCorrln.HwAgARollgCntPrev "MICROSAR RTE" UBYTE NO_COMPU_METHOD 0 0 0 255 ECU_ADDRESS 0 SYMBOL_LINK "Rte_HwAgCorrln_HwAgARollgCntPrev" 0 DISPLAY_IDENTIFIER HwAgCorrln.PerInstanceMemories.HwAgARollgCntPrev /end MEASUREMENT
/begin MEASUREMENT HwAgCorrln.HwAgARollgCntr.Val "MICROSAR RTE" UBYTE NO_COMPU_METHOD 0 0 0 255 ECU_ADDRESS 0 SYMBOL_LINK "Rte_HwAg1Meas_HwAg1RollgCntr_Val" 0 DISPLAY_IDENTIFIER HwAgCorrln.ReceiverPorts.HwAgARollgCntr.Val /end MEASUREMENT
/begin MEASUREMENT HwAgCorrln.HwAgAStallCntPrev "MICROSAR RTE" UBYTE NO_COMPU_METHOD 0 0 0 255 ECU_ADDRESS 0 SYMBOL_LINK "Rte_HwAgCorrln_HwAgAStallCntPrev" 0 DISPLAY_IDENTIFIER HwAgCorrln.PerInstanceMemories.HwAgAStallCntPrev /end MEASUREMENT
/begin MEASUREMENT HwAgCorrln.HwAgCorrlnSt.Val "MICROSAR RTE" UBYTE NO_COMPU_METHOD 0 0 0 255 ECU_ADDRESS 0 SYMBOL_LINK "Rte_HwAgCorrln_HwAgCorrlnSt_Val" 0 DISPLAY_IDENTIFIER HwAgCorrln.SenderPorts.HwAgCorrlnSt.Val /end MEASUREMENT
/begin MEASUREMENT HwAgCorrln.HwAgIdptSig.Val "MICROSAR RTE" UBYTE NO_COMPU_METHOD 0 0 0 255 ECU_ADDRESS 0 SYMBOL_LINK "Rte_HwAgCorrln_HwAgIdptSig_Val" 0 DISPLAY_IDENTIFIER HwAgCorrln.SenderPorts.HwAgIdptSig.Val /end MEASUREMENT
/begin MEASUREMENT HwAgCorrln.dHwAgCorrlnAgAAvl "MICROSAR RTE" UBYTE RTE_CM_BOOLEAN 0 0 0 255 ECU_ADDRESS 0 SYMBOL_LINK "Rte_HwAgCorrln_dHwAgCorrlnAgAAvl" 0 DISPLAY_IDENTIFIER HwAgCorrln.PerInstanceMemories.dHwAgCorrlnAgAAvl /end MEASUREMENT
/begin MEASUREMENT HwAgSnsrls.CmplncErrMotToPinion.Val "MICROSAR RTE" FLOAT32_IEEE NO_COMPU_METHOD 0 0 -3.402823466e+38 3.402823466e+38 ECU_ADDRESS 0 SYMBOL_LINK "Rte_CmplncErr_CmplncErrMotToPinion_Val" 0 DISPLAY_IDENTIFIER HwAgSnsrls.ReceiverPorts.CmplncErrMotToPinion.Val /end MEASUREMENT
/begin MEASUREMENT HwAgSnsrls.CorrdPinionAgHwAgOffs "MICROSAR RTE" FLOAT32_IEEE NO_COMPU_METHOD 0 0 -3.402823466e+38 3.402823466e+38 ECU_ADDRESS 0 SYMBOL_LINK "Rte_HwAgSnsrls_CorrdPinionAgHwAgOffs" 0 DISPLAY_IDENTIFIER HwAgSnsrls.PerInstanceMemories.CorrdPinionAgHwAgOffs /end MEASUREMENT
/begin MEASUREMENT HwAgSnsrls.CorrdPinionAgHwConf "MICROSAR RTE" FLOAT32_IEEE NO_COMPU_METHOD 0 0 -3.402823466e+38 3.402823466e+38 ECU_ADDRESS 0 SYMBOL_LINK "Rte_HwAgSnsrls_CorrdPinionAgHwConf" 0 DISPLAY_IDENTIFIER HwAgSnsrls.PerInstanceMemories.CorrdPinionAgHwConf /end MEASUREMENT
/begin MEASUREMENT HwAgSnsrls.EcuId.Val "MICROSAR RTE" UBYTE NO_COMPU_METHOD 0 0 0 255 ECU_ADDRESS 0 SYMBOL_LINK "Rte_DualEcuIdn_EcuId_Val" 0 DISPLAY_IDENTIFIER HwAgSnsrls.ReceiverPorts.EcuId.Val /end MEASUREMENT
/begin MEASUREMENT HwAgSnsrls.FCentrHwAgEna "MICROSAR RTE" UBYTE RTE_CM_BOOLEAN 0 0 0 255 ECU_ADDRESS 0 SYMBOL_LINK "Rte_HwAgSnsrls_FCentrHwAgEna" 0 DISPLAY_IDENTIFIER HwAgSnsrls.PerInstanceMemories.FCentrHwAgEna /end MEASUREMENT
/begin MEASUREMENT HwAgSnsrls.FCentrHwAgOffs "MICROSAR RTE" FLOAT32_IEEE NO_COMPU_METHOD 0 0 -3.402823466e+38 3.402823466e+38 ECU_ADDRESS 0 SYMBOL_LINK "Rte_HwAgSnsrls_FCentrHwAgOffs" 0 DISPLAY_IDENTIFIER HwAgSnsrls.PerInstanceMemories.FCentrHwAgOffs /end MEASUREMENT
/begin MEASUREMENT HwAgSnsrls.FCentrHwConf "MICROSAR RTE" FLOAT32_IEEE NO_COMPU_METHOD 0 0 -3.402823466e+38 3.402823466e+38 ECU_ADDRESS 0 SYMBOL_LINK "Rte_HwAgSnsrls_FCentrHwConf" 0 DISPLAY_IDENTIFIER HwAgSnsrls.PerInstanceMemories.FCentrHwConf /end MEASUREMENT
/begin MEASUREMENT HwAgSnsrls.HwAgSnsrls.Val "MICROSAR RTE" FLOAT32_IEEE NO_COMPU_METHOD 0 0 -3.402823466e+38 3.402823466e+38 ECU_ADDRESS 0 SYMBOL_LINK "Rte_HwAgSnsrls_HwAgSnsrls_Val" 0 DISPLAY_IDENTIFIER HwAgSnsrls.SenderPorts.HwAgSnsrls.Val /end MEASUREMENT
/begin MEASUREMENT HwAgSnsrls.HwAgSnsrlsConf.Val "MICROSAR RTE" FLOAT32_IEEE NO_COMPU_METHOD 0 0 -3.402823466e+38 3.402823466e+38 ECU_ADDRESS 0 SYMBOL_LINK "Rte_HwAgSnsrls_HwAgSnsrlsConf_Val" 0 DISPLAY_IDENTIFIER HwAgSnsrls.SenderPorts.HwAgSnsrlsConf.Val /end MEASUREMENT
/begin MEASUREMENT HwAgSnsrls.HwTq.Val "MICROSAR RTE" FLOAT32_IEEE NO_COMPU_METHOD 0 0 -3.402823466e+38 3.402823466e+38 ECU_ADDRESS 0 SYMBOL_LINK "Rte_ImcSigArbn_HwTqImcCorrd_Val" 0 DISPLAY_IDENTIFIER HwAgSnsrls.ReceiverPorts.HwTq.Val /end MEASUREMENT
/begin MEASUREMENT HwAgSnsrls.MotAgCumvAlgndCrf.Val "MICROSAR RTE" SLONG NO_COMPU_METHOD 0 0 -2147483648 2147483647 ECU_ADDRESS 0 SYMBOL_LINK "Rte_CDD_MotAgCmp_MotAgCumvAlgndCrf_Val" 0 DISPLAY_IDENTIFIER HwAgSnsrls.ReceiverPorts.MotAgCumvAlgndCrf.Val /end MEASUREMENT
/begin MEASUREMENT HwAgSnsrls.MotAgCumvAlgndVld.Logl "MICROSAR RTE" UBYTE RTE_CM_BOOLEAN 0 0 0 255 ECU_ADDRESS 0 SYMBOL_LINK "Rte_CDD_MotAgCmp_MotAgCumvAlgndVld_Logl" 0 DISPLAY_IDENTIFIER HwAgSnsrls.ReceiverPorts.MotAgCumvAlgndVld.Logl /end MEASUREMENT
/begin MEASUREMENT HwAgSnsrls.MotAgMeclIdptSig.Val "MICROSAR RTE" UBYTE NO_COMPU_METHOD 0 0 0 255 ECU_ADDRESS 0 SYMBOL_LINK "Rte_MotAgCorrln_MotAgMeclIdptSig_Val" 0 DISPLAY_IDENTIFIER HwAgSnsrls.ReceiverPorts.MotAgMeclIdptSig.Val /end MEASUREMENT
/begin MEASUREMENT HwAgSnsrls.MotAgOffs "MICROSAR RTE" FLOAT32_IEEE NO_COMPU_METHOD 0 0 -3.402823466e+38 3.402823466e+38 ECU_ADDRESS 0 SYMBOL_LINK "Rte_HwAgSnsrls_MotAgOffs" 0 DISPLAY_IDENTIFIER HwAgSnsrls.PerInstanceMemories.MotAgOffs /end MEASUREMENT
/begin MEASUREMENT HwAgSnsrls.MotAgOffsEna "MICROSAR RTE" UBYTE RTE_CM_BOOLEAN 0 0 0 255 ECU_ADDRESS 0 SYMBOL_LINK "Rte_HwAgSnsrls_MotAgOffsEna" 0 DISPLAY_IDENTIFIER HwAgSnsrls.PerInstanceMemories.MotAgOffsEna /end MEASUREMENT
/begin MEASUREMENT HwAgSnsrls.MotTqCmdCrf.Val "MICROSAR RTE" FLOAT32_IEEE NO_COMPU_METHOD 0 0 -3.402823466e+38 3.402823466e+38 ECU_ADDRESS 0 SYMBOL_LINK "Rte_MotTqTranlDampg_MotTqCmdCrfDampd_Val" 0 DISPLAY_IDENTIFIER HwAgSnsrls.ReceiverPorts.MotTqCmdCrf.Val /end MEASUREMENT
/begin MEASUREMENT HwAgSnsrls.MotVelCrf.Val "MICROSAR RTE" FLOAT32_IEEE NO_COMPU_METHOD 0 0 -3.402823466e+38 3.402823466e+38 ECU_ADDRESS 0 SYMBOL_LINK "Rte_ImcSigArbn_MotVelCrfImcCorrd_Val" 0 DISPLAY_IDENTIFIER HwAgSnsrls.ReceiverPorts.MotVelCrf.Val /end MEASUREMENT
/begin MEASUREMENT HwAgSnsrls.PinionAg.Val "MICROSAR RTE" FLOAT32_IEEE NO_COMPU_METHOD 0 0 -3.402823466e+38 3.402823466e+38 ECU_ADDRESS 0 SYMBOL_LINK "Rte_HwAgSysArbn_PinionAg_Val" 0 DISPLAY_IDENTIFIER HwAgSnsrls.ReceiverPorts.PinionAg.Val /end MEASUREMENT
/begin MEASUREMENT HwAgSnsrls.PinionAgConf.Val "MICROSAR RTE" FLOAT32_IEEE NO_COMPU_METHOD 0 0 -3.402823466e+38 3.402823466e+38 ECU_ADDRESS 0 SYMBOL_LINK "Rte_HwAgSysArbn_PinionAgConf_Val" 0 DISPLAY_IDENTIFIER HwAgSnsrls.ReceiverPorts.PinionAgConf.Val /end MEASUREMENT
/begin MEASUREMENT HwAgSnsrls.PinionTqFil.FilGain "MICROSAR RTE" FLOAT32_IEEE NO_COMPU_METHOD 0 0 -3.402823466e+38 3.402823466e+38 ECU_ADDRESS 0 SYMBOL_LINK "Rte_HwAgSnsrls_PinionTqFil.FilGain" 0 DISPLAY_IDENTIFIER HwAgSnsrls.PerInstanceMemories.PinionTqFil.FilGain /end MEASUREMENT
/begin MEASUREMENT HwAgSnsrls.PinionTqFil.FilSt "MICROSAR RTE" FLOAT32_IEEE NO_COMPU_METHOD 0 0 -3.402823466e+38 3.402823466e+38 ECU_ADDRESS 0 SYMBOL_LINK "Rte_HwAgSnsrls_PinionTqFil.FilSt" 0 DISPLAY_IDENTIFIER HwAgSnsrls.PerInstanceMemories.PinionTqFil.FilSt /end MEASUREMENT
/begin MEASUREMENT HwAgSnsrls.PrevFildRelHwAg1 "MICROSAR RTE" FLOAT32_IEEE NO_COMPU_METHOD 0 0 -3.402823466e+38 3.402823466e+38 ECU_ADDRESS 0 SYMBOL_LINK "Rte_HwAgSnsrls_PrevFildRelHwAg1" 0 DISPLAY_IDENTIFIER HwAgSnsrls.PerInstanceMemories.PrevFildRelHwAg1 /end MEASUREMENT
/begin MEASUREMENT HwAgSnsrls.PrevHwAgOffs "MICROSAR RTE" FLOAT32_IEEE NO_COMPU_METHOD 0 0 -3.402823466e+38 3.402823466e+38 ECU_ADDRESS 0 SYMBOL_LINK "Rte_HwAgSnsrls_PrevHwAgOffs" 0 DISPLAY_IDENTIFIER HwAgSnsrls.PerInstanceMemories.PrevHwAgOffs /end MEASUREMENT
/begin MEASUREMENT HwAgSnsrls.PrevMaxHwConf "MICROSAR RTE" FLOAT32_IEEE NO_COMPU_METHOD 0 0 -3.402823466e+38 3.402823466e+38 ECU_ADDRESS 0 SYMBOL_LINK "Rte_HwAgSnsrls_PrevMaxHwConf" 0 DISPLAY_IDENTIFIER HwAgSnsrls.PerInstanceMemories.PrevMaxHwConf /end MEASUREMENT
/begin MEASUREMENT HwAgSnsrls.PrevSmotngHwAg "MICROSAR RTE" FLOAT32_IEEE NO_COMPU_METHOD 0 0 -3.402823466e+38 3.402823466e+38 ECU_ADDRESS 0 SYMBOL_LINK "Rte_HwAgSnsrls_PrevSmotngHwAg" 0 DISPLAY_IDENTIFIER HwAgSnsrls.PerInstanceMemories.PrevSmotngHwAg /end MEASUREMENT
/begin MEASUREMENT HwAgSnsrls.PrevSmotngSt "MICROSAR RTE" UBYTE RTE_CM_BOOLEAN 0 0 0 255 ECU_ADDRESS 0 SYMBOL_LINK "Rte_HwAgSnsrls_PrevSmotngSt" 0 DISPLAY_IDENTIFIER HwAgSnsrls.PerInstanceMemories.PrevSmotngSt /end MEASUREMENT
/begin MEASUREMENT HwAgSnsrls.PrevVehDynFil1Ena "MICROSAR RTE" UBYTE RTE_CM_BOOLEAN 0 0 0 255 ECU_ADDRESS 0 SYMBOL_LINK "Rte_HwAgSnsrls_PrevVehDynFil1Ena" 0 DISPLAY_IDENTIFIER HwAgSnsrls.PerInstanceMemories.PrevVehDynFil1Ena /end MEASUREMENT
/begin MEASUREMENT HwAgSnsrls.PrevVehDynFil2Ena "MICROSAR RTE" UBYTE RTE_CM_BOOLEAN 0 0 0 255 ECU_ADDRESS 0 SYMBOL_LINK "Rte_HwAgSnsrls_PrevVehDynFil2Ena" 0 DISPLAY_IDENTIFIER HwAgSnsrls.PerInstanceMemories.PrevVehDynFil2Ena /end MEASUREMENT
/begin MEASUREMENT HwAgSnsrls.RelHwAgFil1.FilGain "MICROSAR RTE" FLOAT32_IEEE NO_COMPU_METHOD 0 0 -3.402823466e+38 3.402823466e+38 ECU_ADDRESS 0 SYMBOL_LINK "Rte_HwAgSnsrls_RelHwAgFil1.FilGain" 0 DISPLAY_IDENTIFIER HwAgSnsrls.PerInstanceMemories.RelHwAgFil1.FilGain /end MEASUREMENT
/begin MEASUREMENT HwAgSnsrls.RelHwAgFil1.FilSt "MICROSAR RTE" FLOAT32_IEEE NO_COMPU_METHOD 0 0 -3.402823466e+38 3.402823466e+38 ECU_ADDRESS 0 SYMBOL_LINK "Rte_HwAgSnsrls_RelHwAgFil1.FilSt" 0 DISPLAY_IDENTIFIER HwAgSnsrls.PerInstanceMemories.RelHwAgFil1.FilSt /end MEASUREMENT
/begin MEASUREMENT HwAgSnsrls.RelHwAgFil2.FilGain "MICROSAR RTE" FLOAT32_IEEE NO_COMPU_METHOD 0 0 -3.402823466e+38 3.402823466e+38 ECU_ADDRESS 0 SYMBOL_LINK "Rte_HwAgSnsrls_RelHwAgFil2.FilGain" 0 DISPLAY_IDENTIFIER HwAgSnsrls.PerInstanceMemories.RelHwAgFil2.FilGain /end MEASUREMENT
/begin MEASUREMENT HwAgSnsrls.RelHwAgFil2.FilSt "MICROSAR RTE" FLOAT32_IEEE NO_COMPU_METHOD 0 0 -3.402823466e+38 3.402823466e+38 ECU_ADDRESS 0 SYMBOL_LINK "Rte_HwAgSnsrls_RelHwAgFil2.FilSt" 0 DISPLAY_IDENTIFIER HwAgSnsrls.PerInstanceMemories.RelHwAgFil2.FilSt /end MEASUREMENT
/begin MEASUREMENT HwAgSnsrls.SelnCaseSt "MICROSAR RTE" UBYTE RTE_CM_ENUM_SelnCaseSt1 0 0 0 255 ECU_ADDRESS 0 SYMBOL_LINK "Rte_HwAgSnsrls_SelnCaseSt" 0 DISPLAY_IDENTIFIER HwAgSnsrls.PerInstanceMemories.SelnCaseSt /end MEASUREMENT
/begin MEASUREMENT HwAgSnsrls.StordLstPrm.PinionAg "MICROSAR RTE" FLOAT32_IEEE NO_COMPU_METHOD 0 0 -3.402823466e+38 3.402823466e+38 ECU_ADDRESS 0 SYMBOL_LINK "Rte_HwAgSnsrls_StordLstPrm.PinionAg" 0 DISPLAY_IDENTIFIER HwAgSnsrls.PerInstanceMemories.StordLstPrm.PinionAg /end MEASUREMENT
/begin MEASUREMENT HwAgSnsrls.StordLstPrm.PinionAgVld "MICROSAR RTE" UBYTE RTE_CM_BOOLEAN 0 0 0 255 ECU_ADDRESS 0 SYMBOL_LINK "Rte_HwAgSnsrls_StordLstPrm.PinionAgVld" 0 DISPLAY_IDENTIFIER HwAgSnsrls.PerInstanceMemories.StordLstPrm.PinionAgVld /end MEASUREMENT
/begin MEASUREMENT HwAgSnsrls.VehDynHwAgOffs "MICROSAR RTE" FLOAT32_IEEE NO_COMPU_METHOD 0 0 -3.402823466e+38 3.402823466e+38 ECU_ADDRESS 0 SYMBOL_LINK "Rte_HwAgSnsrls_VehDynHwAgOffs" 0 DISPLAY_IDENTIFIER HwAgSnsrls.PerInstanceMemories.VehDynHwAgOffs /end MEASUREMENT
/begin MEASUREMENT HwAgSnsrls.VehDynRefTmr1 "MICROSAR RTE" ULONG NO_COMPU_METHOD 0 0 0 4294967295 ECU_ADDRESS 0 SYMBOL_LINK "Rte_HwAgSnsrls_VehDynRefTmr1" 0 DISPLAY_IDENTIFIER HwAgSnsrls.PerInstanceMemories.VehDynRefTmr1 /end MEASUREMENT
/begin MEASUREMENT HwAgSnsrls.VehDynRefTmr2 "MICROSAR RTE" ULONG NO_COMPU_METHOD 0 0 0 4294967295 ECU_ADDRESS 0 SYMBOL_LINK "Rte_HwAgSnsrls_VehDynRefTmr2" 0 DISPLAY_IDENTIFIER HwAgSnsrls.PerInstanceMemories.VehDynRefTmr2 /end MEASUREMENT
/begin MEASUREMENT HwAgSnsrls.VehSpd.Val "MICROSAR RTE" FLOAT32_IEEE NO_COMPU_METHOD 0 0 -3.402823466e+38 3.402823466e+38 ECU_ADDRESS 0 SYMBOL_LINK "Rte_ImcSigArbn_VehSpdImcCorrd_Val" 0 DISPLAY_IDENTIFIER HwAgSnsrls.ReceiverPorts.VehSpd.Val /end MEASUREMENT
/begin MEASUREMENT HwAgSnsrls.VehSpdVld.Logl "MICROSAR RTE" UBYTE RTE_CM_BOOLEAN 0 0 0 255 ECU_ADDRESS 0 SYMBOL_LINK "Rte_VehSigCdng_VehSpdVld_Logl" 0 DISPLAY_IDENTIFIER HwAgSnsrls.ReceiverPorts.VehSpdVld.Logl /end MEASUREMENT
/begin MEASUREMENT HwAgSnsrls.VehYawRate.Val "MICROSAR RTE" FLOAT32_IEEE NO_COMPU_METHOD 0 0 -3.402823466e+38 3.402823466e+38 ECU_ADDRESS 0 SYMBOL_LINK "Rte_VehSigCdng_VehYawRate_Val" 0 DISPLAY_IDENTIFIER HwAgSnsrls.ReceiverPorts.VehYawRate.Val /end MEASUREMENT
/begin MEASUREMENT HwAgSnsrls.VehYawRateVld.Logl "MICROSAR RTE" UBYTE RTE_CM_BOOLEAN 0 0 0 255 ECU_ADDRESS 0 SYMBOL_LINK "Rte_VehSigCdng_VehYawRateVld_Logl" 0 DISPLAY_IDENTIFIER HwAgSnsrls.ReceiverPorts.VehYawRateVld.Logl /end MEASUREMENT
/begin MEASUREMENT HwAgSnsrls.WhlFrqVld.Logl "MICROSAR RTE" UBYTE RTE_CM_BOOLEAN 0 0 0 255 ECU_ADDRESS 0 SYMBOL_LINK "Rte_HwAgSnsrls_WhlFrqVld_Logl" 0 DISPLAY_IDENTIFIER HwAgSnsrls.ReceiverPorts.WhlFrqVld.Logl /end MEASUREMENT
/begin MEASUREMENT HwAgSnsrls.WhlLeFrq.Val "MICROSAR RTE" FLOAT32_IEEE NO_COMPU_METHOD 0 0 -3.402823466e+38 3.402823466e+38 ECU_ADDRESS 0 SYMBOL_LINK "Rte_HwAgSnsrls_WhlLeFrq_Val" 0 DISPLAY_IDENTIFIER HwAgSnsrls.ReceiverPorts.WhlLeFrq.Val /end MEASUREMENT
/begin MEASUREMENT HwAgSnsrls.WhlRiFrq.Val "MICROSAR RTE" FLOAT32_IEEE NO_COMPU_METHOD 0 0 -3.402823466e+38 3.402823466e+38 ECU_ADDRESS 0 SYMBOL_LINK "Rte_HwAgSnsrls_WhlRiFrq_Val" 0 DISPLAY_IDENTIFIER HwAgSnsrls.ReceiverPorts.WhlRiFrq.Val /end MEASUREMENT
/begin MEASUREMENT HwAgSnsrls.WhlSpdHwAgLrndEna "MICROSAR RTE" UBYTE RTE_CM_BOOLEAN 0 0 0 255 ECU_ADDRESS 0 SYMBOL_LINK "Rte_HwAgSnsrls_WhlSpdHwAgLrndEna" 0 DISPLAY_IDENTIFIER HwAgSnsrls.PerInstanceMemories.WhlSpdHwAgLrndEna /end MEASUREMENT
/begin MEASUREMENT HwAgSnsrls.WhlSpdHwAgOffs "MICROSAR RTE" FLOAT32_IEEE NO_COMPU_METHOD 0 0 -3.402823466e+38 3.402823466e+38 ECU_ADDRESS 0 SYMBOL_LINK "Rte_HwAgSnsrls_WhlSpdHwAgOffs" 0 DISPLAY_IDENTIFIER HwAgSnsrls.PerInstanceMemories.WhlSpdHwAgOffs /end MEASUREMENT
/begin MEASUREMENT HwAgSnsrls.WhlSpdHwConf "MICROSAR RTE" FLOAT32_IEEE NO_COMPU_METHOD 0 0 -3.402823466e+38 3.402823466e+38 ECU_ADDRESS 0 SYMBOL_LINK "Rte_HwAgSnsrls_WhlSpdHwConf" 0 DISPLAY_IDENTIFIER HwAgSnsrls.PerInstanceMemories.WhlSpdHwConf /end MEASUREMENT
/begin MEASUREMENT HwAgSnsrls.WhlSpdRefTmr "MICROSAR RTE" ULONG NO_COMPU_METHOD 0 0 0 4294967295 ECU_ADDRESS 0 SYMBOL_LINK "Rte_HwAgSnsrls_WhlSpdRefTmr" 0 DISPLAY_IDENTIFIER HwAgSnsrls.PerInstanceMemories.WhlSpdRefTmr /end MEASUREMENT
/begin MEASUREMENT HwAgSnsrls.YawRateFil.FilGain "MICROSAR RTE" FLOAT32_IEEE NO_COMPU_METHOD 0 0 -3.402823466e+38 3.402823466e+38 ECU_ADDRESS 0 SYMBOL_LINK "Rte_HwAgSnsrls_YawRateFil.FilGain" 0 DISPLAY_IDENTIFIER HwAgSnsrls.PerInstanceMemories.YawRateFil.FilGain /end MEASUREMENT
/begin MEASUREMENT HwAgSnsrls.YawRateFil.FilSt "MICROSAR RTE" FLOAT32_IEEE NO_COMPU_METHOD 0 0 -3.402823466e+38 3.402823466e+38 ECU_ADDRESS 0 SYMBOL_LINK "Rte_HwAgSnsrls_YawRateFil.FilSt" 0 DISPLAY_IDENTIFIER HwAgSnsrls.PerInstanceMemories.YawRateFil.FilSt /end MEASUREMENT
/begin MEASUREMENT HwAgSnsrls.dHwAgSnsrlsStordHwAg "MICROSAR RTE" FLOAT32_IEEE NO_COMPU_METHOD 0 0 -3.402823466e+38 3.402823466e+38 ECU_ADDRESS 0 SYMBOL_LINK "Rte_HwAgSnsrls_dHwAgSnsrlsStordHwAg" 0 DISPLAY_IDENTIFIER HwAgSnsrls.PerInstanceMemories.dHwAgSnsrlsStordHwAg /end MEASUREMENT
/begin MEASUREMENT HwAgSnsrls.dHwAgSnsrlsStordHwConf "MICROSAR RTE" FLOAT32_IEEE NO_COMPU_METHOD 0 0 -3.402823466e+38 3.402823466e+38 ECU_ADDRESS 0 SYMBOL_LINK "Rte_HwAgSnsrls_dHwAgSnsrlsStordHwConf" 0 DISPLAY_IDENTIFIER HwAgSnsrls.PerInstanceMemories.dHwAgSnsrlsStordHwConf /end MEASUREMENT
/begin MEASUREMENT HwAgSnsrls.dHwAgSnsrlsVehDynHwConf "MICROSAR RTE" FLOAT32_IEEE NO_COMPU_METHOD 0 0 -3.402823466e+38 3.402823466e+38 ECU_ADDRESS 0 SYMBOL_LINK "Rte_HwAgSnsrls_dHwAgSnsrlsVehDynHwConf" 0 DISPLAY_IDENTIFIER HwAgSnsrls.PerInstanceMemories.dHwAgSnsrlsVehDynHwConf /end MEASUREMENT
/begin MEASUREMENT HwAgSnsrls.dHwAgSnsrlsWhlSpdHwConf "MICROSAR RTE" FLOAT32_IEEE NO_COMPU_METHOD 0 0 -3.402823466e+38 3.402823466e+38 ECU_ADDRESS 0 SYMBOL_LINK "Rte_HwAgSnsrls_dHwAgSnsrlsWhlSpdHwConf" 0 DISPLAY_IDENTIFIER HwAgSnsrls.PerInstanceMemories.dHwAgSnsrlsWhlSpdHwConf /end MEASUREMENT
/begin MEASUREMENT HwAgSysArbn.CmplncErrPinionToHw.Val "MICROSAR RTE" FLOAT32_IEEE NO_COMPU_METHOD 0 0 -3.402823466e+38 3.402823466e+38 ECU_ADDRESS 0 SYMBOL_LINK "Rte_CmplncErr_CmplncErrPinionToHw_Val" 0 DISPLAY_IDENTIFIER HwAgSysArbn.ReceiverPorts.CmplncErrPinionToHw.Val /end MEASUREMENT
/begin MEASUREMENT HwAgSysArbn.EcuID.Val "MICROSAR RTE" UBYTE NO_COMPU_METHOD 0 0 0 255 ECU_ADDRESS 0 SYMBOL_LINK "Rte_DualEcuIdn_EcuId_Val" 0 DISPLAY_IDENTIFIER HwAgSysArbn.ReceiverPorts.EcuID.Val /end MEASUREMENT
/begin MEASUREMENT HwAgSysArbn.HwAg.Val "MICROSAR RTE" FLOAT32_IEEE NO_COMPU_METHOD 0 0 -3.402823466e+38 3.402823466e+38 ECU_ADDRESS 0 SYMBOL_LINK "Rte_HwAgArbn_HwAg_Val" 0 DISPLAY_IDENTIFIER HwAgSysArbn.ReceiverPorts.HwAg.Val /end MEASUREMENT
/begin MEASUREMENT HwAgSysArbn.HwAgConfRefTi "MICROSAR RTE" ULONG NO_COMPU_METHOD 0 0 0 4294967295 ECU_ADDRESS 0 SYMBOL_LINK "Rte_HwAgSysArbn_HwAgConfRefTi" 0 DISPLAY_IDENTIFIER HwAgSysArbn.PerInstanceMemories.HwAgConfRefTi /end MEASUREMENT
/begin MEASUREMENT HwAgSysArbn.HwAgCorrd.Val "MICROSAR RTE" FLOAT32_IEEE NO_COMPU_METHOD 0 0 -3.402823466e+38 3.402823466e+38 ECU_ADDRESS 0 SYMBOL_LINK "Rte_HwAgArbn_HwAg_Val" 0 DISPLAY_IDENTIFIER HwAgSysArbn.ReceiverPorts.HwAgCorrd.Val /end MEASUREMENT
/begin MEASUREMENT HwAgSysArbn.HwAgFinal.Val "MICROSAR RTE" FLOAT32_IEEE NO_COMPU_METHOD 0 0 -3.402823466e+38 3.402823466e+38 ECU_ADDRESS 0 SYMBOL_LINK "Rte_HwAgSysArbn_HwAgFinal_Val" 0 DISPLAY_IDENTIFIER HwAgSysArbn.SenderPorts.HwAgFinal.Val /end MEASUREMENT
/begin MEASUREMENT HwAgSysArbn.HwAgIdptSig.Val "MICROSAR RTE" UBYTE NO_COMPU_METHOD 0 0 0 255 ECU_ADDRESS 0 SYMBOL_LINK "Rte_HwAgCorrln_HwAgIdptSig_Val" 0 DISPLAY_IDENTIFIER HwAgSysArbn.ReceiverPorts.HwAgIdptSig.Val /end MEASUREMENT
/begin MEASUREMENT HwAgSysArbn.HwAgKineFlt "MICROSAR RTE" UBYTE RTE_CM_BOOLEAN 0 0 0 255 ECU_ADDRESS 0 SYMBOL_LINK "Rte_HwAgSysArbn_HwAgKineFlt" 0 DISPLAY_IDENTIFIER HwAgSysArbn.PerInstanceMemories.HwAgKineFlt /end MEASUREMENT
/begin MEASUREMENT HwAgSysArbn.HwAgLtch "MICROSAR RTE" UBYTE RTE_CM_BOOLEAN 0 0 0 255 ECU_ADDRESS 0 SYMBOL_LINK "Rte_HwAgSysArbn_HwAgLtch" 0 DISPLAY_IDENTIFIER HwAgSysArbn.PerInstanceMemories.HwAgLtch /end MEASUREMENT
/begin MEASUREMENT HwAgSysArbn.HwAgNotCorrd.Val "MICROSAR RTE" FLOAT32_IEEE NO_COMPU_METHOD 0 0 -3.402823466e+38 3.402823466e+38 ECU_ADDRESS 0 SYMBOL_LINK "Rte_HwAgSysArbn_HwAgNotCorrd_Val" 0 DISPLAY_IDENTIFIER HwAgSysArbn.SenderPorts.HwAgNotCorrd.Val /end MEASUREMENT
/begin MEASUREMENT HwAgSysArbn.HwAgSnsrls.Val "MICROSAR RTE" FLOAT32_IEEE NO_COMPU_METHOD 0 0 -3.402823466e+38 3.402823466e+38 ECU_ADDRESS 0 SYMBOL_LINK "Rte_HwAgSnsrls_HwAgSnsrls_Val" 0 DISPLAY_IDENTIFIER HwAgSysArbn.ReceiverPorts.HwAgSnsrls.Val /end MEASUREMENT
/begin MEASUREMENT HwAgSysArbn.HwAgSnsrlsConf.Val "MICROSAR RTE" FLOAT32_IEEE NO_COMPU_METHOD 0 0 -3.402823466e+38 3.402823466e+38 ECU_ADDRESS 0 SYMBOL_LINK "Rte_HwAgSnsrls_HwAgSnsrlsConf_Val" 0 DISPLAY_IDENTIFIER HwAgSysArbn.ReceiverPorts.HwAgSnsrlsConf.Val /end MEASUREMENT
/begin MEASUREMENT HwAgSysArbn.HwAgToMotAgCorrln "MICROSAR RTE" UBYTE RTE_CM_BOOLEAN 0 0 0 255 ECU_ADDRESS 0 SYMBOL_LINK "Rte_HwAgSysArbn_HwAgToMotAgCorrln" 0 DISPLAY_IDENTIFIER HwAgSysArbn.PerInstanceMemories.HwAgToMotAgCorrln /end MEASUREMENT
/begin MEASUREMENT HwAgSysArbn.HwAgToMotAgCorrlnFltFld.Logl "MICROSAR RTE" UBYTE RTE_CM_BOOLEAN 0 0 0 255 ECU_ADDRESS 0 SYMBOL_LINK "Rte_HwAgSysArbn_HwAgToMotAgCorrlnFltFld_Logl" 0 DISPLAY_IDENTIFIER HwAgSysArbn.SenderPorts.HwAgToMotAgCorrlnFltFld.Logl /end MEASUREMENT
/begin MEASUREMENT HwAgSysArbn.HwAgToSerlCom.Val "MICROSAR RTE" FLOAT32_IEEE NO_COMPU_METHOD 0 0 -3.402823466e+38 3.402823466e+38 ECU_ADDRESS 0 SYMBOL_LINK "Rte_HwAgSysArbn_HwAgToSerlCom_Val" 0 DISPLAY_IDENTIFIER HwAgSysArbn.SenderPorts.HwAgToSerlCom.Val /end MEASUREMENT
/begin MEASUREMENT HwAgSysArbn.HwAgTrimPrfmd.Logl "MICROSAR RTE" UBYTE RTE_CM_BOOLEAN 0 0 0 255 ECU_ADDRESS 0 SYMBOL_LINK "Rte_HwAgSysArbn_HwAgTrimPrfmd_Logl" 0 DISPLAY_IDENTIFIER HwAgSysArbn.ReceiverPorts.HwAgTrimPrfmd.Logl /end MEASUREMENT
/begin MEASUREMENT HwAgSysArbn.HwAgVldToSerlCom.Logl "MICROSAR RTE" UBYTE RTE_CM_BOOLEAN 0 0 0 255 ECU_ADDRESS 0 SYMBOL_LINK "Rte_HwAgSysArbn_HwAgVldToSerlCom_Logl" 0 DISPLAY_IDENTIFIER HwAgSysArbn.SenderPorts.HwAgVldToSerlCom.Logl /end MEASUREMENT
/begin MEASUREMENT HwAgSysArbn.HwTq.Val "MICROSAR RTE" FLOAT32_IEEE NO_COMPU_METHOD 0 0 -3.402823466e+38 3.402823466e+38 ECU_ADDRESS 0 SYMBOL_LINK "Rte_ImcSigArbn_HwTqImcCorrd_Val" 0 DISPLAY_IDENTIFIER HwAgSysArbn.ReceiverPorts.HwTq.Val /end MEASUREMENT
/begin MEASUREMENT HwAgSysArbn.HwVel.Val "MICROSAR RTE" FLOAT32_IEEE NO_COMPU_METHOD 0 0 -3.402823466e+38 3.402823466e+38 ECU_ADDRESS 0 SYMBOL_LINK "Rte_HwAgSysArbn_HwVel_Val" 0 DISPLAY_IDENTIFIER HwAgSysArbn.SenderPorts.HwVel.Val /end MEASUREMENT
/begin MEASUREMENT HwAgSysArbn.HwVelToSerlCom.Val "MICROSAR RTE" FLOAT32_IEEE NO_COMPU_METHOD 0 0 -3.402823466e+38 3.402823466e+38 ECU_ADDRESS 0 SYMBOL_LINK "Rte_HwAgSysArbn_HwVelToSerlCom_Val" 0 DISPLAY_IDENTIFIER HwAgSysArbn.SenderPorts.HwVelToSerlCom.Val /end MEASUREMENT
/begin MEASUREMENT HwAgSysArbn.MotVelCrf.Val "MICROSAR RTE" FLOAT32_IEEE NO_COMPU_METHOD 0 0 -3.402823466e+38 3.402823466e+38 ECU_ADDRESS 0 SYMBOL_LINK "Rte_ImcSigArbn_MotVelCrfImcCorrd_Val" 0 DISPLAY_IDENTIFIER HwAgSysArbn.ReceiverPorts.MotVelCrf.Val /end MEASUREMENT
/begin MEASUREMENT HwAgSysArbn.MotVelVld.Logl "MICROSAR RTE" UBYTE RTE_CM_BOOLEAN 0 0 0 255 ECU_ADDRESS 0 SYMBOL_LINK "Rte_CDD_MotVel_MotVelVld_Logl" 0 DISPLAY_IDENTIFIER HwAgSysArbn.ReceiverPorts.MotVelVld.Logl /end MEASUREMENT
/begin MEASUREMENT HwAgSysArbn.PinionAg.Val "MICROSAR RTE" FLOAT32_IEEE NO_COMPU_METHOD 0 0 -3.402823466e+38 3.402823466e+38 ECU_ADDRESS 0 SYMBOL_LINK "Rte_HwAgSysArbn_PinionAg_Val" 0 DISPLAY_IDENTIFIER HwAgSysArbn.SenderPorts.PinionAg.Val /end MEASUREMENT
/begin MEASUREMENT HwAgSysArbn.PinionAgConf.Val "MICROSAR RTE" FLOAT32_IEEE NO_COMPU_METHOD 0 0 -3.402823466e+38 3.402823466e+38 ECU_ADDRESS 0 SYMBOL_LINK "Rte_HwAgSysArbn_PinionAgConf_Val" 0 DISPLAY_IDENTIFIER HwAgSysArbn.SenderPorts.PinionAgConf.Val /end MEASUREMENT
/begin MEASUREMENT HwAgSysArbn.PinionAgPrev "MICROSAR RTE" FLOAT32_IEEE NO_COMPU_METHOD 0 0 -3.402823466e+38 3.402823466e+38 ECU_ADDRESS 0 SYMBOL_LINK "Rte_HwAgSysArbn_PinionAgPrev" 0 DISPLAY_IDENTIFIER HwAgSysArbn.PerInstanceMemories.PinionAgPrev /end MEASUREMENT
/begin MEASUREMENT HwAgSysArbn.PinionVel.Val "MICROSAR RTE" FLOAT32_IEEE NO_COMPU_METHOD 0 0 -3.402823466e+38 3.402823466e+38 ECU_ADDRESS 0 SYMBOL_LINK "Rte_HwAgSysArbn_PinionVel_Val" 0 DISPLAY_IDENTIFIER HwAgSysArbn.SenderPorts.PinionVel.Val /end MEASUREMENT
/begin MEASUREMENT HwAgSysArbn.PinionVelConf.Val "MICROSAR RTE" FLOAT32_IEEE NO_COMPU_METHOD 0 0 -3.402823466e+38 3.402823466e+38 ECU_ADDRESS 0 SYMBOL_LINK "Rte_HwAgSysArbn_PinionVelConf_Val" 0 DISPLAY_IDENTIFIER HwAgSysArbn.SenderPorts.PinionVelConf.Val /end MEASUREMENT
/begin MEASUREMENT HwAgSysArbn.PrevHwAgNotCorrd "MICROSAR RTE" FLOAT32_IEEE NO_COMPU_METHOD 0 0 -3.402823466e+38 3.402823466e+38 ECU_ADDRESS 0 SYMBOL_LINK "Rte_HwAgSysArbn_PrevHwAgNotCorrd" 0 DISPLAY_IDENTIFIER HwAgSysArbn.PerInstanceMemories.PrevHwAgNotCorrd /end MEASUREMENT
/begin MEASUREMENT HwAgSysArbn.PrevPinionAgConf "MICROSAR RTE" FLOAT32_IEEE NO_COMPU_METHOD 0 0 -3.402823466e+38 3.402823466e+38 ECU_ADDRESS 0 SYMBOL_LINK "Rte_HwAgSysArbn_PrevPinionAgConf" 0 DISPLAY_IDENTIFIER HwAgSysArbn.PerInstanceMemories.PrevPinionAgConf /end MEASUREMENT
/begin MEASUREMENT HwAgSysArbn.PrevSeldHwAg "MICROSAR RTE" FLOAT32_IEEE NO_COMPU_METHOD 0 0 -3.402823466e+38 3.402823466e+38 ECU_ADDRESS 0 SYMBOL_LINK "Rte_HwAgSysArbn_PrevSeldHwAg" 0 DISPLAY_IDENTIFIER HwAgSysArbn.PerInstanceMemories.PrevSeldHwAg /end MEASUREMENT
/begin MEASUREMENT HwAgSysArbn.PrevSrcSeln "MICROSAR RTE" SBYTE NO_COMPU_METHOD 0 0 -128 127 ECU_ADDRESS 0 SYMBOL_LINK "Rte_HwAgSysArbn_PrevSrcSeln" 0 DISPLAY_IDENTIFIER HwAgSysArbn.PerInstanceMemories.PrevSrcSeln /end MEASUREMENT
/begin MEASUREMENT HwAgSysArbn.SeldHwAgConf "MICROSAR RTE" FLOAT32_IEEE NO_COMPU_METHOD 0 0 -3.402823466e+38 3.402823466e+38 ECU_ADDRESS 0 SYMBOL_LINK "Rte_HwAgSysArbn_SeldHwAgConf" 0 DISPLAY_IDENTIFIER HwAgSysArbn.PerInstanceMemories.SeldHwAgConf /end MEASUREMENT
/begin MEASUREMENT HwAgSysArbn.SlewElpdRefTmr "MICROSAR RTE" ULONG NO_COMPU_METHOD 0 0 0 4294967295 ECU_ADDRESS 0 SYMBOL_LINK "Rte_HwAgSysArbn_SlewElpdRefTmr" 0 DISPLAY_IDENTIFIER HwAgSysArbn.PerInstanceMemories.SlewElpdRefTmr /end MEASUREMENT
/begin MEASUREMENT HwAgSysArbn.SlewSts "MICROSAR RTE" UBYTE RTE_CM_BOOLEAN 0 0 0 255 ECU_ADDRESS 0 SYMBOL_LINK "Rte_HwAgSysArbn_SlewSts" 0 DISPLAY_IDENTIFIER HwAgSysArbn.PerInstanceMemories.SlewSts /end MEASUREMENT
/begin MEASUREMENT HwAgSysArbn.TqSnsrAgPrev "MICROSAR RTE" FLOAT32_IEEE NO_COMPU_METHOD 0 0 -3.402823466e+38 3.402823466e+38 ECU_ADDRESS 0 SYMBOL_LINK "Rte_HwAgSysArbn_TqSnsrAgPrev" 0 DISPLAY_IDENTIFIER HwAgSysArbn.PerInstanceMemories.TqSnsrAgPrev /end MEASUREMENT
/begin MEASUREMENT HwAgSysArbn.TqSnsrVelFil.FilGain "MICROSAR RTE" FLOAT32_IEEE NO_COMPU_METHOD 0 0 -3.402823466e+38 3.402823466e+38 ECU_ADDRESS 0 SYMBOL_LINK "Rte_HwAgSysArbn_TqSnsrVelFil.FilGain" 0 DISPLAY_IDENTIFIER HwAgSysArbn.PerInstanceMemories.TqSnsrVelFil.FilGain /end MEASUREMENT
/begin MEASUREMENT HwAgSysArbn.TqSnsrVelFil.FilSt "MICROSAR RTE" FLOAT32_IEEE NO_COMPU_METHOD 0 0 -3.402823466e+38 3.402823466e+38 ECU_ADDRESS 0 SYMBOL_LINK "Rte_HwAgSysArbn_TqSnsrVelFil.FilSt" 0 DISPLAY_IDENTIFIER HwAgSysArbn.PerInstanceMemories.TqSnsrVelFil.FilSt /end MEASUREMENT
/begin MEASUREMENT HwTq10Meas.HwTq10.Val "MICROSAR RTE" FLOAT32_IEEE NO_COMPU_METHOD 0 0 -3.402823466e+38 3.402823466e+38 ECU_ADDRESS 0 SYMBOL_LINK "Rte_HwTq10Meas_HwTq10_Val" 0 DISPLAY_IDENTIFIER HwTq10Meas.SenderPorts.HwTq10.Val /end MEASUREMENT
/begin MEASUREMENT HwTq10Meas.HwTq10DataPlsHiLim "MICROSAR RTE" ULONG NO_COMPU_METHOD 0 0 0 4294967295 ECU_ADDRESS 0 SYMBOL_LINK "Rte_HwTq10Meas_HwTq10DataPlsHiLim" 0 DISPLAY_IDENTIFIER HwTq10Meas.PerInstanceMemories.HwTq10DataPlsHiLim /end MEASUREMENT
/begin MEASUREMENT HwTq10Meas.HwTq10DataPlsLoLim "MICROSAR RTE" ULONG NO_COMPU_METHOD 0 0 0 4294967295 ECU_ADDRESS 0 SYMBOL_LINK "Rte_HwTq10Meas_HwTq10DataPlsLoLim" 0 DISPLAY_IDENTIFIER HwTq10Meas.PerInstanceMemories.HwTq10DataPlsLoLim /end MEASUREMENT
/begin MEASUREMENT HwTq10Meas.HwTq10Offs.OffsTrim "MICROSAR RTE" FLOAT32_IEEE NO_COMPU_METHOD 0 0 -3.402823466e+38 3.402823466e+38 ECU_ADDRESS 0 SYMBOL_LINK "Rte_HwTq10Meas_HwTq10Offs.OffsTrim" 0 DISPLAY_IDENTIFIER HwTq10Meas.PerInstanceMemories.HwTq10Offs.OffsTrim /end MEASUREMENT
/begin MEASUREMENT HwTq10Meas.HwTq10Offs.OffsTrimPrfmdSts "MICROSAR RTE" UBYTE RTE_CM_BOOLEAN 0 0 0 255 ECU_ADDRESS 0 SYMBOL_LINK "Rte_HwTq10Meas_HwTq10Offs.OffsTrimPrfmdSts" 0 DISPLAY_IDENTIFIER HwTq10Meas.PerInstanceMemories.HwTq10Offs.OffsTrimPrfmdSts /end MEASUREMENT
/begin MEASUREMENT HwTq10Meas.HwTq10Polarity.Val "MICROSAR RTE" SBYTE NO_COMPU_METHOD 0 0 -128 127 ECU_ADDRESS 0 SYMBOL_LINK "Rte_PolarityCfg_HwTq3Polarity_Val" 0 DISPLAY_IDENTIFIER HwTq10Meas.ReceiverPorts.HwTq10Polarity.Val /end MEASUREMENT
/begin MEASUREMENT HwTq10Meas.HwTq10PrevHwTq "MICROSAR RTE" FLOAT32_IEEE NO_COMPU_METHOD 0 0 -3.402823466e+38 3.402823466e+38 ECU_ADDRESS 0 SYMBOL_LINK "Rte_HwTq10Meas_HwTq10PrevHwTq" 0 DISPLAY_IDENTIFIER HwTq10Meas.PerInstanceMemories.HwTq10PrevHwTq /end MEASUREMENT
/begin MEASUREMENT HwTq10Meas.HwTq10Qlfr.Val "MICROSAR RTE" UBYTE RTE_CM_ENUM_SigQlfr1 0 0 0 255 ECU_ADDRESS 0 SYMBOL_LINK "Rte_HwTq10Meas_HwTq10Qlfr_Val" 0 DISPLAY_IDENTIFIER HwTq10Meas.SenderPorts.HwTq10Qlfr.Val /end MEASUREMENT
/begin MEASUREMENT HwTq10Meas.HwTq10RawDataBuf "MICROSAR RTE" UWORD NO_COMPU_METHOD 0 0 0 65535 MATRIX_DIM 5 1 1 ECU_ADDRESS 0 SYMBOL_LINK "Rte_HwTq10Meas_HwTq10RawDataBuf" 0 DISPLAY_IDENTIFIER HwTq10Meas.PerInstanceMemories.HwTq10RawDataBuf /end MEASUREMENT
/begin MEASUREMENT HwTq10Meas.HwTq10RollgCntr.Val "MICROSAR RTE" UBYTE NO_COMPU_METHOD 0 0 0 255 ECU_ADDRESS 0 SYMBOL_LINK "Rte_HwTq10Meas_HwTq10RollgCntr_Val" 0 DISPLAY_IDENTIFIER HwTq10Meas.SenderPorts.HwTq10RollgCntr.Val /end MEASUREMENT
/begin MEASUREMENT HwTq10Meas.HwTq10RollgCntrPrev "MICROSAR RTE" UBYTE NO_COMPU_METHOD 0 0 0 255 ECU_ADDRESS 0 SYMBOL_LINK "Rte_HwTq10Meas_HwTq10RollgCntrPrev" 0 DISPLAY_IDENTIFIER HwTq10Meas.PerInstanceMemories.HwTq10RollgCntrPrev /end MEASUREMENT
/begin MEASUREMENT HwTq10Meas.HwTq10SyncPlsHiLim "MICROSAR RTE" ULONG NO_COMPU_METHOD 0 0 0 4294967295 ECU_ADDRESS 0 SYMBOL_LINK "Rte_HwTq10Meas_HwTq10SyncPlsHiLim" 0 DISPLAY_IDENTIFIER HwTq10Meas.PerInstanceMemories.HwTq10SyncPlsHiLim /end MEASUREMENT
/begin MEASUREMENT HwTq10Meas.HwTq10SyncPlsLoLim "MICROSAR RTE" ULONG NO_COMPU_METHOD 0 0 0 4294967295 ECU_ADDRESS 0 SYMBOL_LINK "Rte_HwTq10Meas_HwTq10SyncPlsLoLim" 0 DISPLAY_IDENTIFIER HwTq10Meas.PerInstanceMemories.HwTq10SyncPlsLoLim /end MEASUREMENT
/begin MEASUREMENT HwTq10Meas.HwTq10TiStamp "MICROSAR RTE" ULONG NO_COMPU_METHOD 0 0 0 4294967295 ECU_ADDRESS 0 SYMBOL_LINK "Rte_HwTq10Meas_HwTq10TiStamp" 0 DISPLAY_IDENTIFIER HwTq10Meas.PerInstanceMemories.HwTq10TiStamp /end MEASUREMENT
/begin MEASUREMENT HwTq10Meas.HwTq10TiStampPrev "MICROSAR RTE" ULONG NO_COMPU_METHOD 0 0 0 4294967295 ECU_ADDRESS 0 SYMBOL_LINK "Rte_HwTq10Meas_HwTq10TiStampPrev" 0 DISPLAY_IDENTIFIER HwTq10Meas.PerInstanceMemories.HwTq10TiStampPrev /end MEASUREMENT
/begin MEASUREMENT HwTq9Meas.HwTq9.Val "MICROSAR RTE" FLOAT32_IEEE NO_COMPU_METHOD 0 0 -3.402823466e+38 3.402823466e+38 ECU_ADDRESS 0 SYMBOL_LINK "Rte_HwTq9Meas_HwTq9_Val" 0 DISPLAY_IDENTIFIER HwTq9Meas.SenderPorts.HwTq9.Val /end MEASUREMENT
/begin MEASUREMENT HwTq9Meas.HwTq9Offs.OffsTrim "MICROSAR RTE" FLOAT32_IEEE NO_COMPU_METHOD 0 0 -3.402823466e+38 3.402823466e+38 ECU_ADDRESS 0 SYMBOL_LINK "Rte_HwTq9Meas_HwTq9Offs.OffsTrim" 0 DISPLAY_IDENTIFIER HwTq9Meas.PerInstanceMemories.HwTq9Offs.OffsTrim /end MEASUREMENT
/begin MEASUREMENT HwTq9Meas.HwTq9Offs.OffsTrimPrfmdSts "MICROSAR RTE" UBYTE RTE_CM_BOOLEAN 0 0 0 255 ECU_ADDRESS 0 SYMBOL_LINK "Rte_HwTq9Meas_HwTq9Offs.OffsTrimPrfmdSts" 0 DISPLAY_IDENTIFIER HwTq9Meas.PerInstanceMemories.HwTq9Offs.OffsTrimPrfmdSts /end MEASUREMENT
/begin MEASUREMENT HwTq9Meas.HwTq9Polarity.Val "MICROSAR RTE" SBYTE NO_COMPU_METHOD 0 0 -128 127 ECU_ADDRESS 0 SYMBOL_LINK "Rte_PolarityCfg_HwTq2Polarity_Val" 0 DISPLAY_IDENTIFIER HwTq9Meas.ReceiverPorts.HwTq9Polarity.Val /end MEASUREMENT
/begin MEASUREMENT HwTq9Meas.HwTq9PrevHwTq "MICROSAR RTE" FLOAT32_IEEE NO_COMPU_METHOD 0 0 -3.402823466e+38 3.402823466e+38 ECU_ADDRESS 0 SYMBOL_LINK "Rte_HwTq9Meas_HwTq9PrevHwTq" 0 DISPLAY_IDENTIFIER HwTq9Meas.PerInstanceMemories.HwTq9PrevHwTq /end MEASUREMENT
/begin MEASUREMENT HwTq9Meas.HwTq9Qlfr.Val "MICROSAR RTE" UBYTE RTE_CM_ENUM_SigQlfr1 0 0 0 255 ECU_ADDRESS 0 SYMBOL_LINK "Rte_HwTq9Meas_HwTq9Qlfr_Val" 0 DISPLAY_IDENTIFIER HwTq9Meas.SenderPorts.HwTq9Qlfr.Val /end MEASUREMENT
/begin MEASUREMENT HwTq9Meas.HwTq9RawDataBuf "MICROSAR RTE" UWORD NO_COMPU_METHOD 0 0 0 65535 MATRIX_DIM 5 1 1 ECU_ADDRESS 0 SYMBOL_LINK "Rte_HwTq9Meas_HwTq9RawDataBuf" 0 DISPLAY_IDENTIFIER HwTq9Meas.PerInstanceMemories.HwTq9RawDataBuf /end MEASUREMENT
/begin MEASUREMENT HwTq9Meas.HwTq9RollgCntr.Val "MICROSAR RTE" UBYTE NO_COMPU_METHOD 0 0 0 255 ECU_ADDRESS 0 SYMBOL_LINK "Rte_HwTq9Meas_HwTq9RollgCntr_Val" 0 DISPLAY_IDENTIFIER HwTq9Meas.SenderPorts.HwTq9RollgCntr.Val /end MEASUREMENT
/begin MEASUREMENT HwTq9Meas.HwTq9RollgCntrPrev "MICROSAR RTE" UBYTE NO_COMPU_METHOD 0 0 0 255 ECU_ADDRESS 0 SYMBOL_LINK "Rte_HwTq9Meas_HwTq9RollgCntrPrev" 0 DISPLAY_IDENTIFIER HwTq9Meas.PerInstanceMemories.HwTq9RollgCntrPrev /end MEASUREMENT
/begin MEASUREMENT HwTq9Meas.HwTq9TiStamp "MICROSAR RTE" ULONG NO_COMPU_METHOD 0 0 0 4294967295 ECU_ADDRESS 0 SYMBOL_LINK "Rte_HwTq9Meas_HwTq9TiStamp" 0 DISPLAY_IDENTIFIER HwTq9Meas.PerInstanceMemories.HwTq9TiStamp /end MEASUREMENT
/begin MEASUREMENT HwTq9Meas.HwTq9TiStampPrev "MICROSAR RTE" ULONG NO_COMPU_METHOD 0 0 0 4294967295 ECU_ADDRESS 0 SYMBOL_LINK "Rte_HwTq9Meas_HwTq9TiStampPrev" 0 DISPLAY_IDENTIFIER HwTq9Meas.PerInstanceMemories.HwTq9TiStampPrev /end MEASUREMENT
/begin MEASUREMENT HwTqArbn.HwTq.Val "MICROSAR RTE" FLOAT32_IEEE NO_COMPU_METHOD 0 0 -3.402823466e+38 3.402823466e+38 ECU_ADDRESS 0 SYMBOL_LINK "Rte_HwTqArbn_HwTq_Val" 0 DISPLAY_IDENTIFIER HwTqArbn.SenderPorts.HwTq.Val /end MEASUREMENT
/begin MEASUREMENT HwTqArbn.HwTqA.Val "MICROSAR RTE" FLOAT32_IEEE NO_COMPU_METHOD 0 0 -3.402823466e+38 3.402823466e+38 ECU_ADDRESS 0 SYMBOL_LINK "Rte_CDD_HwTq8Meas_HwTq8_Val" 0 DISPLAY_IDENTIFIER HwTqArbn.ReceiverPorts.HwTqA.Val /end MEASUREMENT
/begin MEASUREMENT HwTqArbn.HwTqAQlfr.Val "MICROSAR RTE" UBYTE RTE_CM_ENUM_SigQlfr1 0 0 0 255 ECU_ADDRESS 0 SYMBOL_LINK "Rte_CDD_HwTq8Meas_HwTq8Qlfr_Val" 0 DISPLAY_IDENTIFIER HwTqArbn.ReceiverPorts.HwTqAQlfr.Val /end MEASUREMENT
/begin MEASUREMENT HwTqArbn.HwTqARollgCntr.Val "MICROSAR RTE" UBYTE NO_COMPU_METHOD 0 0 0 255 ECU_ADDRESS 0 SYMBOL_LINK "Rte_CDD_HwTq8Meas_HwTq8RollgCntr_Val" 0 DISPLAY_IDENTIFIER HwTqArbn.ReceiverPorts.HwTqARollgCntr.Val /end MEASUREMENT
/begin MEASUREMENT HwTqArbn.HwTqARollgCntrPrev "MICROSAR RTE" UBYTE NO_COMPU_METHOD 0 0 0 255 ECU_ADDRESS 0 SYMBOL_LINK "Rte_HwTqArbn_HwTqARollgCntrPrev" 0 DISPLAY_IDENTIFIER HwTqArbn.PerInstanceMemories.HwTqARollgCntrPrev /end MEASUREMENT
/begin MEASUREMENT HwTqArbn.HwTqAStallCntrPrev "MICROSAR RTE" UBYTE NO_COMPU_METHOD 0 0 0 255 ECU_ADDRESS 0 SYMBOL_LINK "Rte_HwTqArbn_HwTqAStallCntrPrev" 0 DISPLAY_IDENTIFIER HwTqArbn.PerInstanceMemories.HwTqAStallCntrPrev /end MEASUREMENT
/begin MEASUREMENT HwTqArbn.HwTqB.Val "MICROSAR RTE" FLOAT32_IEEE NO_COMPU_METHOD 0 0 -3.402823466e+38 3.402823466e+38 ECU_ADDRESS 0 SYMBOL_LINK "Rte_CDD_HwTq1Meas_HwTq1_Val" 0 DISPLAY_IDENTIFIER HwTqArbn.ReceiverPorts.HwTqB.Val /end MEASUREMENT
/begin MEASUREMENT HwTqArbn.HwTqBQlfr.Val "MICROSAR RTE" UBYTE RTE_CM_ENUM_SigQlfr1 0 0 0 255 ECU_ADDRESS 0 SYMBOL_LINK "Rte_CDD_HwTq1Meas_HwTq1Qlfr_Val" 0 DISPLAY_IDENTIFIER HwTqArbn.ReceiverPorts.HwTqBQlfr.Val /end MEASUREMENT
/begin MEASUREMENT HwTqArbn.HwTqBRollgCntr.Val "MICROSAR RTE" UBYTE NO_COMPU_METHOD 0 0 0 255 ECU_ADDRESS 0 SYMBOL_LINK "Rte_CDD_HwTq1Meas_HwTq1RollgCntr_Val" 0 DISPLAY_IDENTIFIER HwTqArbn.ReceiverPorts.HwTqBRollgCntr.Val /end MEASUREMENT
/begin MEASUREMENT HwTqArbn.HwTqBRollgCntrPrev "MICROSAR RTE" UBYTE NO_COMPU_METHOD 0 0 0 255 ECU_ADDRESS 0 SYMBOL_LINK "Rte_HwTqArbn_HwTqBRollgCntrPrev" 0 DISPLAY_IDENTIFIER HwTqArbn.PerInstanceMemories.HwTqBRollgCntrPrev /end MEASUREMENT
/begin MEASUREMENT HwTqArbn.HwTqBStallCntrPrev "MICROSAR RTE" UBYTE NO_COMPU_METHOD 0 0 0 255 ECU_ADDRESS 0 SYMBOL_LINK "Rte_HwTqArbn_HwTqBStallCntrPrev" 0 DISPLAY_IDENTIFIER HwTqArbn.PerInstanceMemories.HwTqBStallCntrPrev /end MEASUREMENT
/begin MEASUREMENT HwTqArbn.HwTqC.Val "MICROSAR RTE" FLOAT32_IEEE NO_COMPU_METHOD 0 0 -3.402823466e+38 3.402823466e+38 ECU_ADDRESS 0 SYMBOL_LINK "Rte_HwTq9Meas_HwTq9_Val" 0 DISPLAY_IDENTIFIER HwTqArbn.ReceiverPorts.HwTqC.Val /end MEASUREMENT
/begin MEASUREMENT HwTqArbn.HwTqCQlfr.Val "MICROSAR RTE" UBYTE RTE_CM_ENUM_SigQlfr1 0 0 0 255 ECU_ADDRESS 0 SYMBOL_LINK "Rte_HwTq9Meas_HwTq9Qlfr_Val" 0 DISPLAY_IDENTIFIER HwTqArbn.ReceiverPorts.HwTqCQlfr.Val /end MEASUREMENT
/begin MEASUREMENT HwTqArbn.HwTqCRollgCntr.Val "MICROSAR RTE" UBYTE NO_COMPU_METHOD 0 0 0 255 ECU_ADDRESS 0 SYMBOL_LINK "Rte_HwTq9Meas_HwTq9RollgCntr_Val" 0 DISPLAY_IDENTIFIER HwTqArbn.ReceiverPorts.HwTqCRollgCntr.Val /end MEASUREMENT
/begin MEASUREMENT HwTqArbn.HwTqCRollgCntrPrev "MICROSAR RTE" UBYTE NO_COMPU_METHOD 0 0 0 255 ECU_ADDRESS 0 SYMBOL_LINK "Rte_HwTqArbn_HwTqCRollgCntrPrev" 0 DISPLAY_IDENTIFIER HwTqArbn.PerInstanceMemories.HwTqCRollgCntrPrev /end MEASUREMENT
/begin MEASUREMENT HwTqArbn.HwTqCStallCntrPrev "MICROSAR RTE" UBYTE NO_COMPU_METHOD 0 0 0 255 ECU_ADDRESS 0 SYMBOL_LINK "Rte_HwTqArbn_HwTqCStallCntrPrev" 0 DISPLAY_IDENTIFIER HwTqArbn.PerInstanceMemories.HwTqCStallCntrPrev /end MEASUREMENT
/begin MEASUREMENT HwTqArbn.HwTqCorrlnSts.Val "MICROSAR RTE" UBYTE NO_COMPU_METHOD 0 0 0 255 ECU_ADDRESS 0 SYMBOL_LINK "Rte_HwTqCorrln_HwTqCorrlnSts_Val" 0 DISPLAY_IDENTIFIER HwTqArbn.ReceiverPorts.HwTqCorrlnSts.Val /end MEASUREMENT
/begin MEASUREMENT HwTqArbn.HwTqD.Val "MICROSAR RTE" FLOAT32_IEEE NO_COMPU_METHOD 0 0 -3.402823466e+38 3.402823466e+38 ECU_ADDRESS 0 SYMBOL_LINK "Rte_HwTq10Meas_HwTq10_Val" 0 DISPLAY_IDENTIFIER HwTqArbn.ReceiverPorts.HwTqD.Val /end MEASUREMENT
/begin MEASUREMENT HwTqArbn.HwTqDQlfr.Val "MICROSAR RTE" UBYTE RTE_CM_ENUM_SigQlfr1 0 0 0 255 ECU_ADDRESS 0 SYMBOL_LINK "Rte_HwTq10Meas_HwTq10Qlfr_Val" 0 DISPLAY_IDENTIFIER HwTqArbn.ReceiverPorts.HwTqDQlfr.Val /end MEASUREMENT
/begin MEASUREMENT HwTqArbn.HwTqDRollgCntr.Val "MICROSAR RTE" UBYTE NO_COMPU_METHOD 0 0 0 255 ECU_ADDRESS 0 SYMBOL_LINK "Rte_HwTq10Meas_HwTq10RollgCntr_Val" 0 DISPLAY_IDENTIFIER HwTqArbn.ReceiverPorts.HwTqDRollgCntr.Val /end MEASUREMENT
/begin MEASUREMENT HwTqArbn.HwTqDRollgCntrPrev "MICROSAR RTE" UBYTE NO_COMPU_METHOD 0 0 0 255 ECU_ADDRESS 0 SYMBOL_LINK "Rte_HwTqArbn_HwTqDRollgCntrPrev" 0 DISPLAY_IDENTIFIER HwTqArbn.PerInstanceMemories.HwTqDRollgCntrPrev /end MEASUREMENT
/begin MEASUREMENT HwTqArbn.HwTqDStallCntrPrev "MICROSAR RTE" UBYTE NO_COMPU_METHOD 0 0 0 255 ECU_ADDRESS 0 SYMBOL_LINK "Rte_HwTqArbn_HwTqDStallCntrPrev" 0 DISPLAY_IDENTIFIER HwTqArbn.PerInstanceMemories.HwTqDStallCntrPrev /end MEASUREMENT
/begin MEASUREMENT HwTqArbn.HwTqPrev "MICROSAR RTE" FLOAT32_IEEE NO_COMPU_METHOD 0 0 -3.402823466e+38 3.402823466e+38 ECU_ADDRESS 0 SYMBOL_LINK "Rte_HwTqArbn_HwTqPrev" 0 DISPLAY_IDENTIFIER HwTqArbn.PerInstanceMemories.HwTqPrev /end MEASUREMENT
/begin MEASUREMENT HwTqArbn.dHwTqArbnAAvl "MICROSAR RTE" UBYTE RTE_CM_BOOLEAN 0 0 0 255 ECU_ADDRESS 0 SYMBOL_LINK "Rte_HwTqArbn_dHwTqArbnAAvl" 0 DISPLAY_IDENTIFIER HwTqArbn.PerInstanceMemories.dHwTqArbnAAvl /end MEASUREMENT
/begin MEASUREMENT HwTqArbn.dHwTqArbnBAvl "MICROSAR RTE" UBYTE RTE_CM_BOOLEAN 0 0 0 255 ECU_ADDRESS 0 SYMBOL_LINK "Rte_HwTqArbn_dHwTqArbnBAvl" 0 DISPLAY_IDENTIFIER HwTqArbn.PerInstanceMemories.dHwTqArbnBAvl /end MEASUREMENT
/begin MEASUREMENT HwTqArbn.dHwTqArbnCAvl "MICROSAR RTE" UBYTE RTE_CM_BOOLEAN 0 0 0 255 ECU_ADDRESS 0 SYMBOL_LINK "Rte_HwTqArbn_dHwTqArbnCAvl" 0 DISPLAY_IDENTIFIER HwTqArbn.PerInstanceMemories.dHwTqArbnCAvl /end MEASUREMENT
/begin MEASUREMENT HwTqArbn.dHwTqArbnDAvl "MICROSAR RTE" UBYTE RTE_CM_BOOLEAN 0 0 0 255 ECU_ADDRESS 0 SYMBOL_LINK "Rte_HwTqArbn_dHwTqArbnDAvl" 0 DISPLAY_IDENTIFIER HwTqArbn.PerInstanceMemories.dHwTqArbnDAvl /end MEASUREMENT
/begin MEASUREMENT HwTqArbn.dHwTqArbnHwTqDenom "MICROSAR RTE" FLOAT32_IEEE NO_COMPU_METHOD 0 0 -3.402823466e+38 3.402823466e+38 ECU_ADDRESS 0 SYMBOL_LINK "Rte_HwTqArbn_dHwTqArbnHwTqDenom" 0 DISPLAY_IDENTIFIER HwTqArbn.PerInstanceMemories.dHwTqArbnHwTqDenom /end MEASUREMENT
/begin MEASUREMENT HwTqArbn.dHwTqArbnHwTqNumer "MICROSAR RTE" FLOAT32_IEEE NO_COMPU_METHOD 0 0 -3.402823466e+38 3.402823466e+38 ECU_ADDRESS 0 SYMBOL_LINK "Rte_HwTqArbn_dHwTqArbnHwTqNumer" 0 DISPLAY_IDENTIFIER HwTqArbn.PerInstanceMemories.dHwTqArbnHwTqNumer /end MEASUREMENT
/begin MEASUREMENT HwTqCorrln.HwTqA.Val "MICROSAR RTE" FLOAT32_IEEE NO_COMPU_METHOD 0 0 -3.402823466e+38 3.402823466e+38 ECU_ADDRESS 0 SYMBOL_LINK "Rte_CDD_HwTq8Meas_HwTq8_Val" 0 DISPLAY_IDENTIFIER HwTqCorrln.ReceiverPorts.HwTqA.Val /end MEASUREMENT
/begin MEASUREMENT HwTqCorrln.HwTqAQlfr.Val "MICROSAR RTE" UBYTE RTE_CM_ENUM_SigQlfr1 0 0 0 255 ECU_ADDRESS 0 SYMBOL_LINK "Rte_CDD_HwTq8Meas_HwTq8Qlfr_Val" 0 DISPLAY_IDENTIFIER HwTqCorrln.ReceiverPorts.HwTqAQlfr.Val /end MEASUREMENT
/begin MEASUREMENT HwTqCorrln.HwTqARollgCntr.Val "MICROSAR RTE" UBYTE NO_COMPU_METHOD 0 0 0 255 ECU_ADDRESS 0 SYMBOL_LINK "Rte_CDD_HwTq8Meas_HwTq8RollgCntr_Val" 0 DISPLAY_IDENTIFIER HwTqCorrln.ReceiverPorts.HwTqARollgCntr.Val /end MEASUREMENT
/begin MEASUREMENT HwTqCorrln.HwTqARollgCntrPrev "MICROSAR RTE" UBYTE NO_COMPU_METHOD 0 0 0 255 ECU_ADDRESS 0 SYMBOL_LINK "Rte_HwTqCorrln_HwTqARollgCntrPrev" 0 DISPLAY_IDENTIFIER HwTqCorrln.PerInstanceMemories.HwTqARollgCntrPrev /end MEASUREMENT
/begin MEASUREMENT HwTqCorrln.HwTqAStallCntrPrev "MICROSAR RTE" UBYTE NO_COMPU_METHOD 0 0 0 255 ECU_ADDRESS 0 SYMBOL_LINK "Rte_HwTqCorrln_HwTqAStallCntrPrev" 0 DISPLAY_IDENTIFIER HwTqCorrln.PerInstanceMemories.HwTqAStallCntrPrev /end MEASUREMENT
/begin MEASUREMENT HwTqCorrln.HwTqB.Val "MICROSAR RTE" FLOAT32_IEEE NO_COMPU_METHOD 0 0 -3.402823466e+38 3.402823466e+38 ECU_ADDRESS 0 SYMBOL_LINK "Rte_CDD_HwTq1Meas_HwTq1_Val" 0 DISPLAY_IDENTIFIER HwTqCorrln.ReceiverPorts.HwTqB.Val /end MEASUREMENT
/begin MEASUREMENT HwTqCorrln.HwTqBQlfr.Val "MICROSAR RTE" UBYTE RTE_CM_ENUM_SigQlfr1 0 0 0 255 ECU_ADDRESS 0 SYMBOL_LINK "Rte_CDD_HwTq1Meas_HwTq1Qlfr_Val" 0 DISPLAY_IDENTIFIER HwTqCorrln.ReceiverPorts.HwTqBQlfr.Val /end MEASUREMENT
/begin MEASUREMENT HwTqCorrln.HwTqBRollgCntr.Val "MICROSAR RTE" UBYTE NO_COMPU_METHOD 0 0 0 255 ECU_ADDRESS 0 SYMBOL_LINK "Rte_CDD_HwTq1Meas_HwTq1RollgCntr_Val" 0 DISPLAY_IDENTIFIER HwTqCorrln.ReceiverPorts.HwTqBRollgCntr.Val /end MEASUREMENT
/begin MEASUREMENT HwTqCorrln.HwTqBRollgCntrPrev "MICROSAR RTE" UBYTE NO_COMPU_METHOD 0 0 0 255 ECU_ADDRESS 0 SYMBOL_LINK "Rte_HwTqCorrln_HwTqBRollgCntrPrev" 0 DISPLAY_IDENTIFIER HwTqCorrln.PerInstanceMemories.HwTqBRollgCntrPrev /end MEASUREMENT
/begin MEASUREMENT HwTqCorrln.HwTqBStallCntrPrev "MICROSAR RTE" UBYTE NO_COMPU_METHOD 0 0 0 255 ECU_ADDRESS 0 SYMBOL_LINK "Rte_HwTqCorrln_HwTqBStallCntrPrev" 0 DISPLAY_IDENTIFIER HwTqCorrln.PerInstanceMemories.HwTqBStallCntrPrev /end MEASUREMENT
/begin MEASUREMENT HwTqCorrln.HwTqC.Val "MICROSAR RTE" FLOAT32_IEEE NO_COMPU_METHOD 0 0 -3.402823466e+38 3.402823466e+38 ECU_ADDRESS 0 SYMBOL_LINK "Rte_HwTq9Meas_HwTq9_Val" 0 DISPLAY_IDENTIFIER HwTqCorrln.ReceiverPorts.HwTqC.Val /end MEASUREMENT
/begin MEASUREMENT HwTqCorrln.HwTqCQlfr.Val "MICROSAR RTE" UBYTE RTE_CM_ENUM_SigQlfr1 0 0 0 255 ECU_ADDRESS 0 SYMBOL_LINK "Rte_HwTq9Meas_HwTq9Qlfr_Val" 0 DISPLAY_IDENTIFIER HwTqCorrln.ReceiverPorts.HwTqCQlfr.Val /end MEASUREMENT
/begin MEASUREMENT HwTqCorrln.HwTqCRollgCntr.Val "MICROSAR RTE" UBYTE NO_COMPU_METHOD 0 0 0 255 ECU_ADDRESS 0 SYMBOL_LINK "Rte_HwTq9Meas_HwTq9RollgCntr_Val" 0 DISPLAY_IDENTIFIER HwTqCorrln.ReceiverPorts.HwTqCRollgCntr.Val /end MEASUREMENT
/begin MEASUREMENT HwTqCorrln.HwTqCRollgCntrPrev "MICROSAR RTE" UBYTE NO_COMPU_METHOD 0 0 0 255 ECU_ADDRESS 0 SYMBOL_LINK "Rte_HwTqCorrln_HwTqCRollgCntrPrev" 0 DISPLAY_IDENTIFIER HwTqCorrln.PerInstanceMemories.HwTqCRollgCntrPrev /end MEASUREMENT
/begin MEASUREMENT HwTqCorrln.HwTqCStallCntrPrev "MICROSAR RTE" UBYTE NO_COMPU_METHOD 0 0 0 255 ECU_ADDRESS 0 SYMBOL_LINK "Rte_HwTqCorrln_HwTqCStallCntrPrev" 0 DISPLAY_IDENTIFIER HwTqCorrln.PerInstanceMemories.HwTqCStallCntrPrev /end MEASUREMENT
/begin MEASUREMENT HwTqCorrln.HwTqCorrlnSts.Val "MICROSAR RTE" UBYTE NO_COMPU_METHOD 0 0 0 255 ECU_ADDRESS 0 SYMBOL_LINK "Rte_HwTqCorrln_HwTqCorrlnSts_Val" 0 DISPLAY_IDENTIFIER HwTqCorrln.SenderPorts.HwTqCorrlnSts.Val /end MEASUREMENT
/begin MEASUREMENT HwTqCorrln.HwTqD.Val "MICROSAR RTE" FLOAT32_IEEE NO_COMPU_METHOD 0 0 -3.402823466e+38 3.402823466e+38 ECU_ADDRESS 0 SYMBOL_LINK "Rte_HwTq10Meas_HwTq10_Val" 0 DISPLAY_IDENTIFIER HwTqCorrln.ReceiverPorts.HwTqD.Val /end MEASUREMENT
/begin MEASUREMENT HwTqCorrln.HwTqDQlfr.Val "MICROSAR RTE" UBYTE RTE_CM_ENUM_SigQlfr1 0 0 0 255 ECU_ADDRESS 0 SYMBOL_LINK "Rte_HwTq10Meas_HwTq10Qlfr_Val" 0 DISPLAY_IDENTIFIER HwTqCorrln.ReceiverPorts.HwTqDQlfr.Val /end MEASUREMENT
/begin MEASUREMENT HwTqCorrln.HwTqDRollgCntr.Val "MICROSAR RTE" UBYTE NO_COMPU_METHOD 0 0 0 255 ECU_ADDRESS 0 SYMBOL_LINK "Rte_HwTq10Meas_HwTq10RollgCntr_Val" 0 DISPLAY_IDENTIFIER HwTqCorrln.ReceiverPorts.HwTqDRollgCntr.Val /end MEASUREMENT
/begin MEASUREMENT HwTqCorrln.HwTqDRollgCntrPrev "MICROSAR RTE" UBYTE NO_COMPU_METHOD 0 0 0 255 ECU_ADDRESS 0 SYMBOL_LINK "Rte_HwTqCorrln_HwTqDRollgCntrPrev" 0 DISPLAY_IDENTIFIER HwTqCorrln.PerInstanceMemories.HwTqDRollgCntrPrev /end MEASUREMENT
/begin MEASUREMENT HwTqCorrln.HwTqDStallCntrPrev "MICROSAR RTE" UBYTE NO_COMPU_METHOD 0 0 0 255 ECU_ADDRESS 0 SYMBOL_LINK "Rte_HwTqCorrln_HwTqDStallCntrPrev" 0 DISPLAY_IDENTIFIER HwTqCorrln.PerInstanceMemories.HwTqDStallCntrPrev /end MEASUREMENT
/begin MEASUREMENT HwTqCorrln.HwTqIdptSig.Val "MICROSAR RTE" UBYTE NO_COMPU_METHOD 0 0 0 255 ECU_ADDRESS 0 SYMBOL_LINK "Rte_HwTqCorrln_HwTqIdptSig_Val" 0 DISPLAY_IDENTIFIER HwTqCorrln.SenderPorts.HwTqIdptSig.Val /end MEASUREMENT
/begin MEASUREMENT HwTqCorrln.dHwTqCorrlnAvl "MICROSAR RTE" UBYTE NO_COMPU_METHOD 0 0 0 255 ECU_ADDRESS 0 SYMBOL_LINK "Rte_HwTqCorrln_dHwTqCorrlnAvl" 0 DISPLAY_IDENTIFIER HwTqCorrln.PerInstanceMemories.dHwTqCorrlnAvl /end MEASUREMENT
/begin MEASUREMENT HwTqCorrln.dHwTqCorrlnImdtCorrlnSts "MICROSAR RTE" UBYTE NO_COMPU_METHOD 0 0 0 255 ECU_ADDRESS 0 SYMBOL_LINK "Rte_HwTqCorrln_dHwTqCorrlnImdtCorrlnSts" 0 DISPLAY_IDENTIFIER HwTqCorrln.PerInstanceMemories.dHwTqCorrlnImdtCorrlnSts /end MEASUREMENT
/begin MEASUREMENT HysCmp.AssiCmdBas.Val "MICROSAR RTE" FLOAT32_IEEE NO_COMPU_METHOD 0 0 -3.402823466e+38 3.402823466e+38 ECU_ADDRESS 0 SYMBOL_LINK "Rte_Assi_AssiCmdBas_Val" 0 DISPLAY_IDENTIFIER HysCmp.ReceiverPorts.AssiCmdBas.Val /end MEASUREMENT
/begin MEASUREMENT HysCmp.AssiCmdLpFil.FilGain "MICROSAR RTE" FLOAT32_IEEE NO_COMPU_METHOD 0 0 -3.402823466e+38 3.402823466e+38 ECU_ADDRESS 0 SYMBOL_LINK "Rte_HysCmp_AssiCmdLpFil.FilGain" 0 DISPLAY_IDENTIFIER HysCmp.PerInstanceMemories.AssiCmdLpFil.FilGain /end MEASUREMENT
/begin MEASUREMENT HysCmp.AssiCmdLpFil.FilSt "MICROSAR RTE" FLOAT32_IEEE NO_COMPU_METHOD 0 0 -3.402823466e+38 3.402823466e+38 ECU_ADDRESS 0 SYMBOL_LINK "Rte_HysCmp_AssiCmdLpFil.FilSt" 0 DISPLAY_IDENTIFIER HysCmp.PerInstanceMemories.AssiCmdLpFil.FilSt /end MEASUREMENT
/begin MEASUREMENT HysCmp.AssiMechT.Val "MICROSAR RTE" FLOAT32_IEEE NO_COMPU_METHOD 0 0 -3.402823466e+38 3.402823466e+38 ECU_ADDRESS 0 SYMBOL_LINK "Rte_TEstimn_AssiMechT_Val" 0 DISPLAY_IDENTIFIER HysCmp.ReceiverPorts.AssiMechT.Val /end MEASUREMENT
/begin MEASUREMENT HysCmp.FinalOutpLpFil.FilGain "MICROSAR RTE" FLOAT32_IEEE NO_COMPU_METHOD 0 0 -3.402823466e+38 3.402823466e+38 ECU_ADDRESS 0 SYMBOL_LINK "Rte_HysCmp_FinalOutpLpFil.FilGain" 0 DISPLAY_IDENTIFIER HysCmp.PerInstanceMemories.FinalOutpLpFil.FilGain /end MEASUREMENT
/begin MEASUREMENT HysCmp.FinalOutpLpFil.FilSt "MICROSAR RTE" FLOAT32_IEEE NO_COMPU_METHOD 0 0 -3.402823466e+38 3.402823466e+38 ECU_ADDRESS 0 SYMBOL_LINK "Rte_HysCmp_FinalOutpLpFil.FilSt" 0 DISPLAY_IDENTIFIER HysCmp.PerInstanceMemories.FinalOutpLpFil.FilSt /end MEASUREMENT
/begin MEASUREMENT HysCmp.HwTq.Val "MICROSAR RTE" FLOAT32_IEEE NO_COMPU_METHOD 0 0 -3.402823466e+38 3.402823466e+38 ECU_ADDRESS 0 SYMBOL_LINK "Rte_ImcSigArbn_HwTqImcCorrd_Val" 0 DISPLAY_IDENTIFIER HysCmp.ReceiverPorts.HwTq.Val /end MEASUREMENT
/begin MEASUREMENT HysCmp.HwTqLpFil.FilGain "MICROSAR RTE" FLOAT32_IEEE NO_COMPU_METHOD 0 0 -3.402823466e+38 3.402823466e+38 ECU_ADDRESS 0 SYMBOL_LINK "Rte_HysCmp_HwTqLpFil.FilGain" 0 DISPLAY_IDENTIFIER HysCmp.PerInstanceMemories.HwTqLpFil.FilGain /end MEASUREMENT
/begin MEASUREMENT HysCmp.HwTqLpFil.FilSt "MICROSAR RTE" FLOAT32_IEEE NO_COMPU_METHOD 0 0 -3.402823466e+38 3.402823466e+38 ECU_ADDRESS 0 SYMBOL_LINK "Rte_HysCmp_HwTqLpFil.FilSt" 0 DISPLAY_IDENTIFIER HysCmp.PerInstanceMemories.HwTqLpFil.FilSt /end MEASUREMENT
/begin MEASUREMENT HysCmp.HwTqOvrl.Val "MICROSAR RTE" FLOAT32_IEEE NO_COMPU_METHOD 0 0 -3.402823466e+38 3.402823466e+38 ECU_ADDRESS 0 SYMBOL_LINK "Rte_FordHwTqCmdOvrlLimr_FordColTqOvrl_Val" 0 DISPLAY_IDENTIFIER HysCmp.ReceiverPorts.HwTqOvrl.Val /end MEASUREMENT
/begin MEASUREMENT HysCmp.HysCmpCmd.Val "MICROSAR RTE" FLOAT32_IEEE NO_COMPU_METHOD 0 0 -3.402823466e+38 3.402823466e+38 ECU_ADDRESS 0 SYMBOL_LINK "Rte_HysCmp_HysCmpCmd_Val" 0 DISPLAY_IDENTIFIER HysCmp.SenderPorts.HysCmpCmd.Val /end MEASUREMENT
/begin MEASUREMENT HysCmp.HysCmpCmdDi.Logl "MICROSAR RTE" UBYTE RTE_CM_BOOLEAN 0 0 0 255 ECU_ADDRESS 0 SYMBOL_LINK "Rte_CmnMfgSrv_HysCmpCmdDi_Logl" 0 DISPLAY_IDENTIFIER HysCmp.ReceiverPorts.HysCmpCmdDi.Logl /end MEASUREMENT
/begin GROUP HwAg1Meas.HwAg1MeasHwAg1Snsr0PrtclFltPassStep.Val "MICROSAR RTE" /begin SUB_GROUP /end SUB_GROUP /begin FUNCTION_LIST /end FUNCTION_LIST /begin REF_CHARACTERISTIC HwAg1Meas.HwAg1MeasHwAg1Snsr0PrtclFltPassStep.Val /end REF_CHARACTERISTIC /begin REF_MEASUREMENT /end REF_MEASUREMENT /end GROUP
/begin GROUP HwAg1Meas.HwAg1MeasHwAg1Snsr1PrtclFltFailStep.Val "MICROSAR RTE" /begin SUB_GROUP /end SUB_GROUP /begin FUNCTION_LIST /end FUNCTION_LIST /begin REF_CHARACTERISTIC HwAg1Meas.HwAg1MeasHwAg1Snsr1PrtclFltFailStep.Val /end REF_CHARACTERISTIC /begin REF_MEASUREMENT /end REF_MEASUREMENT /end GROUP
/begin GROUP HwAg1Meas.HwAg1MeasHwAg1Snsr1PrtclFltPassStep.Val "MICROSAR RTE" /begin SUB_GROUP /end SUB_GROUP /begin FUNCTION_LIST /end FUNCTION_LIST /begin REF_CHARACTERISTIC HwAg1Meas.HwAg1MeasHwAg1Snsr1PrtclFltPassStep.Val /end REF_CHARACTERISTIC /begin REF_MEASUREMENT /end REF_MEASUREMENT /end GROUP
/begin GROUP HwAg1Meas.HwAg1MeasSnsr0Rev.Ary1D "MICROSAR RTE" /begin SUB_GROUP /end SUB_GROUP /begin FUNCTION_LIST /end FUNCTION_LIST /begin REF_CHARACTERISTIC HwAg1Meas.HwAg1MeasSnsr0Rev.Ary1D /end REF_CHARACTERISTIC /begin REF_MEASUREMENT /end REF_MEASUREMENT /end GROUP
/begin GROUP HwAg1Meas.HwAg1MeasSnsr1Rev.Ary1D "MICROSAR RTE" /begin SUB_GROUP /end SUB_GROUP /begin FUNCTION_LIST /end FUNCTION_LIST /begin REF_CHARACTERISTIC HwAg1Meas.HwAg1MeasSnsr1Rev.Ary1D /end REF_CHARACTERISTIC /begin REF_MEASUREMENT /end REF_MEASUREMENT /end GROUP
/begin GROUP HwAg1Meas.HwAg1MeasStep.Ary1D "MICROSAR RTE" /begin SUB_GROUP /end SUB_GROUP /begin FUNCTION_LIST /end FUNCTION_LIST /begin REF_CHARACTERISTIC HwAg1Meas.HwAg1MeasStep.Ary1D /end REF_CHARACTERISTIC /begin REF_MEASUREMENT /end REF_MEASUREMENT /end GROUP
/begin GROUP HwAg1Meas.HwAg1MeasVrnrErrThd.Val "MICROSAR RTE" /begin SUB_GROUP /end SUB_GROUP /begin FUNCTION_LIST /end FUNCTION_LIST /begin REF_CHARACTERISTIC HwAg1Meas.HwAg1MeasVrnrErrThd.Val /end REF_CHARACTERISTIC /begin REF_MEASUREMENT /end REF_MEASUREMENT /end GROUP
/begin GROUP HwAg1Meas.HwAg1Offs "MICROSAR RTE" /begin SUB_GROUP /end SUB_GROUP /begin FUNCTION_LIST /end FUNCTION_LIST /begin REF_CHARACTERISTIC /end REF_CHARACTERISTIC
 /begin REF_MEASUREMENT HwAg1Meas.HwAg1Offs.OffsTrim HwAg1Meas.HwAg1Offs.OffsTrimPrfmdSts /end REF_MEASUREMENT
/end GROUP
/begin GROUP HwAg1Meas.HwAg1Polarity.Val "MICROSAR RTE" /begin SUB_GROUP /end SUB_GROUP /begin FUNCTION_LIST /end FUNCTION_LIST /begin REF_CHARACTERISTIC /end REF_CHARACTERISTIC /begin REF_MEASUREMENT HwAg1Meas.HwAg1Polarity.Val /end REF_MEASUREMENT /end GROUP
/begin GROUP HwAg1Meas.HwAg1PrevHwAg1 "MICROSAR RTE" /begin SUB_GROUP /end SUB_GROUP /begin FUNCTION_LIST /end FUNCTION_LIST /begin REF_CHARACTERISTIC /end REF_CHARACTERISTIC /begin REF_MEASUREMENT HwAg1Meas.HwAg1PrevHwAg1 /end REF_MEASUREMENT /end GROUP
/begin GROUP HwAg1Meas.HwAg1PrevRollCnt "MICROSAR RTE" /begin SUB_GROUP /end SUB_GROUP /begin FUNCTION_LIST /end FUNCTION_LIST /begin REF_CHARACTERISTIC /end REF_CHARACTERISTIC /begin REF_MEASUREMENT HwAg1Meas.HwAg1PrevRollCnt /end REF_MEASUREMENT /end GROUP
/begin GROUP HwAg1Meas.HwAg1PrevStepSeqNr "MICROSAR RTE" /begin SUB_GROUP /end SUB_GROUP /begin FUNCTION_LIST /end FUNCTION_LIST /begin REF_CHARACTERISTIC /end REF_CHARACTERISTIC /begin REF_MEASUREMENT HwAg1Meas.HwAg1PrevStepSeqNr /end REF_MEASUREMENT /end GROUP
/begin GROUP HwAg1Meas.HwAg1Qlfr.Val "MICROSAR RTE" /begin SUB_GROUP /end SUB_GROUP /begin FUNCTION_LIST /end FUNCTION_LIST /begin REF_CHARACTERISTIC /end REF_CHARACTERISTIC /begin REF_MEASUREMENT HwAg1Meas.HwAg1Qlfr.Val /end REF_MEASUREMENT /end GROUP
/begin GROUP HwAg1Meas.HwAg1RawDataAvlStrtTi "MICROSAR RTE" /begin SUB_GROUP /end SUB_GROUP /begin FUNCTION_LIST /end FUNCTION_LIST /begin REF_CHARACTERISTIC /end REF_CHARACTERISTIC /begin REF_MEASUREMENT HwAg1Meas.HwAg1RawDataAvlStrtTi /end REF_MEASUREMENT /end GROUP
/begin GROUP HwAg1Meas.HwAg1RollgCntr.Val "MICROSAR RTE" /begin SUB_GROUP /end SUB_GROUP /begin FUNCTION_LIST /end FUNCTION_LIST /begin REF_CHARACTERISTIC /end REF_CHARACTERISTIC /begin REF_MEASUREMENT HwAg1Meas.HwAg1RollgCntr.Val /end REF_MEASUREMENT /end GROUP
/begin GROUP HwAg1Meas.HwAg1Snsr0ComStsErrCntr "MICROSAR RTE" /begin SUB_GROUP /end SUB_GROUP /begin FUNCTION_LIST /end FUNCTION_LIST /begin REF_CHARACTERISTIC /end REF_CHARACTERISTIC /begin REF_MEASUREMENT HwAg1Meas.HwAg1Snsr0ComStsErrCntr /end REF_MEASUREMENT /end GROUP
/begin GROUP HwAg1Meas.HwAg1Snsr0IdErrCntr "MICROSAR RTE" /begin SUB_GROUP /end SUB_GROUP /begin FUNCTION_LIST /end FUNCTION_LIST /begin REF_CHARACTERISTIC /end REF_CHARACTERISTIC /begin REF_MEASUREMENT HwAg1Meas.HwAg1Snsr0IdErrCntr /end REF_MEASUREMENT /end GROUP
/begin GROUP HwAg1Meas.HwAg1Snsr0IntSnsrErrCntr "MICROSAR RTE" /begin SUB_GROUP /end SUB_GROUP /begin FUNCTION_LIST /end FUNCTION_LIST /begin REF_CHARACTERISTIC /end REF_CHARACTERISTIC /begin REF_MEASUREMENT HwAg1Meas.HwAg1Snsr0IntSnsrErrCntr /end REF_MEASUREMENT /end GROUP
/begin GROUP HwAg1Meas.HwAg1Snsr0NoMsgErrCntr "MICROSAR RTE" /begin SUB_GROUP /end SUB_GROUP /begin FUNCTION_LIST /end FUNCTION_LIST /begin REF_CHARACTERISTIC /end REF_CHARACTERISTIC /begin REF_MEASUREMENT HwAg1Meas.HwAg1Snsr0NoMsgErrCntr /end REF_MEASUREMENT /end GROUP
/begin GROUP HwAg1Meas.HwAg1Snsr1ComStsErrCntr "MICROSAR RTE" /begin SUB_GROUP /end SUB_GROUP /begin FUNCTION_LIST /end FUNCTION_LIST /begin REF_CHARACTERISTIC /end REF_CHARACTERISTIC /begin REF_MEASUREMENT HwAg1Meas.HwAg1Snsr1ComStsErrCntr /end REF_MEASUREMENT /end GROUP
/begin GROUP HwAg1Meas.HwAg1Snsr1IdErrCntr "MICROSAR RTE" /begin SUB_GROUP /end SUB_GROUP /begin FUNCTION_LIST /end FUNCTION_LIST /begin REF_CHARACTERISTIC /end REF_CHARACTERISTIC /begin REF_MEASUREMENT HwAg1Meas.HwAg1Snsr1IdErrCntr /end REF_MEASUREMENT /end GROUP
/begin GROUP HwAg1Meas.HwAg1Snsr1IntSnsrErrCntr "MICROSAR RTE" /begin SUB_GROUP /end SUB_GROUP /begin FUNCTION_LIST /end FUNCTION_LIST /begin REF_CHARACTERISTIC /end REF_CHARACTERISTIC /begin REF_MEASUREMENT HwAg1Meas.HwAg1Snsr1IntSnsrErrCntr /end REF_MEASUREMENT /end GROUP
/begin GROUP HwAg1Meas.HwAg1Snsr1NoMsgErrCntr "MICROSAR RTE" /begin SUB_GROUP /end SUB_GROUP /begin FUNCTION_LIST /end FUNCTION_LIST /begin REF_CHARACTERISTIC /end REF_CHARACTERISTIC /begin REF_MEASUREMENT HwAg1Meas.HwAg1Snsr1NoMsgErrCntr /end REF_MEASUREMENT /end GROUP
/begin GROUP HwAg1Meas.HwAg1SnsrTrigNr "MICROSAR RTE" /begin SUB_GROUP /end SUB_GROUP /begin FUNCTION_LIST /end FUNCTION_LIST /begin REF_CHARACTERISTIC /end REF_CHARACTERISTIC /begin REF_MEASUREMENT HwAg1Meas.HwAg1SnsrTrigNr /end REF_MEASUREMENT /end GROUP
/begin GROUP HwAg1Meas.HwAg1SnsrTyp.Val "MICROSAR RTE" /begin SUB_GROUP /end SUB_GROUP /begin FUNCTION_LIST /end FUNCTION_LIST /begin REF_CHARACTERISTIC /end REF_CHARACTERISTIC /begin REF_MEASUREMENT HwAg1Meas.HwAg1SnsrTyp.Val /end REF_MEASUREMENT /end GROUP
/begin GROUP HwAg1Meas.PerInstanceMemories "MICROSAR RTE"
 /begin SUB_GROUP HwAg1Meas.HwAg1IfFltLtch HwAg1Meas.HwAg1InitStepSeqNrCmpl HwAg1Meas.HwAg1LtchClr HwAg1Meas.HwAg1Offs HwAg1Meas.HwAg1PrevHwAg1 HwAg1Meas.HwAg1PrevRollCnt HwAg1Meas.HwAg1PrevStepSeqNr HwAg1Meas.HwAg1RawDataAvlStrtTi HwAg1Meas.HwAg1Snsr0ComStsErrCntr HwAg1Meas.HwAg1Snsr0IdErrCntr HwAg1Meas.HwAg1Snsr0IntSnsrErrCntr HwAg1Meas.HwAg1Snsr0NoMsgErrCntr HwAg1Meas.HwAg1Snsr1ComStsErrCntr HwAg1Meas.HwAg1Snsr1IdErrCntr HwAg1Meas.HwAg1Snsr1IntSnsrErrCntr HwAg1Meas.HwAg1Snsr1NoMsgErrCntr HwAg1Meas.HwAg1SnsrTrigNr HwAg1Meas.PrevHwAg1 HwAg1Meas.PrevHwAg1Qlfr HwAg1Meas.PrevHwAg1Snsr0Raw HwAg1Meas.PrevHwAg1Snsr0TestOk HwAg1Meas.PrevHwAg1Snsr1Raw HwAg1Meas.PrevHwAg1Snsr1TestOk HwAg1Meas.dHwAg1MeasSnsr0Abs HwAg1Meas.dHwAg1MeasSnsr0CS HwAg1Meas.dHwAg1MeasSnsr0FRXD HwAg1Meas.dHwAg1MeasSnsr0Rel HwAg1Meas.dHwAg1MeasSnsr1Abs HwAg1Meas.dHwAg1MeasSnsr1CS HwAg1Meas.dHwAg1MeasSnsr1FRXD HwAg1Meas.dHwAg1MeasSnsr1Rel /end SUB_GROUP
 /begin FUNCTION_LIST /end FUNCTION_LIST
 /begin REF_CHARACTERISTIC /end REF_CHARACTERISTIC
 /begin REF_MEASUREMENT /end REF_MEASUREMENT
/end GROUP
/begin GROUP HwAg1Meas.PrevHwAg1 "MICROSAR RTE" /begin SUB_GROUP /end SUB_GROUP /begin FUNCTION_LIST /end FUNCTION_LIST /begin REF_CHARACTERISTIC /end REF_CHARACTERISTIC /begin REF_MEASUREMENT HwAg1Meas.PrevHwAg1 /end REF_MEASUREMENT /end GROUP
/begin GROUP HwAg1Meas.PrevHwAg1Qlfr "MICROSAR RTE" /begin SUB_GROUP /end SUB_GROUP /begin FUNCTION_LIST /end FUNCTION_LIST /begin REF_CHARACTERISTIC /end REF_CHARACTERISTIC /begin REF_MEASUREMENT HwAg1Meas.PrevHwAg1Qlfr /end REF_MEASUREMENT /end GROUP
/begin GROUP HwAg1Meas.PrevHwAg1Snsr0Raw "MICROSAR RTE" /begin SUB_GROUP /end SUB_GROUP /begin FUNCTION_LIST /end FUNCTION_LIST /begin REF_CHARACTERISTIC /end REF_CHARACTERISTIC /begin REF_MEASUREMENT HwAg1Meas.PrevHwAg1Snsr0Raw /end REF_MEASUREMENT /end GROUP
/begin GROUP HwAg1Meas.PrevHwAg1Snsr0TestOk "MICROSAR RTE" /begin SUB_GROUP /end SUB_GROUP /begin FUNCTION_LIST /end FUNCTION_LIST /begin REF_CHARACTERISTIC /end REF_CHARACTERISTIC /begin REF_MEASUREMENT HwAg1Meas.PrevHwAg1Snsr0TestOk /end REF_MEASUREMENT /end GROUP
/begin GROUP HwAg1Meas.PrevHwAg1Snsr1Raw "MICROSAR RTE" /begin SUB_GROUP /end SUB_GROUP /begin FUNCTION_LIST /end FUNCTION_LIST /begin REF_CHARACTERISTIC /end REF_CHARACTERISTIC /begin REF_MEASUREMENT HwAg1Meas.PrevHwAg1Snsr1Raw /end REF_MEASUREMENT /end GROUP
/begin GROUP HwAg1Meas.PrevHwAg1Snsr1TestOk "MICROSAR RTE" /begin SUB_GROUP /end SUB_GROUP /begin FUNCTION_LIST /end FUNCTION_LIST /begin REF_CHARACTERISTIC /end REF_CHARACTERISTIC /begin REF_MEASUREMENT HwAg1Meas.PrevHwAg1Snsr1TestOk /end REF_MEASUREMENT /end GROUP
/begin GROUP HwAg1Meas.ReceiverPorts "MICROSAR RTE" /begin SUB_GROUP HwAg1Meas.HwAg1Polarity.Val HwAg1Meas.HwAg1SnsrTyp.Val /end SUB_GROUP /begin FUNCTION_LIST /end FUNCTION_LIST /begin REF_CHARACTERISTIC /end REF_CHARACTERISTIC /begin REF_MEASUREMENT /end REF_MEASUREMENT /end GROUP
/begin GROUP HwAg1Meas.SenderPorts "MICROSAR RTE"
 /begin SUB_GROUP HwAg1Meas.HwAg1.Val HwAg1Meas.HwAg1Qlfr.Val HwAg1Meas.HwAg1RollgCntr.Val /end SUB_GROUP
 /begin FUNCTION_LIST /end FUNCTION_LIST
 /begin REF_CHARACTERISTIC /end REF_CHARACTERISTIC
 /begin REF_MEASUREMENT /end REF_MEASUREMENT
/end GROUP
/begin GROUP HwAg1Meas.dHwAg1MeasSnsr0Abs "MICROSAR RTE" /begin SUB_GROUP /end SUB_GROUP /begin FUNCTION_LIST /end FUNCTION_LIST /begin REF_CHARACTERISTIC /end REF_CHARACTERISTIC /begin REF_MEASUREMENT HwAg1Meas.dHwAg1MeasSnsr0Abs /end REF_MEASUREMENT /end GROUP
/begin GROUP HwAg1Meas.dHwAg1MeasSnsr0CS "MICROSAR RTE" /begin SUB_GROUP /end SUB_GROUP /begin FUNCTION_LIST /end FUNCTION_LIST /begin REF_CHARACTERISTIC /end REF_CHARACTERISTIC /begin REF_MEASUREMENT HwAg1Meas.dHwAg1MeasSnsr0CS /end REF_MEASUREMENT /end GROUP
/begin GROUP HwAg1Meas.dHwAg1MeasSnsr0FRXD "MICROSAR RTE" /begin SUB_GROUP /end SUB_GROUP /begin FUNCTION_LIST /end FUNCTION_LIST /begin REF_CHARACTERISTIC /end REF_CHARACTERISTIC /begin REF_MEASUREMENT HwAg1Meas.dHwAg1MeasSnsr0FRXD /end REF_MEASUREMENT /end GROUP
/begin GROUP HwAg1Meas.dHwAg1MeasSnsr0Rel "MICROSAR RTE" /begin SUB_GROUP /end SUB_GROUP /begin FUNCTION_LIST /end FUNCTION_LIST /begin REF_CHARACTERISTIC /end REF_CHARACTERISTIC /begin REF_MEASUREMENT HwAg1Meas.dHwAg1MeasSnsr0Rel /end REF_MEASUREMENT /end GROUP
/begin GROUP HwAg1Meas.dHwAg1MeasSnsr1Abs "MICROSAR RTE" /begin SUB_GROUP /end SUB_GROUP /begin FUNCTION_LIST /end FUNCTION_LIST /begin REF_CHARACTERISTIC /end REF_CHARACTERISTIC /begin REF_MEASUREMENT HwAg1Meas.dHwAg1MeasSnsr1Abs /end REF_MEASUREMENT /end GROUP
/begin GROUP HwAg1Meas.dHwAg1MeasSnsr1CS "MICROSAR RTE" /begin SUB_GROUP /end SUB_GROUP /begin FUNCTION_LIST /end FUNCTION_LIST /begin REF_CHARACTERISTIC /end REF_CHARACTERISTIC /begin REF_MEASUREMENT HwAg1Meas.dHwAg1MeasSnsr1CS /end REF_MEASUREMENT /end GROUP
/begin GROUP HwAg1Meas.dHwAg1MeasSnsr1FRXD "MICROSAR RTE" /begin SUB_GROUP /end SUB_GROUP /begin FUNCTION_LIST /end FUNCTION_LIST /begin REF_CHARACTERISTIC /end REF_CHARACTERISTIC /begin REF_MEASUREMENT HwAg1Meas.dHwAg1MeasSnsr1FRXD /end REF_MEASUREMENT /end GROUP
/begin GROUP HwAg1Meas.dHwAg1MeasSnsr1Rel "MICROSAR RTE" /begin SUB_GROUP /end SUB_GROUP /begin FUNCTION_LIST /end FUNCTION_LIST /begin REF_CHARACTERISTIC /end REF_CHARACTERISTIC /begin REF_MEASUREMENT HwAg1Meas.dHwAg1MeasSnsr1Rel /end REF_MEASUREMENT /end GROUP
/begin GROUP HwAgArbn "MICROSAR RTE"
 /begin SUB_GROUP HwAgArbn.PerInstanceMemories HwAgArbn.ReceiverPorts HwAgArbn.SenderPorts /end SUB_GROUP
 /begin FUNCTION_LIST /end FUNCTION_LIST
 /begin REF_CHARACTERISTIC /end REF_CHARACTERISTIC
 /begin REF_MEASUREMENT /end REF_MEASUREMENT
/end GROUP
/begin GROUP HwAgArbn.HwAg.Val "MICROSAR RTE" /begin SUB_GROUP /end SUB_GROUP /begin FUNCTION_LIST /end FUNCTION_LIST /begin REF_CHARACTERISTIC /end REF_CHARACTERISTIC /begin REF_MEASUREMENT HwAgArbn.HwAg.Val /end REF_MEASUREMENT /end GROUP
/begin GROUP HwAgArbn.HwAgA.Val "MICROSAR RTE" /begin SUB_GROUP /end SUB_GROUP /begin FUNCTION_LIST /end FUNCTION_LIST /begin REF_CHARACTERISTIC /end REF_CHARACTERISTIC /begin REF_MEASUREMENT HwAgArbn.HwAgA.Val /end REF_MEASUREMENT /end GROUP
/begin GROUP HwAgArbn.HwAgAQlfr.Val "MICROSAR RTE" /begin SUB_GROUP /end SUB_GROUP /begin FUNCTION_LIST /end FUNCTION_LIST /begin REF_CHARACTERISTIC /end REF_CHARACTERISTIC /begin REF_MEASUREMENT HwAgArbn.HwAgAQlfr.Val /end REF_MEASUREMENT /end GROUP
/begin GROUP HwAgArbn.HwAgARollgCntr.Val "MICROSAR RTE" /begin SUB_GROUP /end SUB_GROUP /begin FUNCTION_LIST /end FUNCTION_LIST /begin REF_CHARACTERISTIC /end REF_CHARACTERISTIC /begin REF_MEASUREMENT HwAgArbn.HwAgARollgCntr.Val /end REF_MEASUREMENT /end GROUP
/begin GROUP HwAgArbn.HwAgARollgCntrPrev "MICROSAR RTE" /begin SUB_GROUP /end SUB_GROUP /begin FUNCTION_LIST /end FUNCTION_LIST /begin REF_CHARACTERISTIC /end REF_CHARACTERISTIC /begin REF_MEASUREMENT HwAgArbn.HwAgARollgCntrPrev /end REF_MEASUREMENT /end GROUP
/begin GROUP HwAgArbn.HwAgAStallCntrPrev "MICROSAR RTE" /begin SUB_GROUP /end SUB_GROUP /begin FUNCTION_LIST /end FUNCTION_LIST /begin REF_CHARACTERISTIC /end REF_CHARACTERISTIC /begin REF_MEASUREMENT HwAgArbn.HwAgAStallCntrPrev /end REF_MEASUREMENT /end GROUP
/begin GROUP HwAgArbn.HwAgCorrlnSt.Val "MICROSAR RTE" /begin SUB_GROUP /end SUB_GROUP /begin FUNCTION_LIST /end FUNCTION_LIST /begin REF_CHARACTERISTIC /end REF_CHARACTERISTIC /begin REF_MEASUREMENT HwAgArbn.HwAgCorrlnSt.Val /end REF_MEASUREMENT /end GROUP
/begin GROUP HwAgArbn.HwAgPrev "MICROSAR RTE" /begin SUB_GROUP /end SUB_GROUP /begin FUNCTION_LIST /end FUNCTION_LIST /begin REF_CHARACTERISTIC /end REF_CHARACTERISTIC /begin REF_MEASUREMENT HwAgArbn.HwAgPrev /end REF_MEASUREMENT /end GROUP
/begin GROUP HwAgArbn.PerInstanceMemories "MICROSAR RTE"
 /begin SUB_GROUP HwAgArbn.HwAgARollgCntrPrev HwAgArbn.HwAgAStallCntrPrev HwAgArbn.HwAgPrev HwAgArbn.dHwAgArbnAgAAvl /end SUB_GROUP
 /begin FUNCTION_LIST /end FUNCTION_LIST
 /begin REF_CHARACTERISTIC /end REF_CHARACTERISTIC
 /begin REF_MEASUREMENT /end REF_MEASUREMENT
/end GROUP
/begin GROUP HwAgArbn.ReceiverPorts "MICROSAR RTE"
 /begin SUB_GROUP HwAgArbn.HwAgA.Val HwAgArbn.HwAgAQlfr.Val HwAgArbn.HwAgARollgCntr.Val HwAgArbn.HwAgCorrlnSt.Val /end SUB_GROUP
 /begin FUNCTION_LIST /end FUNCTION_LIST
 /begin REF_CHARACTERISTIC /end REF_CHARACTERISTIC
 /begin REF_MEASUREMENT /end REF_MEASUREMENT
/end GROUP
/begin GROUP HwAgArbn.SenderPorts "MICROSAR RTE" /begin SUB_GROUP HwAgArbn.HwAg.Val /end SUB_GROUP /begin FUNCTION_LIST /end FUNCTION_LIST /begin REF_CHARACTERISTIC /end REF_CHARACTERISTIC /begin REF_MEASUREMENT /end REF_MEASUREMENT /end GROUP
/begin GROUP HwAgArbn.dHwAgArbnAgAAvl "MICROSAR RTE" /begin SUB_GROUP /end SUB_GROUP /begin FUNCTION_LIST /end FUNCTION_LIST /begin REF_CHARACTERISTIC /end REF_CHARACTERISTIC /begin REF_MEASUREMENT HwAgArbn.dHwAgArbnAgAAvl /end REF_MEASUREMENT /end GROUP
/begin GROUP HwAgCorrln "MICROSAR RTE"
 /begin SUB_GROUP HwAgCorrln.PerInstanceMemories HwAgCorrln.ReceiverPorts HwAgCorrln.SenderPorts /end SUB_GROUP
 /begin FUNCTION_LIST /end FUNCTION_LIST
 /begin REF_CHARACTERISTIC /end REF_CHARACTERISTIC
 /begin REF_MEASUREMENT /end REF_MEASUREMENT
/end GROUP
/begin GROUP HwAgCorrln.HwAgAQlfr.Val "MICROSAR RTE" /begin SUB_GROUP /end SUB_GROUP /begin FUNCTION_LIST /end FUNCTION_LIST /begin REF_CHARACTERISTIC /end REF_CHARACTERISTIC /begin REF_MEASUREMENT HwAgCorrln.HwAgAQlfr.Val /end REF_MEASUREMENT /end GROUP
/begin GROUP HwAgCorrln.HwAgARollgCntPrev "MICROSAR RTE" /begin SUB_GROUP /end SUB_GROUP /begin FUNCTION_LIST /end FUNCTION_LIST /begin REF_CHARACTERISTIC /end REF_CHARACTERISTIC /begin REF_MEASUREMENT HwAgCorrln.HwAgARollgCntPrev /end REF_MEASUREMENT /end GROUP
/begin GROUP HwAgCorrln.HwAgARollgCntr.Val "MICROSAR RTE" /begin SUB_GROUP /end SUB_GROUP /begin FUNCTION_LIST /end FUNCTION_LIST /begin REF_CHARACTERISTIC /end REF_CHARACTERISTIC /begin REF_MEASUREMENT HwAgCorrln.HwAgARollgCntr.Val /end REF_MEASUREMENT /end GROUP
/begin GROUP HwAgCorrln.HwAgAStallCntPrev "MICROSAR RTE" /begin SUB_GROUP /end SUB_GROUP /begin FUNCTION_LIST /end FUNCTION_LIST /begin REF_CHARACTERISTIC /end REF_CHARACTERISTIC /begin REF_MEASUREMENT HwAgCorrln.HwAgAStallCntPrev /end REF_MEASUREMENT /end GROUP
/begin GROUP HwAgCorrln.HwAgCorrlnSt.Val "MICROSAR RTE" /begin SUB_GROUP /end SUB_GROUP /begin FUNCTION_LIST /end FUNCTION_LIST /begin REF_CHARACTERISTIC /end REF_CHARACTERISTIC /begin REF_MEASUREMENT HwAgCorrln.HwAgCorrlnSt.Val /end REF_MEASUREMENT /end GROUP
/begin GROUP HwAgCorrln.HwAgIdptSig.Val "MICROSAR RTE" /begin SUB_GROUP /end SUB_GROUP /begin FUNCTION_LIST /end FUNCTION_LIST /begin REF_CHARACTERISTIC /end REF_CHARACTERISTIC /begin REF_MEASUREMENT HwAgCorrln.HwAgIdptSig.Val /end REF_MEASUREMENT /end GROUP
/begin GROUP HwAgCorrln.PerInstanceMemories "MICROSAR RTE"
 /begin SUB_GROUP HwAgCorrln.HwAgARollgCntPrev HwAgCorrln.HwAgAStallCntPrev HwAgCorrln.dHwAgCorrlnAgAAvl /end SUB_GROUP
 /begin FUNCTION_LIST /end FUNCTION_LIST
 /begin REF_CHARACTERISTIC /end REF_CHARACTERISTIC
 /begin REF_MEASUREMENT /end REF_MEASUREMENT
/end GROUP
/begin GROUP HwAgCorrln.ReceiverPorts "MICROSAR RTE" /begin SUB_GROUP HwAgCorrln.HwAgAQlfr.Val HwAgCorrln.HwAgARollgCntr.Val /end SUB_GROUP /begin FUNCTION_LIST /end FUNCTION_LIST /begin REF_CHARACTERISTIC /end REF_CHARACTERISTIC /begin REF_MEASUREMENT /end REF_MEASUREMENT /end GROUP
/begin GROUP HwAgCorrln.SenderPorts "MICROSAR RTE" /begin SUB_GROUP HwAgCorrln.HwAgCorrlnSt.Val HwAgCorrln.HwAgIdptSig.Val /end SUB_GROUP /begin FUNCTION_LIST /end FUNCTION_LIST /begin REF_CHARACTERISTIC /end REF_CHARACTERISTIC /begin REF_MEASUREMENT /end REF_MEASUREMENT /end GROUP
/begin GROUP HwAgCorrln.dHwAgCorrlnAgAAvl "MICROSAR RTE" /begin SUB_GROUP /end SUB_GROUP /begin FUNCTION_LIST /end FUNCTION_LIST /begin REF_CHARACTERISTIC /end REF_CHARACTERISTIC /begin REF_MEASUREMENT HwAgCorrln.dHwAgCorrlnAgAAvl /end REF_MEASUREMENT /end GROUP
/begin GROUP HwAgSnsrls "MICROSAR RTE"
 /begin SUB_GROUP HwAgSnsrls.CalibrationParameters HwAgSnsrls.CalibrationPorts HwAgSnsrls.PerInstanceMemories HwAgSnsrls.ReceiverPorts HwAgSnsrls.SenderPorts /end SUB_GROUP
 /begin FUNCTION_LIST /end FUNCTION_LIST
 /begin REF_CHARACTERISTIC /end REF_CHARACTERISTIC
 /begin REF_MEASUREMENT /end REF_MEASUREMENT
/end GROUP
/begin GROUP HwAgSnsrls.CalibrationParameters "MICROSAR RTE" /begin SUB_GROUP HwAgSnsrls.StordLstPrmDft /end SUB_GROUP /begin FUNCTION_LIST /end FUNCTION_LIST /begin REF_CHARACTERISTIC /end REF_CHARACTERISTIC /begin REF_MEASUREMENT /end REF_MEASUREMENT /end GROUP
/begin GROUP HwAgSnsrls.CalibrationPorts "MICROSAR RTE"
 /begin SUB_GROUP HwAgSnsrls.HwAgSnsrlsCorrdPinionAgConfThd.Val HwAgSnsrls.HwAgSnsrlsCorrdPinionAgHwConf.Val HwAgSnsrls.HwAgSnsrlsFCentrHwConf.Val HwAgSnsrls.HwAgSnsrlsFeatEna.Logl HwAgSnsrls.HwAgSnsrlsMotAgIdptSigThd.Val HwAgSnsrls.HwAgSnsrlsPinionTqFilFrq.Val HwAgSnsrls.HwAgSnsrlsRelHwAgFil1Frq.Val HwAgSnsrls.HwAgSnsrlsRelHwAgFil2Frq.Val HwAgSnsrls.HwAgSnsrlsSmotngCoeff.Val HwAgSnsrls.HwAgSnsrlsSmotngStepThd.Val HwAgSnsrls.HwAgSnsrlsStordPinionConf.Val HwAgSnsrls.HwAgSnsrlsStordPinionConfThd.Val HwAgSnsrls.HwAgSnsrlsVehDynDifThd.Val HwAgSnsrls.HwAgSnsrlsVehDynHwConf.Val HwAgSnsrls.HwAgSnsrlsVehDynMotVelThd.Val HwAgSnsrls.HwAgSnsrlsVehDynPinionTqThd.Val HwAgSnsrls.HwAgSnsrlsVehDynTmr1Thd.Val HwAgSnsrls.HwAgSnsrlsVehDynTmr2Thd.Val HwAgSnsrls.HwAgSnsrlsVehDynVehSpdThd.Val HwAgSnsrls.HwAgSnsrlsVehDynYawRateThd.Val HwAgSnsrls.HwAgSnsrlsWhlFrqThd.Val HwAgSnsrls.HwAgSnsrlsWhlSpdHwAgCoeff1.Val HwAgSnsrls.HwAgSnsrlsWhlSpdHwAgCoeff2.Val HwAgSnsrls.HwAgSnsrlsWhlSpdHwAgThd.Val HwAgSnsrls.HwAgSnsrlsWhlSpdHwConf.Val HwAgSnsrls.HwAgSnsrlsWhlSpdRatThd.Val HwAgSnsrls.HwAgSnsrlsWhlSpdTmrThd.Val HwAgSnsrls.HwAgSnsrlsWhlSpdVehSpdThd.Val HwAgSnsrls.HwAgSnsrlsYawRateFilFrq.Val HwAgSnsrls.SysGlbPrmSysKineRat.Val HwAgSnsrls.SysGlbPrmSysTqRat.Val /end SUB_GROUP
 /begin FUNCTION_LIST /end FUNCTION_LIST
 /begin REF_CHARACTERISTIC /end REF_CHARACTERISTIC
 /begin REF_MEASUREMENT /end REF_MEASUREMENT
/end GROUP
/begin GROUP HwAgSnsrls.CmplncErrMotToPinion.Val "MICROSAR RTE" /begin SUB_GROUP /end SUB_GROUP /begin FUNCTION_LIST /end FUNCTION_LIST /begin REF_CHARACTERISTIC /end REF_CHARACTERISTIC /begin REF_MEASUREMENT HwAgSnsrls.CmplncErrMotToPinion.Val /end REF_MEASUREMENT /end GROUP
/begin GROUP HwAgSnsrls.CorrdPinionAgHwAgOffs "MICROSAR RTE" /begin SUB_GROUP /end SUB_GROUP /begin FUNCTION_LIST /end FUNCTION_LIST /begin REF_CHARACTERISTIC /end REF_CHARACTERISTIC /begin REF_MEASUREMENT HwAgSnsrls.CorrdPinionAgHwAgOffs /end REF_MEASUREMENT /end GROUP
/begin GROUP HwAgSnsrls.CorrdPinionAgHwConf "MICROSAR RTE" /begin SUB_GROUP /end SUB_GROUP /begin FUNCTION_LIST /end FUNCTION_LIST /begin REF_CHARACTERISTIC /end REF_CHARACTERISTIC /begin REF_MEASUREMENT HwAgSnsrls.CorrdPinionAgHwConf /end REF_MEASUREMENT /end GROUP
/begin GROUP HwAgSnsrls.EcuId.Val "MICROSAR RTE" /begin SUB_GROUP /end SUB_GROUP /begin FUNCTION_LIST /end FUNCTION_LIST /begin REF_CHARACTERISTIC /end REF_CHARACTERISTIC /begin REF_MEASUREMENT HwAgSnsrls.EcuId.Val /end REF_MEASUREMENT /end GROUP
/begin GROUP HwAgSnsrls.FCentrHwAgEna "MICROSAR RTE" /begin SUB_GROUP /end SUB_GROUP /begin FUNCTION_LIST /end FUNCTION_LIST /begin REF_CHARACTERISTIC /end REF_CHARACTERISTIC /begin REF_MEASUREMENT HwAgSnsrls.FCentrHwAgEna /end REF_MEASUREMENT /end GROUP
/begin GROUP HwAgSnsrls.FCentrHwAgOffs "MICROSAR RTE" /begin SUB_GROUP /end SUB_GROUP /begin FUNCTION_LIST /end FUNCTION_LIST /begin REF_CHARACTERISTIC /end REF_CHARACTERISTIC /begin REF_MEASUREMENT HwAgSnsrls.FCentrHwAgOffs /end REF_MEASUREMENT /end GROUP
/begin GROUP HwAgSnsrls.FCentrHwConf "MICROSAR RTE" /begin SUB_GROUP /end SUB_GROUP /begin FUNCTION_LIST /end FUNCTION_LIST /begin REF_CHARACTERISTIC /end REF_CHARACTERISTIC /begin REF_MEASUREMENT HwAgSnsrls.FCentrHwConf /end REF_MEASUREMENT /end GROUP
/begin GROUP HwAgSnsrls.HwAgSnsrls.Val "MICROSAR RTE" /begin SUB_GROUP /end SUB_GROUP /begin FUNCTION_LIST /end FUNCTION_LIST /begin REF_CHARACTERISTIC /end REF_CHARACTERISTIC /begin REF_MEASUREMENT HwAgSnsrls.HwAgSnsrls.Val /end REF_MEASUREMENT /end GROUP
/begin GROUP HwAgSnsrls.HwAgSnsrlsConf.Val "MICROSAR RTE" /begin SUB_GROUP /end SUB_GROUP /begin FUNCTION_LIST /end FUNCTION_LIST /begin REF_CHARACTERISTIC /end REF_CHARACTERISTIC /begin REF_MEASUREMENT HwAgSnsrls.HwAgSnsrlsConf.Val /end REF_MEASUREMENT /end GROUP
/begin GROUP HwAgSnsrls.HwAgSnsrlsCorrdPinionAgConfThd.Val "MICROSAR RTE" /begin SUB_GROUP /end SUB_GROUP /begin FUNCTION_LIST /end FUNCTION_LIST /begin REF_CHARACTERISTIC HwAgSnsrls.HwAgSnsrlsCorrdPinionAgConfThd.Val /end REF_CHARACTERISTIC /begin REF_MEASUREMENT /end REF_MEASUREMENT /end GROUP
/begin GROUP HwAgSnsrls.HwAgSnsrlsCorrdPinionAgHwConf.Val "MICROSAR RTE" /begin SUB_GROUP /end SUB_GROUP /begin FUNCTION_LIST /end FUNCTION_LIST /begin REF_CHARACTERISTIC HwAgSnsrls.HwAgSnsrlsCorrdPinionAgHwConf.Val /end REF_CHARACTERISTIC /begin REF_MEASUREMENT /end REF_MEASUREMENT /end GROUP
/begin GROUP HwAgSnsrls.HwAgSnsrlsFCentrHwConf.Val "MICROSAR RTE" /begin SUB_GROUP /end SUB_GROUP /begin FUNCTION_LIST /end FUNCTION_LIST /begin REF_CHARACTERISTIC HwAgSnsrls.HwAgSnsrlsFCentrHwConf.Val /end REF_CHARACTERISTIC /begin REF_MEASUREMENT /end REF_MEASUREMENT /end GROUP
/begin GROUP HwAgSnsrls.HwAgSnsrlsFeatEna.Logl "MICROSAR RTE" /begin SUB_GROUP /end SUB_GROUP /begin FUNCTION_LIST /end FUNCTION_LIST /begin REF_CHARACTERISTIC HwAgSnsrls.HwAgSnsrlsFeatEna.Logl /end REF_CHARACTERISTIC /begin REF_MEASUREMENT /end REF_MEASUREMENT /end GROUP
/begin GROUP HwAgSnsrls.HwAgSnsrlsMotAgIdptSigThd.Val "MICROSAR RTE" /begin SUB_GROUP /end SUB_GROUP /begin FUNCTION_LIST /end FUNCTION_LIST /begin REF_CHARACTERISTIC HwAgSnsrls.HwAgSnsrlsMotAgIdptSigThd.Val /end REF_CHARACTERISTIC /begin REF_MEASUREMENT /end REF_MEASUREMENT /end GROUP
/begin GROUP HwAgSnsrls.HwAgSnsrlsPinionTqFilFrq.Val "MICROSAR RTE" /begin SUB_GROUP /end SUB_GROUP /begin FUNCTION_LIST /end FUNCTION_LIST /begin REF_CHARACTERISTIC HwAgSnsrls.HwAgSnsrlsPinionTqFilFrq.Val /end REF_CHARACTERISTIC /begin REF_MEASUREMENT /end REF_MEASUREMENT /end GROUP
/begin GROUP HwAgSnsrls.HwAgSnsrlsRelHwAgFil1Frq.Val "MICROSAR RTE" /begin SUB_GROUP /end SUB_GROUP /begin FUNCTION_LIST /end FUNCTION_LIST /begin REF_CHARACTERISTIC HwAgSnsrls.HwAgSnsrlsRelHwAgFil1Frq.Val /end REF_CHARACTERISTIC /begin REF_MEASUREMENT /end REF_MEASUREMENT /end GROUP
/begin GROUP HwAgSnsrls.HwAgSnsrlsRelHwAgFil2Frq.Val "MICROSAR RTE" /begin SUB_GROUP /end SUB_GROUP /begin FUNCTION_LIST /end FUNCTION_LIST /begin REF_CHARACTERISTIC HwAgSnsrls.HwAgSnsrlsRelHwAgFil2Frq.Val /end REF_CHARACTERISTIC /begin REF_MEASUREMENT /end REF_MEASUREMENT /end GROUP
/begin GROUP HwAgSnsrls.HwAgSnsrlsSmotngCoeff.Val "MICROSAR RTE" /begin SUB_GROUP /end SUB_GROUP /begin FUNCTION_LIST /end FUNCTION_LIST /begin REF_CHARACTERISTIC HwAgSnsrls.HwAgSnsrlsSmotngCoeff.Val /end REF_CHARACTERISTIC /begin REF_MEASUREMENT /end REF_MEASUREMENT /end GROUP
/begin GROUP HwAgSnsrls.HwAgSnsrlsSmotngStepThd.Val "MICROSAR RTE" /begin SUB_GROUP /end SUB_GROUP /begin FUNCTION_LIST /end FUNCTION_LIST /begin REF_CHARACTERISTIC HwAgSnsrls.HwAgSnsrlsSmotngStepThd.Val /end REF_CHARACTERISTIC /begin REF_MEASUREMENT /end REF_MEASUREMENT /end GROUP
/begin GROUP HwAgSnsrls.HwAgSnsrlsStordPinionConf.Val "MICROSAR RTE" /begin SUB_GROUP /end SUB_GROUP /begin FUNCTION_LIST /end FUNCTION_LIST /begin REF_CHARACTERISTIC HwAgSnsrls.HwAgSnsrlsStordPinionConf.Val /end REF_CHARACTERISTIC /begin REF_MEASUREMENT /end REF_MEASUREMENT /end GROUP
/begin GROUP HwAgSnsrls.HwAgSnsrlsStordPinionConfThd.Val "MICROSAR RTE" /begin SUB_GROUP /end SUB_GROUP /begin FUNCTION_LIST /end FUNCTION_LIST /begin REF_CHARACTERISTIC HwAgSnsrls.HwAgSnsrlsStordPinionConfThd.Val /end REF_CHARACTERISTIC /begin REF_MEASUREMENT /end REF_MEASUREMENT /end GROUP
/begin GROUP HwAgSnsrls.HwAgSnsrlsVehDynDifThd.Val "MICROSAR RTE" /begin SUB_GROUP /end SUB_GROUP /begin FUNCTION_LIST /end FUNCTION_LIST /begin REF_CHARACTERISTIC HwAgSnsrls.HwAgSnsrlsVehDynDifThd.Val /end REF_CHARACTERISTIC /begin REF_MEASUREMENT /end REF_MEASUREMENT /end GROUP
/begin GROUP HwAgSnsrls.HwAgSnsrlsVehDynHwConf.Val "MICROSAR RTE" /begin SUB_GROUP /end SUB_GROUP /begin FUNCTION_LIST /end FUNCTION_LIST /begin REF_CHARACTERISTIC HwAgSnsrls.HwAgSnsrlsVehDynHwConf.Val /end REF_CHARACTERISTIC /begin REF_MEASUREMENT /end REF_MEASUREMENT /end GROUP
/begin GROUP HwAgSnsrls.HwAgSnsrlsVehDynMotVelThd.Val "MICROSAR RTE" /begin SUB_GROUP /end SUB_GROUP /begin FUNCTION_LIST /end FUNCTION_LIST /begin REF_CHARACTERISTIC HwAgSnsrls.HwAgSnsrlsVehDynMotVelThd.Val /end REF_CHARACTERISTIC /begin REF_MEASUREMENT /end REF_MEASUREMENT /end GROUP
/begin GROUP HwAgSnsrls.HwAgSnsrlsVehDynPinionTqThd.Val "MICROSAR RTE" /begin SUB_GROUP /end SUB_GROUP /begin FUNCTION_LIST /end FUNCTION_LIST /begin REF_CHARACTERISTIC HwAgSnsrls.HwAgSnsrlsVehDynPinionTqThd.Val /end REF_CHARACTERISTIC /begin REF_MEASUREMENT /end REF_MEASUREMENT /end GROUP
/begin GROUP HwAgSnsrls.HwAgSnsrlsVehDynTmr1Thd.Val "MICROSAR RTE" /begin SUB_GROUP /end SUB_GROUP /begin FUNCTION_LIST /end FUNCTION_LIST /begin REF_CHARACTERISTIC HwAgSnsrls.HwAgSnsrlsVehDynTmr1Thd.Val /end REF_CHARACTERISTIC /begin REF_MEASUREMENT /end REF_MEASUREMENT /end GROUP
/begin GROUP HwAgSnsrls.HwAgSnsrlsVehDynTmr2Thd.Val "MICROSAR RTE" /begin SUB_GROUP /end SUB_GROUP /begin FUNCTION_LIST /end FUNCTION_LIST /begin REF_CHARACTERISTIC HwAgSnsrls.HwAgSnsrlsVehDynTmr2Thd.Val /end REF_CHARACTERISTIC /begin REF_MEASUREMENT /end REF_MEASUREMENT /end GROUP
/begin GROUP HwAgSnsrls.HwAgSnsrlsVehDynVehSpdThd.Val "MICROSAR RTE" /begin SUB_GROUP /end SUB_GROUP /begin FUNCTION_LIST /end FUNCTION_LIST /begin REF_CHARACTERISTIC HwAgSnsrls.HwAgSnsrlsVehDynVehSpdThd.Val /end REF_CHARACTERISTIC /begin REF_MEASUREMENT /end REF_MEASUREMENT /end GROUP
/begin GROUP HwAgSnsrls.HwAgSnsrlsVehDynYawRateThd.Val "MICROSAR RTE" /begin SUB_GROUP /end SUB_GROUP /begin FUNCTION_LIST /end FUNCTION_LIST /begin REF_CHARACTERISTIC HwAgSnsrls.HwAgSnsrlsVehDynYawRateThd.Val /end REF_CHARACTERISTIC /begin REF_MEASUREMENT /end REF_MEASUREMENT /end GROUP
/begin GROUP HwAgSnsrls.HwAgSnsrlsWhlFrqThd.Val "MICROSAR RTE" /begin SUB_GROUP /end SUB_GROUP /begin FUNCTION_LIST /end FUNCTION_LIST /begin REF_CHARACTERISTIC HwAgSnsrls.HwAgSnsrlsWhlFrqThd.Val /end REF_CHARACTERISTIC /begin REF_MEASUREMENT /end REF_MEASUREMENT /end GROUP
/begin GROUP HwAgSnsrls.HwAgSnsrlsWhlSpdHwAgCoeff1.Val "MICROSAR RTE" /begin SUB_GROUP /end SUB_GROUP /begin FUNCTION_LIST /end FUNCTION_LIST /begin REF_CHARACTERISTIC HwAgSnsrls.HwAgSnsrlsWhlSpdHwAgCoeff1.Val /end REF_CHARACTERISTIC /begin REF_MEASUREMENT /end REF_MEASUREMENT /end GROUP
/begin GROUP HwAgSnsrls.HwAgSnsrlsWhlSpdHwAgCoeff2.Val "MICROSAR RTE" /begin SUB_GROUP /end SUB_GROUP /begin FUNCTION_LIST /end FUNCTION_LIST /begin REF_CHARACTERISTIC HwAgSnsrls.HwAgSnsrlsWhlSpdHwAgCoeff2.Val /end REF_CHARACTERISTIC /begin REF_MEASUREMENT /end REF_MEASUREMENT /end GROUP
/begin GROUP HwAgSnsrls.HwAgSnsrlsWhlSpdHwAgThd.Val "MICROSAR RTE" /begin SUB_GROUP /end SUB_GROUP /begin FUNCTION_LIST /end FUNCTION_LIST /begin REF_CHARACTERISTIC HwAgSnsrls.HwAgSnsrlsWhlSpdHwAgThd.Val /end REF_CHARACTERISTIC /begin REF_MEASUREMENT /end REF_MEASUREMENT /end GROUP
/begin GROUP HwAgSnsrls.HwAgSnsrlsWhlSpdHwConf.Val "MICROSAR RTE" /begin SUB_GROUP /end SUB_GROUP /begin FUNCTION_LIST /end FUNCTION_LIST /begin REF_CHARACTERISTIC HwAgSnsrls.HwAgSnsrlsWhlSpdHwConf.Val /end REF_CHARACTERISTIC /begin REF_MEASUREMENT /end REF_MEASUREMENT /end GROUP
/begin GROUP HwAgSnsrls.HwAgSnsrlsWhlSpdRatThd.Val "MICROSAR RTE" /begin SUB_GROUP /end SUB_GROUP /begin FUNCTION_LIST /end FUNCTION_LIST /begin REF_CHARACTERISTIC HwAgSnsrls.HwAgSnsrlsWhlSpdRatThd.Val /end REF_CHARACTERISTIC /begin REF_MEASUREMENT /end REF_MEASUREMENT /end GROUP
/begin GROUP HwAgSnsrls.HwAgSnsrlsWhlSpdTmrThd.Val "MICROSAR RTE" /begin SUB_GROUP /end SUB_GROUP /begin FUNCTION_LIST /end FUNCTION_LIST /begin REF_CHARACTERISTIC HwAgSnsrls.HwAgSnsrlsWhlSpdTmrThd.Val /end REF_CHARACTERISTIC /begin REF_MEASUREMENT /end REF_MEASUREMENT /end GROUP
/begin GROUP HwAgSnsrls.HwAgSnsrlsWhlSpdVehSpdThd.Val "MICROSAR RTE" /begin SUB_GROUP /end SUB_GROUP /begin FUNCTION_LIST /end FUNCTION_LIST /begin REF_CHARACTERISTIC HwAgSnsrls.HwAgSnsrlsWhlSpdVehSpdThd.Val /end REF_CHARACTERISTIC /begin REF_MEASUREMENT /end REF_MEASUREMENT /end GROUP
/begin GROUP HwAgSnsrls.HwAgSnsrlsYawRateFilFrq.Val "MICROSAR RTE" /begin SUB_GROUP /end SUB_GROUP /begin FUNCTION_LIST /end FUNCTION_LIST /begin REF_CHARACTERISTIC HwAgSnsrls.HwAgSnsrlsYawRateFilFrq.Val /end REF_CHARACTERISTIC /begin REF_MEASUREMENT /end REF_MEASUREMENT /end GROUP
/begin GROUP HwAgSnsrls.HwTq.Val "MICROSAR RTE" /begin SUB_GROUP /end SUB_GROUP /begin FUNCTION_LIST /end FUNCTION_LIST /begin REF_CHARACTERISTIC /end REF_CHARACTERISTIC /begin REF_MEASUREMENT HwAgSnsrls.HwTq.Val /end REF_MEASUREMENT /end GROUP
/begin GROUP HwAgSnsrls.MotAgCumvAlgndCrf.Val "MICROSAR RTE" /begin SUB_GROUP /end SUB_GROUP /begin FUNCTION_LIST /end FUNCTION_LIST /begin REF_CHARACTERISTIC /end REF_CHARACTERISTIC /begin REF_MEASUREMENT HwAgSnsrls.MotAgCumvAlgndCrf.Val /end REF_MEASUREMENT /end GROUP
/begin GROUP HwAgSnsrls.MotAgCumvAlgndVld.Logl "MICROSAR RTE" /begin SUB_GROUP /end SUB_GROUP /begin FUNCTION_LIST /end FUNCTION_LIST /begin REF_CHARACTERISTIC /end REF_CHARACTERISTIC /begin REF_MEASUREMENT HwAgSnsrls.MotAgCumvAlgndVld.Logl /end REF_MEASUREMENT /end GROUP
/begin GROUP HwAgSnsrls.MotAgMeclIdptSig.Val "MICROSAR RTE" /begin SUB_GROUP /end SUB_GROUP /begin FUNCTION_LIST /end FUNCTION_LIST /begin REF_CHARACTERISTIC /end REF_CHARACTERISTIC /begin REF_MEASUREMENT HwAgSnsrls.MotAgMeclIdptSig.Val /end REF_MEASUREMENT /end GROUP
/begin GROUP HwAgSnsrls.MotAgOffs "MICROSAR RTE" /begin SUB_GROUP /end SUB_GROUP /begin FUNCTION_LIST /end FUNCTION_LIST /begin REF_CHARACTERISTIC /end REF_CHARACTERISTIC /begin REF_MEASUREMENT HwAgSnsrls.MotAgOffs /end REF_MEASUREMENT /end GROUP
/begin GROUP HwAgSnsrls.MotAgOffsEna "MICROSAR RTE" /begin SUB_GROUP /end SUB_GROUP /begin FUNCTION_LIST /end FUNCTION_LIST /begin REF_CHARACTERISTIC /end REF_CHARACTERISTIC /begin REF_MEASUREMENT HwAgSnsrls.MotAgOffsEna /end REF_MEASUREMENT /end GROUP
/begin GROUP HwAgSnsrls.MotTqCmdCrf.Val "MICROSAR RTE" /begin SUB_GROUP /end SUB_GROUP /begin FUNCTION_LIST /end FUNCTION_LIST /begin REF_CHARACTERISTIC /end REF_CHARACTERISTIC /begin REF_MEASUREMENT HwAgSnsrls.MotTqCmdCrf.Val /end REF_MEASUREMENT /end GROUP
/begin GROUP HwAgSnsrls.MotVelCrf.Val "MICROSAR RTE" /begin SUB_GROUP /end SUB_GROUP /begin FUNCTION_LIST /end FUNCTION_LIST /begin REF_CHARACTERISTIC /end REF_CHARACTERISTIC /begin REF_MEASUREMENT HwAgSnsrls.MotVelCrf.Val /end REF_MEASUREMENT /end GROUP
/begin GROUP HwAgSnsrls.PerInstanceMemories "MICROSAR RTE"
 /begin SUB_GROUP HwAgSnsrls.CorrdPinionAgHwAgOffs HwAgSnsrls.CorrdPinionAgHwConf HwAgSnsrls.FCentrHwAgEna HwAgSnsrls.FCentrHwAgOffs HwAgSnsrls.FCentrHwConf HwAgSnsrls.MotAgOffs HwAgSnsrls.MotAgOffsEna HwAgSnsrls.PinionTqFil HwAgSnsrls.PrevFildRelHwAg1 HwAgSnsrls.PrevHwAgOffs HwAgSnsrls.PrevMaxHwConf HwAgSnsrls.PrevSmotngHwAg HwAgSnsrls.PrevSmotngSt HwAgSnsrls.PrevVehDynFil1Ena HwAgSnsrls.PrevVehDynFil2Ena HwAgSnsrls.RelHwAgFil1 HwAgSnsrls.RelHwAgFil2 HwAgSnsrls.SelnCaseSt HwAgSnsrls.StordLstPrm HwAgSnsrls.VehDynHwAgOffs HwAgSnsrls.VehDynRefTmr1 HwAgSnsrls.VehDynRefTmr2 HwAgSnsrls.WhlSpdHwAgLrndEna HwAgSnsrls.WhlSpdHwAgOffs HwAgSnsrls.WhlSpdHwConf HwAgSnsrls.WhlSpdRefTmr HwAgSnsrls.YawRateFil HwAgSnsrls.dHwAgSnsrlsStordHwAg HwAgSnsrls.dHwAgSnsrlsStordHwConf HwAgSnsrls.dHwAgSnsrlsVehDynHwConf HwAgSnsrls.dHwAgSnsrlsWhlSpdHwConf /end SUB_GROUP
 /begin FUNCTION_LIST /end FUNCTION_LIST
 /begin REF_CHARACTERISTIC /end REF_CHARACTERISTIC
 /begin REF_MEASUREMENT /end REF_MEASUREMENT
/end GROUP
/begin GROUP HwAgSnsrls.PinionAg.Val "MICROSAR RTE" /begin SUB_GROUP /end SUB_GROUP /begin FUNCTION_LIST /end FUNCTION_LIST /begin REF_CHARACTERISTIC /end REF_CHARACTERISTIC /begin REF_MEASUREMENT HwAgSnsrls.PinionAg.Val /end REF_MEASUREMENT /end GROUP
/begin GROUP HwAgSnsrls.PinionAgConf.Val "MICROSAR RTE" /begin SUB_GROUP /end SUB_GROUP /begin FUNCTION_LIST /end FUNCTION_LIST /begin REF_CHARACTERISTIC /end REF_CHARACTERISTIC /begin REF_MEASUREMENT HwAgSnsrls.PinionAgConf.Val /end REF_MEASUREMENT /end GROUP
/begin GROUP HwAgSnsrls.PinionTqFil "MICROSAR RTE" /begin SUB_GROUP /end SUB_GROUP /begin FUNCTION_LIST /end FUNCTION_LIST /begin REF_CHARACTERISTIC /end REF_CHARACTERISTIC
 /begin REF_MEASUREMENT HwAgSnsrls.PinionTqFil.FilGain HwAgSnsrls.PinionTqFil.FilSt /end REF_MEASUREMENT
/end GROUP
/begin GROUP HwAgSnsrls.PrevFildRelHwAg1 "MICROSAR RTE" /begin SUB_GROUP /end SUB_GROUP /begin FUNCTION_LIST /end FUNCTION_LIST /begin REF_CHARACTERISTIC /end REF_CHARACTERISTIC /begin REF_MEASUREMENT HwAgSnsrls.PrevFildRelHwAg1 /end REF_MEASUREMENT /end GROUP
/begin GROUP HwAgSnsrls.PrevHwAgOffs "MICROSAR RTE" /begin SUB_GROUP /end SUB_GROUP /begin FUNCTION_LIST /end FUNCTION_LIST /begin REF_CHARACTERISTIC /end REF_CHARACTERISTIC /begin REF_MEASUREMENT HwAgSnsrls.PrevHwAgOffs /end REF_MEASUREMENT /end GROUP
/begin GROUP HwAgSnsrls.PrevMaxHwConf "MICROSAR RTE" /begin SUB_GROUP /end SUB_GROUP /begin FUNCTION_LIST /end FUNCTION_LIST /begin REF_CHARACTERISTIC /end REF_CHARACTERISTIC /begin REF_MEASUREMENT HwAgSnsrls.PrevMaxHwConf /end REF_MEASUREMENT /end GROUP
/begin GROUP HwAgSnsrls.PrevSmotngHwAg "MICROSAR RTE" /begin SUB_GROUP /end SUB_GROUP /begin FUNCTION_LIST /end FUNCTION_LIST /begin REF_CHARACTERISTIC /end REF_CHARACTERISTIC /begin REF_MEASUREMENT HwAgSnsrls.PrevSmotngHwAg /end REF_MEASUREMENT /end GROUP
/begin GROUP HwAgSnsrls.PrevSmotngSt "MICROSAR RTE" /begin SUB_GROUP /end SUB_GROUP /begin FUNCTION_LIST /end FUNCTION_LIST /begin REF_CHARACTERISTIC /end REF_CHARACTERISTIC /begin REF_MEASUREMENT HwAgSnsrls.PrevSmotngSt /end REF_MEASUREMENT /end GROUP
/begin GROUP HwAgSnsrls.PrevVehDynFil1Ena "MICROSAR RTE" /begin SUB_GROUP /end SUB_GROUP /begin FUNCTION_LIST /end FUNCTION_LIST /begin REF_CHARACTERISTIC /end REF_CHARACTERISTIC /begin REF_MEASUREMENT HwAgSnsrls.PrevVehDynFil1Ena /end REF_MEASUREMENT /end GROUP
/begin GROUP HwAgSnsrls.PrevVehDynFil2Ena "MICROSAR RTE" /begin SUB_GROUP /end SUB_GROUP /begin FUNCTION_LIST /end FUNCTION_LIST /begin REF_CHARACTERISTIC /end REF_CHARACTERISTIC /begin REF_MEASUREMENT HwAgSnsrls.PrevVehDynFil2Ena /end REF_MEASUREMENT /end GROUP
/begin GROUP HwAgSnsrls.ReceiverPorts "MICROSAR RTE"
 /begin SUB_GROUP HwAgSnsrls.CmplncErrMotToPinion.Val HwAgSnsrls.EcuId.Val HwAgSnsrls.HwTq.Val HwAgSnsrls.MotAgCumvAlgndCrf.Val HwAgSnsrls.MotAgCumvAlgndVld.Logl HwAgSnsrls.MotAgMeclIdptSig.Val HwAgSnsrls.MotTqCmdCrf.Val HwAgSnsrls.MotVelCrf.Val HwAgSnsrls.PinionAg.Val HwAgSnsrls.PinionAgConf.Val HwAgSnsrls.VehSpd.Val HwAgSnsrls.VehSpdVld.Logl HwAgSnsrls.VehYawRate.Val HwAgSnsrls.VehYawRateVld.Logl HwAgSnsrls.WhlFrqVld.Logl HwAgSnsrls.WhlLeFrq.Val HwAgSnsrls.WhlRiFrq.Val /end SUB_GROUP
 /begin FUNCTION_LIST /end FUNCTION_LIST
 /begin REF_CHARACTERISTIC /end REF_CHARACTERISTIC
 /begin REF_MEASUREMENT /end REF_MEASUREMENT
/end GROUP
/begin GROUP HwAgSnsrls.RelHwAgFil1 "MICROSAR RTE" /begin SUB_GROUP /end SUB_GROUP /begin FUNCTION_LIST /end FUNCTION_LIST /begin REF_CHARACTERISTIC /end REF_CHARACTERISTIC
 /begin REF_MEASUREMENT HwAgSnsrls.RelHwAgFil1.FilGain HwAgSnsrls.RelHwAgFil1.FilSt /end REF_MEASUREMENT
/end GROUP
/begin GROUP HwAgSnsrls.RelHwAgFil2 "MICROSAR RTE" /begin SUB_GROUP /end SUB_GROUP /begin FUNCTION_LIST /end FUNCTION_LIST /begin REF_CHARACTERISTIC /end REF_CHARACTERISTIC
 /begin REF_MEASUREMENT HwAgSnsrls.RelHwAgFil2.FilGain HwAgSnsrls.RelHwAgFil2.FilSt /end REF_MEASUREMENT
/end GROUP
/begin GROUP HwAgSnsrls.SelnCaseSt "MICROSAR RTE" /begin SUB_GROUP /end SUB_GROUP /begin FUNCTION_LIST /end FUNCTION_LIST /begin REF_CHARACTERISTIC /end REF_CHARACTERISTIC /begin REF_MEASUREMENT HwAgSnsrls.SelnCaseSt /end REF_MEASUREMENT /end GROUP
/begin GROUP HwAgSnsrls.SenderPorts "MICROSAR RTE" /begin SUB_GROUP HwAgSnsrls.HwAgSnsrls.Val HwAgSnsrls.HwAgSnsrlsConf.Val /end SUB_GROUP /begin FUNCTION_LIST /end FUNCTION_LIST /begin REF_CHARACTERISTIC /end REF_CHARACTERISTIC /begin REF_MEASUREMENT /end REF_MEASUREMENT /end GROUP
/begin GROUP HwAgSnsrls.StordLstPrm "MICROSAR RTE" /begin SUB_GROUP /end SUB_GROUP /begin FUNCTION_LIST /end FUNCTION_LIST /begin REF_CHARACTERISTIC /end REF_CHARACTERISTIC
 /begin REF_MEASUREMENT HwAgSnsrls.StordLstPrm.PinionAg HwAgSnsrls.StordLstPrm.PinionAgVld /end REF_MEASUREMENT
/end GROUP
/begin GROUP HwAgSnsrls.StordLstPrmDft "MICROSAR RTE" /begin SUB_GROUP /end SUB_GROUP /begin FUNCTION_LIST /end FUNCTION_LIST
 /begin REF_CHARACTERISTIC HwAgSnsrls.StordLstPrmDft.PinionAg HwAgSnsrls.StordLstPrmDft.PinionAgVld /end REF_CHARACTERISTIC
 /begin REF_MEASUREMENT /end REF_MEASUREMENT
/end GROUP
/begin GROUP HwAgSnsrls.SysGlbPrmSysKineRat.Val "MICROSAR RTE" /begin SUB_GROUP /end SUB_GROUP /begin FUNCTION_LIST /end FUNCTION_LIST /begin REF_CHARACTERISTIC HwAgSnsrls.SysGlbPrmSysKineRat.Val /end REF_CHARACTERISTIC /begin REF_MEASUREMENT /end REF_MEASUREMENT /end GROUP
/begin GROUP HwAgSnsrls.SysGlbPrmSysTqRat.Val "MICROSAR RTE" /begin SUB_GROUP /end SUB_GROUP /begin FUNCTION_LIST /end FUNCTION_LIST /begin REF_CHARACTERISTIC HwAgSnsrls.SysGlbPrmSysTqRat.Val /end REF_CHARACTERISTIC /begin REF_MEASUREMENT /end REF_MEASUREMENT /end GROUP
/begin GROUP HwAgSnsrls.VehDynHwAgOffs "MICROSAR RTE" /begin SUB_GROUP /end SUB_GROUP /begin FUNCTION_LIST /end FUNCTION_LIST /begin REF_CHARACTERISTIC /end REF_CHARACTERISTIC /begin REF_MEASUREMENT HwAgSnsrls.VehDynHwAgOffs /end REF_MEASUREMENT /end GROUP
/begin GROUP HwAgSnsrls.VehDynRefTmr1 "MICROSAR RTE" /begin SUB_GROUP /end SUB_GROUP /begin FUNCTION_LIST /end FUNCTION_LIST /begin REF_CHARACTERISTIC /end REF_CHARACTERISTIC /begin REF_MEASUREMENT HwAgSnsrls.VehDynRefTmr1 /end REF_MEASUREMENT /end GROUP
/begin GROUP HwAgSnsrls.VehDynRefTmr2 "MICROSAR RTE" /begin SUB_GROUP /end SUB_GROUP /begin FUNCTION_LIST /end FUNCTION_LIST /begin REF_CHARACTERISTIC /end REF_CHARACTERISTIC /begin REF_MEASUREMENT HwAgSnsrls.VehDynRefTmr2 /end REF_MEASUREMENT /end GROUP
/begin GROUP HwAgSnsrls.VehSpd.Val "MICROSAR RTE" /begin SUB_GROUP /end SUB_GROUP /begin FUNCTION_LIST /end FUNCTION_LIST /begin REF_CHARACTERISTIC /end REF_CHARACTERISTIC /begin REF_MEASUREMENT HwAgSnsrls.VehSpd.Val /end REF_MEASUREMENT /end GROUP
/begin GROUP HwAgSnsrls.VehSpdVld.Logl "MICROSAR RTE" /begin SUB_GROUP /end SUB_GROUP /begin FUNCTION_LIST /end FUNCTION_LIST /begin REF_CHARACTERISTIC /end REF_CHARACTERISTIC /begin REF_MEASUREMENT HwAgSnsrls.VehSpdVld.Logl /end REF_MEASUREMENT /end GROUP
/begin GROUP HwAgSnsrls.VehYawRate.Val "MICROSAR RTE" /begin SUB_GROUP /end SUB_GROUP /begin FUNCTION_LIST /end FUNCTION_LIST /begin REF_CHARACTERISTIC /end REF_CHARACTERISTIC /begin REF_MEASUREMENT HwAgSnsrls.VehYawRate.Val /end REF_MEASUREMENT /end GROUP
/begin GROUP HwAgSnsrls.VehYawRateVld.Logl "MICROSAR RTE" /begin SUB_GROUP /end SUB_GROUP /begin FUNCTION_LIST /end FUNCTION_LIST /begin REF_CHARACTERISTIC /end REF_CHARACTERISTIC /begin REF_MEASUREMENT HwAgSnsrls.VehYawRateVld.Logl /end REF_MEASUREMENT /end GROUP
/begin GROUP HwAgSnsrls.WhlFrqVld.Logl "MICROSAR RTE" /begin SUB_GROUP /end SUB_GROUP /begin FUNCTION_LIST /end FUNCTION_LIST /begin REF_CHARACTERISTIC /end REF_CHARACTERISTIC /begin REF_MEASUREMENT HwAgSnsrls.WhlFrqVld.Logl /end REF_MEASUREMENT /end GROUP
/begin GROUP HwAgSnsrls.WhlLeFrq.Val "MICROSAR RTE" /begin SUB_GROUP /end SUB_GROUP /begin FUNCTION_LIST /end FUNCTION_LIST /begin REF_CHARACTERISTIC /end REF_CHARACTERISTIC /begin REF_MEASUREMENT HwAgSnsrls.WhlLeFrq.Val /end REF_MEASUREMENT /end GROUP
/begin GROUP HwAgSnsrls.WhlRiFrq.Val "MICROSAR RTE" /begin SUB_GROUP /end SUB_GROUP /begin FUNCTION_LIST /end FUNCTION_LIST /begin REF_CHARACTERISTIC /end REF_CHARACTERISTIC /begin REF_MEASUREMENT HwAgSnsrls.WhlRiFrq.Val /end REF_MEASUREMENT /end GROUP
/begin GROUP HwAgSnsrls.WhlSpdHwAgLrndEna "MICROSAR RTE" /begin SUB_GROUP /end SUB_GROUP /begin FUNCTION_LIST /end FUNCTION_LIST /begin REF_CHARACTERISTIC /end REF_CHARACTERISTIC /begin REF_MEASUREMENT HwAgSnsrls.WhlSpdHwAgLrndEna /end REF_MEASUREMENT /end GROUP
/begin GROUP HwAgSnsrls.WhlSpdHwAgOffs "MICROSAR RTE" /begin SUB_GROUP /end SUB_GROUP /begin FUNCTION_LIST /end FUNCTION_LIST /begin REF_CHARACTERISTIC /end REF_CHARACTERISTIC /begin REF_MEASUREMENT HwAgSnsrls.WhlSpdHwAgOffs /end REF_MEASUREMENT /end GROUP
/begin GROUP HwAgSnsrls.WhlSpdHwConf "MICROSAR RTE" /begin SUB_GROUP /end SUB_GROUP /begin FUNCTION_LIST /end FUNCTION_LIST /begin REF_CHARACTERISTIC /end REF_CHARACTERISTIC /begin REF_MEASUREMENT HwAgSnsrls.WhlSpdHwConf /end REF_MEASUREMENT /end GROUP
/begin GROUP HwAgSnsrls.WhlSpdRefTmr "MICROSAR RTE" /begin SUB_GROUP /end SUB_GROUP /begin FUNCTION_LIST /end FUNCTION_LIST /begin REF_CHARACTERISTIC /end REF_CHARACTERISTIC /begin REF_MEASUREMENT HwAgSnsrls.WhlSpdRefTmr /end REF_MEASUREMENT /end GROUP
/begin GROUP HwAgSnsrls.YawRateFil "MICROSAR RTE" /begin SUB_GROUP /end SUB_GROUP /begin FUNCTION_LIST /end FUNCTION_LIST /begin REF_CHARACTERISTIC /end REF_CHARACTERISTIC /begin REF_MEASUREMENT HwAgSnsrls.YawRateFil.FilGain HwAgSnsrls.YawRateFil.FilSt /end REF_MEASUREMENT /end GROUP
/begin GROUP HwAgSnsrls.dHwAgSnsrlsStordHwAg "MICROSAR RTE" /begin SUB_GROUP /end SUB_GROUP /begin FUNCTION_LIST /end FUNCTION_LIST /begin REF_CHARACTERISTIC /end REF_CHARACTERISTIC /begin REF_MEASUREMENT HwAgSnsrls.dHwAgSnsrlsStordHwAg /end REF_MEASUREMENT /end GROUP
/begin GROUP HwAgSnsrls.dHwAgSnsrlsStordHwConf "MICROSAR RTE" /begin SUB_GROUP /end SUB_GROUP /begin FUNCTION_LIST /end FUNCTION_LIST /begin REF_CHARACTERISTIC /end REF_CHARACTERISTIC /begin REF_MEASUREMENT HwAgSnsrls.dHwAgSnsrlsStordHwConf /end REF_MEASUREMENT /end GROUP
/begin GROUP HwAgSnsrls.dHwAgSnsrlsVehDynHwConf "MICROSAR RTE" /begin SUB_GROUP /end SUB_GROUP /begin FUNCTION_LIST /end FUNCTION_LIST /begin REF_CHARACTERISTIC /end REF_CHARACTERISTIC /begin REF_MEASUREMENT HwAgSnsrls.dHwAgSnsrlsVehDynHwConf /end REF_MEASUREMENT /end GROUP
/begin GROUP HwAgSnsrls.dHwAgSnsrlsWhlSpdHwConf "MICROSAR RTE" /begin SUB_GROUP /end SUB_GROUP /begin FUNCTION_LIST /end FUNCTION_LIST /begin REF_CHARACTERISTIC /end REF_CHARACTERISTIC /begin REF_MEASUREMENT HwAgSnsrls.dHwAgSnsrlsWhlSpdHwConf /end REF_MEASUREMENT /end GROUP
/begin GROUP HwAgSysArbn "MICROSAR RTE"
 /begin SUB_GROUP HwAgSysArbn.CalibrationPorts HwAgSysArbn.PerInstanceMemories HwAgSysArbn.ReceiverPorts HwAgSysArbn.SenderPorts /end SUB_GROUP
 /begin FUNCTION_LIST /end FUNCTION_LIST
 /begin REF_CHARACTERISTIC /end REF_CHARACTERISTIC
 /begin REF_MEASUREMENT /end REF_MEASUREMENT
/end GROUP
/begin GROUP HwAgSysArbn.CalibrationPorts "MICROSAR RTE"
 /begin SUB_GROUP HwAgSysArbn.HwAgSysArbn2PinionPosSnsrAvl.Logl HwAgSysArbn.HwAgSysArbnHwAgConf1Snsr.Val HwAgSysArbn.HwAgSysArbnHwAgConf1SnsrHwAgTrimNotPrfmd.Val HwAgSysArbn.HwAgSysArbnHwAgConf2Snsr.Val HwAgSysArbn.HwAgSysArbnHwAgConf2SnsrHwAgTrimNotPrfmd.Val HwAgSysArbn.HwAgSysArbnHwAgConfNoSnsr.Val HwAgSysArbn.HwAgSysArbnHwAgConfTiThd.Val HwAgSysArbn.HwAgSysArbnHwAgCorrdCorrlnThd.Val HwAgSysArbn.HwAgSysArbnHwAgCorrlnFailDebStep.Val HwAgSysArbn.HwAgSysArbnHwAgCorrlnPassDebStep.Val HwAgSysArbn.HwAgSysArbnHwAgCorrlnRng.Val HwAgSysArbn.HwAgSysArbnHwAgIdptSigLim.Val HwAgSysArbn.HwAgSysArbnHwAgSlewRate.Val HwAgSysArbn.HwAgSysArbnHwAgSnsrlsCorrlnThd.Val HwAgSysArbn.HwAgSysArbnHwAgSnsrlsKineThd.Val HwAgSysArbn.HwAgSysArbnImcHwAgCorrlnRng.Val HwAgSysArbn.HwAgSysArbnPinionAgConfThd.Val HwAgSysArbn.HwAgSysArbnSerlComHwAgCorrdConf.Val HwAgSysArbn.HwAgSysArbnSerlComHwAgSnsrlsConf.Val HwAgSysArbn.HwAgSysArbnSlewRateTmr.Val HwAgSysArbn.HwAgSysArbnTqSnsrVelFilFrq.Val HwAgSysArbn.SysGlbPrmSysKineRat.Val HwAgSysArbn.SysGlbPrmTorsBarStfn.Val /end SUB_GROUP
 /begin FUNCTION_LIST /end FUNCTION_LIST
 /begin REF_CHARACTERISTIC /end REF_CHARACTERISTIC
 /begin REF_MEASUREMENT /end REF_MEASUREMENT
/end GROUP
/begin GROUP HwAgSysArbn.CmplncErrPinionToHw.Val "MICROSAR RTE" /begin SUB_GROUP /end SUB_GROUP /begin FUNCTION_LIST /end FUNCTION_LIST /begin REF_CHARACTERISTIC /end REF_CHARACTERISTIC /begin REF_MEASUREMENT HwAgSysArbn.CmplncErrPinionToHw.Val /end REF_MEASUREMENT /end GROUP
/begin GROUP HwAgSysArbn.EcuID.Val "MICROSAR RTE" /begin SUB_GROUP /end SUB_GROUP /begin FUNCTION_LIST /end FUNCTION_LIST /begin REF_CHARACTERISTIC /end REF_CHARACTERISTIC /begin REF_MEASUREMENT HwAgSysArbn.EcuID.Val /end REF_MEASUREMENT /end GROUP
/begin GROUP HwAgSysArbn.HwAg.Val "MICROSAR RTE" /begin SUB_GROUP /end SUB_GROUP /begin FUNCTION_LIST /end FUNCTION_LIST /begin REF_CHARACTERISTIC /end REF_CHARACTERISTIC /begin REF_MEASUREMENT HwAgSysArbn.HwAg.Val /end REF_MEASUREMENT /end GROUP
/begin GROUP HwAgSysArbn.HwAgConfRefTi "MICROSAR RTE" /begin SUB_GROUP /end SUB_GROUP /begin FUNCTION_LIST /end FUNCTION_LIST /begin REF_CHARACTERISTIC /end REF_CHARACTERISTIC /begin REF_MEASUREMENT HwAgSysArbn.HwAgConfRefTi /end REF_MEASUREMENT /end GROUP
/begin GROUP HwAgSysArbn.HwAgCorrd.Val "MICROSAR RTE" /begin SUB_GROUP /end SUB_GROUP /begin FUNCTION_LIST /end FUNCTION_LIST /begin REF_CHARACTERISTIC /end REF_CHARACTERISTIC /begin REF_MEASUREMENT HwAgSysArbn.HwAgCorrd.Val /end REF_MEASUREMENT /end GROUP
/begin GROUP HwAgSysArbn.HwAgFinal.Val "MICROSAR RTE" /begin SUB_GROUP /end SUB_GROUP /begin FUNCTION_LIST /end FUNCTION_LIST /begin REF_CHARACTERISTIC /end REF_CHARACTERISTIC /begin REF_MEASUREMENT HwAgSysArbn.HwAgFinal.Val /end REF_MEASUREMENT /end GROUP
/begin GROUP HwAgSysArbn.HwAgIdptSig.Val "MICROSAR RTE" /begin SUB_GROUP /end SUB_GROUP /begin FUNCTION_LIST /end FUNCTION_LIST /begin REF_CHARACTERISTIC /end REF_CHARACTERISTIC /begin REF_MEASUREMENT HwAgSysArbn.HwAgIdptSig.Val /end REF_MEASUREMENT /end GROUP
/begin GROUP HwAgSysArbn.HwAgKineFlt "MICROSAR RTE" /begin SUB_GROUP /end SUB_GROUP /begin FUNCTION_LIST /end FUNCTION_LIST /begin REF_CHARACTERISTIC /end REF_CHARACTERISTIC /begin REF_MEASUREMENT HwAgSysArbn.HwAgKineFlt /end REF_MEASUREMENT /end GROUP
/begin GROUP HwAgSysArbn.HwAgLtch "MICROSAR RTE" /begin SUB_GROUP /end SUB_GROUP /begin FUNCTION_LIST /end FUNCTION_LIST /begin REF_CHARACTERISTIC /end REF_CHARACTERISTIC /begin REF_MEASUREMENT HwAgSysArbn.HwAgLtch /end REF_MEASUREMENT /end GROUP
/begin GROUP HwAgSysArbn.HwAgNotCorrd.Val "MICROSAR RTE" /begin SUB_GROUP /end SUB_GROUP /begin FUNCTION_LIST /end FUNCTION_LIST /begin REF_CHARACTERISTIC /end REF_CHARACTERISTIC /begin REF_MEASUREMENT HwAgSysArbn.HwAgNotCorrd.Val /end REF_MEASUREMENT /end GROUP
/begin GROUP HwAgSysArbn.HwAgSnsrls.Val "MICROSAR RTE" /begin SUB_GROUP /end SUB_GROUP /begin FUNCTION_LIST /end FUNCTION_LIST /begin REF_CHARACTERISTIC /end REF_CHARACTERISTIC /begin REF_MEASUREMENT HwAgSysArbn.HwAgSnsrls.Val /end REF_MEASUREMENT /end GROUP
/begin GROUP HwAgSysArbn.HwAgSnsrlsConf.Val "MICROSAR RTE" /begin SUB_GROUP /end SUB_GROUP /begin FUNCTION_LIST /end FUNCTION_LIST /begin REF_CHARACTERISTIC /end REF_CHARACTERISTIC /begin REF_MEASUREMENT HwAgSysArbn.HwAgSnsrlsConf.Val /end REF_MEASUREMENT /end GROUP
/begin GROUP HwAgSysArbn.HwAgSysArbn2PinionPosSnsrAvl.Logl "MICROSAR RTE" /begin SUB_GROUP /end SUB_GROUP /begin FUNCTION_LIST /end FUNCTION_LIST /begin REF_CHARACTERISTIC HwAgSysArbn.HwAgSysArbn2PinionPosSnsrAvl.Logl /end REF_CHARACTERISTIC /begin REF_MEASUREMENT /end REF_MEASUREMENT /end GROUP
/begin GROUP HwAgSysArbn.HwAgSysArbnHwAgConf1Snsr.Val "MICROSAR RTE" /begin SUB_GROUP /end SUB_GROUP /begin FUNCTION_LIST /end FUNCTION_LIST /begin REF_CHARACTERISTIC HwAgSysArbn.HwAgSysArbnHwAgConf1Snsr.Val /end REF_CHARACTERISTIC /begin REF_MEASUREMENT /end REF_MEASUREMENT /end GROUP
/begin GROUP HwAgSysArbn.HwAgSysArbnHwAgConf1SnsrHwAgTrimNotPrfmd.Val "MICROSAR RTE" /begin SUB_GROUP /end SUB_GROUP /begin FUNCTION_LIST /end FUNCTION_LIST /begin REF_CHARACTERISTIC HwAgSysArbn.HwAgSysArbnHwAgConf1SnsrHwAgTrimNotPrfmd.Val /end REF_CHARACTERISTIC /begin REF_MEASUREMENT /end REF_MEASUREMENT /end GROUP
/begin GROUP HwAgSysArbn.HwAgSysArbnHwAgConf2Snsr.Val "MICROSAR RTE" /begin SUB_GROUP /end SUB_GROUP /begin FUNCTION_LIST /end FUNCTION_LIST /begin REF_CHARACTERISTIC HwAgSysArbn.HwAgSysArbnHwAgConf2Snsr.Val /end REF_CHARACTERISTIC /begin REF_MEASUREMENT /end REF_MEASUREMENT /end GROUP
/begin GROUP HwAgSysArbn.HwAgSysArbnHwAgConf2SnsrHwAgTrimNotPrfmd.Val "MICROSAR RTE" /begin SUB_GROUP /end SUB_GROUP /begin FUNCTION_LIST /end FUNCTION_LIST /begin REF_CHARACTERISTIC HwAgSysArbn.HwAgSysArbnHwAgConf2SnsrHwAgTrimNotPrfmd.Val /end REF_CHARACTERISTIC /begin REF_MEASUREMENT /end REF_MEASUREMENT /end GROUP
/begin GROUP HwAgSysArbn.HwAgSysArbnHwAgConfNoSnsr.Val "MICROSAR RTE" /begin SUB_GROUP /end SUB_GROUP /begin FUNCTION_LIST /end FUNCTION_LIST /begin REF_CHARACTERISTIC HwAgSysArbn.HwAgSysArbnHwAgConfNoSnsr.Val /end REF_CHARACTERISTIC /begin REF_MEASUREMENT /end REF_MEASUREMENT /end GROUP
/begin GROUP HwAgSysArbn.HwAgSysArbnHwAgConfTiThd.Val "MICROSAR RTE" /begin SUB_GROUP /end SUB_GROUP /begin FUNCTION_LIST /end FUNCTION_LIST /begin REF_CHARACTERISTIC HwAgSysArbn.HwAgSysArbnHwAgConfTiThd.Val /end REF_CHARACTERISTIC /begin REF_MEASUREMENT /end REF_MEASUREMENT /end GROUP
/begin GROUP HwAgSysArbn.HwAgSysArbnHwAgCorrdCorrlnThd.Val "MICROSAR RTE" /begin SUB_GROUP /end SUB_GROUP /begin FUNCTION_LIST /end FUNCTION_LIST /begin REF_CHARACTERISTIC HwAgSysArbn.HwAgSysArbnHwAgCorrdCorrlnThd.Val /end REF_CHARACTERISTIC /begin REF_MEASUREMENT /end REF_MEASUREMENT /end GROUP
/begin GROUP HwAgSysArbn.HwAgSysArbnHwAgCorrlnFailDebStep.Val "MICROSAR RTE" /begin SUB_GROUP /end SUB_GROUP /begin FUNCTION_LIST /end FUNCTION_LIST /begin REF_CHARACTERISTIC HwAgSysArbn.HwAgSysArbnHwAgCorrlnFailDebStep.Val /end REF_CHARACTERISTIC /begin REF_MEASUREMENT /end REF_MEASUREMENT /end GROUP
/begin GROUP HwAgSysArbn.HwAgSysArbnHwAgCorrlnPassDebStep.Val "MICROSAR RTE" /begin SUB_GROUP /end SUB_GROUP /begin FUNCTION_LIST /end FUNCTION_LIST /begin REF_CHARACTERISTIC HwAgSysArbn.HwAgSysArbnHwAgCorrlnPassDebStep.Val /end REF_CHARACTERISTIC /begin REF_MEASUREMENT /end REF_MEASUREMENT /end GROUP
/begin GROUP HwAgSysArbn.HwAgSysArbnHwAgCorrlnRng.Val "MICROSAR RTE" /begin SUB_GROUP /end SUB_GROUP /begin FUNCTION_LIST /end FUNCTION_LIST /begin REF_CHARACTERISTIC HwAgSysArbn.HwAgSysArbnHwAgCorrlnRng.Val /end REF_CHARACTERISTIC /begin REF_MEASUREMENT /end REF_MEASUREMENT /end GROUP
/begin GROUP HwAgSysArbn.HwAgSysArbnHwAgIdptSigLim.Val "MICROSAR RTE" /begin SUB_GROUP /end SUB_GROUP /begin FUNCTION_LIST /end FUNCTION_LIST /begin REF_CHARACTERISTIC HwAgSysArbn.HwAgSysArbnHwAgIdptSigLim.Val /end REF_CHARACTERISTIC /begin REF_MEASUREMENT /end REF_MEASUREMENT /end GROUP
/begin GROUP HwAgSysArbn.HwAgSysArbnHwAgSlewRate.Val "MICROSAR RTE" /begin SUB_GROUP /end SUB_GROUP /begin FUNCTION_LIST /end FUNCTION_LIST /begin REF_CHARACTERISTIC HwAgSysArbn.HwAgSysArbnHwAgSlewRate.Val /end REF_CHARACTERISTIC /begin REF_MEASUREMENT /end REF_MEASUREMENT /end GROUP
/begin GROUP HwAgSysArbn.HwAgSysArbnHwAgSnsrlsCorrlnThd.Val "MICROSAR RTE" /begin SUB_GROUP /end SUB_GROUP /begin FUNCTION_LIST /end FUNCTION_LIST /begin REF_CHARACTERISTIC HwAgSysArbn.HwAgSysArbnHwAgSnsrlsCorrlnThd.Val /end REF_CHARACTERISTIC /begin REF_MEASUREMENT /end REF_MEASUREMENT /end GROUP
/begin GROUP HwAgSysArbn.HwAgSysArbnHwAgSnsrlsKineThd.Val "MICROSAR RTE" /begin SUB_GROUP /end SUB_GROUP /begin FUNCTION_LIST /end FUNCTION_LIST /begin REF_CHARACTERISTIC HwAgSysArbn.HwAgSysArbnHwAgSnsrlsKineThd.Val /end REF_CHARACTERISTIC /begin REF_MEASUREMENT /end REF_MEASUREMENT /end GROUP
/begin GROUP HwAgSysArbn.HwAgSysArbnImcHwAgCorrlnRng.Val "MICROSAR RTE" /begin SUB_GROUP /end SUB_GROUP /begin FUNCTION_LIST /end FUNCTION_LIST /begin REF_CHARACTERISTIC HwAgSysArbn.HwAgSysArbnImcHwAgCorrlnRng.Val /end REF_CHARACTERISTIC /begin REF_MEASUREMENT /end REF_MEASUREMENT /end GROUP
/begin GROUP HwAgSysArbn.HwAgSysArbnPinionAgConfThd.Val "MICROSAR RTE" /begin SUB_GROUP /end SUB_GROUP /begin FUNCTION_LIST /end FUNCTION_LIST /begin REF_CHARACTERISTIC HwAgSysArbn.HwAgSysArbnPinionAgConfThd.Val /end REF_CHARACTERISTIC /begin REF_MEASUREMENT /end REF_MEASUREMENT /end GROUP
/begin GROUP HwAgSysArbn.HwAgSysArbnSerlComHwAgCorrdConf.Val "MICROSAR RTE" /begin SUB_GROUP /end SUB_GROUP /begin FUNCTION_LIST /end FUNCTION_LIST /begin REF_CHARACTERISTIC HwAgSysArbn.HwAgSysArbnSerlComHwAgCorrdConf.Val /end REF_CHARACTERISTIC /begin REF_MEASUREMENT /end REF_MEASUREMENT /end GROUP
/begin GROUP HwAgSysArbn.HwAgSysArbnSerlComHwAgSnsrlsConf.Val "MICROSAR RTE" /begin SUB_GROUP /end SUB_GROUP /begin FUNCTION_LIST /end FUNCTION_LIST /begin REF_CHARACTERISTIC HwAgSysArbn.HwAgSysArbnSerlComHwAgSnsrlsConf.Val /end REF_CHARACTERISTIC /begin REF_MEASUREMENT /end REF_MEASUREMENT /end GROUP
/begin GROUP HwAgSysArbn.HwAgSysArbnSlewRateTmr.Val "MICROSAR RTE" /begin SUB_GROUP /end SUB_GROUP /begin FUNCTION_LIST /end FUNCTION_LIST /begin REF_CHARACTERISTIC HwAgSysArbn.HwAgSysArbnSlewRateTmr.Val /end REF_CHARACTERISTIC /begin REF_MEASUREMENT /end REF_MEASUREMENT /end GROUP
/begin GROUP HwAgSysArbn.HwAgSysArbnTqSnsrVelFilFrq.Val "MICROSAR RTE" /begin SUB_GROUP /end SUB_GROUP /begin FUNCTION_LIST /end FUNCTION_LIST /begin REF_CHARACTERISTIC HwAgSysArbn.HwAgSysArbnTqSnsrVelFilFrq.Val /end REF_CHARACTERISTIC /begin REF_MEASUREMENT /end REF_MEASUREMENT /end GROUP
/begin GROUP HwAgSysArbn.HwAgToMotAgCorrln "MICROSAR RTE" /begin SUB_GROUP /end SUB_GROUP /begin FUNCTION_LIST /end FUNCTION_LIST /begin REF_CHARACTERISTIC /end REF_CHARACTERISTIC /begin REF_MEASUREMENT HwAgSysArbn.HwAgToMotAgCorrln /end REF_MEASUREMENT /end GROUP
/begin GROUP HwAgSysArbn.HwAgToMotAgCorrlnFltFld.Logl "MICROSAR RTE" /begin SUB_GROUP /end SUB_GROUP /begin FUNCTION_LIST /end FUNCTION_LIST /begin REF_CHARACTERISTIC /end REF_CHARACTERISTIC /begin REF_MEASUREMENT HwAgSysArbn.HwAgToMotAgCorrlnFltFld.Logl /end REF_MEASUREMENT /end GROUP
/begin GROUP HwAgSysArbn.HwAgToSerlCom.Val "MICROSAR RTE" /begin SUB_GROUP /end SUB_GROUP /begin FUNCTION_LIST /end FUNCTION_LIST /begin REF_CHARACTERISTIC /end REF_CHARACTERISTIC /begin REF_MEASUREMENT HwAgSysArbn.HwAgToSerlCom.Val /end REF_MEASUREMENT /end GROUP
/begin GROUP HwAgSysArbn.HwAgTrimPrfmd.Logl "MICROSAR RTE" /begin SUB_GROUP /end SUB_GROUP /begin FUNCTION_LIST /end FUNCTION_LIST /begin REF_CHARACTERISTIC /end REF_CHARACTERISTIC /begin REF_MEASUREMENT HwAgSysArbn.HwAgTrimPrfmd.Logl /end REF_MEASUREMENT /end GROUP
/begin GROUP HwAgSysArbn.HwAgVldToSerlCom.Logl "MICROSAR RTE" /begin SUB_GROUP /end SUB_GROUP /begin FUNCTION_LIST /end FUNCTION_LIST /begin REF_CHARACTERISTIC /end REF_CHARACTERISTIC /begin REF_MEASUREMENT HwAgSysArbn.HwAgVldToSerlCom.Logl /end REF_MEASUREMENT /end GROUP
/begin GROUP HwAgSysArbn.HwTq.Val "MICROSAR RTE" /begin SUB_GROUP /end SUB_GROUP /begin FUNCTION_LIST /end FUNCTION_LIST /begin REF_CHARACTERISTIC /end REF_CHARACTERISTIC /begin REF_MEASUREMENT HwAgSysArbn.HwTq.Val /end REF_MEASUREMENT /end GROUP
/begin GROUP HwAgSysArbn.HwVel.Val "MICROSAR RTE" /begin SUB_GROUP /end SUB_GROUP /begin FUNCTION_LIST /end FUNCTION_LIST /begin REF_CHARACTERISTIC /end REF_CHARACTERISTIC /begin REF_MEASUREMENT HwAgSysArbn.HwVel.Val /end REF_MEASUREMENT /end GROUP
/begin GROUP HwAgSysArbn.HwVelToSerlCom.Val "MICROSAR RTE" /begin SUB_GROUP /end SUB_GROUP /begin FUNCTION_LIST /end FUNCTION_LIST /begin REF_CHARACTERISTIC /end REF_CHARACTERISTIC /begin REF_MEASUREMENT HwAgSysArbn.HwVelToSerlCom.Val /end REF_MEASUREMENT /end GROUP
/begin GROUP HwAgSysArbn.MotVelCrf.Val "MICROSAR RTE" /begin SUB_GROUP /end SUB_GROUP /begin FUNCTION_LIST /end FUNCTION_LIST /begin REF_CHARACTERISTIC /end REF_CHARACTERISTIC /begin REF_MEASUREMENT HwAgSysArbn.MotVelCrf.Val /end REF_MEASUREMENT /end GROUP
/begin GROUP HwAgSysArbn.MotVelVld.Logl "MICROSAR RTE" /begin SUB_GROUP /end SUB_GROUP /begin FUNCTION_LIST /end FUNCTION_LIST /begin REF_CHARACTERISTIC /end REF_CHARACTERISTIC /begin REF_MEASUREMENT HwAgSysArbn.MotVelVld.Logl /end REF_MEASUREMENT /end GROUP
/begin GROUP HwAgSysArbn.PerInstanceMemories "MICROSAR RTE"
 /begin SUB_GROUP HwAgSysArbn.HwAgConfRefTi HwAgSysArbn.HwAgKineFlt HwAgSysArbn.HwAgLtch HwAgSysArbn.HwAgToMotAgCorrln HwAgSysArbn.PinionAgPrev HwAgSysArbn.PrevHwAgNotCorrd HwAgSysArbn.PrevPinionAgConf HwAgSysArbn.PrevSeldHwAg HwAgSysArbn.PrevSrcSeln HwAgSysArbn.SeldHwAgConf HwAgSysArbn.SlewElpdRefTmr HwAgSysArbn.SlewSts HwAgSysArbn.TqSnsrAgPrev HwAgSysArbn.TqSnsrVelFil /end SUB_GROUP
 /begin FUNCTION_LIST /end FUNCTION_LIST
 /begin REF_CHARACTERISTIC /end REF_CHARACTERISTIC
 /begin REF_MEASUREMENT /end REF_MEASUREMENT
/end GROUP
/begin GROUP HwAgSysArbn.PinionAg.Val "MICROSAR RTE" /begin SUB_GROUP /end SUB_GROUP /begin FUNCTION_LIST /end FUNCTION_LIST /begin REF_CHARACTERISTIC /end REF_CHARACTERISTIC /begin REF_MEASUREMENT HwAgSysArbn.PinionAg.Val /end REF_MEASUREMENT /end GROUP
/begin GROUP HwAgSysArbn.PinionAgConf.Val "MICROSAR RTE" /begin SUB_GROUP /end SUB_GROUP /begin FUNCTION_LIST /end FUNCTION_LIST /begin REF_CHARACTERISTIC /end REF_CHARACTERISTIC /begin REF_MEASUREMENT HwAgSysArbn.PinionAgConf.Val /end REF_MEASUREMENT /end GROUP
/begin GROUP HwAgSysArbn.PinionAgPrev "MICROSAR RTE" /begin SUB_GROUP /end SUB_GROUP /begin FUNCTION_LIST /end FUNCTION_LIST /begin REF_CHARACTERISTIC /end REF_CHARACTERISTIC /begin REF_MEASUREMENT HwAgSysArbn.PinionAgPrev /end REF_MEASUREMENT /end GROUP
/begin GROUP HwAgSysArbn.PinionVel.Val "MICROSAR RTE" /begin SUB_GROUP /end SUB_GROUP /begin FUNCTION_LIST /end FUNCTION_LIST /begin REF_CHARACTERISTIC /end REF_CHARACTERISTIC /begin REF_MEASUREMENT HwAgSysArbn.PinionVel.Val /end REF_MEASUREMENT /end GROUP
/begin GROUP HwAgSysArbn.PinionVelConf.Val "MICROSAR RTE" /begin SUB_GROUP /end SUB_GROUP /begin FUNCTION_LIST /end FUNCTION_LIST /begin REF_CHARACTERISTIC /end REF_CHARACTERISTIC /begin REF_MEASUREMENT HwAgSysArbn.PinionVelConf.Val /end REF_MEASUREMENT /end GROUP
/begin GROUP HwAgSysArbn.PrevHwAgNotCorrd "MICROSAR RTE" /begin SUB_GROUP /end SUB_GROUP /begin FUNCTION_LIST /end FUNCTION_LIST /begin REF_CHARACTERISTIC /end REF_CHARACTERISTIC /begin REF_MEASUREMENT HwAgSysArbn.PrevHwAgNotCorrd /end REF_MEASUREMENT /end GROUP
/begin GROUP HwAgSysArbn.PrevPinionAgConf "MICROSAR RTE" /begin SUB_GROUP /end SUB_GROUP /begin FUNCTION_LIST /end FUNCTION_LIST /begin REF_CHARACTERISTIC /end REF_CHARACTERISTIC /begin REF_MEASUREMENT HwAgSysArbn.PrevPinionAgConf /end REF_MEASUREMENT /end GROUP
/begin GROUP HwAgSysArbn.PrevSeldHwAg "MICROSAR RTE" /begin SUB_GROUP /end SUB_GROUP /begin FUNCTION_LIST /end FUNCTION_LIST /begin REF_CHARACTERISTIC /end REF_CHARACTERISTIC /begin REF_MEASUREMENT HwAgSysArbn.PrevSeldHwAg /end REF_MEASUREMENT /end GROUP
/begin GROUP HwAgSysArbn.PrevSrcSeln "MICROSAR RTE" /begin SUB_GROUP /end SUB_GROUP /begin FUNCTION_LIST /end FUNCTION_LIST /begin REF_CHARACTERISTIC /end REF_CHARACTERISTIC /begin REF_MEASUREMENT HwAgSysArbn.PrevSrcSeln /end REF_MEASUREMENT /end GROUP
/begin GROUP HwAgSysArbn.ReceiverPorts "MICROSAR RTE"
 /begin SUB_GROUP HwAgSysArbn.CmplncErrPinionToHw.Val HwAgSysArbn.EcuID.Val HwAgSysArbn.HwAg.Val HwAgSysArbn.HwAgCorrd.Val HwAgSysArbn.HwAgIdptSig.Val HwAgSysArbn.HwAgSnsrls.Val HwAgSysArbn.HwAgSnsrlsConf.Val HwAgSysArbn.HwAgTrimPrfmd.Logl HwAgSysArbn.HwTq.Val HwAgSysArbn.MotVelCrf.Val HwAgSysArbn.MotVelVld.Logl /end SUB_GROUP
 /begin FUNCTION_LIST /end FUNCTION_LIST
 /begin REF_CHARACTERISTIC /end REF_CHARACTERISTIC
 /begin REF_MEASUREMENT /end REF_MEASUREMENT
/end GROUP
/begin GROUP HwAgSysArbn.SeldHwAgConf "MICROSAR RTE" /begin SUB_GROUP /end SUB_GROUP /begin FUNCTION_LIST /end FUNCTION_LIST /begin REF_CHARACTERISTIC /end REF_CHARACTERISTIC /begin REF_MEASUREMENT HwAgSysArbn.SeldHwAgConf /end REF_MEASUREMENT /end GROUP
/begin GROUP HwAgSysArbn.SenderPorts "MICROSAR RTE"
 /begin SUB_GROUP HwAgSysArbn.HwAgFinal.Val HwAgSysArbn.HwAgNotCorrd.Val HwAgSysArbn.HwAgToMotAgCorrlnFltFld.Logl HwAgSysArbn.HwAgToSerlCom.Val HwAgSysArbn.HwAgVldToSerlCom.Logl HwAgSysArbn.HwVel.Val HwAgSysArbn.HwVelToSerlCom.Val HwAgSysArbn.PinionAg.Val HwAgSysArbn.PinionAgConf.Val HwAgSysArbn.PinionVel.Val HwAgSysArbn.PinionVelConf.Val /end SUB_GROUP
 /begin FUNCTION_LIST /end FUNCTION_LIST
 /begin REF_CHARACTERISTIC /end REF_CHARACTERISTIC
 /begin REF_MEASUREMENT /end REF_MEASUREMENT
/end GROUP
/begin GROUP HwAgSysArbn.SlewElpdRefTmr "MICROSAR RTE" /begin SUB_GROUP /end SUB_GROUP /begin FUNCTION_LIST /end FUNCTION_LIST /begin REF_CHARACTERISTIC /end REF_CHARACTERISTIC /begin REF_MEASUREMENT HwAgSysArbn.SlewElpdRefTmr /end REF_MEASUREMENT /end GROUP
/begin GROUP HwAgSysArbn.SlewSts "MICROSAR RTE" /begin SUB_GROUP /end SUB_GROUP /begin FUNCTION_LIST /end FUNCTION_LIST /begin REF_CHARACTERISTIC /end REF_CHARACTERISTIC /begin REF_MEASUREMENT HwAgSysArbn.SlewSts /end REF_MEASUREMENT /end GROUP
/begin GROUP HwAgSysArbn.SysGlbPrmSysKineRat.Val "MICROSAR RTE" /begin SUB_GROUP /end SUB_GROUP /begin FUNCTION_LIST /end FUNCTION_LIST /begin REF_CHARACTERISTIC HwAgSysArbn.SysGlbPrmSysKineRat.Val /end REF_CHARACTERISTIC /begin REF_MEASUREMENT /end REF_MEASUREMENT /end GROUP
/begin GROUP HwAgSysArbn.SysGlbPrmTorsBarStfn.Val "MICROSAR RTE" /begin SUB_GROUP /end SUB_GROUP /begin FUNCTION_LIST /end FUNCTION_LIST /begin REF_CHARACTERISTIC HwAgSysArbn.SysGlbPrmTorsBarStfn.Val /end REF_CHARACTERISTIC /begin REF_MEASUREMENT /end REF_MEASUREMENT /end GROUP
/begin GROUP HwAgSysArbn.TqSnsrAgPrev "MICROSAR RTE" /begin SUB_GROUP /end SUB_GROUP /begin FUNCTION_LIST /end FUNCTION_LIST /begin REF_CHARACTERISTIC /end REF_CHARACTERISTIC /begin REF_MEASUREMENT HwAgSysArbn.TqSnsrAgPrev /end REF_MEASUREMENT /end GROUP
/begin GROUP HwAgSysArbn.TqSnsrVelFil "MICROSAR RTE" /begin SUB_GROUP /end SUB_GROUP /begin FUNCTION_LIST /end FUNCTION_LIST /begin REF_CHARACTERISTIC /end REF_CHARACTERISTIC
 /begin REF_MEASUREMENT HwAgSysArbn.TqSnsrVelFil.FilGain HwAgSysArbn.TqSnsrVelFil.FilSt /end REF_MEASUREMENT
/end GROUP
/begin GROUP HwTq10Meas "MICROSAR RTE"
 /begin SUB_GROUP HwTq10Meas.PerInstanceMemories HwTq10Meas.ReceiverPorts HwTq10Meas.SenderPorts /end SUB_GROUP
 /begin FUNCTION_LIST /end FUNCTION_LIST
 /begin REF_CHARACTERISTIC /end REF_CHARACTERISTIC
 /begin REF_MEASUREMENT /end REF_MEASUREMENT
/end GROUP
/begin GROUP HwTq10Meas.HwTq10.Val "MICROSAR RTE" /begin SUB_GROUP /end SUB_GROUP /begin FUNCTION_LIST /end FUNCTION_LIST /begin REF_CHARACTERISTIC /end REF_CHARACTERISTIC /begin REF_MEASUREMENT HwTq10Meas.HwTq10.Val /end REF_MEASUREMENT /end GROUP
/begin GROUP HwTq10Meas.HwTq10DataPlsHiLim "MICROSAR RTE" /begin SUB_GROUP /end SUB_GROUP /begin FUNCTION_LIST /end FUNCTION_LIST /begin REF_CHARACTERISTIC /end REF_CHARACTERISTIC /begin REF_MEASUREMENT HwTq10Meas.HwTq10DataPlsHiLim /end REF_MEASUREMENT /end GROUP
/begin GROUP HwTq10Meas.HwTq10DataPlsLoLim "MICROSAR RTE" /begin SUB_GROUP /end SUB_GROUP /begin FUNCTION_LIST /end FUNCTION_LIST /begin REF_CHARACTERISTIC /end REF_CHARACTERISTIC /begin REF_MEASUREMENT HwTq10Meas.HwTq10DataPlsLoLim /end REF_MEASUREMENT /end GROUP
/begin GROUP HwTq10Meas.HwTq10Offs "MICROSAR RTE" /begin SUB_GROUP /end SUB_GROUP /begin FUNCTION_LIST /end FUNCTION_LIST /begin REF_CHARACTERISTIC /end REF_CHARACTERISTIC
 /begin REF_MEASUREMENT HwTq10Meas.HwTq10Offs.OffsTrim HwTq10Meas.HwTq10Offs.OffsTrimPrfmdSts /end REF_MEASUREMENT
/end GROUP
/begin GROUP HwTq10Meas.HwTq10Polarity.Val "MICROSAR RTE" /begin SUB_GROUP /end SUB_GROUP /begin FUNCTION_LIST /end FUNCTION_LIST /begin REF_CHARACTERISTIC /end REF_CHARACTERISTIC /begin REF_MEASUREMENT HwTq10Meas.HwTq10Polarity.Val /end REF_MEASUREMENT /end GROUP
/begin GROUP HwTq10Meas.HwTq10PrevHwTq "MICROSAR RTE" /begin SUB_GROUP /end SUB_GROUP /begin FUNCTION_LIST /end FUNCTION_LIST /begin REF_CHARACTERISTIC /end REF_CHARACTERISTIC /begin REF_MEASUREMENT HwTq10Meas.HwTq10PrevHwTq /end REF_MEASUREMENT /end GROUP
/begin GROUP HwTq10Meas.HwTq10Qlfr.Val "MICROSAR RTE" /begin SUB_GROUP /end SUB_GROUP /begin FUNCTION_LIST /end FUNCTION_LIST /begin REF_CHARACTERISTIC /end REF_CHARACTERISTIC /begin REF_MEASUREMENT HwTq10Meas.HwTq10Qlfr.Val /end REF_MEASUREMENT /end GROUP
/begin GROUP HwTq10Meas.HwTq10RawDataBuf "MICROSAR RTE" /begin SUB_GROUP /end SUB_GROUP /begin FUNCTION_LIST /end FUNCTION_LIST /begin REF_CHARACTERISTIC /end REF_CHARACTERISTIC /begin REF_MEASUREMENT HwTq10Meas.HwTq10RawDataBuf /end REF_MEASUREMENT /end GROUP
/begin GROUP HwTq10Meas.HwTq10RollgCntr.Val "MICROSAR RTE" /begin SUB_GROUP /end SUB_GROUP /begin FUNCTION_LIST /end FUNCTION_LIST /begin REF_CHARACTERISTIC /end REF_CHARACTERISTIC /begin REF_MEASUREMENT HwTq10Meas.HwTq10RollgCntr.Val /end REF_MEASUREMENT /end GROUP
/begin GROUP HwTq10Meas.HwTq10RollgCntrPrev "MICROSAR RTE" /begin SUB_GROUP /end SUB_GROUP /begin FUNCTION_LIST /end FUNCTION_LIST /begin REF_CHARACTERISTIC /end REF_CHARACTERISTIC /begin REF_MEASUREMENT HwTq10Meas.HwTq10RollgCntrPrev /end REF_MEASUREMENT /end GROUP
/begin GROUP HwTq10Meas.HwTq10SyncPlsHiLim "MICROSAR RTE" /begin SUB_GROUP /end SUB_GROUP /begin FUNCTION_LIST /end FUNCTION_LIST /begin REF_CHARACTERISTIC /end REF_CHARACTERISTIC /begin REF_MEASUREMENT HwTq10Meas.HwTq10SyncPlsHiLim /end REF_MEASUREMENT /end GROUP
/begin GROUP HwTq10Meas.HwTq10SyncPlsLoLim "MICROSAR RTE" /begin SUB_GROUP /end SUB_GROUP /begin FUNCTION_LIST /end FUNCTION_LIST /begin REF_CHARACTERISTIC /end REF_CHARACTERISTIC /begin REF_MEASUREMENT HwTq10Meas.HwTq10SyncPlsLoLim /end REF_MEASUREMENT /end GROUP
/begin GROUP HwTq10Meas.HwTq10TiStamp "MICROSAR RTE" /begin SUB_GROUP /end SUB_GROUP /begin FUNCTION_LIST /end FUNCTION_LIST /begin REF_CHARACTERISTIC /end REF_CHARACTERISTIC /begin REF_MEASUREMENT HwTq10Meas.HwTq10TiStamp /end REF_MEASUREMENT /end GROUP
/begin GROUP HwTq10Meas.HwTq10TiStampPrev "MICROSAR RTE" /begin SUB_GROUP /end SUB_GROUP /begin FUNCTION_LIST /end FUNCTION_LIST /begin REF_CHARACTERISTIC /end REF_CHARACTERISTIC /begin REF_MEASUREMENT HwTq10Meas.HwTq10TiStampPrev /end REF_MEASUREMENT /end GROUP
/begin GROUP HwTq10Meas.PerInstanceMemories "MICROSAR RTE"
 /begin SUB_GROUP HwTq10Meas.HwTq10DataPlsHiLim HwTq10Meas.HwTq10DataPlsLoLim HwTq10Meas.HwTq10Offs HwTq10Meas.HwTq10PrevHwTq HwTq10Meas.HwTq10RawDataBuf HwTq10Meas.HwTq10RollgCntrPrev HwTq10Meas.HwTq10SyncPlsHiLim HwTq10Meas.HwTq10SyncPlsLoLim HwTq10Meas.HwTq10TiStamp HwTq10Meas.HwTq10TiStampPrev /end SUB_GROUP
 /begin FUNCTION_LIST /end FUNCTION_LIST
 /begin REF_CHARACTERISTIC /end REF_CHARACTERISTIC
 /begin REF_MEASUREMENT /end REF_MEASUREMENT
/end GROUP
/begin GROUP HwTq10Meas.ReceiverPorts "MICROSAR RTE" /begin SUB_GROUP HwTq10Meas.HwTq10Polarity.Val /end SUB_GROUP /begin FUNCTION_LIST /end FUNCTION_LIST /begin REF_CHARACTERISTIC /end REF_CHARACTERISTIC /begin REF_MEASUREMENT /end REF_MEASUREMENT /end GROUP
/begin GROUP HwTq10Meas.SenderPorts "MICROSAR RTE"
 /begin SUB_GROUP HwTq10Meas.HwTq10.Val HwTq10Meas.HwTq10Qlfr.Val HwTq10Meas.HwTq10RollgCntr.Val /end SUB_GROUP
 /begin FUNCTION_LIST /end FUNCTION_LIST
 /begin REF_CHARACTERISTIC /end REF_CHARACTERISTIC
 /begin REF_MEASUREMENT /end REF_MEASUREMENT
/end GROUP
/begin GROUP HwTq9Meas "MICROSAR RTE"
 /begin SUB_GROUP HwTq9Meas.PerInstanceMemories HwTq9Meas.ReceiverPorts HwTq9Meas.SenderPorts /end SUB_GROUP
 /begin FUNCTION_LIST /end FUNCTION_LIST
 /begin REF_CHARACTERISTIC /end REF_CHARACTERISTIC
 /begin REF_MEASUREMENT /end REF_MEASUREMENT
/end GROUP
/begin GROUP HwTq9Meas.HwTq9.Val "MICROSAR RTE" /begin SUB_GROUP /end SUB_GROUP /begin FUNCTION_LIST /end FUNCTION_LIST /begin REF_CHARACTERISTIC /end REF_CHARACTERISTIC /begin REF_MEASUREMENT HwTq9Meas.HwTq9.Val /end REF_MEASUREMENT /end GROUP
/begin GROUP HwTq9Meas.HwTq9Offs "MICROSAR RTE" /begin SUB_GROUP /end SUB_GROUP /begin FUNCTION_LIST /end FUNCTION_LIST /begin REF_CHARACTERISTIC /end REF_CHARACTERISTIC
 /begin REF_MEASUREMENT HwTq9Meas.HwTq9Offs.OffsTrim HwTq9Meas.HwTq9Offs.OffsTrimPrfmdSts /end REF_MEASUREMENT
/end GROUP
/begin GROUP HwTq9Meas.HwTq9Polarity.Val "MICROSAR RTE" /begin SUB_GROUP /end SUB_GROUP /begin FUNCTION_LIST /end FUNCTION_LIST /begin REF_CHARACTERISTIC /end REF_CHARACTERISTIC /begin REF_MEASUREMENT HwTq9Meas.HwTq9Polarity.Val /end REF_MEASUREMENT /end GROUP
/begin GROUP HwTq9Meas.HwTq9PrevHwTq "MICROSAR RTE" /begin SUB_GROUP /end SUB_GROUP /begin FUNCTION_LIST /end FUNCTION_LIST /begin REF_CHARACTERISTIC /end REF_CHARACTERISTIC /begin REF_MEASUREMENT HwTq9Meas.HwTq9PrevHwTq /end REF_MEASUREMENT /end GROUP
/begin GROUP HwTq9Meas.HwTq9Qlfr.Val "MICROSAR RTE" /begin SUB_GROUP /end SUB_GROUP /begin FUNCTION_LIST /end FUNCTION_LIST /begin REF_CHARACTERISTIC /end REF_CHARACTERISTIC /begin REF_MEASUREMENT HwTq9Meas.HwTq9Qlfr.Val /end REF_MEASUREMENT /end GROUP
/begin GROUP HwTq9Meas.HwTq9RawDataBuf "MICROSAR RTE" /begin SUB_GROUP /end SUB_GROUP /begin FUNCTION_LIST /end FUNCTION_LIST /begin REF_CHARACTERISTIC /end REF_CHARACTERISTIC /begin REF_MEASUREMENT HwTq9Meas.HwTq9RawDataBuf /end REF_MEASUREMENT /end GROUP
/begin GROUP HwTq9Meas.HwTq9RollgCntr.Val "MICROSAR RTE" /begin SUB_GROUP /end SUB_GROUP /begin FUNCTION_LIST /end FUNCTION_LIST /begin REF_CHARACTERISTIC /end REF_CHARACTERISTIC /begin REF_MEASUREMENT HwTq9Meas.HwTq9RollgCntr.Val /end REF_MEASUREMENT /end GROUP
/begin GROUP HwTq9Meas.HwTq9RollgCntrPrev "MICROSAR RTE" /begin SUB_GROUP /end SUB_GROUP /begin FUNCTION_LIST /end FUNCTION_LIST /begin REF_CHARACTERISTIC /end REF_CHARACTERISTIC /begin REF_MEASUREMENT HwTq9Meas.HwTq9RollgCntrPrev /end REF_MEASUREMENT /end GROUP
/begin GROUP HwTq9Meas.HwTq9TiStamp "MICROSAR RTE" /begin SUB_GROUP /end SUB_GROUP /begin FUNCTION_LIST /end FUNCTION_LIST /begin REF_CHARACTERISTIC /end REF_CHARACTERISTIC /begin REF_MEASUREMENT HwTq9Meas.HwTq9TiStamp /end REF_MEASUREMENT /end GROUP
/begin GROUP HwTq9Meas.HwTq9TiStampPrev "MICROSAR RTE" /begin SUB_GROUP /end SUB_GROUP /begin FUNCTION_LIST /end FUNCTION_LIST /begin REF_CHARACTERISTIC /end REF_CHARACTERISTIC /begin REF_MEASUREMENT HwTq9Meas.HwTq9TiStampPrev /end REF_MEASUREMENT /end GROUP
/begin GROUP HwTq9Meas.PerInstanceMemories "MICROSAR RTE"
 /begin SUB_GROUP HwTq9Meas.HwTq9Offs HwTq9Meas.HwTq9PrevHwTq HwTq9Meas.HwTq9RawDataBuf HwTq9Meas.HwTq9RollgCntrPrev HwTq9Meas.HwTq9TiStamp HwTq9Meas.HwTq9TiStampPrev /end SUB_GROUP
 /begin FUNCTION_LIST /end FUNCTION_LIST
 /begin REF_CHARACTERISTIC /end REF_CHARACTERISTIC
 /begin REF_MEASUREMENT /end REF_MEASUREMENT
/end GROUP
/begin GROUP HwTq9Meas.ReceiverPorts "MICROSAR RTE" /begin SUB_GROUP HwTq9Meas.HwTq9Polarity.Val /end SUB_GROUP /begin FUNCTION_LIST /end FUNCTION_LIST /begin REF_CHARACTERISTIC /end REF_CHARACTERISTIC /begin REF_MEASUREMENT /end REF_MEASUREMENT /end GROUP
/begin GROUP HwTq9Meas.SenderPorts "MICROSAR RTE"
 /begin SUB_GROUP HwTq9Meas.HwTq9.Val HwTq9Meas.HwTq9Qlfr.Val HwTq9Meas.HwTq9RollgCntr.Val /end SUB_GROUP
 /begin FUNCTION_LIST /end FUNCTION_LIST
 /begin REF_CHARACTERISTIC /end REF_CHARACTERISTIC
 /begin REF_MEASUREMENT /end REF_MEASUREMENT
/end GROUP
/begin GROUP HwTqArbn "MICROSAR RTE"
 /begin SUB_GROUP HwTqArbn.CalibrationPorts HwTqArbn.PerInstanceMemories HwTqArbn.ReceiverPorts HwTqArbn.SenderPorts /end SUB_GROUP
 /begin FUNCTION_LIST /end FUNCTION_LIST
 /begin REF_CHARACTERISTIC /end REF_CHARACTERISTIC
 /begin REF_MEASUREMENT /end REF_MEASUREMENT
/end GROUP
/begin GROUP HwTqArbn.CalibrationPorts "MICROSAR RTE" /begin SUB_GROUP HwTqArbn.HwTqArbnHwTqMaxStallCnt.Val /end SUB_GROUP /begin FUNCTION_LIST /end FUNCTION_LIST /begin REF_CHARACTERISTIC /end REF_CHARACTERISTIC /begin REF_MEASUREMENT /end REF_MEASUREMENT /end GROUP
/begin GROUP HwTqArbn.HwTq.Val "MICROSAR RTE" /begin SUB_GROUP /end SUB_GROUP /begin FUNCTION_LIST /end FUNCTION_LIST /begin REF_CHARACTERISTIC /end REF_CHARACTERISTIC /begin REF_MEASUREMENT HwTqArbn.HwTq.Val /end REF_MEASUREMENT /end GROUP
/begin GROUP HwTqArbn.HwTqA.Val "MICROSAR RTE" /begin SUB_GROUP /end SUB_GROUP /begin FUNCTION_LIST /end FUNCTION_LIST /begin REF_CHARACTERISTIC /end REF_CHARACTERISTIC /begin REF_MEASUREMENT HwTqArbn.HwTqA.Val /end REF_MEASUREMENT /end GROUP
/begin GROUP HwTqArbn.HwTqAQlfr.Val "MICROSAR RTE" /begin SUB_GROUP /end SUB_GROUP /begin FUNCTION_LIST /end FUNCTION_LIST /begin REF_CHARACTERISTIC /end REF_CHARACTERISTIC /begin REF_MEASUREMENT HwTqArbn.HwTqAQlfr.Val /end REF_MEASUREMENT /end GROUP
/begin GROUP HwTqArbn.HwTqARollgCntr.Val "MICROSAR RTE" /begin SUB_GROUP /end SUB_GROUP /begin FUNCTION_LIST /end FUNCTION_LIST /begin REF_CHARACTERISTIC /end REF_CHARACTERISTIC /begin REF_MEASUREMENT HwTqArbn.HwTqARollgCntr.Val /end REF_MEASUREMENT /end GROUP
/begin GROUP HwTqArbn.HwTqARollgCntrPrev "MICROSAR RTE" /begin SUB_GROUP /end SUB_GROUP /begin FUNCTION_LIST /end FUNCTION_LIST /begin REF_CHARACTERISTIC /end REF_CHARACTERISTIC /begin REF_MEASUREMENT HwTqArbn.HwTqARollgCntrPrev /end REF_MEASUREMENT /end GROUP
/begin GROUP HwTqArbn.HwTqAStallCntrPrev "MICROSAR RTE" /begin SUB_GROUP /end SUB_GROUP /begin FUNCTION_LIST /end FUNCTION_LIST /begin REF_CHARACTERISTIC /end REF_CHARACTERISTIC /begin REF_MEASUREMENT HwTqArbn.HwTqAStallCntrPrev /end REF_MEASUREMENT /end GROUP
/begin GROUP HwTqArbn.HwTqArbnHwTqMaxStallCnt.Val "MICROSAR RTE" /begin SUB_GROUP /end SUB_GROUP /begin FUNCTION_LIST /end FUNCTION_LIST /begin REF_CHARACTERISTIC HwTqArbn.HwTqArbnHwTqMaxStallCnt.Val /end REF_CHARACTERISTIC /begin REF_MEASUREMENT /end REF_MEASUREMENT /end GROUP
/begin GROUP HwTqArbn.HwTqB.Val "MICROSAR RTE" /begin SUB_GROUP /end SUB_GROUP /begin FUNCTION_LIST /end FUNCTION_LIST /begin REF_CHARACTERISTIC /end REF_CHARACTERISTIC /begin REF_MEASUREMENT HwTqArbn.HwTqB.Val /end REF_MEASUREMENT /end GROUP
/begin GROUP HwTqArbn.HwTqBQlfr.Val "MICROSAR RTE" /begin SUB_GROUP /end SUB_GROUP /begin FUNCTION_LIST /end FUNCTION_LIST /begin REF_CHARACTERISTIC /end REF_CHARACTERISTIC /begin REF_MEASUREMENT HwTqArbn.HwTqBQlfr.Val /end REF_MEASUREMENT /end GROUP
/begin GROUP HwTqArbn.HwTqBRollgCntr.Val "MICROSAR RTE" /begin SUB_GROUP /end SUB_GROUP /begin FUNCTION_LIST /end FUNCTION_LIST /begin REF_CHARACTERISTIC /end REF_CHARACTERISTIC /begin REF_MEASUREMENT HwTqArbn.HwTqBRollgCntr.Val /end REF_MEASUREMENT /end GROUP
/begin GROUP HwTqArbn.HwTqBRollgCntrPrev "MICROSAR RTE" /begin SUB_GROUP /end SUB_GROUP /begin FUNCTION_LIST /end FUNCTION_LIST /begin REF_CHARACTERISTIC /end REF_CHARACTERISTIC /begin REF_MEASUREMENT HwTqArbn.HwTqBRollgCntrPrev /end REF_MEASUREMENT /end GROUP
/begin GROUP HwTqArbn.HwTqBStallCntrPrev "MICROSAR RTE" /begin SUB_GROUP /end SUB_GROUP /begin FUNCTION_LIST /end FUNCTION_LIST /begin REF_CHARACTERISTIC /end REF_CHARACTERISTIC /begin REF_MEASUREMENT HwTqArbn.HwTqBStallCntrPrev /end REF_MEASUREMENT /end GROUP
/begin GROUP HwTqArbn.HwTqC.Val "MICROSAR RTE" /begin SUB_GROUP /end SUB_GROUP /begin FUNCTION_LIST /end FUNCTION_LIST /begin REF_CHARACTERISTIC /end REF_CHARACTERISTIC /begin REF_MEASUREMENT HwTqArbn.HwTqC.Val /end REF_MEASUREMENT /end GROUP
/begin GROUP HwTqArbn.HwTqCQlfr.Val "MICROSAR RTE" /begin SUB_GROUP /end SUB_GROUP /begin FUNCTION_LIST /end FUNCTION_LIST /begin REF_CHARACTERISTIC /end REF_CHARACTERISTIC /begin REF_MEASUREMENT HwTqArbn.HwTqCQlfr.Val /end REF_MEASUREMENT /end GROUP
/begin GROUP HwTqArbn.HwTqCRollgCntr.Val "MICROSAR RTE" /begin SUB_GROUP /end SUB_GROUP /begin FUNCTION_LIST /end FUNCTION_LIST /begin REF_CHARACTERISTIC /end REF_CHARACTERISTIC /begin REF_MEASUREMENT HwTqArbn.HwTqCRollgCntr.Val /end REF_MEASUREMENT /end GROUP
/begin GROUP HwTqArbn.HwTqCRollgCntrPrev "MICROSAR RTE" /begin SUB_GROUP /end SUB_GROUP /begin FUNCTION_LIST /end FUNCTION_LIST /begin REF_CHARACTERISTIC /end REF_CHARACTERISTIC /begin REF_MEASUREMENT HwTqArbn.HwTqCRollgCntrPrev /end REF_MEASUREMENT /end GROUP
/begin GROUP HwTqArbn.HwTqCStallCntrPrev "MICROSAR RTE" /begin SUB_GROUP /end SUB_GROUP /begin FUNCTION_LIST /end FUNCTION_LIST /begin REF_CHARACTERISTIC /end REF_CHARACTERISTIC /begin REF_MEASUREMENT HwTqArbn.HwTqCStallCntrPrev /end REF_MEASUREMENT /end GROUP
/begin GROUP HwTqArbn.HwTqCorrlnSts.Val "MICROSAR RTE" /begin SUB_GROUP /end SUB_GROUP /begin FUNCTION_LIST /end FUNCTION_LIST /begin REF_CHARACTERISTIC /end REF_CHARACTERISTIC /begin REF_MEASUREMENT HwTqArbn.HwTqCorrlnSts.Val /end REF_MEASUREMENT /end GROUP
/begin GROUP HwTqArbn.HwTqD.Val "MICROSAR RTE" /begin SUB_GROUP /end SUB_GROUP /begin FUNCTION_LIST /end FUNCTION_LIST /begin REF_CHARACTERISTIC /end REF_CHARACTERISTIC /begin REF_MEASUREMENT HwTqArbn.HwTqD.Val /end REF_MEASUREMENT /end GROUP
/begin GROUP HwTqArbn.HwTqDQlfr.Val "MICROSAR RTE" /begin SUB_GROUP /end SUB_GROUP /begin FUNCTION_LIST /end FUNCTION_LIST /begin REF_CHARACTERISTIC /end REF_CHARACTERISTIC /begin REF_MEASUREMENT HwTqArbn.HwTqDQlfr.Val /end REF_MEASUREMENT /end GROUP
/begin GROUP HwTqArbn.HwTqDRollgCntr.Val "MICROSAR RTE" /begin SUB_GROUP /end SUB_GROUP /begin FUNCTION_LIST /end FUNCTION_LIST /begin REF_CHARACTERISTIC /end REF_CHARACTERISTIC /begin REF_MEASUREMENT HwTqArbn.HwTqDRollgCntr.Val /end REF_MEASUREMENT /end GROUP
/begin GROUP HwTqArbn.HwTqDRollgCntrPrev "MICROSAR RTE" /begin SUB_GROUP /end SUB_GROUP /begin FUNCTION_LIST /end FUNCTION_LIST /begin REF_CHARACTERISTIC /end REF_CHARACTERISTIC /begin REF_MEASUREMENT HwTqArbn.HwTqDRollgCntrPrev /end REF_MEASUREMENT /end GROUP
/begin GROUP HwTqArbn.HwTqDStallCntrPrev "MICROSAR RTE" /begin SUB_GROUP /end SUB_GROUP /begin FUNCTION_LIST /end FUNCTION_LIST /begin REF_CHARACTERISTIC /end REF_CHARACTERISTIC /begin REF_MEASUREMENT HwTqArbn.HwTqDStallCntrPrev /end REF_MEASUREMENT /end GROUP
/begin GROUP HwTqArbn.HwTqPrev "MICROSAR RTE" /begin SUB_GROUP /end SUB_GROUP /begin FUNCTION_LIST /end FUNCTION_LIST /begin REF_CHARACTERISTIC /end REF_CHARACTERISTIC /begin REF_MEASUREMENT HwTqArbn.HwTqPrev /end REF_MEASUREMENT /end GROUP
/begin GROUP HwTqArbn.PerInstanceMemories "MICROSAR RTE"
 /begin SUB_GROUP HwTqArbn.HwTqARollgCntrPrev HwTqArbn.HwTqAStallCntrPrev HwTqArbn.HwTqBRollgCntrPrev HwTqArbn.HwTqBStallCntrPrev HwTqArbn.HwTqCRollgCntrPrev HwTqArbn.HwTqCStallCntrPrev HwTqArbn.HwTqDRollgCntrPrev HwTqArbn.HwTqDStallCntrPrev HwTqArbn.HwTqPrev HwTqArbn.dHwTqArbnAAvl HwTqArbn.dHwTqArbnBAvl HwTqArbn.dHwTqArbnCAvl HwTqArbn.dHwTqArbnDAvl HwTqArbn.dHwTqArbnHwTqDenom HwTqArbn.dHwTqArbnHwTqNumer /end SUB_GROUP
 /begin FUNCTION_LIST /end FUNCTION_LIST
 /begin REF_CHARACTERISTIC /end REF_CHARACTERISTIC
 /begin REF_MEASUREMENT /end REF_MEASUREMENT
/end GROUP
/begin GROUP HwTqArbn.ReceiverPorts "MICROSAR RTE"
 /begin SUB_GROUP HwTqArbn.HwTqA.Val HwTqArbn.HwTqAQlfr.Val HwTqArbn.HwTqARollgCntr.Val HwTqArbn.HwTqB.Val HwTqArbn.HwTqBQlfr.Val HwTqArbn.HwTqBRollgCntr.Val HwTqArbn.HwTqC.Val HwTqArbn.HwTqCQlfr.Val HwTqArbn.HwTqCRollgCntr.Val HwTqArbn.HwTqCorrlnSts.Val HwTqArbn.HwTqD.Val HwTqArbn.HwTqDQlfr.Val HwTqArbn.HwTqDRollgCntr.Val /end SUB_GROUP
 /begin FUNCTION_LIST /end FUNCTION_LIST
 /begin REF_CHARACTERISTIC /end REF_CHARACTERISTIC
 /begin REF_MEASUREMENT /end REF_MEASUREMENT
/end GROUP
/begin GROUP HwTqArbn.SenderPorts "MICROSAR RTE" /begin SUB_GROUP HwTqArbn.HwTq.Val /end SUB_GROUP /begin FUNCTION_LIST /end FUNCTION_LIST /begin REF_CHARACTERISTIC /end REF_CHARACTERISTIC /begin REF_MEASUREMENT /end REF_MEASUREMENT /end GROUP
/begin GROUP HwTqArbn.dHwTqArbnAAvl "MICROSAR RTE" /begin SUB_GROUP /end SUB_GROUP /begin FUNCTION_LIST /end FUNCTION_LIST /begin REF_CHARACTERISTIC /end REF_CHARACTERISTIC /begin REF_MEASUREMENT HwTqArbn.dHwTqArbnAAvl /end REF_MEASUREMENT /end GROUP
/begin GROUP HwTqArbn.dHwTqArbnBAvl "MICROSAR RTE" /begin SUB_GROUP /end SUB_GROUP /begin FUNCTION_LIST /end FUNCTION_LIST /begin REF_CHARACTERISTIC /end REF_CHARACTERISTIC /begin REF_MEASUREMENT HwTqArbn.dHwTqArbnBAvl /end REF_MEASUREMENT /end GROUP
/begin GROUP HwTqArbn.dHwTqArbnCAvl "MICROSAR RTE" /begin SUB_GROUP /end SUB_GROUP /begin FUNCTION_LIST /end FUNCTION_LIST /begin REF_CHARACTERISTIC /end REF_CHARACTERISTIC /begin REF_MEASUREMENT HwTqArbn.dHwTqArbnCAvl /end REF_MEASUREMENT /end GROUP
/begin GROUP HwTqArbn.dHwTqArbnDAvl "MICROSAR RTE" /begin SUB_GROUP /end SUB_GROUP /begin FUNCTION_LIST /end FUNCTION_LIST /begin REF_CHARACTERISTIC /end REF_CHARACTERISTIC /begin REF_MEASUREMENT HwTqArbn.dHwTqArbnDAvl /end REF_MEASUREMENT /end GROUP
/begin GROUP HwTqArbn.dHwTqArbnHwTqDenom "MICROSAR RTE" /begin SUB_GROUP /end SUB_GROUP /begin FUNCTION_LIST /end FUNCTION_LIST /begin REF_CHARACTERISTIC /end REF_CHARACTERISTIC /begin REF_MEASUREMENT HwTqArbn.dHwTqArbnHwTqDenom /end REF_MEASUREMENT /end GROUP
/begin GROUP HwTqArbn.dHwTqArbnHwTqNumer "MICROSAR RTE" /begin SUB_GROUP /end SUB_GROUP /begin FUNCTION_LIST /end FUNCTION_LIST /begin REF_CHARACTERISTIC /end REF_CHARACTERISTIC /begin REF_MEASUREMENT HwTqArbn.dHwTqArbnHwTqNumer /end REF_MEASUREMENT /end GROUP
/begin GROUP HwTqCorrln "MICROSAR RTE"
 /begin SUB_GROUP HwTqCorrln.CalibrationPorts HwTqCorrln.PerInstanceMemories HwTqCorrln.ReceiverPorts HwTqCorrln.SenderPorts /end SUB_GROUP
 /begin FUNCTION_LIST /end FUNCTION_LIST
 /begin REF_CHARACTERISTIC /end REF_CHARACTERISTIC
 /begin REF_MEASUREMENT /end REF_MEASUREMENT
/end GROUP
/begin GROUP HwTqCorrln.CalibrationPorts "MICROSAR RTE"
 /begin SUB_GROUP HwTqCorrln.HwTqArbnHwTqMaxStallCnt.Val HwTqCorrln.HwTqCorrlnImdtCorrlnChkFailThd.Val HwTqCorrln.HwTqCorrlnNtcFailStep.Val HwTqCorrln.HwTqCorrlnNtcPassStep.Val /end SUB_GROUP
 /begin FUNCTION_LIST /end FUNCTION_LIST
 /begin REF_CHARACTERISTIC /end REF_CHARACTERISTIC
 /begin REF_MEASUREMENT /end REF_MEASUREMENT
/end GROUP
/begin GROUP HwTqCorrln.HwTqA.Val "MICROSAR RTE" /begin SUB_GROUP /end SUB_GROUP /begin FUNCTION_LIST /end FUNCTION_LIST /begin REF_CHARACTERISTIC /end REF_CHARACTERISTIC /begin REF_MEASUREMENT HwTqCorrln.HwTqA.Val /end REF_MEASUREMENT /end GROUP
/begin GROUP HwTqCorrln.HwTqAQlfr.Val "MICROSAR RTE" /begin SUB_GROUP /end SUB_GROUP /begin FUNCTION_LIST /end FUNCTION_LIST /begin REF_CHARACTERISTIC /end REF_CHARACTERISTIC /begin REF_MEASUREMENT HwTqCorrln.HwTqAQlfr.Val /end REF_MEASUREMENT /end GROUP
/begin GROUP HwTqCorrln.HwTqARollgCntr.Val "MICROSAR RTE" /begin SUB_GROUP /end SUB_GROUP /begin FUNCTION_LIST /end FUNCTION_LIST /begin REF_CHARACTERISTIC /end REF_CHARACTERISTIC /begin REF_MEASUREMENT HwTqCorrln.HwTqARollgCntr.Val /end REF_MEASUREMENT /end GROUP
/begin GROUP HwTqCorrln.HwTqARollgCntrPrev "MICROSAR RTE" /begin SUB_GROUP /end SUB_GROUP /begin FUNCTION_LIST /end FUNCTION_LIST /begin REF_CHARACTERISTIC /end REF_CHARACTERISTIC /begin REF_MEASUREMENT HwTqCorrln.HwTqARollgCntrPrev /end REF_MEASUREMENT /end GROUP
/begin GROUP HwTqCorrln.HwTqAStallCntrPrev "MICROSAR RTE" /begin SUB_GROUP /end SUB_GROUP /begin FUNCTION_LIST /end FUNCTION_LIST /begin REF_CHARACTERISTIC /end REF_CHARACTERISTIC /begin REF_MEASUREMENT HwTqCorrln.HwTqAStallCntrPrev /end REF_MEASUREMENT /end GROUP
/begin GROUP HwTqCorrln.HwTqArbnHwTqMaxStallCnt.Val "MICROSAR RTE" /begin SUB_GROUP /end SUB_GROUP /begin FUNCTION_LIST /end FUNCTION_LIST /begin REF_CHARACTERISTIC HwTqCorrln.HwTqArbnHwTqMaxStallCnt.Val /end REF_CHARACTERISTIC /begin REF_MEASUREMENT /end REF_MEASUREMENT /end GROUP
/begin GROUP HwTqCorrln.HwTqB.Val "MICROSAR RTE" /begin SUB_GROUP /end SUB_GROUP /begin FUNCTION_LIST /end FUNCTION_LIST /begin REF_CHARACTERISTIC /end REF_CHARACTERISTIC /begin REF_MEASUREMENT HwTqCorrln.HwTqB.Val /end REF_MEASUREMENT /end GROUP
/begin GROUP HwTqCorrln.HwTqBQlfr.Val "MICROSAR RTE" /begin SUB_GROUP /end SUB_GROUP /begin FUNCTION_LIST /end FUNCTION_LIST /begin REF_CHARACTERISTIC /end REF_CHARACTERISTIC /begin REF_MEASUREMENT HwTqCorrln.HwTqBQlfr.Val /end REF_MEASUREMENT /end GROUP
/begin GROUP HwTqCorrln.HwTqBRollgCntr.Val "MICROSAR RTE" /begin SUB_GROUP /end SUB_GROUP /begin FUNCTION_LIST /end FUNCTION_LIST /begin REF_CHARACTERISTIC /end REF_CHARACTERISTIC /begin REF_MEASUREMENT HwTqCorrln.HwTqBRollgCntr.Val /end REF_MEASUREMENT /end GROUP
/begin GROUP HwTqCorrln.HwTqBRollgCntrPrev "MICROSAR RTE" /begin SUB_GROUP /end SUB_GROUP /begin FUNCTION_LIST /end FUNCTION_LIST /begin REF_CHARACTERISTIC /end REF_CHARACTERISTIC /begin REF_MEASUREMENT HwTqCorrln.HwTqBRollgCntrPrev /end REF_MEASUREMENT /end GROUP
/begin GROUP HwTqCorrln.HwTqBStallCntrPrev "MICROSAR RTE" /begin SUB_GROUP /end SUB_GROUP /begin FUNCTION_LIST /end FUNCTION_LIST /begin REF_CHARACTERISTIC /end REF_CHARACTERISTIC /begin REF_MEASUREMENT HwTqCorrln.HwTqBStallCntrPrev /end REF_MEASUREMENT /end GROUP
/begin GROUP HwTqCorrln.HwTqC.Val "MICROSAR RTE" /begin SUB_GROUP /end SUB_GROUP /begin FUNCTION_LIST /end FUNCTION_LIST /begin REF_CHARACTERISTIC /end REF_CHARACTERISTIC /begin REF_MEASUREMENT HwTqCorrln.HwTqC.Val /end REF_MEASUREMENT /end GROUP
/begin GROUP HwTqCorrln.HwTqCQlfr.Val "MICROSAR RTE" /begin SUB_GROUP /end SUB_GROUP /begin FUNCTION_LIST /end FUNCTION_LIST /begin REF_CHARACTERISTIC /end REF_CHARACTERISTIC /begin REF_MEASUREMENT HwTqCorrln.HwTqCQlfr.Val /end REF_MEASUREMENT /end GROUP
/begin GROUP HwTqCorrln.HwTqCRollgCntr.Val "MICROSAR RTE" /begin SUB_GROUP /end SUB_GROUP /begin FUNCTION_LIST /end FUNCTION_LIST /begin REF_CHARACTERISTIC /end REF_CHARACTERISTIC /begin REF_MEASUREMENT HwTqCorrln.HwTqCRollgCntr.Val /end REF_MEASUREMENT /end GROUP
/begin GROUP HwTqCorrln.HwTqCRollgCntrPrev "MICROSAR RTE" /begin SUB_GROUP /end SUB_GROUP /begin FUNCTION_LIST /end FUNCTION_LIST /begin REF_CHARACTERISTIC /end REF_CHARACTERISTIC /begin REF_MEASUREMENT HwTqCorrln.HwTqCRollgCntrPrev /end REF_MEASUREMENT /end GROUP
/begin GROUP HwTqCorrln.HwTqCStallCntrPrev "MICROSAR RTE" /begin SUB_GROUP /end SUB_GROUP /begin FUNCTION_LIST /end FUNCTION_LIST /begin REF_CHARACTERISTIC /end REF_CHARACTERISTIC /begin REF_MEASUREMENT HwTqCorrln.HwTqCStallCntrPrev /end REF_MEASUREMENT /end GROUP
/begin GROUP HwTqCorrln.HwTqCorrlnImdtCorrlnChkFailThd.Val "MICROSAR RTE" /begin SUB_GROUP /end SUB_GROUP /begin FUNCTION_LIST /end FUNCTION_LIST /begin REF_CHARACTERISTIC HwTqCorrln.HwTqCorrlnImdtCorrlnChkFailThd.Val /end REF_CHARACTERISTIC /begin REF_MEASUREMENT /end REF_MEASUREMENT /end GROUP
/begin GROUP HwTqCorrln.HwTqCorrlnNtcFailStep.Val "MICROSAR RTE" /begin SUB_GROUP /end SUB_GROUP /begin FUNCTION_LIST /end FUNCTION_LIST /begin REF_CHARACTERISTIC HwTqCorrln.HwTqCorrlnNtcFailStep.Val /end REF_CHARACTERISTIC /begin REF_MEASUREMENT /end REF_MEASUREMENT /end GROUP
/begin GROUP HwTqCorrln.HwTqCorrlnNtcPassStep.Val "MICROSAR RTE" /begin SUB_GROUP /end SUB_GROUP /begin FUNCTION_LIST /end FUNCTION_LIST /begin REF_CHARACTERISTIC HwTqCorrln.HwTqCorrlnNtcPassStep.Val /end REF_CHARACTERISTIC /begin REF_MEASUREMENT /end REF_MEASUREMENT /end GROUP
/begin GROUP HwTqCorrln.HwTqCorrlnSts.Val "MICROSAR RTE" /begin SUB_GROUP /end SUB_GROUP /begin FUNCTION_LIST /end FUNCTION_LIST /begin REF_CHARACTERISTIC /end REF_CHARACTERISTIC /begin REF_MEASUREMENT HwTqCorrln.HwTqCorrlnSts.Val /end REF_MEASUREMENT /end GROUP
/begin GROUP HwTqCorrln.HwTqD.Val "MICROSAR RTE" /begin SUB_GROUP /end SUB_GROUP /begin FUNCTION_LIST /end FUNCTION_LIST /begin REF_CHARACTERISTIC /end REF_CHARACTERISTIC /begin REF_MEASUREMENT HwTqCorrln.HwTqD.Val /end REF_MEASUREMENT /end GROUP
/begin GROUP HwTqCorrln.HwTqDQlfr.Val "MICROSAR RTE" /begin SUB_GROUP /end SUB_GROUP /begin FUNCTION_LIST /end FUNCTION_LIST /begin REF_CHARACTERISTIC /end REF_CHARACTERISTIC /begin REF_MEASUREMENT HwTqCorrln.HwTqDQlfr.Val /end REF_MEASUREMENT /end GROUP
/begin GROUP HwTqCorrln.HwTqDRollgCntr.Val "MICROSAR RTE" /begin SUB_GROUP /end SUB_GROUP /begin FUNCTION_LIST /end FUNCTION_LIST /begin REF_CHARACTERISTIC /end REF_CHARACTERISTIC /begin REF_MEASUREMENT HwTqCorrln.HwTqDRollgCntr.Val /end REF_MEASUREMENT /end GROUP
/begin GROUP HwTqCorrln.HwTqDRollgCntrPrev "MICROSAR RTE" /begin SUB_GROUP /end SUB_GROUP /begin FUNCTION_LIST /end FUNCTION_LIST /begin REF_CHARACTERISTIC /end REF_CHARACTERISTIC /begin REF_MEASUREMENT HwTqCorrln.HwTqDRollgCntrPrev /end REF_MEASUREMENT /end GROUP
/begin GROUP HwTqCorrln.HwTqDStallCntrPrev "MICROSAR RTE" /begin SUB_GROUP /end SUB_GROUP /begin FUNCTION_LIST /end FUNCTION_LIST /begin REF_CHARACTERISTIC /end REF_CHARACTERISTIC /begin REF_MEASUREMENT HwTqCorrln.HwTqDStallCntrPrev /end REF_MEASUREMENT /end GROUP
/begin GROUP HwTqCorrln.HwTqIdptSig.Val "MICROSAR RTE" /begin SUB_GROUP /end SUB_GROUP /begin FUNCTION_LIST /end FUNCTION_LIST /begin REF_CHARACTERISTIC /end REF_CHARACTERISTIC /begin REF_MEASUREMENT HwTqCorrln.HwTqIdptSig.Val /end REF_MEASUREMENT /end GROUP
/begin GROUP HwTqCorrln.PerInstanceMemories "MICROSAR RTE"
 /begin SUB_GROUP HwTqCorrln.HwTqARollgCntrPrev HwTqCorrln.HwTqAStallCntrPrev HwTqCorrln.HwTqBRollgCntrPrev HwTqCorrln.HwTqBStallCntrPrev HwTqCorrln.HwTqCRollgCntrPrev HwTqCorrln.HwTqCStallCntrPrev HwTqCorrln.HwTqDRollgCntrPrev HwTqCorrln.HwTqDStallCntrPrev HwTqCorrln.dHwTqCorrlnAvl HwTqCorrln.dHwTqCorrlnImdtCorrlnSts /end SUB_GROUP
 /begin FUNCTION_LIST /end FUNCTION_LIST
 /begin REF_CHARACTERISTIC /end REF_CHARACTERISTIC
 /begin REF_MEASUREMENT /end REF_MEASUREMENT
/end GROUP
/begin GROUP HwTqCorrln.ReceiverPorts "MICROSAR RTE"
 /begin SUB_GROUP HwTqCorrln.HwTqA.Val HwTqCorrln.HwTqAQlfr.Val HwTqCorrln.HwTqARollgCntr.Val HwTqCorrln.HwTqB.Val HwTqCorrln.HwTqBQlfr.Val HwTqCorrln.HwTqBRollgCntr.Val HwTqCorrln.HwTqC.Val HwTqCorrln.HwTqCQlfr.Val HwTqCorrln.HwTqCRollgCntr.Val HwTqCorrln.HwTqD.Val HwTqCorrln.HwTqDQlfr.Val HwTqCorrln.HwTqDRollgCntr.Val /end SUB_GROUP
 /begin FUNCTION_LIST /end FUNCTION_LIST
 /begin REF_CHARACTERISTIC /end REF_CHARACTERISTIC
 /begin REF_MEASUREMENT /end REF_MEASUREMENT
/end GROUP
/begin GROUP HwTqCorrln.SenderPorts "MICROSAR RTE" /begin SUB_GROUP HwTqCorrln.HwTqCorrlnSts.Val HwTqCorrln.HwTqIdptSig.Val /end SUB_GROUP /begin FUNCTION_LIST /end FUNCTION_LIST /begin REF_CHARACTERISTIC /end REF_CHARACTERISTIC /begin REF_MEASUREMENT /end REF_MEASUREMENT /end GROUP
/begin GROUP HwTqCorrln.dHwTqCorrlnAvl "MICROSAR RTE" /begin SUB_GROUP /end SUB_GROUP /begin FUNCTION_LIST /end FUNCTION_LIST /begin REF_CHARACTERISTIC /end REF_CHARACTERISTIC /begin REF_MEASUREMENT HwTqCorrln.dHwTqCorrlnAvl /end REF_MEASUREMENT /end GROUP
/begin GROUP HwTqCorrln.dHwTqCorrlnImdtCorrlnSts "MICROSAR RTE" /begin SUB_GROUP /end SUB_GROUP /begin FUNCTION_LIST /end FUNCTION_LIST /begin REF_CHARACTERISTIC /end REF_CHARACTERISTIC /begin REF_MEASUREMENT HwTqCorrln.dHwTqCorrlnImdtCorrlnSts /end REF_MEASUREMENT /end GROUP
/begin GROUP HysCmp "MICROSAR RTE"
 /begin SUB_GROUP HysCmp.CalibrationPorts HysCmp.PerInstanceMemories HysCmp.ReceiverPorts HysCmp.SenderPorts /end SUB_GROUP
 /begin FUNCTION_LIST /end FUNCTION_LIST
 /begin REF_CHARACTERISTIC /end REF_CHARACTERISTIC
 /begin REF_MEASUREMENT /end REF_MEASUREMENT
/end GROUP
/begin GROUP HysCmp.AssiCmdBas.Val "MICROSAR RTE" /begin SUB_GROUP /end SUB_GROUP /begin FUNCTION_LIST /end FUNCTION_LIST /begin REF_CHARACTERISTIC /end REF_CHARACTERISTIC /begin REF_MEASUREMENT HysCmp.AssiCmdBas.Val /end REF_MEASUREMENT /end GROUP
/begin GROUP HysCmp.AssiCmdLpFil "MICROSAR RTE" /begin SUB_GROUP /end SUB_GROUP /begin FUNCTION_LIST /end FUNCTION_LIST /begin REF_CHARACTERISTIC /end REF_CHARACTERISTIC /begin REF_MEASUREMENT HysCmp.AssiCmdLpFil.FilGain HysCmp.AssiCmdLpFil.FilSt /end REF_MEASUREMENT /end GROUP
/begin GROUP HysCmp.AssiMechT.Val "MICROSAR RTE" /begin SUB_GROUP /end SUB_GROUP /begin FUNCTION_LIST /end FUNCTION_LIST /begin REF_CHARACTERISTIC /end REF_CHARACTERISTIC /begin REF_MEASUREMENT HysCmp.AssiMechT.Val /end REF_MEASUREMENT /end GROUP
/begin GROUP HysCmp.CalibrationPorts "MICROSAR RTE"
 /begin SUB_GROUP HysCmp.HysCmpAssiCmdLpFilFrq.Val HysCmp.HysCmpAssiInpLim.Val HysCmp.HysCmpEffLossY.Ary1D HysCmp.HysCmpEffOffsY.Ary1D HysCmp.HysCmpFinalOutpLpFilFrq.Val HysCmp.HysCmpFricTScaX.Ary1D HysCmp.HysCmpFricTScaY.Ary1D HysCmp.HysCmpFricWhlImbRejctnBlndX.Ary1D HysCmp.HysCmpFricWhlImbRejctnBlndY.Ary1D HysCmp.HysCmpFricWhlImbRejctnOffY.Ary1D HysCmp.HysCmpFricWhlImbRejctnOnY.Ary1D HysCmp.HysCmpHwTqLpFilFrq.Val HysCmp.HysCmpHwTqScaX.Ary2D HysCmp.HysCmpHwTqScaY.Ary2D HysCmp.HysCmpHysSatnY.Ary1D HysCmp.HysCmpNegHysCmpScaX.Ary1D HysCmp.HysCmpNegHysCmpScaY.Ary1D HysCmp.HysCmpNegHysCmpX.Ary1D HysCmp.HysCmpNegHysCmpY.Ary1D HysCmp.HysCmpOutpLim.Val HysCmp.HysCmpRevGain.Val HysCmp.HysCmpRiseX.Ary1D HysCmp.HysCmpRiseY.Ary1D HysCmp.SysGlbPrmSysTqRat.Val HysCmp.SysGlbPrmVehSpdBilnrSeln.Ary1D /end SUB_GROUP
 /begin FUNCTION_LIST /end FUNCTION_LIST
 /begin REF_CHARACTERISTIC /end REF_CHARACTERISTIC
 /begin REF_MEASUREMENT /end REF_MEASUREMENT
/end GROUP
/begin GROUP HysCmp.FinalOutpLpFil "MICROSAR RTE" /begin SUB_GROUP /end SUB_GROUP /begin FUNCTION_LIST /end FUNCTION_LIST /begin REF_CHARACTERISTIC /end REF_CHARACTERISTIC /begin REF_MEASUREMENT HysCmp.FinalOutpLpFil.FilGain HysCmp.FinalOutpLpFil.FilSt /end REF_MEASUREMENT /end GROUP
/begin GROUP HysCmp.HwTq.Val "MICROSAR RTE" /begin SUB_GROUP /end SUB_GROUP /begin FUNCTION_LIST /end FUNCTION_LIST /begin REF_CHARACTERISTIC /end REF_CHARACTERISTIC /begin REF_MEASUREMENT HysCmp.HwTq.Val /end REF_MEASUREMENT /end GROUP
/begin GROUP HysCmp.HwTqLpFil "MICROSAR RTE" /begin SUB_GROUP /end SUB_GROUP /begin FUNCTION_LIST /end FUNCTION_LIST /begin REF_CHARACTERISTIC /end REF_CHARACTERISTIC /begin REF_MEASUREMENT HysCmp.HwTqLpFil.FilGain HysCmp.HwTqLpFil.FilSt /end REF_MEASUREMENT /end GROUP
/begin GROUP HysCmp.HwTqOvrl.Val "MICROSAR RTE" /begin SUB_GROUP /end SUB_GROUP /begin FUNCTION_LIST /end FUNCTION_LIST /begin REF_CHARACTERISTIC /end REF_CHARACTERISTIC /begin REF_MEASUREMENT HysCmp.HwTqOvrl.Val /end REF_MEASUREMENT /end GROUP
/begin GROUP HysCmp.HysCmpAssiCmdLpFilFrq.Val "MICROSAR RTE" /begin SUB_GROUP /end SUB_GROUP /begin FUNCTION_LIST /end FUNCTION_LIST /begin REF_CHARACTERISTIC HysCmp.HysCmpAssiCmdLpFilFrq.Val /end REF_CHARACTERISTIC /begin REF_MEASUREMENT /end REF_MEASUREMENT /end GROUP
/begin GROUP HysCmp.HysCmpAssiInpLim.Val "MICROSAR RTE" /begin SUB_GROUP /end SUB_GROUP /begin FUNCTION_LIST /end FUNCTION_LIST /begin REF_CHARACTERISTIC HysCmp.HysCmpAssiInpLim.Val /end REF_CHARACTERISTIC /begin REF_MEASUREMENT /end REF_MEASUREMENT /end GROUP
/begin GROUP HysCmp.HysCmpCmd.Val "MICROSAR RTE" /begin SUB_GROUP /end SUB_GROUP /begin FUNCTION_LIST /end FUNCTION_LIST /begin REF_CHARACTERISTIC /end REF_CHARACTERISTIC /begin REF_MEASUREMENT HysCmp.HysCmpCmd.Val /end REF_MEASUREMENT /end GROUP
/begin GROUP HysCmp.HysCmpCmdDi.Logl "MICROSAR RTE" /begin SUB_GROUP /end SUB_GROUP /begin FUNCTION_LIST /end FUNCTION_LIST /begin REF_CHARACTERISTIC /end REF_CHARACTERISTIC /begin REF_MEASUREMENT HysCmp.HysCmpCmdDi.Logl /end REF_MEASUREMENT /end GROUP
/begin GROUP HysCmp.HysCmpEffLossY.Ary1D "MICROSAR RTE" /begin SUB_GROUP /end SUB_GROUP /begin FUNCTION_LIST /end FUNCTION_LIST /begin REF_CHARACTERISTIC HysCmp.HysCmpEffLossY.Ary1D /end REF_CHARACTERISTIC /begin REF_MEASUREMENT /end REF_MEASUREMENT /end GROUP
/**********************************************************************************************************************
* RECORD_LAYOUT
*********************************************************************************************************************/
/begin RECORD_LAYOUT RTE_RL_UBYTE FNC_VALUES 1 UBYTE ROW_DIR DIRECT /end RECORD_LAYOUT
/begin RECORD_LAYOUT RTE_RL_UWORD FNC_VALUES 1 UWORD ROW_DIR DIRECT /end RECORD_LAYOUT
/begin RECORD_LAYOUT RTE_RL_ULONG FNC_VALUES 1 ULONG ROW_DIR DIRECT /end RECORD_LAYOUT
/begin RECORD_LAYOUT RTE_RL_SWORD FNC_VALUES 1 SWORD ROW_DIR DIRECT /end RECORD_LAYOUT
/begin RECORD_LAYOUT RTE_RL_FLOAT32_IEEE FNC_VALUES 1 FLOAT32_IEEE ROW_DIR DIRECT /end RECORD_LAYOUT
/begin RECORD_LAYOUT RTE_RL_BOOLEAN FNC_VALUES 1 UBYTE ROW_DIR DIRECT /end RECORD_LAYOUT
/**********************************************************************************************************************
* COMPU_METHOD / COMPU_VTAB_RANGE
*********************************************************************************************************************/
/begin COMPU_METHOD RTE_CM_BOOLEAN "" TAB_VERB "%3.1" "" COMPU_TAB_REF RTE_CM_BOOLEAN /end COMPU_METHOD
/begin COMPU_VTAB_RANGE RTE_CM_BOOLEAN "" 2 0 0 "false" 1 255 "true" /end COMPU_VTAB_RANGE
/begin COMPU_METHOD RTE_CM_ENUM_SigQlfr1 "" TAB_VERB "%.1" "" COMPU_TAB_REF RTE_CM_ENUM_SigQlfr1 /end COMPU_METHOD
/begin COMPU_VTAB_RANGE RTE_CM_ENUM_SigQlfr1 "" 3 0 0 "SIGQLFR_NORES" 1 1 "SIGQLFR_PASSD" 2 2 "SIGQLFR_FAILD" /end COMPU_VTAB_RANGE
/begin COMPU_METHOD RTE_CM_ENUM_HwAgSnsrTyp1 "" TAB_VERB "%.1" "" COMPU_TAB_REF RTE_CM_ENUM_HwAgSnsrTyp1 /end COMPU_METHOD
/begin COMPU_VTAB_RANGE RTE_CM_ENUM_HwAgSnsrTyp1 "" 2 0 0 "HWAGSNSRTYP_NOSNSR" 1 1 "HWAGSNSRTYP_A1335" /end COMPU_VTAB_RANGE
/begin COMPU_METHOD RTE_CM_ENUM_SelnCaseSt1 "" TAB_VERB "%.1" "" COMPU_TAB_REF RTE_CM_ENUM_SelnCaseSt1 /end COMPU_METHOD
/begin COMPU_VTAB_RANGE RTE_CM_ENUM_SelnCaseSt1 "" 5 0 0 "SELNCASEST_FCENTR" 1 1 "SELNCASEST_VEHDYN" 2 2 "SELNCASEST_WHLSPD" 3 3 "SELNCASEST_STORDLSTPOSN" 4 4 "SELNCASEST_CORRDPINIONAG" /end COMPU_VTAB_RANGE
