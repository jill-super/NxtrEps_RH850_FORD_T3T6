/begin CHARACTERISTIC CustDiag.DidEE00Dft "MICROSAR RTE" VAL_BLK 0x0 RTE_RL_UBYTE 0 NO_COMPU_METHOD 0 255 MATRIX_DIM 3 1 1 SYMBOL_LINK "Rte_CalprmRom_CustDiag_DEFAULT_RTE_CDATA_GROUP.DidEE00Dft" 0 DISPLAY_IDENTIFIER CustDiag.CalibrationParameters.DidEE00Dft /end CHARACTERISTIC
/begin CHARACTERISTIC CustDiag.DidEE01Dft "MICROSAR RTE" VALUE 0x0 RTE_RL_UBYTE 0 NO_COMPU_METHOD 0 255 SYMBOL_LINK "Rte_CalprmRom_CustDiag_DEFAULT_RTE_CDATA_GROUP.DidEE01Dft" 0 DISPLAY_IDENTIFIER CustDiag.CalibrationParameters.DidEE01Dft /end CHARACTERISTIC
/begin CHARACTERISTIC CustDiag.DidEE02Dft "MICROSAR RTE" VALUE 0x0 RTE_RL_UBYTE 0 NO_COMPU_METHOD 0 255 SYMBOL_LINK "Rte_CalprmRom_CustDiag_DEFAULT_RTE_CDATA_GROUP.DidEE02Dft" 0 DISPLAY_IDENTIFIER CustDiag.CalibrationParameters.DidEE02Dft /end CHARACTERISTIC
/begin CHARACTERISTIC CustDiag.DidEE21Dft "MICROSAR RTE" VAL_BLK 0x0 RTE_RL_UBYTE 0 NO_COMPU_METHOD 0 255 MATRIX_DIM 20 1 1 SYMBOL_LINK "Rte_CalprmRom_CustDiag_DEFAULT_RTE_CDATA_GROUP.DidEE21Dft" 0 DISPLAY_IDENTIFIER CustDiag.CalibrationParameters.DidEE21Dft /end CHARACTERISTIC
/begin CHARACTERISTIC CustDiag.DidEE22Dft "MICROSAR RTE" VAL_BLK 0x0 RTE_RL_UBYTE 0 NO_COMPU_METHOD 0 255 MATRIX_DIM 40 1 1 SYMBOL_LINK "Rte_CalprmRom_CustDiag_DEFAULT_RTE_CDATA_GROUP.DidEE22Dft" 0 DISPLAY_IDENTIFIER CustDiag.CalibrationParameters.DidEE22Dft /end CHARACTERISTIC
/begin CHARACTERISTIC CustDiag.DidEE23Dft "MICROSAR RTE" VAL_BLK 0x0 RTE_RL_UBYTE 0 NO_COMPU_METHOD 0 255 MATRIX_DIM 40 1 1 SYMBOL_LINK "Rte_CalprmRom_CustDiag_DEFAULT_RTE_CDATA_GROUP.DidEE23Dft" 0 DISPLAY_IDENTIFIER CustDiag.CalibrationParameters.DidEE23Dft /end CHARACTERISTIC
/begin CHARACTERISTIC CustDiag.DidEE40Dft "MICROSAR RTE" VAL_BLK 0x0 RTE_RL_UBYTE 0 NO_COMPU_METHOD 0 255 MATRIX_DIM 3 1 1 SYMBOL_LINK "Rte_CalprmRom_CustDiag_DEFAULT_RTE_CDATA_GROUP.DidEE40Dft" 0 DISPLAY_IDENTIFIER CustDiag.CalibrationParameters.DidEE40Dft /end CHARACTERISTIC
/begin CHARACTERISTIC CustDiag.DidEE41Dft "MICROSAR RTE" VALUE 0x0 RTE_RL_UBYTE 0 NO_COMPU_METHOD 0 255 SYMBOL_LINK "Rte_CalprmRom_CustDiag_DEFAULT_RTE_CDATA_GROUP.DidEE41Dft" 0 DISPLAY_IDENTIFIER CustDiag.CalibrationParameters.DidEE41Dft /end CHARACTERISTIC
/begin CHARACTERISTIC CustDiag.DidEE81Dft "MICROSAR RTE" VAL_BLK 0x0 RTE_RL_UBYTE 0 NO_COMPU_METHOD 0 255 MATRIX_DIM 4 1 1 SYMBOL_LINK "Rte_CalprmRom_CustDiag_DEFAULT_RTE_CDATA_GROUP.DidEE81Dft" 0 DISPLAY_IDENTIFIER CustDiag.CalibrationParameters.DidEE81Dft /end CHARACTERISTIC
/begin CHARACTERISTIC CustDiag.DidEE82Dft "MICROSAR RTE" VAL_BLK 0x0 RTE_RL_UBYTE 0 NO_COMPU_METHOD 0 255 MATRIX_DIM 4 1 1 SYMBOL_LINK "Rte_CalprmRom_CustDiag_DEFAULT_RTE_CDATA_GROUP.DidEE82Dft" 0 DISPLAY_IDENTIFIER CustDiag.CalibrationParameters.DidEE82Dft /end CHARACTERISTIC
/begin CHARACTERISTIC CustDiag.DidEE83Dft "MICROSAR RTE" VAL_BLK 0x0 RTE_RL_UBYTE 0 NO_COMPU_METHOD 0 255 MATRIX_DIM 4 1 1 SYMBOL_LINK "Rte_CalprmRom_CustDiag_DEFAULT_RTE_CDATA_GROUP.DidEE83Dft" 0 DISPLAY_IDENTIFIER CustDiag.CalibrationParameters.DidEE83Dft /end CHARACTERISTIC
/begin CHARACTERISTIC CustDiag.DidEE84Dft "MICROSAR RTE" VAL_BLK 0x0 RTE_RL_UBYTE 0 NO_COMPU_METHOD 0 255 MATRIX_DIM 4 1 1 SYMBOL_LINK "Rte_CalprmRom_CustDiag_DEFAULT_RTE_CDATA_GROUP.DidEE84Dft" 0 DISPLAY_IDENTIFIER CustDiag.CalibrationParameters.DidEE84Dft /end CHARACTERISTIC
/begin CHARACTERISTIC CustDiag.DidEE85Dft "MICROSAR RTE" VAL_BLK 0x0 RTE_RL_UBYTE 0 NO_COMPU_METHOD 0 255 MATRIX_DIM 4 1 1 SYMBOL_LINK "Rte_CalprmRom_CustDiag_DEFAULT_RTE_CDATA_GROUP.DidEE85Dft" 0 DISPLAY_IDENTIFIER CustDiag.CalibrationParameters.DidEE85Dft /end CHARACTERISTIC
/begin CHARACTERISTIC CustDiag.DidEE86Dft "MICROSAR RTE" VAL_BLK 0x0 RTE_RL_UBYTE 0 NO_COMPU_METHOD 0 255 MATRIX_DIM 4 1 1 SYMBOL_LINK "Rte_CalprmRom_CustDiag_DEFAULT_RTE_CDATA_GROUP.DidEE86Dft" 0 DISPLAY_IDENTIFIER CustDiag.CalibrationParameters.DidEE86Dft /end CHARACTERISTIC
/begin CHARACTERISTIC CustDiag.DidEE87Dft "MICROSAR RTE" VAL_BLK 0x0 RTE_RL_UBYTE 0 NO_COMPU_METHOD 0 255 MATRIX_DIM 4 1 1 SYMBOL_LINK "Rte_CalprmRom_CustDiag_DEFAULT_RTE_CDATA_GROUP.DidEE87Dft" 0 DISPLAY_IDENTIFIER CustDiag.CalibrationParameters.DidEE87Dft /end CHARACTERISTIC
/begin CHARACTERISTIC CustDiag.DidEE88Dft "MICROSAR RTE" VAL_BLK 0x0 RTE_RL_UBYTE 0 NO_COMPU_METHOD 0 255 MATRIX_DIM 4 1 1 SYMBOL_LINK "Rte_CalprmRom_CustDiag_DEFAULT_RTE_CDATA_GROUP.DidEE88Dft" 0 DISPLAY_IDENTIFIER CustDiag.CalibrationParameters.DidEE88Dft /end CHARACTERISTIC
/begin CHARACTERISTIC CustDiag.DidEED0Dft "MICROSAR RTE" VALUE 0x0 RTE_RL_UBYTE 0 NO_COMPU_METHOD 0 255 SYMBOL_LINK "Rte_CalprmRom_CustDiag_DEFAULT_RTE_CDATA_GROUP.DidEED0Dft" 0 DISPLAY_IDENTIFIER CustDiag.CalibrationParameters.DidEED0Dft /end CHARACTERISTIC
/begin CHARACTERISTIC CustDiag.DidF110Dft "MICROSAR RTE" VAL_BLK 0x0 RTE_RL_UBYTE 0 NO_COMPU_METHOD 0 255 MATRIX_DIM 24 1 1 SYMBOL_LINK "Rte_CalprmRom_CustDiag_DEFAULT_RTE_CDATA_GROUP.DidF110Dft" 0 DISPLAY_IDENTIFIER CustDiag.CalibrationParameters.DidF110Dft /end CHARACTERISTIC
/begin CHARACTERISTIC CustDiag.DidF111Dft "MICROSAR RTE" VAL_BLK 0x0 RTE_RL_UBYTE 0 NO_COMPU_METHOD 0 255 MATRIX_DIM 24 1 1 SYMBOL_LINK "Rte_CalprmRom_CustDiag_DEFAULT_RTE_CDATA_GROUP.DidF111Dft" 0 DISPLAY_IDENTIFIER CustDiag.CalibrationParameters.DidF111Dft /end CHARACTERISTIC
/begin CHARACTERISTIC CustDiag.DidF113Dft "MICROSAR RTE" VAL_BLK 0x0 RTE_RL_UBYTE 0 NO_COMPU_METHOD 0 255 MATRIX_DIM 24 1 1 SYMBOL_LINK "Rte_CalprmRom_CustDiag_DEFAULT_RTE_CDATA_GROUP.DidF113Dft" 0 DISPLAY_IDENTIFIER CustDiag.CalibrationParameters.DidF113Dft /end CHARACTERISTIC
/begin CHARACTERISTIC CustDiag.DidF15FDft "MICROSAR RTE" VAL_BLK 0x0 RTE_RL_UBYTE 0 NO_COMPU_METHOD 0 255 MATRIX_DIM 10 1 1 SYMBOL_LINK "Rte_CalprmRom_CustDiag_DEFAULT_RTE_CDATA_GROUP.DidF15FDft" 0 DISPLAY_IDENTIFIER CustDiag.CalibrationParameters.DidF15FDft /end CHARACTERISTIC
/begin CHARACTERISTIC CustDiag.DidF162Dft "MICROSAR RTE" VALUE 0x0 RTE_RL_UBYTE 0 NO_COMPU_METHOD 0 255 SYMBOL_LINK "Rte_CalprmRom_CustDiag_DEFAULT_RTE_CDATA_GROUP.DidF162Dft" 0 DISPLAY_IDENTIFIER CustDiag.CalibrationParameters.DidF162Dft /end CHARACTERISTIC
/begin CHARACTERISTIC CustDiag.DidF163Dft "MICROSAR RTE" VALUE 0x0 RTE_RL_UBYTE 0 NO_COMPU_METHOD 0 255 SYMBOL_LINK "Rte_CalprmRom_CustDiag_DEFAULT_RTE_CDATA_GROUP.DidF163Dft" 0 DISPLAY_IDENTIFIER CustDiag.CalibrationParameters.DidF163Dft /end CHARACTERISTIC
/begin CHARACTERISTIC CustDiag.DidF166Dft "MICROSAR RTE" VAL_BLK 0x0 RTE_RL_UBYTE 0 NO_COMPU_METHOD 0 255 MATRIX_DIM 4 1 1 SYMBOL_LINK "Rte_CalprmRom_CustDiag_DEFAULT_RTE_CDATA_GROUP.DidF166Dft" 0 DISPLAY_IDENTIFIER CustDiag.CalibrationParameters.DidF166Dft /end CHARACTERISTIC
/begin CHARACTERISTIC CustDiag.DidF18ADft "MICROSAR RTE" VAL_BLK 0x0 RTE_RL_UBYTE 0 NO_COMPU_METHOD 0 255 MATRIX_DIM 24 1 1 SYMBOL_LINK "Rte_CalprmRom_CustDiag_DEFAULT_RTE_CDATA_GROUP.DidF18ADft" 0 DISPLAY_IDENTIFIER CustDiag.CalibrationParameters.DidF18ADft /end CHARACTERISTIC
/begin CHARACTERISTIC CustDiag.DidF18CDft "MICROSAR RTE" VAL_BLK 0x0 RTE_RL_UBYTE 0 NO_COMPU_METHOD 0 255 MATRIX_DIM 16 1 1 SYMBOL_LINK "Rte_CalprmRom_CustDiag_DEFAULT_RTE_CDATA_GROUP.DidF18CDft" 0 DISPLAY_IDENTIFIER CustDiag.CalibrationParameters.DidF18CDft /end CHARACTERISTIC
/begin CHARACTERISTIC CustDiag.DidF190Dft "MICROSAR RTE" VAL_BLK 0x0 RTE_RL_UBYTE 0 NO_COMPU_METHOD 0 255 MATRIX_DIM 24 1 1 SYMBOL_LINK "Rte_CalprmRom_CustDiag_DEFAULT_RTE_CDATA_GROUP.DidF190Dft" 0 DISPLAY_IDENTIFIER CustDiag.CalibrationParameters.DidF190Dft /end CHARACTERISTIC
/begin CHARACTERISTIC CustDiag.NxtrCalIdsCal0DevlpDesc.Ary1D "MICROSAR RTE" VAL_BLK 0x0 RTE_RL_UBYTE 0 NO_COMPU_METHOD 0 255 MATRIX_DIM 48 1 1 SYMBOL_LINK "Rte_CalprmRom_CalRegn01Cmn_DEFAULT_RTE_CALPRM_GROUP.NxtrCalIdsCal0DevlpDesc_Ary1D" 0 DISPLAY_IDENTIFIER CustDiag.CalibrationPorts.NxtrCalIdsCal0DevlpDesc.Ary1D /end CHARACTERISTIC
/begin CHARACTERISTIC CustDiag.NxtrCalIdsCal1DevlpDesc.Ary1D "MICROSAR RTE" VAL_BLK 0x0 RTE_RL_UBYTE 0 NO_COMPU_METHOD 0 255 MATRIX_DIM 48 1 1 SYMBOL_LINK "Rte_CalprmRom_CalRegn02Cmn_DEFAULT_RTE_CALPRM_GROUP.NxtrCalIdsCal1DevlpDesc_Ary1D" 0 DISPLAY_IDENTIFIER CustDiag.CalibrationPorts.NxtrCalIdsCal1DevlpDesc.Ary1D /end CHARACTERISTIC
/begin CHARACTERISTIC Dampg.DampgHwTqX.Ary1D "MICROSAR RTE" VAL_BLK 0x0 RTE_RL_UWORD 0 NO_COMPU_METHOD 0 65535 MATRIX_DIM 2 1 1 SYMBOL_LINK "Rte_CalprmRom_CalRegn02Rt00GroupA_DEFAULT_RTE_CALPRM_GROUP.DampgHwTqX_Ary1D" 0 DISPLAY_IDENTIFIER Dampg.CalibrationPorts.DampgHwTqX.Ary1D /end CHARACTERISTIC
/begin CHARACTERISTIC Dampg.DampgHwTqY.Ary1D "MICROSAR RTE" VAL_BLK 0x0 RTE_RL_UWORD 0 NO_COMPU_METHOD 0 65535 MATRIX_DIM 2 1 1 SYMBOL_LINK "Rte_CalprmRom_CalRegn02Rt00GroupA_DEFAULT_RTE_CALPRM_GROUP.DampgHwTqY_Ary1D" 0 DISPLAY_IDENTIFIER Dampg.CalibrationPorts.DampgHwTqY.Ary1D /end CHARACTERISTIC
/begin CHARACTERISTIC Dampg.DampgHydAssiLim.Ary1D "MICROSAR RTE" VAL_BLK 0x0 RTE_RL_UWORD 0 NO_COMPU_METHOD 0 65535 MATRIX_DIM 12 1 1 SYMBOL_LINK "Rte_CalprmRom_CalRegn02Inin00GroupA_DEFAULT_RTE_CALPRM_GROUP.DampgHydAssiLim_Ary1D" 0 DISPLAY_IDENTIFIER Dampg.CalibrationPorts.DampgHydAssiLim.Ary1D /end CHARACTERISTIC
/begin CHARACTERISTIC Dampg.DampgHydBasCoeff1.Val "MICROSAR RTE" VALUE 0x0 RTE_RL_FLOAT32_IEEE 0 NO_COMPU_METHOD -3.402823466e+38 3.402823466e+38 SYMBOL_LINK "Rte_CalprmRom_CalRegn01Inin00GroupA_DEFAULT_RTE_CALPRM_GROUP.DampgHydBasCoeff1_Val" 0 DISPLAY_IDENTIFIER Dampg.CalibrationPorts.DampgHydBasCoeff1.Val /end CHARACTERISTIC
/begin CHARACTERISTIC Dampg.DampgHydBasCoeff2.Val "MICROSAR RTE" VALUE 0x0 RTE_RL_FLOAT32_IEEE 0 NO_COMPU_METHOD -3.402823466e+38 3.402823466e+38 SYMBOL_LINK "Rte_CalprmRom_CalRegn01Inin00GroupA_DEFAULT_RTE_CALPRM_GROUP.DampgHydBasCoeff2_Val" 0 DISPLAY_IDENTIFIER Dampg.CalibrationPorts.DampgHydBasCoeff2.Val /end CHARACTERISTIC
/begin CHARACTERISTIC Dampg.DampgHydBasCoeff3.Val "MICROSAR RTE" VALUE 0x0 RTE_RL_FLOAT32_IEEE 0 NO_COMPU_METHOD -3.402823466e+38 3.402823466e+38 SYMBOL_LINK "Rte_CalprmRom_CalRegn01Inin00GroupA_DEFAULT_RTE_CALPRM_GROUP.DampgHydBasCoeff3_Val" 0 DISPLAY_IDENTIFIER Dampg.CalibrationPorts.DampgHydBasCoeff3.Val /end CHARACTERISTIC
/begin CHARACTERISTIC Dampg.DampgHydBasCoeff4.Val "MICROSAR RTE" VALUE 0x0 RTE_RL_FLOAT32_IEEE 0 NO_COMPU_METHOD -3.402823466e+38 3.402823466e+38 SYMBOL_LINK "Rte_CalprmRom_CalRegn01Inin00GroupA_DEFAULT_RTE_CALPRM_GROUP.DampgHydBasCoeff4_Val" 0 DISPLAY_IDENTIFIER Dampg.CalibrationPorts.DampgHydBasCoeff4.Val /end CHARACTERISTIC
/begin CHARACTERISTIC Dampg.DampgHydCoeff1ScaY.Ary1D "MICROSAR RTE" VAL_BLK 0x0 RTE_RL_UWORD 0 NO_COMPU_METHOD 0 65535 MATRIX_DIM 12 1 1 SYMBOL_LINK "Rte_CalprmRom_CalRegn02Rt00GroupA_DEFAULT_RTE_CALPRM_GROUP.DampgHydCoeff1ScaY_Ary1D" 0 DISPLAY_IDENTIFIER Dampg.CalibrationPorts.DampgHydCoeff1ScaY.Ary1D /end CHARACTERISTIC
/begin CHARACTERISTIC Dampg.DampgHydCoeff2ScaY.Ary1D "MICROSAR RTE" VAL_BLK 0x0 RTE_RL_UWORD 0 NO_COMPU_METHOD 0 65535 MATRIX_DIM 12 1 1 SYMBOL_LINK "Rte_CalprmRom_CalRegn02Rt00GroupA_DEFAULT_RTE_CALPRM_GROUP.DampgHydCoeff2ScaY_Ary1D" 0 DISPLAY_IDENTIFIER Dampg.CalibrationPorts.DampgHydCoeff2ScaY.Ary1D /end CHARACTERISTIC
/begin CHARACTERISTIC Dampg.DampgHydCoeff3ScaY.Ary1D "MICROSAR RTE" VAL_BLK 0x0 RTE_RL_UWORD 0 NO_COMPU_METHOD 0 65535 MATRIX_DIM 12 1 1 SYMBOL_LINK "Rte_CalprmRom_CalRegn02Rt00GroupA_DEFAULT_RTE_CALPRM_GROUP.DampgHydCoeff3ScaY_Ary1D" 0 DISPLAY_IDENTIFIER Dampg.CalibrationPorts.DampgHydCoeff3ScaY.Ary1D /end CHARACTERISTIC
/begin CHARACTERISTIC Dampg.DampgHydCoeff4ScaY.Ary1D "MICROSAR RTE" VAL_BLK 0x0 RTE_RL_UWORD 0 NO_COMPU_METHOD 0 65535 MATRIX_DIM 12 1 1 SYMBOL_LINK "Rte_CalprmRom_CalRegn02Rt00GroupA_DEFAULT_RTE_CALPRM_GROUP.DampgHydCoeff4ScaY_Ary1D" 0 DISPLAY_IDENTIFIER Dampg.CalibrationPorts.DampgHydCoeff4ScaY.Ary1D /end CHARACTERISTIC
/begin CHARACTERISTIC Dampg.DampgHydOutpLim.Val "MICROSAR RTE" VALUE 0x0 RTE_RL_FLOAT32_IEEE 0 NO_COMPU_METHOD -3.402823466e+38 3.402823466e+38 SYMBOL_LINK "Rte_CalprmRom_CalRegn01Inin00GroupA_DEFAULT_RTE_CALPRM_GROUP.DampgHydOutpLim_Val" 0 DISPLAY_IDENTIFIER Dampg.CalibrationPorts.DampgHydOutpLim.Val /end CHARACTERISTIC
/begin CHARACTERISTIC Dampg.DampgMotVelLpFilFrq.Val "MICROSAR RTE" VALUE 0x0 RTE_RL_FLOAT32_IEEE 0 NO_COMPU_METHOD -3.402823466e+38 3.402823466e+38 SYMBOL_LINK "Rte_CalprmRom_CalRegn01Inin00GroupA_DEFAULT_RTE_CALPRM_GROUP.DampgMotVelLpFilFrq_Val" 0 DISPLAY_IDENTIFIER Dampg.CalibrationPorts.DampgMotVelLpFilFrq.Val /end CHARACTERISTIC
/begin CHARACTERISTIC Dampg.DampgMotVelX.Ary2D "MICROSAR RTE" VAL_BLK 0x0 RTE_RL_UWORD 0 NO_COMPU_METHOD 0 65535 MATRIX_DIM 13 12 1 SYMBOL_LINK "Rte_CalprmRom_CalRegn02Rt00GroupA_DEFAULT_RTE_CALPRM_GROUP.DampgMotVelX_Ary2D" 0 DISPLAY_IDENTIFIER Dampg.CalibrationPorts.DampgMotVelX.Ary2D /end CHARACTERISTIC
/begin CHARACTERISTIC Dampg.DampgMotVelY.Ary2D "MICROSAR RTE" VAL_BLK 0x0 RTE_RL_UWORD 0 NO_COMPU_METHOD 0 65535 MATRIX_DIM 13 12 1 SYMBOL_LINK "Rte_CalprmRom_CalRegn02Rt00GroupA_DEFAULT_RTE_CALPRM_GROUP.DampgMotVelY_Ary2D" 0 DISPLAY_IDENTIFIER Dampg.CalibrationPorts.DampgMotVelY.Ary2D /end CHARACTERISTIC
/begin CHARACTERISTIC Dampg.DampgQuad13Mplr.Val "MICROSAR RTE" VALUE 0x0 RTE_RL_FLOAT32_IEEE 0 NO_COMPU_METHOD -3.402823466e+38 3.402823466e+38 SYMBOL_LINK "Rte_CalprmRom_CalRegn01Inin00GroupA_DEFAULT_RTE_CALPRM_GROUP.DampgQuad13Mplr_Val" 0 DISPLAY_IDENTIFIER Dampg.CalibrationPorts.DampgQuad13Mplr.Val /end CHARACTERISTIC
/begin CHARACTERISTIC Dampg.DampgQuad24Mplr.Val "MICROSAR RTE" VALUE 0x0 RTE_RL_FLOAT32_IEEE 0 NO_COMPU_METHOD -3.402823466e+38 3.402823466e+38 SYMBOL_LINK "Rte_CalprmRom_CalRegn01Inin00GroupA_DEFAULT_RTE_CALPRM_GROUP.DampgQuad24Mplr_Val" 0 DISPLAY_IDENTIFIER Dampg.CalibrationPorts.DampgQuad24Mplr.Val /end CHARACTERISTIC
/begin CHARACTERISTIC Dampg.DampgQuadHwTqBacklsh.Val "MICROSAR RTE" VALUE 0x0 RTE_RL_FLOAT32_IEEE 0 NO_COMPU_METHOD -3.402823466e+38 3.402823466e+38 SYMBOL_LINK "Rte_CalprmRom_CalRegn01CmnGroupA_DEFAULT_RTE_CALPRM_GROUP.DampgQuadHwTqBacklsh_Val" 0 DISPLAY_IDENTIFIER Dampg.CalibrationPorts.DampgQuadHwTqBacklsh.Val /end CHARACTERISTIC
/begin CHARACTERISTIC Dampg.DampgQuadHwTqLpFilFrq.Val "MICROSAR RTE" VALUE 0x0 RTE_RL_FLOAT32_IEEE 0 NO_COMPU_METHOD -3.402823466e+38 3.402823466e+38 SYMBOL_LINK "Rte_CalprmRom_CalRegn01Inin00GroupA_DEFAULT_RTE_CALPRM_GROUP.DampgQuadHwTqLpFilFrq_Val" 0 DISPLAY_IDENTIFIER Dampg.CalibrationPorts.DampgQuadHwTqLpFilFrq.Val /end CHARACTERISTIC
/begin CHARACTERISTIC Dampg.DampgQuadMotVelBacklsh.Val "MICROSAR RTE" VALUE 0x0 RTE_RL_FLOAT32_IEEE 0 NO_COMPU_METHOD -3.402823466e+38 3.402823466e+38 SYMBOL_LINK "Rte_CalprmRom_CalRegn01CmnGroupA_DEFAULT_RTE_CALPRM_GROUP.DampgQuadMotVelBacklsh_Val" 0 DISPLAY_IDENTIFIER Dampg.CalibrationPorts.DampgQuadMotVelBacklsh.Val /end CHARACTERISTIC
/begin CHARACTERISTIC Dampg.DampgQuadMotVelLpFilFrq.Val "MICROSAR RTE" VALUE 0x0 RTE_RL_FLOAT32_IEEE 0 NO_COMPU_METHOD -3.402823466e+38 3.402823466e+38 SYMBOL_LINK "Rte_CalprmRom_CalRegn01Inin00GroupA_DEFAULT_RTE_CALPRM_GROUP.DampgQuadMotVelLpFilFrq_Val" 0 DISPLAY_IDENTIFIER Dampg.CalibrationPorts.DampgQuadMotVelLpFilFrq.Val /end CHARACTERISTIC
/begin CHARACTERISTIC Dampg.DampgQuadScaLpFilFrq.Val "MICROSAR RTE" VALUE 0x0 RTE_RL_FLOAT32_IEEE 0 NO_COMPU_METHOD -3.402823466e+38 3.402823466e+38 SYMBOL_LINK "Rte_CalprmRom_CalRegn01Inin00GroupA_DEFAULT_RTE_CALPRM_GROUP.DampgQuadScaLpFilFrq_Val" 0 DISPLAY_IDENTIFIER Dampg.CalibrationPorts.DampgQuadScaLpFilFrq.Val /end CHARACTERISTIC
/begin CHARACTERISTIC Dampg.DampgTScaX.Ary1D "MICROSAR RTE" VAL_BLK 0x0 RTE_RL_SWORD 0 NO_COMPU_METHOD -32768 32767 MATRIX_DIM 14 1 1 SYMBOL_LINK "Rte_CalprmRom_CalRegn01Inin00GroupA_DEFAULT_RTE_CALPRM_GROUP.DampgTScaX_Ary1D" 0 DISPLAY_IDENTIFIER Dampg.CalibrationPorts.DampgTScaX.Ary1D /end CHARACTERISTIC
/begin CHARACTERISTIC Dampg.DampgTScaY.Ary1D "MICROSAR RTE" VAL_BLK 0x0 RTE_RL_UWORD 0 NO_COMPU_METHOD 0 65535 MATRIX_DIM 14 1 1 SYMBOL_LINK "Rte_CalprmRom_CalRegn01Inin00GroupA_DEFAULT_RTE_CALPRM_GROUP.DampgTScaY_Ary1D" 0 DISPLAY_IDENTIFIER Dampg.CalibrationPorts.DampgTScaY.Ary1D /end CHARACTERISTIC
/begin CHARACTERISTIC Dampg.SysGlbPrmVehSpdBilnrSeln.Ary1D "MICROSAR RTE" VAL_BLK 0x0 RTE_RL_UWORD 0 NO_COMPU_METHOD 0 65535 MATRIX_DIM 12 1 1 SYMBOL_LINK "Rte_CalprmRom_CalRegn01Inin00_DEFAULT_RTE_CALPRM_GROUP.SysGlbPrmVehSpdBilnrSeln_Ary1D" 0 DISPLAY_IDENTIFIER Dampg.CalibrationPorts.SysGlbPrmVehSpdBilnrSeln.Ary1D /end CHARACTERISTIC
/begin CHARACTERISTIC DiagcMgr.DiagcMgrApplCrcDft "MICROSAR RTE" VALUE 0x0 RTE_RL_ULONG 0 NO_COMPU_METHOD 0 4294967295 SYMBOL_LINK "Rte_CalprmRom_DiagcMgr_DEFAULT_RTE_CDATA_GROUP.DiagcMgrApplCrcDft" 0 DISPLAY_IDENTIFIER DiagcMgr.CalibrationParameters.DiagcMgrApplCrcDft /end CHARACTERISTIC
/begin CHARACTERISTIC DiagcMgr.DiagcMgrFltResp.Ary1D "MICROSAR RTE" VAL_BLK 0x0 RTE_RL_UWORD 0 NO_COMPU_METHOD 0 65535 MATRIX_DIM 512 1 1 SYMBOL_LINK "Rte_CalprmRom_CalRegn01Cmn_DEFAULT_RTE_CALPRM_GROUP.DiagcMgrFltResp_Ary1D" 0 DISPLAY_IDENTIFIER DiagcMgr.CalibrationPorts.DiagcMgrFltResp.Ary1D /end CHARACTERISTIC
/begin CHARACTERISTIC DiagcMgrProxyAppl10.DiagcMgrFltResp.Ary1D "MICROSAR RTE" VAL_BLK 0x0 RTE_RL_UWORD 0 NO_COMPU_METHOD 0 65535 MATRIX_DIM 512 1 1 SYMBOL_LINK "Rte_CalprmRom_CalRegn01Cmn_DEFAULT_RTE_CALPRM_GROUP.DiagcMgrFltResp_Ary1D" 0 DISPLAY_IDENTIFIER DiagcMgrProxyAppl10.CalibrationPorts.DiagcMgrFltResp.Ary1D /end CHARACTERISTIC
/begin CHARACTERISTIC DrvrTqEstimn.DrvrTqEstimnMtrxA.Ary2D "MICROSAR RTE" VAL_BLK 0x0 RTE_RL_FLOAT32_IEEE 0 NO_COMPU_METHOD -3.402823466e+38 3.402823466e+38 MATRIX_DIM 5 5 1 SYMBOL_LINK "Rte_CalprmRom_CalRegn01Cmn_DEFAULT_RTE_CALPRM_GROUP.DrvrTqEstimnMtrxA_Ary2D" 0 DISPLAY_IDENTIFIER DrvrTqEstimn.CalibrationPorts.DrvrTqEstimnMtrxA.Ary2D /end CHARACTERISTIC
/begin CHARACTERISTIC DrvrTqEstimn.DrvrTqEstimnMtrxB.Ary2D "MICROSAR RTE" VAL_BLK 0x0 RTE_RL_FLOAT32_IEEE 0 NO_COMPU_METHOD -3.402823466e+38 3.402823466e+38 MATRIX_DIM 4 5 1 SYMBOL_LINK "Rte_CalprmRom_CalRegn01Cmn_DEFAULT_RTE_CALPRM_GROUP.DrvrTqEstimnMtrxB_Ary2D" 0 DISPLAY_IDENTIFIER DrvrTqEstimn.CalibrationPorts.DrvrTqEstimnMtrxB.Ary2D /end CHARACTERISTIC
/begin CHARACTERISTIC DrvrTqEstimn.DrvrTqEstimnMtrxC.Ary1D "MICROSAR RTE" VAL_BLK 0x0 RTE_RL_FLOAT32_IEEE 0 NO_COMPU_METHOD -3.402823466e+38 3.402823466e+38 MATRIX_DIM 5 1 1 SYMBOL_LINK "Rte_CalprmRom_CalRegn01Cmn_DEFAULT_RTE_CALPRM_GROUP.DrvrTqEstimnMtrxC_Ary1D" 0 DISPLAY_IDENTIFIER DrvrTqEstimn.CalibrationPorts.DrvrTqEstimnMtrxC.Ary1D /end CHARACTERISTIC
/begin CHARACTERISTIC DrvrTqEstimn.DrvrTqEstimnMtrxD.Ary1D "MICROSAR RTE" VAL_BLK 0x0 RTE_RL_FLOAT32_IEEE 0 NO_COMPU_METHOD -3.402823466e+38 3.402823466e+38 MATRIX_DIM 4 1 1 SYMBOL_LINK "Rte_CalprmRom_CalRegn01Cmn_DEFAULT_RTE_CALPRM_GROUP.DrvrTqEstimnMtrxD_Ary1D" 0 DISPLAY_IDENTIFIER DrvrTqEstimn.CalibrationPorts.DrvrTqEstimnMtrxD.Ary1D /end CHARACTERISTIC
/begin CHARACTERISTIC DrvrTqEstimn.SysGlbPrmSysKineRat.Val "MICROSAR RTE" VALUE 0x0 RTE_RL_FLOAT32_IEEE 0 NO_COMPU_METHOD -3.402823466e+38 3.402823466e+38 SYMBOL_LINK "Rte_CalprmRom_CalRegn02Inin00_DEFAULT_RTE_CALPRM_GROUP.SysGlbPrmSysKineRat_Val" 0 DISPLAY_IDENTIFIER DrvrTqEstimn.CalibrationPorts.SysGlbPrmSysKineRat.Val /end CHARACTERISTIC
/begin CHARACTERISTIC DrvrTqEstimn.SysGlbPrmSysTqRat.Val "MICROSAR RTE" VALUE 0x0 RTE_RL_FLOAT32_IEEE 0 NO_COMPU_METHOD -3.402823466e+38 3.402823466e+38 SYMBOL_LINK "Rte_CalprmRom_CalRegn01Inin00_DEFAULT_RTE_CALPRM_GROUP.SysGlbPrmSysTqRat_Val" 0 DISPLAY_IDENTIFIER DrvrTqEstimn.CalibrationPorts.SysGlbPrmSysTqRat.Val /end CHARACTERISTIC
/begin CHARACTERISTIC DualCtrlrOutpMgr.DualCtrlrOutpMgrConOutpSca.Val "MICROSAR RTE" VALUE 0x0 RTE_RL_FLOAT32_IEEE 0 NO_COMPU_METHOD -3.402823466e+38 3.402823466e+38 SYMBOL_LINK "Rte_CalprmRom_CalRegn01Inin00_DEFAULT_RTE_CALPRM_GROUP.DualCtrlrOutpMgrConOutpSca_Val" 0 DISPLAY_IDENTIFIER DualCtrlrOutpMgr.CalibrationPorts.DualCtrlrOutpMgrConOutpSca.Val /end CHARACTERISTIC
/begin CHARACTERISTIC DualCtrlrOutpMgr.DualCtrlrOutpMgrDiRateTblY.Ary1D "MICROSAR RTE" VAL_BLK 0x0 RTE_RL_UWORD 0 NO_COMPU_METHOD 0 65535 MATRIX_DIM 10 1 1 SYMBOL_LINK "Rte_CalprmRom_CalRegn01Inin00_DEFAULT_RTE_CALPRM_GROUP.DualCtrlrOutpMgrDiRateTblY_Ary1D" 0 DISPLAY_IDENTIFIER DualCtrlrOutpMgr.CalibrationPorts.DualCtrlrOutpMgrDiRateTblY.Ary1D /end CHARACTERISTIC
/begin CHARACTERISTIC DualCtrlrOutpMgr.DualCtrlrOutpMgrEnaRate.Val "MICROSAR RTE" VALUE 0x0 RTE_RL_FLOAT32_IEEE 0 NO_COMPU_METHOD -3.402823466e+38 3.402823466e+38 SYMBOL_LINK "Rte_CalprmRom_CalRegn01Inin00_DEFAULT_RTE_CALPRM_GROUP.DualCtrlrOutpMgrEnaRate_Val" 0 DISPLAY_IDENTIFIER DualCtrlrOutpMgr.CalibrationPorts.DualCtrlrOutpMgrEnaRate.Val /end CHARACTERISTIC
/begin CHARACTERISTIC DualCtrlrOutpMgr.DualCtrlrOutpMgrFltThdTmr.Val "MICROSAR RTE" VALUE 0x0 RTE_RL_UWORD 0 NO_COMPU_METHOD 0 65535 SYMBOL_LINK "Rte_CalprmRom_CalRegn01Inin00_DEFAULT_RTE_CALPRM_GROUP.DualCtrlrOutpMgrFltThdTmr_Val" 0 DISPLAY_IDENTIFIER DualCtrlrOutpMgr.CalibrationPorts.DualCtrlrOutpMgrFltThdTmr.Val /end CHARACTERISTIC
/begin CHARACTERISTIC DualCtrlrOutpMgr.DualCtrlrOutpMgrLimdOutpSca.Val "MICROSAR RTE" VALUE 0x0 RTE_RL_FLOAT32_IEEE 0 NO_COMPU_METHOD -3.402823466e+38 3.402823466e+38 SYMBOL_LINK "Rte_CalprmRom_CalRegn01Inin00_DEFAULT_RTE_CALPRM_GROUP.DualCtrlrOutpMgrLimdOutpSca_Val" 0 DISPLAY_IDENTIFIER DualCtrlrOutpMgr.CalibrationPorts.DualCtrlrOutpMgrLimdOutpSca.Val /end CHARACTERISTIC
/begin CHARACTERISTIC DualCtrlrOutpMgr.DualCtrlrOutpMgrMaxOutpSca.Val "MICROSAR RTE" VALUE 0x0 RTE_RL_FLOAT32_IEEE 0 NO_COMPU_METHOD -3.402823466e+38 3.402823466e+38 SYMBOL_LINK "Rte_CalprmRom_CalRegn01Inin00_DEFAULT_RTE_CALPRM_GROUP.DualCtrlrOutpMgrMaxOutpSca_Val" 0 DISPLAY_IDENTIFIER DualCtrlrOutpMgr.CalibrationPorts.DualCtrlrOutpMgrMaxOutpSca.Val /end CHARACTERISTIC
/begin CHARACTERISTIC DualCtrlrOutpMgr.DualCtrlrOutpMgrMaxOutpTmr.Val "MICROSAR RTE" VALUE 0x0 RTE_RL_UWORD 0 NO_COMPU_METHOD 0 65535 SYMBOL_LINK "Rte_CalprmRom_CalRegn01Inin00_DEFAULT_RTE_CALPRM_GROUP.DualCtrlrOutpMgrMaxOutpTmr_Val" 0 DISPLAY_IDENTIFIER DualCtrlrOutpMgr.CalibrationPorts.DualCtrlrOutpMgrMaxOutpTmr.Val /end CHARACTERISTIC
/begin CHARACTERISTIC DualCtrlrOutpMgr.DualCtrlrOutpMgrMinOutpTmr.Val "MICROSAR RTE" VALUE 0x0 RTE_RL_UWORD 0 NO_COMPU_METHOD 0 65535 SYMBOL_LINK "Rte_CalprmRom_CalRegn01Inin00_DEFAULT_RTE_CALPRM_GROUP.DualCtrlrOutpMgrMinOutpTmr_Val" 0 DISPLAY_IDENTIFIER DualCtrlrOutpMgr.CalibrationPorts.DualCtrlrOutpMgrMinOutpTmr.Val /end CHARACTERISTIC
/begin CHARACTERISTIC DualCtrlrOutpMgr.DualCtrlrOutpMgrNonRecFltThdTmr.Val "MICROSAR RTE" VALUE 0x0 RTE_RL_UWORD 0 NO_COMPU_METHOD 0 65535 SYMBOL_LINK "Rte_CalprmRom_CalRegn01Inin00_DEFAULT_RTE_CALPRM_GROUP.DualCtrlrOutpMgrNonRecFltThdTmr_Val" 0 DISPLAY_IDENTIFIER DualCtrlrOutpMgr.CalibrationPorts.DualCtrlrOutpMgrNonRecFltThdTmr.Val /end CHARACTERISTIC
/begin CHARACTERISTIC DualCtrlrOutpMgr.DualCtrlrOutpMgrThdTmr.Val "MICROSAR RTE" VALUE 0x0 RTE_RL_UWORD 0 NO_COMPU_METHOD 0 65535 SYMBOL_LINK "Rte_CalprmRom_CalRegn01Inin00_DEFAULT_RTE_CALPRM_GROUP.DualCtrlrOutpMgrThdTmr_Val" 0 DISPLAY_IDENTIFIER DualCtrlrOutpMgr.CalibrationPorts.DualCtrlrOutpMgrThdTmr.Val /end CHARACTERISTIC
/begin CHARACTERISTIC DualCtrlrOutpMgr.DualCtrlrOutpMgrVehSpdRefTblX.Ary1D "MICROSAR RTE" VAL_BLK 0x0 RTE_RL_UWORD 0 NO_COMPU_METHOD 0 65535 MATRIX_DIM 10 1 1 SYMBOL_LINK "Rte_CalprmRom_CalRegn01Inin00_DEFAULT_RTE_CALPRM_GROUP.DualCtrlrOutpMgrVehSpdRefTblX_Ary1D" 0 DISPLAY_IDENTIFIER DualCtrlrOutpMgr.CalibrationPorts.DualCtrlrOutpMgrVehSpdRefTblX.Ary1D /end CHARACTERISTIC
/begin CHARACTERISTIC DualCtrlrOutpMgr.DualCtrlrOutpMgrVltgModFltThdTmr.Val "MICROSAR RTE" VALUE 0x0 RTE_RL_UWORD 0 NO_COMPU_METHOD 0 65535 SYMBOL_LINK "Rte_CalprmRom_CalRegn01Inin00_DEFAULT_RTE_CALPRM_GROUP.DualCtrlrOutpMgrVltgModFltThdTmr_Val" 0 DISPLAY_IDENTIFIER DualCtrlrOutpMgr.CalibrationPorts.DualCtrlrOutpMgrVltgModFltThdTmr.Val /end CHARACTERISTIC
/begin MEASUREMENT CustDiag.DidEE00 "MICROSAR RTE" UBYTE NO_COMPU_METHOD 0 0 0 255 MATRIX_DIM 3 1 1 ECU_ADDRESS 0 SYMBOL_LINK "Rte_CustDiag_DidEE00" 0 DISPLAY_IDENTIFIER CustDiag.PerInstanceMemories.DidEE00 /end MEASUREMENT
/begin MEASUREMENT CustDiag.DidEE01 "MICROSAR RTE" UBYTE NO_COMPU_METHOD 0 0 0 255 ECU_ADDRESS 0 SYMBOL_LINK "Rte_CustDiag_DidEE01" 0 DISPLAY_IDENTIFIER CustDiag.PerInstanceMemories.DidEE01 /end MEASUREMENT
/begin MEASUREMENT CustDiag.DidEE02 "MICROSAR RTE" UBYTE NO_COMPU_METHOD 0 0 0 255 ECU_ADDRESS 0 SYMBOL_LINK "Rte_CustDiag_DidEE02" 0 DISPLAY_IDENTIFIER CustDiag.PerInstanceMemories.DidEE02 /end MEASUREMENT
/begin MEASUREMENT CustDiag.DidEE21 "MICROSAR RTE" UBYTE NO_COMPU_METHOD 0 0 0 255 MATRIX_DIM 20 1 1 ECU_ADDRESS 0 SYMBOL_LINK "Rte_CustDiag_DidEE21" 0 DISPLAY_IDENTIFIER CustDiag.PerInstanceMemories.DidEE21 /end MEASUREMENT
/begin MEASUREMENT CustDiag.DidEE22 "MICROSAR RTE" UBYTE NO_COMPU_METHOD 0 0 0 255 MATRIX_DIM 40 1 1 ECU_ADDRESS 0 SYMBOL_LINK "Rte_CustDiag_DidEE22" 0 DISPLAY_IDENTIFIER CustDiag.PerInstanceMemories.DidEE22 /end MEASUREMENT
/begin MEASUREMENT CustDiag.DidEE23 "MICROSAR RTE" UBYTE NO_COMPU_METHOD 0 0 0 255 MATRIX_DIM 40 1 1 ECU_ADDRESS 0 SYMBOL_LINK "Rte_CustDiag_DidEE23" 0 DISPLAY_IDENTIFIER CustDiag.PerInstanceMemories.DidEE23 /end MEASUREMENT
/begin MEASUREMENT CustDiag.DidEE40 "MICROSAR RTE" UBYTE NO_COMPU_METHOD 0 0 0 255 MATRIX_DIM 3 1 1 ECU_ADDRESS 0 SYMBOL_LINK "Rte_CustDiag_DidEE40" 0 DISPLAY_IDENTIFIER CustDiag.PerInstanceMemories.DidEE40 /end MEASUREMENT
/begin MEASUREMENT CustDiag.DidEE41 "MICROSAR RTE" UBYTE NO_COMPU_METHOD 0 0 0 255 ECU_ADDRESS 0 SYMBOL_LINK "Rte_CustDiag_DidEE41" 0 DISPLAY_IDENTIFIER CustDiag.PerInstanceMemories.DidEE41 /end MEASUREMENT
/begin MEASUREMENT CustDiag.DidEE81 "MICROSAR RTE" UBYTE NO_COMPU_METHOD 0 0 0 255 MATRIX_DIM 4 1 1 ECU_ADDRESS 0 SYMBOL_LINK "Rte_CustDiag_DidEE81" 0 DISPLAY_IDENTIFIER CustDiag.PerInstanceMemories.DidEE81 /end MEASUREMENT
/begin MEASUREMENT CustDiag.DidEE82 "MICROSAR RTE" UBYTE NO_COMPU_METHOD 0 0 0 255 MATRIX_DIM 4 1 1 ECU_ADDRESS 0 SYMBOL_LINK "Rte_CustDiag_DidEE82" 0 DISPLAY_IDENTIFIER CustDiag.PerInstanceMemories.DidEE82 /end MEASUREMENT
/begin MEASUREMENT CustDiag.DidEE83 "MICROSAR RTE" UBYTE NO_COMPU_METHOD 0 0 0 255 MATRIX_DIM 4 1 1 ECU_ADDRESS 0 SYMBOL_LINK "Rte_CustDiag_DidEE83" 0 DISPLAY_IDENTIFIER CustDiag.PerInstanceMemories.DidEE83 /end MEASUREMENT
/begin MEASUREMENT CustDiag.DidEE84 "MICROSAR RTE" UBYTE NO_COMPU_METHOD 0 0 0 255 MATRIX_DIM 4 1 1 ECU_ADDRESS 0 SYMBOL_LINK "Rte_CustDiag_DidEE84" 0 DISPLAY_IDENTIFIER CustDiag.PerInstanceMemories.DidEE84 /end MEASUREMENT
/begin MEASUREMENT CustDiag.DidEE85 "MICROSAR RTE" UBYTE NO_COMPU_METHOD 0 0 0 255 MATRIX_DIM 4 1 1 ECU_ADDRESS 0 SYMBOL_LINK "Rte_CustDiag_DidEE85" 0 DISPLAY_IDENTIFIER CustDiag.PerInstanceMemories.DidEE85 /end MEASUREMENT
/begin MEASUREMENT CustDiag.DidEE86 "MICROSAR RTE" UBYTE NO_COMPU_METHOD 0 0 0 255 MATRIX_DIM 4 1 1 ECU_ADDRESS 0 SYMBOL_LINK "Rte_CustDiag_DidEE86" 0 DISPLAY_IDENTIFIER CustDiag.PerInstanceMemories.DidEE86 /end MEASUREMENT
/begin MEASUREMENT CustDiag.DidEE87 "MICROSAR RTE" UBYTE NO_COMPU_METHOD 0 0 0 255 MATRIX_DIM 4 1 1 ECU_ADDRESS 0 SYMBOL_LINK "Rte_CustDiag_DidEE87" 0 DISPLAY_IDENTIFIER CustDiag.PerInstanceMemories.DidEE87 /end MEASUREMENT
/begin MEASUREMENT CustDiag.DidEE88 "MICROSAR RTE" UBYTE NO_COMPU_METHOD 0 0 0 255 MATRIX_DIM 4 1 1 ECU_ADDRESS 0 SYMBOL_LINK "Rte_CustDiag_DidEE88" 0 DISPLAY_IDENTIFIER CustDiag.PerInstanceMemories.DidEE88 /end MEASUREMENT
/begin MEASUREMENT CustDiag.DidEED0 "MICROSAR RTE" UBYTE NO_COMPU_METHOD 0 0 0 255 ECU_ADDRESS 0 SYMBOL_LINK "Rte_CustDiag_DidEED0" 0 DISPLAY_IDENTIFIER CustDiag.PerInstanceMemories.DidEED0 /end MEASUREMENT
/begin MEASUREMENT CustDiag.DidF110 "MICROSAR RTE" UBYTE NO_COMPU_METHOD 0 0 0 255 MATRIX_DIM 24 1 1 ECU_ADDRESS 0 SYMBOL_LINK "Rte_CustDiag_DidF110" 0 DISPLAY_IDENTIFIER CustDiag.PerInstanceMemories.DidF110 /end MEASUREMENT
/begin MEASUREMENT CustDiag.DidF111 "MICROSAR RTE" UBYTE NO_COMPU_METHOD 0 0 0 255 MATRIX_DIM 24 1 1 ECU_ADDRESS 0 SYMBOL_LINK "Rte_CustDiag_DidF111" 0 DISPLAY_IDENTIFIER CustDiag.PerInstanceMemories.DidF111 /end MEASUREMENT
/begin MEASUREMENT CustDiag.DidF113 "MICROSAR RTE" UBYTE NO_COMPU_METHOD 0 0 0 255 MATRIX_DIM 24 1 1 ECU_ADDRESS 0 SYMBOL_LINK "Rte_CustDiag_DidF113" 0 DISPLAY_IDENTIFIER CustDiag.PerInstanceMemories.DidF113 /end MEASUREMENT
/begin MEASUREMENT CustDiag.DidF15F "MICROSAR RTE" UBYTE NO_COMPU_METHOD 0 0 0 255 MATRIX_DIM 10 1 1 ECU_ADDRESS 0 SYMBOL_LINK "Rte_CustDiag_DidF15F" 0 DISPLAY_IDENTIFIER CustDiag.PerInstanceMemories.DidF15F /end MEASUREMENT
/begin MEASUREMENT CustDiag.DidF162 "MICROSAR RTE" UBYTE NO_COMPU_METHOD 0 0 0 255 ECU_ADDRESS 0 SYMBOL_LINK "Rte_CustDiag_DidF162" 0 DISPLAY_IDENTIFIER CustDiag.PerInstanceMemories.DidF162 /end MEASUREMENT
/begin MEASUREMENT CustDiag.DidF163 "MICROSAR RTE" UBYTE NO_COMPU_METHOD 0 0 0 255 ECU_ADDRESS 0 SYMBOL_LINK "Rte_CustDiag_DidF163" 0 DISPLAY_IDENTIFIER CustDiag.PerInstanceMemories.DidF163 /end MEASUREMENT
/begin MEASUREMENT CustDiag.DidF166 "MICROSAR RTE" UBYTE NO_COMPU_METHOD 0 0 0 255 MATRIX_DIM 4 1 1 ECU_ADDRESS 0 SYMBOL_LINK "Rte_CustDiag_DidF166" 0 DISPLAY_IDENTIFIER CustDiag.PerInstanceMemories.DidF166 /end MEASUREMENT
/begin MEASUREMENT CustDiag.DidF18A "MICROSAR RTE" UBYTE NO_COMPU_METHOD 0 0 0 255 MATRIX_DIM 24 1 1 ECU_ADDRESS 0 SYMBOL_LINK "Rte_CustDiag_DidF18A" 0 DISPLAY_IDENTIFIER CustDiag.PerInstanceMemories.DidF18A /end MEASUREMENT
/begin MEASUREMENT CustDiag.DidF18C "MICROSAR RTE" UBYTE NO_COMPU_METHOD 0 0 0 255 MATRIX_DIM 16 1 1 ECU_ADDRESS 0 SYMBOL_LINK "Rte_CustDiag_DidF18C" 0 DISPLAY_IDENTIFIER CustDiag.PerInstanceMemories.DidF18C /end MEASUREMENT
/begin MEASUREMENT CustDiag.DidF190 "MICROSAR RTE" UBYTE NO_COMPU_METHOD 0 0 0 255 MATRIX_DIM 24 1 1 ECU_ADDRESS 0 SYMBOL_LINK "Rte_CustDiag_DidF190" 0 DISPLAY_IDENTIFIER CustDiag.PerInstanceMemories.DidF190 /end MEASUREMENT
/begin MEASUREMENT CustDiag.EcuId "MICROSAR RTE" UBYTE NO_COMPU_METHOD 0 0 0 255 ECU_ADDRESS 0 SYMBOL_LINK "Rte_CustDiag_EcuId" 0 DISPLAY_IDENTIFIER CustDiag.PerInstanceMemories.EcuId /end MEASUREMENT
/begin MEASUREMENT CustDiag.EcuId.Val "MICROSAR RTE" UBYTE NO_COMPU_METHOD 0 0 0 255 ECU_ADDRESS 0 SYMBOL_LINK "Rte_DualEcuIdn_EcuId_Val" 0 DISPLAY_IDENTIFIER CustDiag.ReceiverPorts.EcuId.Val /end MEASUREMENT
/begin MEASUREMENT CustDiag.EcuResetMode "MICROSAR RTE" UBYTE RTE_CM_ENUM_BswM_BswMEcuResetMod 0 0 0 255 ECU_ADDRESS 0 SYMBOL_LINK "Rte_CustDiag_EcuResetMode" 0 DISPLAY_IDENTIFIER CustDiag.PerInstanceMemories.EcuResetMode /end MEASUREMENT
/begin MEASUREMENT CustDiag.EcuTFild.Val "MICROSAR RTE" FLOAT32_IEEE NO_COMPU_METHOD 0 0 -3.402823466e+38 3.402823466e+38 ECU_ADDRESS 0 SYMBOL_LINK "Rte_EcuTMeas_EcuTFild_Val" 0 DISPLAY_IDENTIFIER CustDiag.ReceiverPorts.EcuTFild.Val /end MEASUREMENT
/begin MEASUREMENT CustDiag.EolByteNTCPara "MICROSAR RTE" UBYTE NO_COMPU_METHOD 0 0 0 255 ECU_ADDRESS 0 SYMBOL_LINK "Rte_CustDiag_EolByteNTCPara" 0 DISPLAY_IDENTIFIER CustDiag.PerInstanceMemories.EolByteNTCPara /end MEASUREMENT
/begin MEASUREMENT CustDiag.FordAbsPrsnt.Logl "MICROSAR RTE" UBYTE RTE_CM_BOOLEAN 0 0 0 255 ECU_ADDRESS 0 SYMBOL_LINK "Rte_CustDiag_FordAbsPrsnt_Logl" 0 DISPLAY_IDENTIFIER CustDiag.SenderPorts.FordAbsPrsnt.Logl /end MEASUREMENT
/begin MEASUREMENT CustDiag.FordActvNiblCtrlEnad.Logl "MICROSAR RTE" UBYTE RTE_CM_BOOLEAN 0 0 0 255 ECU_ADDRESS 0 SYMBOL_LINK "Rte_CustDiag_FordActvNiblCtrlEnad_Logl" 0 DISPLAY_IDENTIFIER CustDiag.SenderPorts.FordActvNiblCtrlEnad.Logl /end MEASUREMENT
/begin MEASUREMENT CustDiag.FordActvParkAssiEnad.Logl "MICROSAR RTE" UBYTE RTE_CM_BOOLEAN 0 0 0 255 ECU_ADDRESS 0 SYMBOL_LINK "Rte_CustDiag_FordActvParkAssiEnad_Logl" 0 DISPLAY_IDENTIFIER CustDiag.SenderPorts.FordActvParkAssiEnad.Logl /end MEASUREMENT
/begin MEASUREMENT CustDiag.FordActvRtnEnad.Logl "MICROSAR RTE" UBYTE RTE_CM_BOOLEAN 0 0 0 255 ECU_ADDRESS 0 SYMBOL_LINK "Rte_CustDiag_FordActvRtnEnad_Logl" 0 DISPLAY_IDENTIFIER CustDiag.SenderPorts.FordActvRtnEnad.Logl /end MEASUREMENT
/begin MEASUREMENT CustDiag.FordAfsEquid.Logl "MICROSAR RTE" UBYTE RTE_CM_BOOLEAN 0 0 0 255 ECU_ADDRESS 0 SYMBOL_LINK "Rte_CustDiag_FordAfsEquid_Logl" 0 DISPLAY_IDENTIFIER CustDiag.SenderPorts.FordAfsEquid.Logl /end MEASUREMENT
/begin MEASUREMENT CustDiag.FordAppldFinalMotTq.Val "MICROSAR RTE" SLONG NO_COMPU_METHOD 0 0 -2147483648 2147483647 ECU_ADDRESS 0 SYMBOL_LINK "Rte_FordHwTqCdng_FordAppldFinalMotTq_Val" 0 DISPLAY_IDENTIFIER CustDiag.ReceiverPorts.FordAppldFinalMotTq.Val /end MEASUREMENT
/begin MEASUREMENT CustDiag.FordBrkPlsRejctnEnad.Logl "MICROSAR RTE" UBYTE RTE_CM_BOOLEAN 0 0 0 255 ECU_ADDRESS 0 SYMBOL_LINK "Rte_CustDiag_FordBrkPlsRejctnEnad_Logl" 0 DISPLAY_IDENTIFIER CustDiag.SenderPorts.FordBrkPlsRejctnEnad.Logl /end MEASUREMENT
/begin MEASUREMENT CustDiag.FordCmpdHwPosn.Val "MICROSAR RTE" FLOAT32_IEEE NO_COMPU_METHOD 0 0 -3.402823466e+38 3.402823466e+38 ECU_ADDRESS 0 SYMBOL_LINK "Rte_FordHwAgArbn_FordCmpdHwPosntoSerlCom_Val" 0 DISPLAY_IDENTIFIER CustDiag.ReceiverPorts.FordCmpdHwPosn.Val /end MEASUREMENT
/begin MEASUREMENT CustDiag.FordDrvrSteerRcmdnEnad.Logl "MICROSAR RTE" UBYTE RTE_CM_BOOLEAN 0 0 0 255 ECU_ADDRESS 0 SYMBOL_LINK "Rte_CustDiag_FordDrvrSteerRcmdnEnad_Logl" 0 DISPLAY_IDENTIFIER CustDiag.SenderPorts.FordDrvrSteerRcmdnEnad.Logl /end MEASUREMENT
/begin MEASUREMENT CustDiag.FordEngTqClass.Val "MICROSAR RTE" UBYTE NO_COMPU_METHOD 0 0 0 255 ECU_ADDRESS 0 SYMBOL_LINK "Rte_CustDiag_FordEngTqClass_Val" 0 DISPLAY_IDENTIFIER CustDiag.SenderPorts.FordEngTqClass.Val /end MEASUREMENT
/begin MEASUREMENT CustDiag.FordEpsCurr.Val "MICROSAR RTE" FLOAT32_IEEE NO_COMPU_METHOD 0 0 -3.402823466e+38 3.402823466e+38 ECU_ADDRESS 0 SYMBOL_LINK "Rte_FordVltgIf_FordEpsCurr_Val" 0 DISPLAY_IDENTIFIER CustDiag.ReceiverPorts.FordEpsCurr.Val /end MEASUREMENT
/begin MEASUREMENT CustDiag.FordEpsLifeCycMod.Val "MICROSAR RTE" UBYTE NO_COMPU_METHOD 0 0 0 255 ECU_ADDRESS 0 SYMBOL_LINK "Rte_FordCanDtcInhb_FordEpsLifeCycMod_Val" 0 DISPLAY_IDENTIFIER CustDiag.ReceiverPorts.FordEpsLifeCycMod.Val /end MEASUREMENT
/begin MEASUREMENT CustDiag.FordEpsSysSt.Val "MICROSAR RTE" UBYTE RTE_CM_ENUM_FordEpsSysSt1 0 0 0 255 ECU_ADDRESS 0 SYMBOL_LINK "Rte_FordSysSt_FordEpsSysSt_Val" 0 DISPLAY_IDENTIFIER CustDiag.ReceiverPorts.FordEpsSysSt.Val /end MEASUREMENT
/begin MEASUREMENT CustDiag.FordEpsVltg.Val "MICROSAR RTE" FLOAT32_IEEE NO_COMPU_METHOD 0 0 -3.402823466e+38 3.402823466e+38 ECU_ADDRESS 0 SYMBOL_LINK "Rte_FordVltgIf_FordEpsVltg_Val" 0 DISPLAY_IDENTIFIER CustDiag.ReceiverPorts.FordEpsVltg.Val /end MEASUREMENT
/begin MEASUREMENT CustDiag.FordEscPrsnt.Logl "MICROSAR RTE" UBYTE RTE_CM_BOOLEAN 0 0 0 255 ECU_ADDRESS 0 SYMBOL_LINK "Rte_CustDiag_FordEscPrsnt_Logl" 0 DISPLAY_IDENTIFIER CustDiag.SenderPorts.FordEscPrsnt.Logl /end MEASUREMENT
/begin MEASUREMENT CustDiag.FordEvasSteerAssiEnad.Logl "MICROSAR RTE" UBYTE RTE_CM_BOOLEAN 0 0 0 255 ECU_ADDRESS 0 SYMBOL_LINK "Rte_CustDiag_FordEvasSteerAssiEnad_Logl" 0 DISPLAY_IDENTIFIER CustDiag.SenderPorts.FordEvasSteerAssiEnad.Logl /end MEASUREMENT
/begin MEASUREMENT CustDiag.FordInpTqRaw.Val "MICROSAR RTE" SWORD NO_COMPU_METHOD 0 0 -32768 32767 ECU_ADDRESS 0 SYMBOL_LINK "Rte_FordHwTqCdng_FordInpTqRaw_Val" 0 DISPLAY_IDENTIFIER CustDiag.ReceiverPorts.FordInpTqRaw.Val /end MEASUREMENT
/begin MEASUREMENT CustDiag.FordLaneCentrAssiEnad.Logl "MICROSAR RTE" UBYTE RTE_CM_BOOLEAN 0 0 0 255 ECU_ADDRESS 0 SYMBOL_LINK "Rte_CustDiag_FordLaneCentrAssiEnad_Logl" 0 DISPLAY_IDENTIFIER CustDiag.SenderPorts.FordLaneCentrAssiEnad.Logl /end MEASUREMENT
/begin MEASUREMENT CustDiag.FordLaneDprtrWarnEnad.Logl "MICROSAR RTE" UBYTE RTE_CM_BOOLEAN 0 0 0 255 ECU_ADDRESS 0 SYMBOL_LINK "Rte_CustDiag_FordLaneDprtrWarnEnad_Logl" 0 DISPLAY_IDENTIFIER CustDiag.SenderPorts.FordLaneDprtrWarnEnad.Logl /end MEASUREMENT
/begin MEASUREMENT CustDiag.FordLaneKeepAssiEnad.Logl "MICROSAR RTE" UBYTE RTE_CM_BOOLEAN 0 0 0 255 ECU_ADDRESS 0 SYMBOL_LINK "Rte_CustDiag_FordLaneKeepAssiEnad_Logl" 0 DISPLAY_IDENTIFIER CustDiag.SenderPorts.FordLaneKeepAssiEnad.Logl /end MEASUREMENT
/begin MEASUREMENT CustDiag.FordMaxBattCurr.Val "MICROSAR RTE" FLOAT32_IEEE NO_COMPU_METHOD 0 0 -3.402823466e+38 3.402823466e+38 ECU_ADDRESS 0 SYMBOL_LINK "Rte_FordVltgIf_FordMaxBattCurr_Val" 0 DISPLAY_IDENTIFIER CustDiag.ReceiverPorts.FordMaxBattCurr.Val /end MEASUREMENT
/begin MEASUREMENT CustDiag.FordMinBattVltg.Val "MICROSAR RTE" FLOAT32_IEEE NO_COMPU_METHOD 0 0 -3.402823466e+38 3.402823466e+38 ECU_ADDRESS 0 SYMBOL_LINK "Rte_FordVltgIf_FordMinBattVltg_Val" 0 DISPLAY_IDENTIFIER CustDiag.ReceiverPorts.FordMinBattVltg.Val /end MEASUREMENT
/begin MEASUREMENT CustDiag.FordPullDriftCmpEnad.Logl "MICROSAR RTE" UBYTE RTE_CM_BOOLEAN 0 0 0 255 ECU_ADDRESS 0 SYMBOL_LINK "Rte_CustDiag_FordPullDriftCmpEnad_Logl" 0 DISPLAY_IDENTIFIER CustDiag.SenderPorts.FordPullDriftCmpEnad.Logl /end MEASUREMENT
/begin MEASUREMENT CustDiag.FordResrchFctEnad.Logl "MICROSAR RTE" UBYTE RTE_CM_BOOLEAN 0 0 0 255 ECU_ADDRESS 0 SYMBOL_LINK "Rte_CustDiag_FordResrchFctEnad_Logl" 0 DISPLAY_IDENTIFIER CustDiag.SenderPorts.FordResrchFctEnad.Logl /end MEASUREMENT
/begin MEASUREMENT CustDiag.FordSelDrvModEnad.Logl "MICROSAR RTE" UBYTE RTE_CM_BOOLEAN 0 0 0 255 ECU_ADDRESS 0 SYMBOL_LINK "Rte_CustDiag_FordSelDrvModEnad_Logl" 0 DISPLAY_IDENTIFIER CustDiag.SenderPorts.FordSelDrvModEnad.Logl /end MEASUREMENT
/begin MEASUREMENT CustDiag.FordSoftEndStopEnad.Logl "MICROSAR RTE" UBYTE RTE_CM_BOOLEAN 0 0 0 255 ECU_ADDRESS 0 SYMBOL_LINK "Rte_CustDiag_FordSoftEndStopEnad_Logl" 0 DISPLAY_IDENTIFIER CustDiag.SenderPorts.FordSoftEndStopEnad.Logl /end MEASUREMENT
/begin MEASUREMENT CustDiag.FordSrvPullDriftCmpRstVal.Val "MICROSAR RTE" SWORD NO_COMPU_METHOD 0 0 -32768 32767 ECU_ADDRESS 0 SYMBOL_LINK "Rte_CustDiag_FordSrvPullDriftCmpRstVal_Val" 0 DISPLAY_IDENTIFIER CustDiag.SenderPorts.FordSrvPullDriftCmpRstVal.Val /end MEASUREMENT
/begin MEASUREMENT CustDiag.FordStrtStopSt.Val "MICROSAR RTE" UBYTE NO_COMPU_METHOD 0 0 0 255 ECU_ADDRESS 0 SYMBOL_LINK "Rte_CustDiag_FordStrtStopSt_Val" 0 DISPLAY_IDENTIFIER CustDiag.SenderPorts.FordStrtStopSt.Val /end MEASUREMENT
/begin MEASUREMENT CustDiag.FordTqSteerCmpEnad.Logl "MICROSAR RTE" UBYTE RTE_CM_BOOLEAN 0 0 0 255 ECU_ADDRESS 0 SYMBOL_LINK "Rte_CustDiag_FordTqSteerCmpEnad_Logl" 0 DISPLAY_IDENTIFIER CustDiag.SenderPorts.FordTqSteerCmpEnad.Logl /end MEASUREMENT
/begin MEASUREMENT CustDiag.FordTrfcJamAssiEnad.Logl "MICROSAR RTE" UBYTE RTE_CM_BOOLEAN 0 0 0 255 ECU_ADDRESS 0 SYMBOL_LINK "Rte_CustDiag_FordTrfcJamAssiEnad_Logl" 0 DISPLAY_IDENTIFIER CustDiag.SenderPorts.FordTrfcJamAssiEnad.Logl /end MEASUREMENT
/begin MEASUREMENT CustDiag.FordTrlrBackupAssi5WhlEnad.Logl "MICROSAR RTE" UBYTE RTE_CM_BOOLEAN 0 0 0 255 ECU_ADDRESS 0 SYMBOL_LINK "Rte_CustDiag_FordTrlrBackupAssi5WhlEnad_Logl" 0 DISPLAY_IDENTIFIER CustDiag.SenderPorts.FordTrlrBackupAssi5WhlEnad.Logl /end MEASUREMENT
/begin MEASUREMENT CustDiag.FordTrlrBackupAssiEnad.Logl "MICROSAR RTE" UBYTE RTE_CM_BOOLEAN 0 0 0 255 ECU_ADDRESS 0 SYMBOL_LINK "Rte_CustDiag_FordTrlrBackupAssiEnad_Logl" 0 DISPLAY_IDENTIFIER CustDiag.SenderPorts.FordTrlrBackupAssiEnad.Logl /end MEASUREMENT
/begin MEASUREMENT CustDiag.FordTrlrBackupAssiTrigEnad.Logl "MICROSAR RTE" UBYTE RTE_CM_BOOLEAN 0 0 0 255 ECU_ADDRESS 0 SYMBOL_LINK "Rte_CustDiag_FordTrlrBackupAssiTrigEnad_Logl" 0 DISPLAY_IDENTIFIER CustDiag.SenderPorts.FordTrlrBackupAssiTrigEnad.Logl /end MEASUREMENT
/begin MEASUREMENT CustDiag.FordVehGlbRealTi.Val "MICROSAR RTE" FLOAT32_IEEE NO_COMPU_METHOD 0 0 -3.402823466e+38 3.402823466e+38 ECU_ADDRESS 0 SYMBOL_LINK "Rte_FordMsg40ABusHiSpd_FordVehGlbRealTi_Val" 0 DISPLAY_IDENTIFIER CustDiag.ReceiverPorts.FordVehGlbRealTi.Val /end MEASUREMENT
/begin MEASUREMENT CustDiag.FordVehIdnNr.Ary1D "MICROSAR RTE" UBYTE NO_COMPU_METHOD 0 0 0 255 MATRIX_DIM 17 1 1 ECU_ADDRESS 0 SYMBOL_LINK "Rte_FordMsg40ABusHiSpd_FordVehIdnNr_Ary1D" 0 DISPLAY_IDENTIFIER CustDiag.ReceiverPorts.FordVehIdnNr.Ary1D /end MEASUREMENT
/begin MEASUREMENT CustDiag.FordVehOdom.Val "MICROSAR RTE" FLOAT32_IEEE NO_COMPU_METHOD 0 0 -3.402823466e+38 3.402823466e+38 ECU_ADDRESS 0 SYMBOL_LINK "Rte_FordMsg430BusHiSpd_FordVehOdom_Val" 0 DISPLAY_IDENTIFIER CustDiag.ReceiverPorts.FordVehOdom.Val /end MEASUREMENT
/begin MEASUREMENT CustDiag.FordVehSpdLoQly.Val "MICROSAR RTE" FLOAT32_IEEE NO_COMPU_METHOD 0 0 -3.402823466e+38 3.402823466e+38 ECU_ADDRESS 0 SYMBOL_LINK "Rte_FordVehSpdArbn_FordVehSpdLoQly_Val" 0 DISPLAY_IDENTIFIER CustDiag.ReceiverPorts.FordVehSpdLoQly.Val /end MEASUREMENT
/begin MEASUREMENT CustDiag.FordVehSpdLoQlyVld.Logl "MICROSAR RTE" UBYTE RTE_CM_BOOLEAN 0 0 0 255 ECU_ADDRESS 0 SYMBOL_LINK "Rte_FordVehSpdArbn_FordVehSpdLoQlyVld_Logl" 0 DISPLAY_IDENTIFIER CustDiag.ReceiverPorts.FordVehSpdLoQlyVld.Logl /end MEASUREMENT
/begin MEASUREMENT CustDiag.FordVehSteerPinionAgOffs.Val "MICROSAR RTE" FLOAT32_IEEE NO_COMPU_METHOD 0 0 -3.402823466e+38 3.402823466e+38 ECU_ADDRESS 0 SYMBOL_LINK "Rte_FordMsg414BusHiSpd_FordVehSteerPinionAgOffs_Val" 0 DISPLAY_IDENTIFIER CustDiag.ReceiverPorts.FordVehSteerPinionAgOffs.Val /end MEASUREMENT
/begin MEASUREMENT CustDiag.HwVelToSerlCom.Val "MICROSAR RTE" FLOAT32_IEEE NO_COMPU_METHOD 0 0 -3.402823466e+38 3.402823466e+38 ECU_ADDRESS 0 SYMBOL_LINK "Rte_HwAgSysArbn_HwVelToSerlCom_Val" 0 DISPLAY_IDENTIFIER CustDiag.ReceiverPorts.HwVelToSerlCom.Val /end MEASUREMENT
/begin MEASUREMENT CustDiag.IgnCntr.Val "MICROSAR RTE" ULONG NO_COMPU_METHOD 0 0 0 4294967295 ECU_ADDRESS 0 SYMBOL_LINK "Rte_CmnMfgSrv_IgnCntr_Val" 0 DISPLAY_IDENTIFIER CustDiag.ReceiverPorts.IgnCntr.Val /end MEASUREMENT
/begin MEASUREMENT CustDiag.MaxCurr "MICROSAR RTE" FLOAT32_IEEE NO_COMPU_METHOD 0 0 -3.402823466e+38 3.402823466e+38 ECU_ADDRESS 0 SYMBOL_LINK "Rte_CustDiag_MaxCurr" 0 DISPLAY_IDENTIFIER CustDiag.PerInstanceMemories.MaxCurr /end MEASUREMENT
/begin MEASUREMENT CustDiag.MaxTemp "MICROSAR RTE" FLOAT32_IEEE NO_COMPU_METHOD 0 0 -3.402823466e+38 3.402823466e+38 ECU_ADDRESS 0 SYMBOL_LINK "Rte_CustDiag_MaxTemp" 0 DISPLAY_IDENTIFIER CustDiag.PerInstanceMemories.MaxTemp /end MEASUREMENT
/begin MEASUREMENT CustDiag.MinVltg "MICROSAR RTE" FLOAT32_IEEE NO_COMPU_METHOD 0 0 -3.402823466e+38 3.402823466e+38 ECU_ADDRESS 0 SYMBOL_LINK "Rte_CustDiag_MinVltg" 0 DISPLAY_IDENTIFIER CustDiag.PerInstanceMemories.MinVltg /end MEASUREMENT
/begin MEASUREMENT CustDiag.MotCurrQax.Val "MICROSAR RTE" FLOAT32_IEEE NO_COMPU_METHOD 0 0 -3.402823466e+38 3.402823466e+38 ECU_ADDRESS 0 SYMBOL_LINK "Rte_CDD_MotCtrlMgr_MotCurrQax_Val" 0 DISPLAY_IDENTIFIER CustDiag.ReceiverPorts.MotCurrQax.Val /end MEASUREMENT
/begin MEASUREMENT CustDiag.ReqDelayCnt "MICROSAR RTE" UBYTE NO_COMPU_METHOD 0 0 0 255 ECU_ADDRESS 0 SYMBOL_LINK "Rte_CustDiag_ReqDelayCnt" 0 DISPLAY_IDENTIFIER CustDiag.PerInstanceMemories.ReqDelayCnt /end MEASUREMENT
/begin MEASUREMENT CustDiag.RstReq "MICROSAR RTE" UBYTE NO_COMPU_METHOD 0 0 0 255 ECU_ADDRESS 0 SYMBOL_LINK "Rte_CustDiag_RstReq" 0 DISPLAY_IDENTIFIER CustDiag.PerInstanceMemories.RstReq /end MEASUREMENT
/begin MEASUREMENT CustDiag.RstReq.Val "MICROSAR RTE" UBYTE NO_COMPU_METHOD 0 0 0 255 ECU_ADDRESS 0 SYMBOL_LINK "Rte_CustDiag_RstReq_Val" 0 DISPLAY_IDENTIFIER CustDiag.SenderPorts.RstReq.Val /end MEASUREMENT
/begin MEASUREMENT CustDiag.RstStrt "MICROSAR RTE" UBYTE NO_COMPU_METHOD 0 0 0 255 ECU_ADDRESS 0 SYMBOL_LINK "Rte_CustDiag_RstStrt" 0 DISPLAY_IDENTIFIER CustDiag.PerInstanceMemories.RstStrt /end MEASUREMENT
/begin MEASUREMENT CustDiag.Rtn0202Strt "MICROSAR RTE" UBYTE RTE_CM_BOOLEAN 0 0 0 255 ECU_ADDRESS 0 SYMBOL_LINK "Rte_CustDiag_Rtn0202Strt" 0 DISPLAY_IDENTIFIER CustDiag.PerInstanceMemories.Rtn0202Strt /end MEASUREMENT
/begin MEASUREMENT CustDiag.RtnDC00Req "MICROSAR RTE" UBYTE NO_COMPU_METHOD 0 0 0 255 ECU_ADDRESS 0 SYMBOL_LINK "Rte_CustDiag_RtnDC00Req" 0 DISPLAY_IDENTIFIER CustDiag.PerInstanceMemories.RtnDC00Req /end MEASUREMENT
/begin MEASUREMENT CustDiag.RtnDC00Req.Val "MICROSAR RTE" UBYTE NO_COMPU_METHOD 0 0 0 255 ECU_ADDRESS 0 SYMBOL_LINK "Rte_CustDiag_RtnDC00Req_Val" 0 DISPLAY_IDENTIFIER CustDiag.SenderPorts.RtnDC00Req.Val /end MEASUREMENT
/begin MEASUREMENT CustDiag.VehSpd.Val "MICROSAR RTE" FLOAT32_IEEE NO_COMPU_METHOD 0 0 -3.402823466e+38 3.402823466e+38 ECU_ADDRESS 0 SYMBOL_LINK "Rte_ImcSigArbn_VehSpdImcCorrd_Val" 0 DISPLAY_IDENTIFIER CustDiag.ReceiverPorts.VehSpd.Val /end MEASUREMENT
/begin MEASUREMENT Dampg.AssiCmdBas.Val "MICROSAR RTE" FLOAT32_IEEE NO_COMPU_METHOD 0 0 -3.402823466e+38 3.402823466e+38 ECU_ADDRESS 0 SYMBOL_LINK "Rte_Assi_AssiCmdBas_Val" 0 DISPLAY_IDENTIFIER Dampg.ReceiverPorts.AssiCmdBas.Val /end MEASUREMENT
/begin MEASUREMENT Dampg.AssiMechT.Val "MICROSAR RTE" FLOAT32_IEEE NO_COMPU_METHOD 0 0 -3.402823466e+38 3.402823466e+38 ECU_ADDRESS 0 SYMBOL_LINK "Rte_TEstimn_AssiMechT_Val" 0 DISPLAY_IDENTIFIER Dampg.ReceiverPorts.AssiMechT.Val /end MEASUREMENT
/begin MEASUREMENT Dampg.DampgCmdBas.Val "MICROSAR RTE" FLOAT32_IEEE NO_COMPU_METHOD 0 0 -3.402823466e+38 3.402823466e+38 ECU_ADDRESS 0 SYMBOL_LINK "Rte_Dampg_DampgCmdBas_Val" 0 DISPLAY_IDENTIFIER Dampg.SenderPorts.DampgCmdBas.Val /end MEASUREMENT
/begin MEASUREMENT Dampg.DampgCmdBasDi.Logl "MICROSAR RTE" UBYTE RTE_CM_BOOLEAN 0 0 0 255 ECU_ADDRESS 0 SYMBOL_LINK "Rte_CmnMfgSrv_DampgCmdBasDi_Logl" 0 DISPLAY_IDENTIFIER Dampg.ReceiverPorts.DampgCmdBasDi.Logl /end MEASUREMENT
/begin MEASUREMENT Dampg.DampgCmdOvrl.Val "MICROSAR RTE" FLOAT32_IEEE NO_COMPU_METHOD 0 0 -3.402823466e+38 3.402823466e+38 ECU_ADDRESS 0 SYMBOL_LINK "Rte_Dampg_DampgCmdOvrl_Val" 0 DISPLAY_IDENTIFIER Dampg.ReceiverPorts.DampgCmdOvrl.Val /end MEASUREMENT
/begin MEASUREMENT Dampg.DampgCmdSca.Val "MICROSAR RTE" FLOAT32_IEEE NO_COMPU_METHOD 0 0 -3.402823466e+38 3.402823466e+38 ECU_ADDRESS 0 SYMBOL_LINK "Rte_Dampg_DampgCmdSca_Val" 0 DISPLAY_IDENTIFIER Dampg.ReceiverPorts.DampgCmdSca.Val /end MEASUREMENT
/begin MEASUREMENT Dampg.HwTq.Val "MICROSAR RTE" FLOAT32_IEEE NO_COMPU_METHOD 0 0 -3.402823466e+38 3.402823466e+38 ECU_ADDRESS 0 SYMBOL_LINK "Rte_ImcSigArbn_HwTqImcCorrd_Val" 0 DISPLAY_IDENTIFIER Dampg.ReceiverPorts.HwTq.Val /end MEASUREMENT
/begin MEASUREMENT Dampg.MotVelCrf.Val "MICROSAR RTE" FLOAT32_IEEE NO_COMPU_METHOD 0 0 -3.402823466e+38 3.402823466e+38 ECU_ADDRESS 0 SYMBOL_LINK "Rte_ImcSigArbn_MotVelCrfImcCorrd_Val" 0 DISPLAY_IDENTIFIER Dampg.ReceiverPorts.MotVelCrf.Val /end MEASUREMENT
/begin MEASUREMENT Dampg.MotVelDampgLpFil.FilGain "MICROSAR RTE" FLOAT32_IEEE NO_COMPU_METHOD 0 0 -3.402823466e+38 3.402823466e+38 ECU_ADDRESS 0 SYMBOL_LINK "Rte_Dampg_MotVelDampgLpFil.FilGain" 0 DISPLAY_IDENTIFIER Dampg.PerInstanceMemories.MotVelDampgLpFil.FilGain /end MEASUREMENT
/begin MEASUREMENT Dampg.MotVelDampgLpFil.FilSt "MICROSAR RTE" FLOAT32_IEEE NO_COMPU_METHOD 0 0 -3.402823466e+38 3.402823466e+38 ECU_ADDRESS 0 SYMBOL_LINK "Rte_Dampg_MotVelDampgLpFil.FilSt" 0 DISPLAY_IDENTIFIER Dampg.PerInstanceMemories.MotVelDampgLpFil.FilSt /end MEASUREMENT
/begin MEASUREMENT Dampg.PrevHwTqBacklshOutp "MICROSAR RTE" FLOAT32_IEEE NO_COMPU_METHOD 0 0 -3.402823466e+38 3.402823466e+38 ECU_ADDRESS 0 SYMBOL_LINK "Rte_Dampg_PrevHwTqBacklshOutp" 0 DISPLAY_IDENTIFIER Dampg.PerInstanceMemories.PrevHwTqBacklshOutp /end MEASUREMENT
/begin MEASUREMENT Dampg.PrevMotVelBacklshOutp "MICROSAR RTE" FLOAT32_IEEE NO_COMPU_METHOD 0 0 -3.402823466e+38 3.402823466e+38 ECU_ADDRESS 0 SYMBOL_LINK "Rte_Dampg_PrevMotVelBacklshOutp" 0 DISPLAY_IDENTIFIER Dampg.PerInstanceMemories.PrevMotVelBacklshOutp /end MEASUREMENT
/begin MEASUREMENT Dampg.QuadDampgHwTqLpFil.FilGain "MICROSAR RTE" FLOAT32_IEEE NO_COMPU_METHOD 0 0 -3.402823466e+38 3.402823466e+38 ECU_ADDRESS 0 SYMBOL_LINK "Rte_Dampg_QuadDampgHwTqLpFil.FilGain" 0 DISPLAY_IDENTIFIER Dampg.PerInstanceMemories.QuadDampgHwTqLpFil.FilGain /end MEASUREMENT
/begin MEASUREMENT Dampg.QuadDampgHwTqLpFil.FilSt "MICROSAR RTE" FLOAT32_IEEE NO_COMPU_METHOD 0 0 -3.402823466e+38 3.402823466e+38 ECU_ADDRESS 0 SYMBOL_LINK "Rte_Dampg_QuadDampgHwTqLpFil.FilSt" 0 DISPLAY_IDENTIFIER Dampg.PerInstanceMemories.QuadDampgHwTqLpFil.FilSt /end MEASUREMENT
/begin MEASUREMENT Dampg.QuadDampgMotVelLpFil.FilGain "MICROSAR RTE" FLOAT32_IEEE NO_COMPU_METHOD 0 0 -3.402823466e+38 3.402823466e+38 ECU_ADDRESS 0 SYMBOL_LINK "Rte_Dampg_QuadDampgMotVelLpFil.FilGain" 0 DISPLAY_IDENTIFIER Dampg.PerInstanceMemories.QuadDampgMotVelLpFil.FilGain /end MEASUREMENT
/begin MEASUREMENT Dampg.QuadDampgMotVelLpFil.FilSt "MICROSAR RTE" FLOAT32_IEEE NO_COMPU_METHOD 0 0 -3.402823466e+38 3.402823466e+38 ECU_ADDRESS 0 SYMBOL_LINK "Rte_Dampg_QuadDampgMotVelLpFil.FilSt" 0 DISPLAY_IDENTIFIER Dampg.PerInstanceMemories.QuadDampgMotVelLpFil.FilSt /end MEASUREMENT
/begin MEASUREMENT Dampg.QuadDampgScaLpFil.FilGain "MICROSAR RTE" FLOAT32_IEEE NO_COMPU_METHOD 0 0 -3.402823466e+38 3.402823466e+38 ECU_ADDRESS 0 SYMBOL_LINK "Rte_Dampg_QuadDampgScaLpFil.FilGain" 0 DISPLAY_IDENTIFIER Dampg.PerInstanceMemories.QuadDampgScaLpFil.FilGain /end MEASUREMENT
/begin MEASUREMENT Dampg.QuadDampgScaLpFil.FilSt "MICROSAR RTE" FLOAT32_IEEE NO_COMPU_METHOD 0 0 -3.402823466e+38 3.402823466e+38 ECU_ADDRESS 0 SYMBOL_LINK "Rte_Dampg_QuadDampgScaLpFil.FilSt" 0 DISPLAY_IDENTIFIER Dampg.PerInstanceMemories.QuadDampgScaLpFil.FilSt /end MEASUREMENT
/begin MEASUREMENT Dampg.VehSpd.Val "MICROSAR RTE" FLOAT32_IEEE NO_COMPU_METHOD 0 0 -3.402823466e+38 3.402823466e+38 ECU_ADDRESS 0 SYMBOL_LINK "Rte_ImcSigArbn_VehSpdImcCorrd_Val" 0 DISPLAY_IDENTIFIER Dampg.ReceiverPorts.VehSpd.Val /end MEASUREMENT
/begin MEASUREMENT Dampg.dDampgAssiMechTSca "MICROSAR RTE" FLOAT32_IEEE NO_COMPU_METHOD 0 0 -3.402823466e+38 3.402823466e+38 ECU_ADDRESS 0 SYMBOL_LINK "Rte_Dampg_dDampgAssiMechTSca" 0 DISPLAY_IDENTIFIER Dampg.PerInstanceMemories.dDampgAssiMechTSca /end MEASUREMENT
/begin MEASUREMENT Dampg.dDampgCoeff1Term "MICROSAR RTE" FLOAT32_IEEE NO_COMPU_METHOD 0 0 -3.402823466e+38 3.402823466e+38 ECU_ADDRESS 0 SYMBOL_LINK "Rte_Dampg_dDampgCoeff1Term" 0 DISPLAY_IDENTIFIER Dampg.PerInstanceMemories.dDampgCoeff1Term /end MEASUREMENT
/begin MEASUREMENT Dampg.dDampgCoeff2Term "MICROSAR RTE" FLOAT32_IEEE NO_COMPU_METHOD 0 0 -3.402823466e+38 3.402823466e+38 ECU_ADDRESS 0 SYMBOL_LINK "Rte_Dampg_dDampgCoeff2Term" 0 DISPLAY_IDENTIFIER Dampg.PerInstanceMemories.dDampgCoeff2Term /end MEASUREMENT
/begin MEASUREMENT Dampg.dDampgCoeff3Term "MICROSAR RTE" FLOAT32_IEEE NO_COMPU_METHOD 0 0 -3.402823466e+38 3.402823466e+38 ECU_ADDRESS 0 SYMBOL_LINK "Rte_Dampg_dDampgCoeff3Term" 0 DISPLAY_IDENTIFIER Dampg.PerInstanceMemories.dDampgCoeff3Term /end MEASUREMENT
/begin MEASUREMENT Dampg.dDampgCoeff4Term "MICROSAR RTE" FLOAT32_IEEE NO_COMPU_METHOD 0 0 -3.402823466e+38 3.402823466e+38 ECU_ADDRESS 0 SYMBOL_LINK "Rte_Dampg_dDampgCoeff4Term" 0 DISPLAY_IDENTIFIER Dampg.PerInstanceMemories.dDampgCoeff4Term /end MEASUREMENT
/begin MEASUREMENT Dampg.dDampgHwTqSca "MICROSAR RTE" FLOAT32_IEEE NO_COMPU_METHOD 0 0 -3.402823466e+38 3.402823466e+38 ECU_ADDRESS 0 SYMBOL_LINK "Rte_Dampg_dDampgHwTqSca" 0 DISPLAY_IDENTIFIER Dampg.PerInstanceMemories.dDampgHwTqSca /end MEASUREMENT
/begin MEASUREMENT Dampg.dDampgMotVelDampgCmd "MICROSAR RTE" FLOAT32_IEEE NO_COMPU_METHOD 0 0 -3.402823466e+38 3.402823466e+38 ECU_ADDRESS 0 SYMBOL_LINK "Rte_Dampg_dDampgMotVelDampgCmd" 0 DISPLAY_IDENTIFIER Dampg.PerInstanceMemories.dDampgMotVelDampgCmd /end MEASUREMENT
/begin MEASUREMENT Dampg.dDampgQuadHwTqBacklsh "MICROSAR RTE" FLOAT32_IEEE NO_COMPU_METHOD 0 0 -3.402823466e+38 3.402823466e+38 ECU_ADDRESS 0 SYMBOL_LINK "Rte_Dampg_dDampgQuadHwTqBacklsh" 0 DISPLAY_IDENTIFIER Dampg.PerInstanceMemories.dDampgQuadHwTqBacklsh /end MEASUREMENT
/begin MEASUREMENT Dampg.dDampgQuadMotVelBacklsh "MICROSAR RTE" FLOAT32_IEEE NO_COMPU_METHOD 0 0 -3.402823466e+38 3.402823466e+38 ECU_ADDRESS 0 SYMBOL_LINK "Rte_Dampg_dDampgQuadMotVelBacklsh" 0 DISPLAY_IDENTIFIER Dampg.PerInstanceMemories.dDampgQuadMotVelBacklsh /end MEASUREMENT
/begin MEASUREMENT DampgPahSum.DampgCmd.Val "MICROSAR RTE" FLOAT32_IEEE NO_COMPU_METHOD 0 0 -3.402823466e+38 3.402823466e+38 ECU_ADDRESS 0 SYMBOL_LINK "Rte_DampgPahSum_DampgCmd_Val" 0 DISPLAY_IDENTIFIER DampgPahSum.SenderPorts.DampgCmd.Val /end MEASUREMENT
/begin MEASUREMENT DampgPahSum.DampgCmdBas.Val "MICROSAR RTE" FLOAT32_IEEE NO_COMPU_METHOD 0 0 -3.402823466e+38 3.402823466e+38 ECU_ADDRESS 0 SYMBOL_LINK "Rte_Dampg_DampgCmdBas_Val" 0 DISPLAY_IDENTIFIER DampgPahSum.ReceiverPorts.DampgCmdBas.Val /end MEASUREMENT
/begin MEASUREMENT DampgPahSum.InertiaCmpVelCmd.Val "MICROSAR RTE" FLOAT32_IEEE NO_COMPU_METHOD 0 0 -3.402823466e+38 3.402823466e+38 ECU_ADDRESS 0 SYMBOL_LINK "Rte_InertiaCmpVel_InertiaCmpVelCmd_Val" 0 DISPLAY_IDENTIFIER DampgPahSum.ReceiverPorts.InertiaCmpVelCmd.Val /end MEASUREMENT
/begin MEASUREMENT Dcm.Dcm_Read_BswM_MDGP_BswMEcuResetMod.Dcm_Read_BswM_MDGP_BswMEcuResetMod "MICROSAR RTE" UBYTE RTE_CM_ENUM_BswMEcuResetMod 0 0 0 255 ECU_ADDRESS 0 SYMBOL_LINK "Rte_ModeMachine_CustDiag_BswM_MSI_BswMEcuResetMod_BswM_MDGP_BswMEcuResetMod" 0 DISPLAY_IDENTIFIER Dcm.ModeRequirePorts.Dcm_Read_BswM_MDGP_BswMEcuResetMod.Dcm_Read_BswM_MDGP_BswMEcuResetMod /end MEASUREMENT
/begin MEASUREMENT DiagcMgr.BrdgVltg.Val "MICROSAR RTE" FLOAT32_IEEE NO_COMPU_METHOD 0 0 -3.402823466e+38 3.402823466e+38 ECU_ADDRESS 0 SYMBOL_LINK "Rte_BattVltg_BrdgVltg_Val" 0 DISPLAY_IDENTIFIER DiagcMgr.ReceiverPorts.BrdgVltg.Val /end MEASUREMENT
/begin MEASUREMENT DiagcMgr.ClrDiagcFlg "MICROSAR RTE" UBYTE NO_COMPU_METHOD 0 0 0 255 ECU_ADDRESS 0 SYMBOL_LINK "Rte_DiagcMgr_ClrDiagcFlg" 0 DISPLAY_IDENTIFIER DiagcMgr.PerInstanceMemories.ClrDiagcFlg /end MEASUREMENT
/begin MEASUREMENT DiagcMgr.ClrDiagcFlgProxy.Val "MICROSAR RTE" UBYTE NO_COMPU_METHOD 0 0 0 255 ECU_ADDRESS 0 SYMBOL_LINK "Rte_DiagcMgr_ClrDiagcFlgProxy_Val" 0 DISPLAY_IDENTIFIER DiagcMgr.SenderPorts.ClrDiagcFlgProxy.Val /end MEASUREMENT
/begin MEASUREMENT DiagcMgr.DiagcMgrApplCrc "MICROSAR RTE" ULONG NO_COMPU_METHOD 0 0 0 4294967295 ECU_ADDRESS 0 SYMBOL_LINK "Rte_DiagcMgr_DiagcMgrApplCrc" 0 DISPLAY_IDENTIFIER DiagcMgr.PerInstanceMemories.DiagcMgrApplCrc /end MEASUREMENT
/begin MEASUREMENT DiagcMgr.DiagcMgrLtchCntrAry "MICROSAR RTE" UBYTE NO_COMPU_METHOD 0 0 0 255 MATRIX_DIM 20 1 1 ECU_ADDRESS 0 SYMBOL_LINK "Rte_DiagcMgr_DiagcMgrLtchCntrAry" 0 DISPLAY_IDENTIFIER DiagcMgr.PerInstanceMemories.DiagcMgrLtchCntrAry /end MEASUREMENT
/begin MEASUREMENT DiagcMgr.DiagcMgrNtcFltAry[0].AgiCntr "MICROSAR RTE" UBYTE NO_COMPU_METHOD 0 0 0 255 ECU_ADDRESS 0 SYMBOL_LINK "Rte_DiagcMgr_DiagcMgrNtcFltAry[0].AgiCntr" 0 DISPLAY_IDENTIFIER DiagcMgr.PerInstanceMemories.DiagcMgrNtcFltAry[0].AgiCntr /end MEASUREMENT
/begin MEASUREMENT DiagcMgr.DiagcMgrNtcFltAry[0].NtcNr "MICROSAR RTE" UWORD RTE_CM_ENUM_NtcNrWithResd1 0 0 0 65535 ECU_ADDRESS 0 SYMBOL_LINK "Rte_DiagcMgr_DiagcMgrNtcFltAry[0].NtcNr" 0 DISPLAY_IDENTIFIER DiagcMgr.PerInstanceMemories.DiagcMgrNtcFltAry[0].NtcNr /end MEASUREMENT
/begin MEASUREMENT DiagcMgr.DiagcMgrNtcFltAry[0].Sts "MICROSAR RTE" UBYTE NO_COMPU_METHOD 0 0 0 255 ECU_ADDRESS 0 SYMBOL_LINK "Rte_DiagcMgr_DiagcMgrNtcFltAry[0].Sts" 0 DISPLAY_IDENTIFIER DiagcMgr.PerInstanceMemories.DiagcMgrNtcFltAry[0].Sts /end MEASUREMENT
/begin MEASUREMENT DiagcMgr.DiagcMgrNtcFltAry[10].AgiCntr "MICROSAR RTE" UBYTE NO_COMPU_METHOD 0 0 0 255 ECU_ADDRESS 0 SYMBOL_LINK "Rte_DiagcMgr_DiagcMgrNtcFltAry[10].AgiCntr" 0 DISPLAY_IDENTIFIER DiagcMgr.PerInstanceMemories.DiagcMgrNtcFltAry[10].AgiCntr /end MEASUREMENT
/begin MEASUREMENT DiagcMgr.DiagcMgrNtcFltAry[10].NtcNr "MICROSAR RTE" UWORD RTE_CM_ENUM_NtcNrWithResd1 0 0 0 65535 ECU_ADDRESS 0 SYMBOL_LINK "Rte_DiagcMgr_DiagcMgrNtcFltAry[10].NtcNr" 0 DISPLAY_IDENTIFIER DiagcMgr.PerInstanceMemories.DiagcMgrNtcFltAry[10].NtcNr /end MEASUREMENT
/begin MEASUREMENT DiagcMgr.DiagcMgrNtcFltAry[10].Sts "MICROSAR RTE" UBYTE NO_COMPU_METHOD 0 0 0 255 ECU_ADDRESS 0 SYMBOL_LINK "Rte_DiagcMgr_DiagcMgrNtcFltAry[10].Sts" 0 DISPLAY_IDENTIFIER DiagcMgr.PerInstanceMemories.DiagcMgrNtcFltAry[10].Sts /end MEASUREMENT
/begin MEASUREMENT DiagcMgr.DiagcMgrNtcFltAry[11].AgiCntr "MICROSAR RTE" UBYTE NO_COMPU_METHOD 0 0 0 255 ECU_ADDRESS 0 SYMBOL_LINK "Rte_DiagcMgr_DiagcMgrNtcFltAry[11].AgiCntr" 0 DISPLAY_IDENTIFIER DiagcMgr.PerInstanceMemories.DiagcMgrNtcFltAry[11].AgiCntr /end MEASUREMENT
/begin MEASUREMENT DiagcMgr.DiagcMgrNtcFltAry[11].NtcNr "MICROSAR RTE" UWORD RTE_CM_ENUM_NtcNrWithResd1 0 0 0 65535 ECU_ADDRESS 0 SYMBOL_LINK "Rte_DiagcMgr_DiagcMgrNtcFltAry[11].NtcNr" 0 DISPLAY_IDENTIFIER DiagcMgr.PerInstanceMemories.DiagcMgrNtcFltAry[11].NtcNr /end MEASUREMENT
/begin MEASUREMENT DiagcMgr.DiagcMgrNtcFltAry[11].Sts "MICROSAR RTE" UBYTE NO_COMPU_METHOD 0 0 0 255 ECU_ADDRESS 0 SYMBOL_LINK "Rte_DiagcMgr_DiagcMgrNtcFltAry[11].Sts" 0 DISPLAY_IDENTIFIER DiagcMgr.PerInstanceMemories.DiagcMgrNtcFltAry[11].Sts /end MEASUREMENT
/begin MEASUREMENT DiagcMgr.DiagcMgrNtcFltAry[12].AgiCntr "MICROSAR RTE" UBYTE NO_COMPU_METHOD 0 0 0 255 ECU_ADDRESS 0 SYMBOL_LINK "Rte_DiagcMgr_DiagcMgrNtcFltAry[12].AgiCntr" 0 DISPLAY_IDENTIFIER DiagcMgr.PerInstanceMemories.DiagcMgrNtcFltAry[12].AgiCntr /end MEASUREMENT
/begin MEASUREMENT DiagcMgr.DiagcMgrNtcFltAry[12].NtcNr "MICROSAR RTE" UWORD RTE_CM_ENUM_NtcNrWithResd1 0 0 0 65535 ECU_ADDRESS 0 SYMBOL_LINK "Rte_DiagcMgr_DiagcMgrNtcFltAry[12].NtcNr" 0 DISPLAY_IDENTIFIER DiagcMgr.PerInstanceMemories.DiagcMgrNtcFltAry[12].NtcNr /end MEASUREMENT
/begin MEASUREMENT DiagcMgr.DiagcMgrNtcFltAry[12].Sts "MICROSAR RTE" UBYTE NO_COMPU_METHOD 0 0 0 255 ECU_ADDRESS 0 SYMBOL_LINK "Rte_DiagcMgr_DiagcMgrNtcFltAry[12].Sts" 0 DISPLAY_IDENTIFIER DiagcMgr.PerInstanceMemories.DiagcMgrNtcFltAry[12].Sts /end MEASUREMENT
/begin MEASUREMENT DiagcMgr.DiagcMgrNtcFltAry[13].AgiCntr "MICROSAR RTE" UBYTE NO_COMPU_METHOD 0 0 0 255 ECU_ADDRESS 0 SYMBOL_LINK "Rte_DiagcMgr_DiagcMgrNtcFltAry[13].AgiCntr" 0 DISPLAY_IDENTIFIER DiagcMgr.PerInstanceMemories.DiagcMgrNtcFltAry[13].AgiCntr /end MEASUREMENT
/begin MEASUREMENT DiagcMgr.DiagcMgrNtcFltAry[13].NtcNr "MICROSAR RTE" UWORD RTE_CM_ENUM_NtcNrWithResd1 0 0 0 65535 ECU_ADDRESS 0 SYMBOL_LINK "Rte_DiagcMgr_DiagcMgrNtcFltAry[13].NtcNr" 0 DISPLAY_IDENTIFIER DiagcMgr.PerInstanceMemories.DiagcMgrNtcFltAry[13].NtcNr /end MEASUREMENT
/begin MEASUREMENT DiagcMgr.DiagcMgrNtcFltAry[13].Sts "MICROSAR RTE" UBYTE NO_COMPU_METHOD 0 0 0 255 ECU_ADDRESS 0 SYMBOL_LINK "Rte_DiagcMgr_DiagcMgrNtcFltAry[13].Sts" 0 DISPLAY_IDENTIFIER DiagcMgr.PerInstanceMemories.DiagcMgrNtcFltAry[13].Sts /end MEASUREMENT
/begin MEASUREMENT DiagcMgr.DiagcMgrNtcFltAry[14].AgiCntr "MICROSAR RTE" UBYTE NO_COMPU_METHOD 0 0 0 255 ECU_ADDRESS 0 SYMBOL_LINK "Rte_DiagcMgr_DiagcMgrNtcFltAry[14].AgiCntr" 0 DISPLAY_IDENTIFIER DiagcMgr.PerInstanceMemories.DiagcMgrNtcFltAry[14].AgiCntr /end MEASUREMENT
/begin MEASUREMENT DiagcMgr.DiagcMgrNtcFltAry[14].NtcNr "MICROSAR RTE" UWORD RTE_CM_ENUM_NtcNrWithResd1 0 0 0 65535 ECU_ADDRESS 0 SYMBOL_LINK "Rte_DiagcMgr_DiagcMgrNtcFltAry[14].NtcNr" 0 DISPLAY_IDENTIFIER DiagcMgr.PerInstanceMemories.DiagcMgrNtcFltAry[14].NtcNr /end MEASUREMENT
/begin MEASUREMENT DiagcMgr.DiagcMgrNtcFltAry[14].Sts "MICROSAR RTE" UBYTE NO_COMPU_METHOD 0 0 0 255 ECU_ADDRESS 0 SYMBOL_LINK "Rte_DiagcMgr_DiagcMgrNtcFltAry[14].Sts" 0 DISPLAY_IDENTIFIER DiagcMgr.PerInstanceMemories.DiagcMgrNtcFltAry[14].Sts /end MEASUREMENT
/begin MEASUREMENT DiagcMgr.DiagcMgrNtcFltAry[15].AgiCntr "MICROSAR RTE" UBYTE NO_COMPU_METHOD 0 0 0 255 ECU_ADDRESS 0 SYMBOL_LINK "Rte_DiagcMgr_DiagcMgrNtcFltAry[15].AgiCntr" 0 DISPLAY_IDENTIFIER DiagcMgr.PerInstanceMemories.DiagcMgrNtcFltAry[15].AgiCntr /end MEASUREMENT
/begin MEASUREMENT DiagcMgr.DiagcMgrNtcFltAry[15].NtcNr "MICROSAR RTE" UWORD RTE_CM_ENUM_NtcNrWithResd1 0 0 0 65535 ECU_ADDRESS 0 SYMBOL_LINK "Rte_DiagcMgr_DiagcMgrNtcFltAry[15].NtcNr" 0 DISPLAY_IDENTIFIER DiagcMgr.PerInstanceMemories.DiagcMgrNtcFltAry[15].NtcNr /end MEASUREMENT
/begin MEASUREMENT DiagcMgr.DiagcMgrNtcFltAry[15].Sts "MICROSAR RTE" UBYTE NO_COMPU_METHOD 0 0 0 255 ECU_ADDRESS 0 SYMBOL_LINK "Rte_DiagcMgr_DiagcMgrNtcFltAry[15].Sts" 0 DISPLAY_IDENTIFIER DiagcMgr.PerInstanceMemories.DiagcMgrNtcFltAry[15].Sts /end MEASUREMENT
/begin MEASUREMENT DiagcMgr.DiagcMgrNtcFltAry[16].AgiCntr "MICROSAR RTE" UBYTE NO_COMPU_METHOD 0 0 0 255 ECU_ADDRESS 0 SYMBOL_LINK "Rte_DiagcMgr_DiagcMgrNtcFltAry[16].AgiCntr" 0 DISPLAY_IDENTIFIER DiagcMgr.PerInstanceMemories.DiagcMgrNtcFltAry[16].AgiCntr /end MEASUREMENT
/begin MEASUREMENT DiagcMgr.DiagcMgrNtcFltAry[16].NtcNr "MICROSAR RTE" UWORD RTE_CM_ENUM_NtcNrWithResd1 0 0 0 65535 ECU_ADDRESS 0 SYMBOL_LINK "Rte_DiagcMgr_DiagcMgrNtcFltAry[16].NtcNr" 0 DISPLAY_IDENTIFIER DiagcMgr.PerInstanceMemories.DiagcMgrNtcFltAry[16].NtcNr /end MEASUREMENT
/begin MEASUREMENT DiagcMgr.DiagcMgrNtcFltAry[16].Sts "MICROSAR RTE" UBYTE NO_COMPU_METHOD 0 0 0 255 ECU_ADDRESS 0 SYMBOL_LINK "Rte_DiagcMgr_DiagcMgrNtcFltAry[16].Sts" 0 DISPLAY_IDENTIFIER DiagcMgr.PerInstanceMemories.DiagcMgrNtcFltAry[16].Sts /end MEASUREMENT
/begin MEASUREMENT DiagcMgr.DiagcMgrNtcFltAry[17].AgiCntr "MICROSAR RTE" UBYTE NO_COMPU_METHOD 0 0 0 255 ECU_ADDRESS 0 SYMBOL_LINK "Rte_DiagcMgr_DiagcMgrNtcFltAry[17].AgiCntr" 0 DISPLAY_IDENTIFIER DiagcMgr.PerInstanceMemories.DiagcMgrNtcFltAry[17].AgiCntr /end MEASUREMENT
/begin MEASUREMENT DiagcMgr.DiagcMgrNtcFltAry[17].NtcNr "MICROSAR RTE" UWORD RTE_CM_ENUM_NtcNrWithResd1 0 0 0 65535 ECU_ADDRESS 0 SYMBOL_LINK "Rte_DiagcMgr_DiagcMgrNtcFltAry[17].NtcNr" 0 DISPLAY_IDENTIFIER DiagcMgr.PerInstanceMemories.DiagcMgrNtcFltAry[17].NtcNr /end MEASUREMENT
/begin MEASUREMENT DiagcMgr.DiagcMgrNtcFltAry[17].Sts "MICROSAR RTE" UBYTE NO_COMPU_METHOD 0 0 0 255 ECU_ADDRESS 0 SYMBOL_LINK "Rte_DiagcMgr_DiagcMgrNtcFltAry[17].Sts" 0 DISPLAY_IDENTIFIER DiagcMgr.PerInstanceMemories.DiagcMgrNtcFltAry[17].Sts /end MEASUREMENT
/begin MEASUREMENT DiagcMgr.DiagcMgrNtcFltAry[18].AgiCntr "MICROSAR RTE" UBYTE NO_COMPU_METHOD 0 0 0 255 ECU_ADDRESS 0 SYMBOL_LINK "Rte_DiagcMgr_DiagcMgrNtcFltAry[18].AgiCntr" 0 DISPLAY_IDENTIFIER DiagcMgr.PerInstanceMemories.DiagcMgrNtcFltAry[18].AgiCntr /end MEASUREMENT
/begin MEASUREMENT DiagcMgr.DiagcMgrNtcFltAry[18].NtcNr "MICROSAR RTE" UWORD RTE_CM_ENUM_NtcNrWithResd1 0 0 0 65535 ECU_ADDRESS 0 SYMBOL_LINK "Rte_DiagcMgr_DiagcMgrNtcFltAry[18].NtcNr" 0 DISPLAY_IDENTIFIER DiagcMgr.PerInstanceMemories.DiagcMgrNtcFltAry[18].NtcNr /end MEASUREMENT
/begin MEASUREMENT DiagcMgr.DiagcMgrNtcFltAry[18].Sts "MICROSAR RTE" UBYTE NO_COMPU_METHOD 0 0 0 255 ECU_ADDRESS 0 SYMBOL_LINK "Rte_DiagcMgr_DiagcMgrNtcFltAry[18].Sts" 0 DISPLAY_IDENTIFIER DiagcMgr.PerInstanceMemories.DiagcMgrNtcFltAry[18].Sts /end MEASUREMENT
/begin MEASUREMENT DiagcMgr.DiagcMgrNtcFltAry[19].AgiCntr "MICROSAR RTE" UBYTE NO_COMPU_METHOD 0 0 0 255 ECU_ADDRESS 0 SYMBOL_LINK "Rte_DiagcMgr_DiagcMgrNtcFltAry[19].AgiCntr" 0 DISPLAY_IDENTIFIER DiagcMgr.PerInstanceMemories.DiagcMgrNtcFltAry[19].AgiCntr /end MEASUREMENT
/begin MEASUREMENT DiagcMgr.DiagcMgrNtcFltAry[19].NtcNr "MICROSAR RTE" UWORD RTE_CM_ENUM_NtcNrWithResd1 0 0 0 65535 ECU_ADDRESS 0 SYMBOL_LINK "Rte_DiagcMgr_DiagcMgrNtcFltAry[19].NtcNr" 0 DISPLAY_IDENTIFIER DiagcMgr.PerInstanceMemories.DiagcMgrNtcFltAry[19].NtcNr /end MEASUREMENT
/begin MEASUREMENT DiagcMgr.DiagcMgrNtcFltAry[19].Sts "MICROSAR RTE" UBYTE NO_COMPU_METHOD 0 0 0 255 ECU_ADDRESS 0 SYMBOL_LINK "Rte_DiagcMgr_DiagcMgrNtcFltAry[19].Sts" 0 DISPLAY_IDENTIFIER DiagcMgr.PerInstanceMemories.DiagcMgrNtcFltAry[19].Sts /end MEASUREMENT
/begin MEASUREMENT DiagcMgr.DiagcMgrNtcFltAry[1].AgiCntr "MICROSAR RTE" UBYTE NO_COMPU_METHOD 0 0 0 255 ECU_ADDRESS 0 SYMBOL_LINK "Rte_DiagcMgr_DiagcMgrNtcFltAry[1].AgiCntr" 0 DISPLAY_IDENTIFIER DiagcMgr.PerInstanceMemories.DiagcMgrNtcFltAry[1].AgiCntr /end MEASUREMENT
/begin MEASUREMENT DiagcMgr.DiagcMgrNtcFltAry[1].NtcNr "MICROSAR RTE" UWORD RTE_CM_ENUM_NtcNrWithResd1 0 0 0 65535 ECU_ADDRESS 0 SYMBOL_LINK "Rte_DiagcMgr_DiagcMgrNtcFltAry[1].NtcNr" 0 DISPLAY_IDENTIFIER DiagcMgr.PerInstanceMemories.DiagcMgrNtcFltAry[1].NtcNr /end MEASUREMENT
/begin MEASUREMENT DiagcMgr.DiagcMgrNtcFltAry[1].Sts "MICROSAR RTE" UBYTE NO_COMPU_METHOD 0 0 0 255 ECU_ADDRESS 0 SYMBOL_LINK "Rte_DiagcMgr_DiagcMgrNtcFltAry[1].Sts" 0 DISPLAY_IDENTIFIER DiagcMgr.PerInstanceMemories.DiagcMgrNtcFltAry[1].Sts /end MEASUREMENT
/begin MEASUREMENT DiagcMgr.DiagcMgrNtcFltAry[2].AgiCntr "MICROSAR RTE" UBYTE NO_COMPU_METHOD 0 0 0 255 ECU_ADDRESS 0 SYMBOL_LINK "Rte_DiagcMgr_DiagcMgrNtcFltAry[2].AgiCntr" 0 DISPLAY_IDENTIFIER DiagcMgr.PerInstanceMemories.DiagcMgrNtcFltAry[2].AgiCntr /end MEASUREMENT
/begin MEASUREMENT DiagcMgr.DiagcMgrNtcFltAry[2].NtcNr "MICROSAR RTE" UWORD RTE_CM_ENUM_NtcNrWithResd1 0 0 0 65535 ECU_ADDRESS 0 SYMBOL_LINK "Rte_DiagcMgr_DiagcMgrNtcFltAry[2].NtcNr" 0 DISPLAY_IDENTIFIER DiagcMgr.PerInstanceMemories.DiagcMgrNtcFltAry[2].NtcNr /end MEASUREMENT
/begin MEASUREMENT DiagcMgr.DiagcMgrNtcFltAry[2].Sts "MICROSAR RTE" UBYTE NO_COMPU_METHOD 0 0 0 255 ECU_ADDRESS 0 SYMBOL_LINK "Rte_DiagcMgr_DiagcMgrNtcFltAry[2].Sts" 0 DISPLAY_IDENTIFIER DiagcMgr.PerInstanceMemories.DiagcMgrNtcFltAry[2].Sts /end MEASUREMENT
/begin MEASUREMENT DiagcMgr.DiagcMgrNtcFltAry[3].AgiCntr "MICROSAR RTE" UBYTE NO_COMPU_METHOD 0 0 0 255 ECU_ADDRESS 0 SYMBOL_LINK "Rte_DiagcMgr_DiagcMgrNtcFltAry[3].AgiCntr" 0 DISPLAY_IDENTIFIER DiagcMgr.PerInstanceMemories.DiagcMgrNtcFltAry[3].AgiCntr /end MEASUREMENT
/begin MEASUREMENT DiagcMgr.DiagcMgrNtcFltAry[3].NtcNr "MICROSAR RTE" UWORD RTE_CM_ENUM_NtcNrWithResd1 0 0 0 65535 ECU_ADDRESS 0 SYMBOL_LINK "Rte_DiagcMgr_DiagcMgrNtcFltAry[3].NtcNr" 0 DISPLAY_IDENTIFIER DiagcMgr.PerInstanceMemories.DiagcMgrNtcFltAry[3].NtcNr /end MEASUREMENT
/begin MEASUREMENT DiagcMgr.DiagcMgrNtcFltAry[3].Sts "MICROSAR RTE" UBYTE NO_COMPU_METHOD 0 0 0 255 ECU_ADDRESS 0 SYMBOL_LINK "Rte_DiagcMgr_DiagcMgrNtcFltAry[3].Sts" 0 DISPLAY_IDENTIFIER DiagcMgr.PerInstanceMemories.DiagcMgrNtcFltAry[3].Sts /end MEASUREMENT
/begin MEASUREMENT DiagcMgr.DiagcMgrNtcFltAry[4].AgiCntr "MICROSAR RTE" UBYTE NO_COMPU_METHOD 0 0 0 255 ECU_ADDRESS 0 SYMBOL_LINK "Rte_DiagcMgr_DiagcMgrNtcFltAry[4].AgiCntr" 0 DISPLAY_IDENTIFIER DiagcMgr.PerInstanceMemories.DiagcMgrNtcFltAry[4].AgiCntr /end MEASUREMENT
/begin MEASUREMENT DiagcMgr.DiagcMgrNtcFltAry[4].NtcNr "MICROSAR RTE" UWORD RTE_CM_ENUM_NtcNrWithResd1 0 0 0 65535 ECU_ADDRESS 0 SYMBOL_LINK "Rte_DiagcMgr_DiagcMgrNtcFltAry[4].NtcNr" 0 DISPLAY_IDENTIFIER DiagcMgr.PerInstanceMemories.DiagcMgrNtcFltAry[4].NtcNr /end MEASUREMENT
/begin MEASUREMENT DiagcMgr.DiagcMgrNtcFltAry[4].Sts "MICROSAR RTE" UBYTE NO_COMPU_METHOD 0 0 0 255 ECU_ADDRESS 0 SYMBOL_LINK "Rte_DiagcMgr_DiagcMgrNtcFltAry[4].Sts" 0 DISPLAY_IDENTIFIER DiagcMgr.PerInstanceMemories.DiagcMgrNtcFltAry[4].Sts /end MEASUREMENT
/begin MEASUREMENT DiagcMgr.DiagcMgrNtcFltAry[5].AgiCntr "MICROSAR RTE" UBYTE NO_COMPU_METHOD 0 0 0 255 ECU_ADDRESS 0 SYMBOL_LINK "Rte_DiagcMgr_DiagcMgrNtcFltAry[5].AgiCntr" 0 DISPLAY_IDENTIFIER DiagcMgr.PerInstanceMemories.DiagcMgrNtcFltAry[5].AgiCntr /end MEASUREMENT
/begin MEASUREMENT DiagcMgr.DiagcMgrNtcFltAry[5].NtcNr "MICROSAR RTE" UWORD RTE_CM_ENUM_NtcNrWithResd1 0 0 0 65535 ECU_ADDRESS 0 SYMBOL_LINK "Rte_DiagcMgr_DiagcMgrNtcFltAry[5].NtcNr" 0 DISPLAY_IDENTIFIER DiagcMgr.PerInstanceMemories.DiagcMgrNtcFltAry[5].NtcNr /end MEASUREMENT
/begin MEASUREMENT DiagcMgr.DiagcMgrNtcFltAry[5].Sts "MICROSAR RTE" UBYTE NO_COMPU_METHOD 0 0 0 255 ECU_ADDRESS 0 SYMBOL_LINK "Rte_DiagcMgr_DiagcMgrNtcFltAry[5].Sts" 0 DISPLAY_IDENTIFIER DiagcMgr.PerInstanceMemories.DiagcMgrNtcFltAry[5].Sts /end MEASUREMENT
/begin MEASUREMENT DiagcMgr.DiagcMgrNtcFltAry[6].AgiCntr "MICROSAR RTE" UBYTE NO_COMPU_METHOD 0 0 0 255 ECU_ADDRESS 0 SYMBOL_LINK "Rte_DiagcMgr_DiagcMgrNtcFltAry[6].AgiCntr" 0 DISPLAY_IDENTIFIER DiagcMgr.PerInstanceMemories.DiagcMgrNtcFltAry[6].AgiCntr /end MEASUREMENT
/begin MEASUREMENT DiagcMgr.DiagcMgrNtcFltAry[6].NtcNr "MICROSAR RTE" UWORD RTE_CM_ENUM_NtcNrWithResd1 0 0 0 65535 ECU_ADDRESS 0 SYMBOL_LINK "Rte_DiagcMgr_DiagcMgrNtcFltAry[6].NtcNr" 0 DISPLAY_IDENTIFIER DiagcMgr.PerInstanceMemories.DiagcMgrNtcFltAry[6].NtcNr /end MEASUREMENT
/begin MEASUREMENT DiagcMgr.DiagcMgrNtcFltAry[6].Sts "MICROSAR RTE" UBYTE NO_COMPU_METHOD 0 0 0 255 ECU_ADDRESS 0 SYMBOL_LINK "Rte_DiagcMgr_DiagcMgrNtcFltAry[6].Sts" 0 DISPLAY_IDENTIFIER DiagcMgr.PerInstanceMemories.DiagcMgrNtcFltAry[6].Sts /end MEASUREMENT
/begin MEASUREMENT DiagcMgr.DiagcMgrNtcFltAry[7].AgiCntr "MICROSAR RTE" UBYTE NO_COMPU_METHOD 0 0 0 255 ECU_ADDRESS 0 SYMBOL_LINK "Rte_DiagcMgr_DiagcMgrNtcFltAry[7].AgiCntr" 0 DISPLAY_IDENTIFIER DiagcMgr.PerInstanceMemories.DiagcMgrNtcFltAry[7].AgiCntr /end MEASUREMENT
/begin MEASUREMENT DiagcMgr.DiagcMgrNtcFltAry[7].NtcNr "MICROSAR RTE" UWORD RTE_CM_ENUM_NtcNrWithResd1 0 0 0 65535 ECU_ADDRESS 0 SYMBOL_LINK "Rte_DiagcMgr_DiagcMgrNtcFltAry[7].NtcNr" 0 DISPLAY_IDENTIFIER DiagcMgr.PerInstanceMemories.DiagcMgrNtcFltAry[7].NtcNr /end MEASUREMENT
/begin MEASUREMENT DiagcMgr.DiagcMgrNtcFltAry[7].Sts "MICROSAR RTE" UBYTE NO_COMPU_METHOD 0 0 0 255 ECU_ADDRESS 0 SYMBOL_LINK "Rte_DiagcMgr_DiagcMgrNtcFltAry[7].Sts" 0 DISPLAY_IDENTIFIER DiagcMgr.PerInstanceMemories.DiagcMgrNtcFltAry[7].Sts /end MEASUREMENT
/begin MEASUREMENT DiagcMgr.DiagcMgrNtcFltAry[8].AgiCntr "MICROSAR RTE" UBYTE NO_COMPU_METHOD 0 0 0 255 ECU_ADDRESS 0 SYMBOL_LINK "Rte_DiagcMgr_DiagcMgrNtcFltAry[8].AgiCntr" 0 DISPLAY_IDENTIFIER DiagcMgr.PerInstanceMemories.DiagcMgrNtcFltAry[8].AgiCntr /end MEASUREMENT
/begin MEASUREMENT DiagcMgr.DiagcMgrNtcFltAry[8].NtcNr "MICROSAR RTE" UWORD RTE_CM_ENUM_NtcNrWithResd1 0 0 0 65535 ECU_ADDRESS 0 SYMBOL_LINK "Rte_DiagcMgr_DiagcMgrNtcFltAry[8].NtcNr" 0 DISPLAY_IDENTIFIER DiagcMgr.PerInstanceMemories.DiagcMgrNtcFltAry[8].NtcNr /end MEASUREMENT
/begin MEASUREMENT DiagcMgr.DiagcMgrNtcFltAry[8].Sts "MICROSAR RTE" UBYTE NO_COMPU_METHOD 0 0 0 255 ECU_ADDRESS 0 SYMBOL_LINK "Rte_DiagcMgr_DiagcMgrNtcFltAry[8].Sts" 0 DISPLAY_IDENTIFIER DiagcMgr.PerInstanceMemories.DiagcMgrNtcFltAry[8].Sts /end MEASUREMENT
/begin MEASUREMENT DiagcMgr.DiagcMgrNtcFltAry[9].AgiCntr "MICROSAR RTE" UBYTE NO_COMPU_METHOD 0 0 0 255 ECU_ADDRESS 0 SYMBOL_LINK "Rte_DiagcMgr_DiagcMgrNtcFltAry[9].AgiCntr" 0 DISPLAY_IDENTIFIER DiagcMgr.PerInstanceMemories.DiagcMgrNtcFltAry[9].AgiCntr /end MEASUREMENT
/begin MEASUREMENT DiagcMgr.DiagcMgrNtcFltAry[9].NtcNr "MICROSAR RTE" UWORD RTE_CM_ENUM_NtcNrWithResd1 0 0 0 65535 ECU_ADDRESS 0 SYMBOL_LINK "Rte_DiagcMgr_DiagcMgrNtcFltAry[9].NtcNr" 0 DISPLAY_IDENTIFIER DiagcMgr.PerInstanceMemories.DiagcMgrNtcFltAry[9].NtcNr /end MEASUREMENT
/begin MEASUREMENT DiagcMgr.DiagcMgrNtcFltAry[9].Sts "MICROSAR RTE" UBYTE NO_COMPU_METHOD 0 0 0 255 ECU_ADDRESS 0 SYMBOL_LINK "Rte_DiagcMgr_DiagcMgrNtcFltAry[9].Sts" 0 DISPLAY_IDENTIFIER DiagcMgr.PerInstanceMemories.DiagcMgrNtcFltAry[9].Sts /end MEASUREMENT
/begin MEASUREMENT DiagcMgr.DiagcStsCtrldShtDwnFltPrsnt.Logl "MICROSAR RTE" UBYTE RTE_CM_BOOLEAN 0 0 0 255 ECU_ADDRESS 0 SYMBOL_LINK "Rte_DiagcMgr_DiagcStsCtrldShtDwnFltPrsnt_Logl" 0 DISPLAY_IDENTIFIER DiagcMgr.SenderPorts.DiagcStsCtrldShtDwnFltPrsnt.Logl /end MEASUREMENT
/begin MEASUREMENT DiagcMgr.DiagcStsNonRcvrlReqDiFltPrsnt.Logl "MICROSAR RTE" UBYTE RTE_CM_BOOLEAN 0 0 0 255 ECU_ADDRESS 0 SYMBOL_LINK "Rte_DiagcMgr_DiagcStsNonRcvrlReqDiFltPrsnt_Logl" 0 DISPLAY_IDENTIFIER DiagcMgr.SenderPorts.DiagcStsNonRcvrlReqDiFltPrsnt.Logl /end MEASUREMENT
/begin MEASUREMENT DiagcMgr.DtcEnaSts "MICROSAR RTE" UWORD NO_COMPU_METHOD 0 0 0 65535 ECU_ADDRESS 0 SYMBOL_LINK "Rte_DiagcMgr_DtcEnaSts" 0 DISPLAY_IDENTIFIER DiagcMgr.PerInstanceMemories.DtcEnaSts /end MEASUREMENT
/begin MEASUREMENT DiagcMgr.EcuTFild.Val "MICROSAR RTE" FLOAT32_IEEE NO_COMPU_METHOD 0 0 -3.402823466e+38 3.402823466e+38 ECU_ADDRESS 0 SYMBOL_LINK "Rte_EcuTMeas_EcuTFild_Val" 0 DISPLAY_IDENTIFIER DiagcMgr.ReceiverPorts.EcuTFild.Val /end MEASUREMENT
/begin MEASUREMENT DiagcMgr.HwTq.Val "MICROSAR RTE" FLOAT32_IEEE NO_COMPU_METHOD 0 0 -3.402823466e+38 3.402823466e+38 ECU_ADDRESS 0 SYMBOL_LINK "Rte_ImcSigArbn_HwTqImcCorrd_Val" 0 DISPLAY_IDENTIFIER DiagcMgr.ReceiverPorts.HwTq.Val /end MEASUREMENT
/begin MEASUREMENT DiagcMgr.IgnCntr.Val "MICROSAR RTE" ULONG NO_COMPU_METHOD 0 0 0 4294967295 ECU_ADDRESS 0 SYMBOL_LINK "Rte_CmnMfgSrv_IgnCntr_Val" 0 DISPLAY_IDENTIFIER DiagcMgr.ReceiverPorts.IgnCntr.Val /end MEASUREMENT
/begin MEASUREMENT DiagcMgr.MfgDiagcInhb.Logl "MICROSAR RTE" UBYTE RTE_CM_BOOLEAN 0 0 0 255 ECU_ADDRESS 0 SYMBOL_LINK "Rte_CmnMfgSrv_MfgDiagcInhb_Logl" 0 DISPLAY_IDENTIFIER DiagcMgr.ReceiverPorts.MfgDiagcInhb.Logl /end MEASUREMENT
/begin MEASUREMENT DiagcMgr.MotTqCmdMrfScad.Val "MICROSAR RTE" FLOAT32_IEEE NO_COMPU_METHOD 0 0 -3.402823466e+38 3.402823466e+38 ECU_ADDRESS 0 SYMBOL_LINK "Rte_MotTqCmdSca_MotTqCmdMrfScad_Val" 0 DISPLAY_IDENTIFIER DiagcMgr.ReceiverPorts.MotTqCmdMrfScad.Val /end MEASUREMENT
/begin MEASUREMENT DiagcMgr.PrevClrDtcFlg "MICROSAR RTE" UBYTE NO_COMPU_METHOD 0 0 0 255 ECU_ADDRESS 0 SYMBOL_LINK "Rte_DiagcMgr_PrevClrDtcFlg" 0 DISPLAY_IDENTIFIER DiagcMgr.PerInstanceMemories.PrevClrDtcFlg /end MEASUREMENT
/begin MEASUREMENT DiagcMgr.SwApplCrc.Val "MICROSAR RTE" ULONG NO_COMPU_METHOD 0 0 0 4294967295 ECU_ADDRESS 0 SYMBOL_LINK "Rte_CDD_FlsMem_SwApplCrc_Val" 0 DISPLAY_IDENTIFIER DiagcMgr.ReceiverPorts.SwApplCrc.Val /end MEASUREMENT
/begin MEASUREMENT DiagcMgr.SysDiMotTqCmdSca.Val "MICROSAR RTE" FLOAT32_IEEE NO_COMPU_METHOD 0 0 -3.402823466e+38 3.402823466e+38 ECU_ADDRESS 0 SYMBOL_LINK "Rte_DiagcMgr_SysDiMotTqCmdSca_Val" 0 DISPLAY_IDENTIFIER DiagcMgr.SenderPorts.SysDiMotTqCmdSca.Val /end MEASUREMENT
/begin MEASUREMENT DiagcMgr.SysDiRampRate.Val "MICROSAR RTE" FLOAT32_IEEE NO_COMPU_METHOD 0 0 -3.402823466e+38 3.402823466e+38 ECU_ADDRESS 0 SYMBOL_LINK "Rte_DiagcMgr_SysDiRampRate_Val" 0 DISPLAY_IDENTIFIER DiagcMgr.SenderPorts.SysDiRampRate.Val /end MEASUREMENT
/begin MEASUREMENT DiagcMgr.SysSt.Val "MICROSAR RTE" UBYTE RTE_CM_ENUM_SysSt1 0 0 0 255 ECU_ADDRESS 0 SYMBOL_LINK "Rte_SysStMod_SysSt_Val" 0 DISPLAY_IDENTIFIER DiagcMgr.ReceiverPorts.SysSt.Val /end MEASUREMENT
/begin MEASUREMENT DiagcMgr.SysStFltOutpReqDi.Logl "MICROSAR RTE" UBYTE RTE_CM_BOOLEAN 0 0 0 255 ECU_ADDRESS 0 SYMBOL_LINK "Rte_DiagcMgr_SysStFltOutpReqDi_Logl" 0 DISPLAY_IDENTIFIER DiagcMgr.SenderPorts.SysStFltOutpReqDi.Logl /end MEASUREMENT
/begin MEASUREMENT DiagcMgrProxyAppl10.ClrDiagcFlgProxy.Val "MICROSAR RTE" UBYTE NO_COMPU_METHOD 0 0 0 255 ECU_ADDRESS 0 SYMBOL_LINK "Rte_DiagcMgr_ClrDiagcFlgProxy_Val" 0 DISPLAY_IDENTIFIER DiagcMgrProxyAppl10.ReceiverPorts.ClrDiagcFlgProxy.Val /end MEASUREMENT
/begin MEASUREMENT DiagcMgrProxyAppl10.DiagcData10.ActvMotTqCmdSca "MICROSAR RTE" FLOAT32_IEEE NO_COMPU_METHOD 0 0 -3.402823466e+38 3.402823466e+38 ECU_ADDRESS 0 SYMBOL_LINK "Rte_DiagcMgrProxyAppl10_DiagcData10.ActvMotTqCmdSca" 0 DISPLAY_IDENTIFIER DiagcMgrProxyAppl10.PerInstanceMemories.DiagcData10.ActvMotTqCmdSca /end MEASUREMENT
/begin MEASUREMENT DiagcMgrProxyAppl10.DiagcData10.ActvRampRate "MICROSAR RTE" FLOAT32_IEEE NO_COMPU_METHOD 0 0 -3.402823466e+38 3.402823466e+38 ECU_ADDRESS 0 SYMBOL_LINK "Rte_DiagcMgrProxyAppl10_DiagcData10.ActvRampRate" 0 DISPLAY_IDENTIFIER DiagcMgrProxyAppl10.PerInstanceMemories.DiagcData10.ActvRampRate /end MEASUREMENT
/begin MEASUREMENT DiagcMgrProxyAppl10.DiagcData10.DiagcSts "MICROSAR RTE" UBYTE NO_COMPU_METHOD 0 0 0 255 ECU_ADDRESS 0 SYMBOL_LINK "Rte_DiagcMgrProxyAppl10_DiagcData10.DiagcSts" 0 DISPLAY_IDENTIFIER DiagcMgrProxyAppl10.PerInstanceMemories.DiagcData10.DiagcSts /end MEASUREMENT
/begin MEASUREMENT DiagcMgrProxyAppl10.PrevClrNtcFlg10 "MICROSAR RTE" UBYTE NO_COMPU_METHOD 0 0 0 255 ECU_ADDRESS 0 SYMBOL_LINK "Rte_DiagcMgrProxyAppl10_PrevClrNtcFlg10" 0 DISPLAY_IDENTIFIER DiagcMgrProxyAppl10.PerInstanceMemories.PrevClrNtcFlg10 /end MEASUREMENT
/begin MEASUREMENT DiagcMgrProxyAppl10.ProxySetNtcData10.ActvMotTqCmdSca "MICROSAR RTE" FLOAT32_IEEE NO_COMPU_METHOD 0 0 -3.402823466e+38 3.402823466e+38 ECU_ADDRESS 0 SYMBOL_LINK "Rte_DiagcMgrProxyAppl10_ProxySetNtcData10.ActvMotTqCmdSca" 0 DISPLAY_IDENTIFIER DiagcMgrProxyAppl10.PerInstanceMemories.ProxySetNtcData10.ActvMotTqCmdSca /end MEASUREMENT
/begin MEASUREMENT DiagcMgrProxyAppl10.ProxySetNtcData10.ActvRampRate "MICROSAR RTE" FLOAT32_IEEE NO_COMPU_METHOD 0 0 -3.402823466e+38 3.402823466e+38 ECU_ADDRESS 0 SYMBOL_LINK "Rte_DiagcMgrProxyAppl10_ProxySetNtcData10.ActvRampRate" 0 DISPLAY_IDENTIFIER DiagcMgrProxyAppl10.PerInstanceMemories.ProxySetNtcData10.ActvRampRate /end MEASUREMENT
/begin MEASUREMENT DiagcMgrProxyAppl10.ProxySetNtcData10.DiagcSts "MICROSAR RTE" UBYTE NO_COMPU_METHOD 0 0 0 255 ECU_ADDRESS 0 SYMBOL_LINK "Rte_DiagcMgrProxyAppl10_ProxySetNtcData10.DiagcSts" 0 DISPLAY_IDENTIFIER DiagcMgrProxyAppl10.PerInstanceMemories.ProxySetNtcData10.DiagcSts /end MEASUREMENT
/begin MEASUREMENT DrvrTqEstimn.AssiMechPolarity.Val "MICROSAR RTE" SBYTE NO_COMPU_METHOD 0 0 -128 127 ECU_ADDRESS 0 SYMBOL_LINK "Rte_PolarityCfg_AssiMechPolarity_Val" 0 DISPLAY_IDENTIFIER DrvrTqEstimn.ReceiverPorts.AssiMechPolarity.Val /end MEASUREMENT
/begin MEASUREMENT DrvrTqEstimn.DrvrTqEstimd.Val "MICROSAR RTE" FLOAT32_IEEE NO_COMPU_METHOD 0 0 -3.402823466e+38 3.402823466e+38 ECU_ADDRESS 0 SYMBOL_LINK "Rte_DrvrTqEstimn_DrvrTqEstimd_Val" 0 DISPLAY_IDENTIFIER DrvrTqEstimn.SenderPorts.DrvrTqEstimd.Val /end MEASUREMENT
/begin MEASUREMENT DrvrTqEstimn.DrvrTqStPrev "MICROSAR RTE" FLOAT32_IEEE NO_COMPU_METHOD 0 0 -3.402823466e+38 3.402823466e+38 MATRIX_DIM 5 1 1 ECU_ADDRESS 0 SYMBOL_LINK "Rte_DrvrTqEstimn_DrvrTqStPrev" 0 DISPLAY_IDENTIFIER DrvrTqEstimn.PerInstanceMemories.DrvrTqStPrev /end MEASUREMENT
/begin MEASUREMENT DrvrTqEstimn.HwAg.Val "MICROSAR RTE" FLOAT32_IEEE NO_COMPU_METHOD 0 0 -3.402823466e+38 3.402823466e+38 ECU_ADDRESS 0 SYMBOL_LINK "Rte_ImcSigArbn_HwAgImcCorrd_Val" 0 DISPLAY_IDENTIFIER DrvrTqEstimn.ReceiverPorts.HwAg.Val /end MEASUREMENT
/begin MEASUREMENT DrvrTqEstimn.HwTq.Val "MICROSAR RTE" FLOAT32_IEEE NO_COMPU_METHOD 0 0 -3.402823466e+38 3.402823466e+38 ECU_ADDRESS 0 SYMBOL_LINK "Rte_ImcSigArbn_HwTqImcCorrd_Val" 0 DISPLAY_IDENTIFIER DrvrTqEstimn.ReceiverPorts.HwTq.Val /end MEASUREMENT
/begin MEASUREMENT DrvrTqEstimn.MotTqCmdPwrLimd.Val "MICROSAR RTE" FLOAT32_IEEE NO_COMPU_METHOD 0 0 -3.402823466e+38 3.402823466e+38 ECU_ADDRESS 0 SYMBOL_LINK "Rte_PwrLimr_MotTqCmdPwrLimd_Val" 0 DISPLAY_IDENTIFIER DrvrTqEstimn.ReceiverPorts.MotTqCmdPwrLimd.Val /end MEASUREMENT
/begin MEASUREMENT DrvrTqEstimn.MotVelCrf.Val "MICROSAR RTE" FLOAT32_IEEE NO_COMPU_METHOD 0 0 -3.402823466e+38 3.402823466e+38 ECU_ADDRESS 0 SYMBOL_LINK "Rte_ImcSigArbn_MotVelCrfImcCorrd_Val" 0 DISPLAY_IDENTIFIER DrvrTqEstimn.ReceiverPorts.MotVelCrf.Val /end MEASUREMENT
/begin MEASUREMENT DualCtrlrOutpMgr.DualEcuFltMtgtnEna.Logl "MICROSAR RTE" UBYTE RTE_CM_BOOLEAN 0 0 0 255 ECU_ADDRESS 0 SYMBOL_LINK "Rte_DualCtrlrOutpMgr_DualEcuFltMtgtnEna_Logl" 0 DISPLAY_IDENTIFIER DualCtrlrOutpMgr.SenderPorts.DualEcuFltMtgtnEna.Logl /end MEASUREMENT
/begin MEASUREMENT DualCtrlrOutpMgr.DualEcuFltMtgtnSca.Val "MICROSAR RTE" FLOAT32_IEEE NO_COMPU_METHOD 0 0 -3.402823466e+38 3.402823466e+38 ECU_ADDRESS 0 SYMBOL_LINK "Rte_DualCtrlrOutpMgr_DualEcuFltMtgtnSca_Val" 0 DISPLAY_IDENTIFIER DualCtrlrOutpMgr.SenderPorts.DualEcuFltMtgtnSca.Val /end MEASUREMENT
/begin MEASUREMENT DualCtrlrOutpMgr.DualEcuMotCtrlMtgtnEna.Logl "MICROSAR RTE" UBYTE RTE_CM_BOOLEAN 0 0 0 255 ECU_ADDRESS 0 SYMBOL_LINK "Rte_DualCtrlrOutpMgr_DualEcuMotCtrlMtgtnEna_Logl" 0 DISPLAY_IDENTIFIER DualCtrlrOutpMgr.SenderPorts.DualEcuMotCtrlMtgtnEna.Logl /end MEASUREMENT
/begin MEASUREMENT DualCtrlrOutpMgr.FltLrngEnaPrev "MICROSAR RTE" UBYTE RTE_CM_BOOLEAN 0 0 0 255 ECU_ADDRESS 0 SYMBOL_LINK "Rte_DualCtrlrOutpMgr_FltLrngEnaPrev" 0 DISPLAY_IDENTIFIER DualCtrlrOutpMgr.PerInstanceMemories.FltLrngEnaPrev /end MEASUREMENT
/begin MEASUREMENT DualCtrlrOutpMgr.FltRefTiEnaLrng "MICROSAR RTE" ULONG NO_COMPU_METHOD 0 0 0 4294967295 ECU_ADDRESS 0 SYMBOL_LINK "Rte_DualCtrlrOutpMgr_FltRefTiEnaLrng" 0 DISPLAY_IDENTIFIER DualCtrlrOutpMgr.PerInstanceMemories.FltRefTiEnaLrng /end MEASUREMENT
/begin MEASUREMENT DualCtrlrOutpMgr.FltStsPrev "MICROSAR RTE" UBYTE RTE_CM_BOOLEAN 0 0 0 255 ECU_ADDRESS 0 SYMBOL_LINK "Rte_DualCtrlrOutpMgr_FltStsPrev" 0 DISPLAY_IDENTIFIER DualCtrlrOutpMgr.PerInstanceMemories.FltStsPrev /end MEASUREMENT
/begin MEASUREMENT DualCtrlrOutpMgr.ImcSysSt.Val "MICROSAR RTE" UBYTE RTE_CM_ENUM_SysSt1 0 0 0 255 ECU_ADDRESS 0 SYMBOL_LINK "Rte_ImcSigArbn_ImcSysSt_Val" 0 DISPLAY_IDENTIFIER DualCtrlrOutpMgr.ReceiverPorts.ImcSysSt.Val /end MEASUREMENT
/begin MEASUREMENT DualCtrlrOutpMgr.ImcSysStVld.Val "MICROSAR RTE" UBYTE RTE_CM_ENUM_ImcArbnRxSts1 0 0 0 255 ECU_ADDRESS 0 SYMBOL_LINK "Rte_DualCtrlrOutpMgr_ImcSysStVld_Val" 0 DISPLAY_IDENTIFIER DualCtrlrOutpMgr.ReceiverPorts.ImcSysStVld.Val /end MEASUREMENT
/begin MEASUREMENT DualCtrlrOutpMgr.LtchImcDualEcuMotCtrlMtgtnEnaPrev "MICROSAR RTE" UBYTE RTE_CM_BOOLEAN 0 0 0 255 ECU_ADDRESS 0 SYMBOL_LINK "Rte_DualCtrlrOutpMgr_LtchImcDualEcuMotCtrlMtgtnEnaPrev" 0 DISPLAY_IDENTIFIER DualCtrlrOutpMgr.PerInstanceMemories.LtchImcDualEcuMotCtrlMtgtnEnaPrev /end MEASUREMENT
/begin MEASUREMENT DualCtrlrOutpMgr.LtchRefTiEnaLrng "MICROSAR RTE" ULONG NO_COMPU_METHOD 0 0 0 4294967295 ECU_ADDRESS 0 SYMBOL_LINK "Rte_DualCtrlrOutpMgr_LtchRefTiEnaLrng" 0 DISPLAY_IDENTIFIER DualCtrlrOutpMgr.PerInstanceMemories.LtchRefTiEnaLrng /end MEASUREMENT
/begin MEASUREMENT DualCtrlrOutpMgr.LtchSysStPrev "MICROSAR RTE" UBYTE RTE_CM_BOOLEAN 0 0 0 255 ECU_ADDRESS 0 SYMBOL_LINK "Rte_DualCtrlrOutpMgr_LtchSysStPrev" 0 DISPLAY_IDENTIFIER DualCtrlrOutpMgr.PerInstanceMemories.LtchSysStPrev /end MEASUREMENT
/begin MEASUREMENT DualCtrlrOutpMgr.MaxOutpRefTiEna "MICROSAR RTE" ULONG NO_COMPU_METHOD 0 0 0 4294967295 ECU_ADDRESS 0 SYMBOL_LINK "Rte_DualCtrlrOutpMgr_MaxOutpRefTiEna" 0 DISPLAY_IDENTIFIER DualCtrlrOutpMgr.PerInstanceMemories.MaxOutpRefTiEna /end MEASUREMENT
/begin MEASUREMENT DualCtrlrOutpMgr.MaxOutpTmrCmpl "MICROSAR RTE" UBYTE RTE_CM_BOOLEAN 0 0 0 255 ECU_ADDRESS 0 SYMBOL_LINK "Rte_DualCtrlrOutpMgr_MaxOutpTmrCmpl" 0 DISPLAY_IDENTIFIER DualCtrlrOutpMgr.PerInstanceMemories.MaxOutpTmrCmpl /end MEASUREMENT
/begin MEASUREMENT DualCtrlrOutpMgr.MotAndThermProtnLoaMod.Val "MICROSAR RTE" UBYTE NO_COMPU_METHOD 0 0 0 255 ECU_ADDRESS 0 SYMBOL_LINK "Rte_LoaMgr_MotAndThermProtnLoaMod_Val" 0 DISPLAY_IDENTIFIER DualCtrlrOutpMgr.ReceiverPorts.MotAndThermProtnLoaMod.Val /end MEASUREMENT
/begin MEASUREMENT DualCtrlrOutpMgr.NonRecFltEnaPrev "MICROSAR RTE" UBYTE RTE_CM_BOOLEAN 0 0 0 255 ECU_ADDRESS 0 SYMBOL_LINK "Rte_DualCtrlrOutpMgr_NonRecFltEnaPrev" 0 DISPLAY_IDENTIFIER DualCtrlrOutpMgr.PerInstanceMemories.NonRecFltEnaPrev /end MEASUREMENT
/begin MEASUREMENT DualCtrlrOutpMgr.NonRecFltRefTiEnaLrng "MICROSAR RTE" ULONG NO_COMPU_METHOD 0 0 0 4294967295 ECU_ADDRESS 0 SYMBOL_LINK "Rte_DualCtrlrOutpMgr_NonRecFltRefTiEnaLrng" 0 DISPLAY_IDENTIFIER DualCtrlrOutpMgr.PerInstanceMemories.NonRecFltRefTiEnaLrng /end MEASUREMENT
/begin MEASUREMENT DualCtrlrOutpMgr.OutpSca "MICROSAR RTE" FLOAT32_IEEE NO_COMPU_METHOD 0 0 -3.402823466e+38 3.402823466e+38 ECU_ADDRESS 0 SYMBOL_LINK "Rte_DualCtrlrOutpMgr_OutpSca" 0 DISPLAY_IDENTIFIER DualCtrlrOutpMgr.PerInstanceMemories.OutpSca /end MEASUREMENT
/begin MEASUREMENT DualCtrlrOutpMgr.PrevLtch "MICROSAR RTE" UBYTE RTE_CM_BOOLEAN 0 0 0 255 ECU_ADDRESS 0 SYMBOL_LINK "Rte_DualCtrlrOutpMgr_PrevLtch" 0 DISPLAY_IDENTIFIER DualCtrlrOutpMgr.PerInstanceMemories.PrevLtch /end MEASUREMENT
/begin MEASUREMENT DualCtrlrOutpMgr.PrevLtchNonRecFlt "MICROSAR RTE" UBYTE RTE_CM_BOOLEAN 0 0 0 255 ECU_ADDRESS 0 SYMBOL_LINK "Rte_DualCtrlrOutpMgr_PrevLtchNonRecFlt" 0 DISPLAY_IDENTIFIER DualCtrlrOutpMgr.PerInstanceMemories.PrevLtchNonRecFlt /end MEASUREMENT
/begin MEASUREMENT DualCtrlrOutpMgr.RefTiEnaLrng "MICROSAR RTE" ULONG NO_COMPU_METHOD 0 0 0 4294967295 ECU_ADDRESS 0 SYMBOL_LINK "Rte_DualCtrlrOutpMgr_RefTiEnaLrng" 0 DISPLAY_IDENTIFIER DualCtrlrOutpMgr.PerInstanceMemories.RefTiEnaLrng /end MEASUREMENT
/begin MEASUREMENT DualCtrlrOutpMgr.SysSt.Val "MICROSAR RTE" UBYTE RTE_CM_ENUM_SysSt1 0 0 0 255 ECU_ADDRESS 0 SYMBOL_LINK "Rte_SysStMod_SysSt_Val" 0 DISPLAY_IDENTIFIER DualCtrlrOutpMgr.ReceiverPorts.SysSt.Val /end MEASUREMENT
/begin MEASUREMENT DualCtrlrOutpMgr.SysStLrngEnaPrev "MICROSAR RTE" UBYTE RTE_CM_BOOLEAN 0 0 0 255 ECU_ADDRESS 0 SYMBOL_LINK "Rte_DualCtrlrOutpMgr_SysStLrngEnaPrev" 0 DISPLAY_IDENTIFIER DualCtrlrOutpMgr.PerInstanceMemories.SysStLrngEnaPrev /end MEASUREMENT
/begin MEASUREMENT DualCtrlrOutpMgr.SysStRefTiEnaLrng "MICROSAR RTE" ULONG NO_COMPU_METHOD 0 0 0 4294967295 ECU_ADDRESS 0 SYMBOL_LINK "Rte_DualCtrlrOutpMgr_SysStRefTiEnaLrng" 0 DISPLAY_IDENTIFIER DualCtrlrOutpMgr.PerInstanceMemories.SysStRefTiEnaLrng /end MEASUREMENT
/begin MEASUREMENT DualCtrlrOutpMgr.VehSpd.Val "MICROSAR RTE" FLOAT32_IEEE NO_COMPU_METHOD 0 0 -3.402823466e+38 3.402823466e+38 ECU_ADDRESS 0 SYMBOL_LINK "Rte_ImcSigArbn_VehSpdImcCorrd_Val" 0 DISPLAY_IDENTIFIER DualCtrlrOutpMgr.ReceiverPorts.VehSpd.Val /end MEASUREMENT
/begin MEASUREMENT DualEcuIdn.EcuComTiOut.Logl "MICROSAR RTE" UBYTE RTE_CM_BOOLEAN 0 0 0 255 ECU_ADDRESS 0 SYMBOL_LINK "Rte_DualEcuIdn_EcuComTiOut_Logl" 0 DISPLAY_IDENTIFIER DualEcuIdn.ReceiverPorts.EcuComTiOut.Logl /end MEASUREMENT
/begin MEASUREMENT DualEcuIdn.EcuId.Val "MICROSAR RTE" UBYTE NO_COMPU_METHOD 0 0 0 255 ECU_ADDRESS 0 SYMBOL_LINK "Rte_DualEcuIdn_EcuId_Val" 0 DISPLAY_IDENTIFIER DualEcuIdn.SenderPorts.EcuId.Val /end MEASUREMENT
/begin MEASUREMENT DualEcuIdn.EcuIdInt "MICROSAR RTE" UBYTE NO_COMPU_METHOD 0 0 0 255 ECU_ADDRESS 0 SYMBOL_LINK "Rte_DualEcuIdn_EcuIdInt" 0 DISPLAY_IDENTIFIER DualEcuIdn.PerInstanceMemories.EcuIdInt /end MEASUREMENT
/begin MEASUREMENT DualEcuIdn.EcuIdnEvlnCmpl "MICROSAR RTE" UBYTE RTE_CM_BOOLEAN 0 0 0 255 ECU_ADDRESS 0 SYMBOL_LINK "Rte_DualEcuIdn_EcuIdnEvlnCmpl" 0 DISPLAY_IDENTIFIER DualEcuIdn.PerInstanceMemories.EcuIdnEvlnCmpl /end MEASUREMENT
/begin MEASUREMENT DualEcuIdn.SecdryEcuIdnReqTiOutCntr "MICROSAR RTE" UBYTE NO_COMPU_METHOD 0 0 0 255 ECU_ADDRESS 0 SYMBOL_LINK "Rte_DualEcuIdn_SecdryEcuIdnReqTiOutCntr" 0 DISPLAY_IDENTIFIER DualEcuIdn.PerInstanceMemories.SecdryEcuIdnReqTiOutCntr /end MEASUREMENT
/begin MEASUREMENT DutyCycThermProtn.AbsltTLimSlewStVari "MICROSAR RTE" FLOAT32_IEEE NO_COMPU_METHOD 0 0 -3.402823466e+38 3.402823466e+38 ECU_ADDRESS 0 SYMBOL_LINK "Rte_DutyCycThermProtn_AbsltTLimSlewStVari" 0 DISPLAY_IDENTIFIER DutyCycThermProtn.PerInstanceMemories.AbsltTLimSlewStVari /end MEASUREMENT
/begin GROUP CustDiag.DidEE00 "MICROSAR RTE" /begin SUB_GROUP /end SUB_GROUP /begin FUNCTION_LIST /end FUNCTION_LIST /begin REF_CHARACTERISTIC /end REF_CHARACTERISTIC /begin REF_MEASUREMENT CustDiag.DidEE00 /end REF_MEASUREMENT /end GROUP
/begin GROUP CustDiag.DidEE00Dft "MICROSAR RTE" /begin SUB_GROUP /end SUB_GROUP /begin FUNCTION_LIST /end FUNCTION_LIST /begin REF_CHARACTERISTIC CustDiag.DidEE00Dft /end REF_CHARACTERISTIC /begin REF_MEASUREMENT /end REF_MEASUREMENT /end GROUP
/begin GROUP CustDiag.DidEE01 "MICROSAR RTE" /begin SUB_GROUP /end SUB_GROUP /begin FUNCTION_LIST /end FUNCTION_LIST /begin REF_CHARACTERISTIC /end REF_CHARACTERISTIC /begin REF_MEASUREMENT CustDiag.DidEE01 /end REF_MEASUREMENT /end GROUP
/begin GROUP CustDiag.DidEE01Dft "MICROSAR RTE" /begin SUB_GROUP /end SUB_GROUP /begin FUNCTION_LIST /end FUNCTION_LIST /begin REF_CHARACTERISTIC CustDiag.DidEE01Dft /end REF_CHARACTERISTIC /begin REF_MEASUREMENT /end REF_MEASUREMENT /end GROUP
/begin GROUP CustDiag.DidEE02 "MICROSAR RTE" /begin SUB_GROUP /end SUB_GROUP /begin FUNCTION_LIST /end FUNCTION_LIST /begin REF_CHARACTERISTIC /end REF_CHARACTERISTIC /begin REF_MEASUREMENT CustDiag.DidEE02 /end REF_MEASUREMENT /end GROUP
/begin GROUP CustDiag.DidEE02Dft "MICROSAR RTE" /begin SUB_GROUP /end SUB_GROUP /begin FUNCTION_LIST /end FUNCTION_LIST /begin REF_CHARACTERISTIC CustDiag.DidEE02Dft /end REF_CHARACTERISTIC /begin REF_MEASUREMENT /end REF_MEASUREMENT /end GROUP
/begin GROUP CustDiag.DidEE21 "MICROSAR RTE" /begin SUB_GROUP /end SUB_GROUP /begin FUNCTION_LIST /end FUNCTION_LIST /begin REF_CHARACTERISTIC /end REF_CHARACTERISTIC /begin REF_MEASUREMENT CustDiag.DidEE21 /end REF_MEASUREMENT /end GROUP
/begin GROUP CustDiag.DidEE21Dft "MICROSAR RTE" /begin SUB_GROUP /end SUB_GROUP /begin FUNCTION_LIST /end FUNCTION_LIST /begin REF_CHARACTERISTIC CustDiag.DidEE21Dft /end REF_CHARACTERISTIC /begin REF_MEASUREMENT /end REF_MEASUREMENT /end GROUP
/begin GROUP CustDiag.DidEE22 "MICROSAR RTE" /begin SUB_GROUP /end SUB_GROUP /begin FUNCTION_LIST /end FUNCTION_LIST /begin REF_CHARACTERISTIC /end REF_CHARACTERISTIC /begin REF_MEASUREMENT CustDiag.DidEE22 /end REF_MEASUREMENT /end GROUP
/begin GROUP CustDiag.DidEE22Dft "MICROSAR RTE" /begin SUB_GROUP /end SUB_GROUP /begin FUNCTION_LIST /end FUNCTION_LIST /begin REF_CHARACTERISTIC CustDiag.DidEE22Dft /end REF_CHARACTERISTIC /begin REF_MEASUREMENT /end REF_MEASUREMENT /end GROUP
/begin GROUP CustDiag.DidEE23 "MICROSAR RTE" /begin SUB_GROUP /end SUB_GROUP /begin FUNCTION_LIST /end FUNCTION_LIST /begin REF_CHARACTERISTIC /end REF_CHARACTERISTIC /begin REF_MEASUREMENT CustDiag.DidEE23 /end REF_MEASUREMENT /end GROUP
/begin GROUP CustDiag.DidEE23Dft "MICROSAR RTE" /begin SUB_GROUP /end SUB_GROUP /begin FUNCTION_LIST /end FUNCTION_LIST /begin REF_CHARACTERISTIC CustDiag.DidEE23Dft /end REF_CHARACTERISTIC /begin REF_MEASUREMENT /end REF_MEASUREMENT /end GROUP
/begin GROUP CustDiag.DidEE40 "MICROSAR RTE" /begin SUB_GROUP /end SUB_GROUP /begin FUNCTION_LIST /end FUNCTION_LIST /begin REF_CHARACTERISTIC /end REF_CHARACTERISTIC /begin REF_MEASUREMENT CustDiag.DidEE40 /end REF_MEASUREMENT /end GROUP
/begin GROUP CustDiag.DidEE40Dft "MICROSAR RTE" /begin SUB_GROUP /end SUB_GROUP /begin FUNCTION_LIST /end FUNCTION_LIST /begin REF_CHARACTERISTIC CustDiag.DidEE40Dft /end REF_CHARACTERISTIC /begin REF_MEASUREMENT /end REF_MEASUREMENT /end GROUP
/begin GROUP CustDiag.DidEE41 "MICROSAR RTE" /begin SUB_GROUP /end SUB_GROUP /begin FUNCTION_LIST /end FUNCTION_LIST /begin REF_CHARACTERISTIC /end REF_CHARACTERISTIC /begin REF_MEASUREMENT CustDiag.DidEE41 /end REF_MEASUREMENT /end GROUP
/begin GROUP CustDiag.DidEE41Dft "MICROSAR RTE" /begin SUB_GROUP /end SUB_GROUP /begin FUNCTION_LIST /end FUNCTION_LIST /begin REF_CHARACTERISTIC CustDiag.DidEE41Dft /end REF_CHARACTERISTIC /begin REF_MEASUREMENT /end REF_MEASUREMENT /end GROUP
/begin GROUP CustDiag.DidEE81 "MICROSAR RTE" /begin SUB_GROUP /end SUB_GROUP /begin FUNCTION_LIST /end FUNCTION_LIST /begin REF_CHARACTERISTIC /end REF_CHARACTERISTIC /begin REF_MEASUREMENT CustDiag.DidEE81 /end REF_MEASUREMENT /end GROUP
/begin GROUP CustDiag.DidEE81Dft "MICROSAR RTE" /begin SUB_GROUP /end SUB_GROUP /begin FUNCTION_LIST /end FUNCTION_LIST /begin REF_CHARACTERISTIC CustDiag.DidEE81Dft /end REF_CHARACTERISTIC /begin REF_MEASUREMENT /end REF_MEASUREMENT /end GROUP
/begin GROUP CustDiag.DidEE82 "MICROSAR RTE" /begin SUB_GROUP /end SUB_GROUP /begin FUNCTION_LIST /end FUNCTION_LIST /begin REF_CHARACTERISTIC /end REF_CHARACTERISTIC /begin REF_MEASUREMENT CustDiag.DidEE82 /end REF_MEASUREMENT /end GROUP
/begin GROUP CustDiag.DidEE82Dft "MICROSAR RTE" /begin SUB_GROUP /end SUB_GROUP /begin FUNCTION_LIST /end FUNCTION_LIST /begin REF_CHARACTERISTIC CustDiag.DidEE82Dft /end REF_CHARACTERISTIC /begin REF_MEASUREMENT /end REF_MEASUREMENT /end GROUP
/begin GROUP CustDiag.DidEE83 "MICROSAR RTE" /begin SUB_GROUP /end SUB_GROUP /begin FUNCTION_LIST /end FUNCTION_LIST /begin REF_CHARACTERISTIC /end REF_CHARACTERISTIC /begin REF_MEASUREMENT CustDiag.DidEE83 /end REF_MEASUREMENT /end GROUP
/begin GROUP CustDiag.DidEE83Dft "MICROSAR RTE" /begin SUB_GROUP /end SUB_GROUP /begin FUNCTION_LIST /end FUNCTION_LIST /begin REF_CHARACTERISTIC CustDiag.DidEE83Dft /end REF_CHARACTERISTIC /begin REF_MEASUREMENT /end REF_MEASUREMENT /end GROUP
/begin GROUP CustDiag.DidEE84 "MICROSAR RTE" /begin SUB_GROUP /end SUB_GROUP /begin FUNCTION_LIST /end FUNCTION_LIST /begin REF_CHARACTERISTIC /end REF_CHARACTERISTIC /begin REF_MEASUREMENT CustDiag.DidEE84 /end REF_MEASUREMENT /end GROUP
/begin GROUP CustDiag.DidEE84Dft "MICROSAR RTE" /begin SUB_GROUP /end SUB_GROUP /begin FUNCTION_LIST /end FUNCTION_LIST /begin REF_CHARACTERISTIC CustDiag.DidEE84Dft /end REF_CHARACTERISTIC /begin REF_MEASUREMENT /end REF_MEASUREMENT /end GROUP
/begin GROUP CustDiag.DidEE85 "MICROSAR RTE" /begin SUB_GROUP /end SUB_GROUP /begin FUNCTION_LIST /end FUNCTION_LIST /begin REF_CHARACTERISTIC /end REF_CHARACTERISTIC /begin REF_MEASUREMENT CustDiag.DidEE85 /end REF_MEASUREMENT /end GROUP
/begin GROUP CustDiag.DidEE85Dft "MICROSAR RTE" /begin SUB_GROUP /end SUB_GROUP /begin FUNCTION_LIST /end FUNCTION_LIST /begin REF_CHARACTERISTIC CustDiag.DidEE85Dft /end REF_CHARACTERISTIC /begin REF_MEASUREMENT /end REF_MEASUREMENT /end GROUP
/begin GROUP CustDiag.DidEE86 "MICROSAR RTE" /begin SUB_GROUP /end SUB_GROUP /begin FUNCTION_LIST /end FUNCTION_LIST /begin REF_CHARACTERISTIC /end REF_CHARACTERISTIC /begin REF_MEASUREMENT CustDiag.DidEE86 /end REF_MEASUREMENT /end GROUP
/begin GROUP CustDiag.DidEE86Dft "MICROSAR RTE" /begin SUB_GROUP /end SUB_GROUP /begin FUNCTION_LIST /end FUNCTION_LIST /begin REF_CHARACTERISTIC CustDiag.DidEE86Dft /end REF_CHARACTERISTIC /begin REF_MEASUREMENT /end REF_MEASUREMENT /end GROUP
/begin GROUP CustDiag.DidEE87 "MICROSAR RTE" /begin SUB_GROUP /end SUB_GROUP /begin FUNCTION_LIST /end FUNCTION_LIST /begin REF_CHARACTERISTIC /end REF_CHARACTERISTIC /begin REF_MEASUREMENT CustDiag.DidEE87 /end REF_MEASUREMENT /end GROUP
/begin GROUP CustDiag.DidEE87Dft "MICROSAR RTE" /begin SUB_GROUP /end SUB_GROUP /begin FUNCTION_LIST /end FUNCTION_LIST /begin REF_CHARACTERISTIC CustDiag.DidEE87Dft /end REF_CHARACTERISTIC /begin REF_MEASUREMENT /end REF_MEASUREMENT /end GROUP
/begin GROUP CustDiag.DidEE88 "MICROSAR RTE" /begin SUB_GROUP /end SUB_GROUP /begin FUNCTION_LIST /end FUNCTION_LIST /begin REF_CHARACTERISTIC /end REF_CHARACTERISTIC /begin REF_MEASUREMENT CustDiag.DidEE88 /end REF_MEASUREMENT /end GROUP
/begin GROUP CustDiag.DidEE88Dft "MICROSAR RTE" /begin SUB_GROUP /end SUB_GROUP /begin FUNCTION_LIST /end FUNCTION_LIST /begin REF_CHARACTERISTIC CustDiag.DidEE88Dft /end REF_CHARACTERISTIC /begin REF_MEASUREMENT /end REF_MEASUREMENT /end GROUP
/begin GROUP CustDiag.DidEED0 "MICROSAR RTE" /begin SUB_GROUP /end SUB_GROUP /begin FUNCTION_LIST /end FUNCTION_LIST /begin REF_CHARACTERISTIC /end REF_CHARACTERISTIC /begin REF_MEASUREMENT CustDiag.DidEED0 /end REF_MEASUREMENT /end GROUP
/begin GROUP CustDiag.DidEED0Dft "MICROSAR RTE" /begin SUB_GROUP /end SUB_GROUP /begin FUNCTION_LIST /end FUNCTION_LIST /begin REF_CHARACTERISTIC CustDiag.DidEED0Dft /end REF_CHARACTERISTIC /begin REF_MEASUREMENT /end REF_MEASUREMENT /end GROUP
/begin GROUP CustDiag.DidF110 "MICROSAR RTE" /begin SUB_GROUP /end SUB_GROUP /begin FUNCTION_LIST /end FUNCTION_LIST /begin REF_CHARACTERISTIC /end REF_CHARACTERISTIC /begin REF_MEASUREMENT CustDiag.DidF110 /end REF_MEASUREMENT /end GROUP
/begin GROUP CustDiag.DidF110Dft "MICROSAR RTE" /begin SUB_GROUP /end SUB_GROUP /begin FUNCTION_LIST /end FUNCTION_LIST /begin REF_CHARACTERISTIC CustDiag.DidF110Dft /end REF_CHARACTERISTIC /begin REF_MEASUREMENT /end REF_MEASUREMENT /end GROUP
/begin GROUP CustDiag.DidF111 "MICROSAR RTE" /begin SUB_GROUP /end SUB_GROUP /begin FUNCTION_LIST /end FUNCTION_LIST /begin REF_CHARACTERISTIC /end REF_CHARACTERISTIC /begin REF_MEASUREMENT CustDiag.DidF111 /end REF_MEASUREMENT /end GROUP
/begin GROUP CustDiag.DidF111Dft "MICROSAR RTE" /begin SUB_GROUP /end SUB_GROUP /begin FUNCTION_LIST /end FUNCTION_LIST /begin REF_CHARACTERISTIC CustDiag.DidF111Dft /end REF_CHARACTERISTIC /begin REF_MEASUREMENT /end REF_MEASUREMENT /end GROUP
/begin GROUP CustDiag.DidF113 "MICROSAR RTE" /begin SUB_GROUP /end SUB_GROUP /begin FUNCTION_LIST /end FUNCTION_LIST /begin REF_CHARACTERISTIC /end REF_CHARACTERISTIC /begin REF_MEASUREMENT CustDiag.DidF113 /end REF_MEASUREMENT /end GROUP
/begin GROUP CustDiag.DidF113Dft "MICROSAR RTE" /begin SUB_GROUP /end SUB_GROUP /begin FUNCTION_LIST /end FUNCTION_LIST /begin REF_CHARACTERISTIC CustDiag.DidF113Dft /end REF_CHARACTERISTIC /begin REF_MEASUREMENT /end REF_MEASUREMENT /end GROUP
/begin GROUP CustDiag.DidF15F "MICROSAR RTE" /begin SUB_GROUP /end SUB_GROUP /begin FUNCTION_LIST /end FUNCTION_LIST /begin REF_CHARACTERISTIC /end REF_CHARACTERISTIC /begin REF_MEASUREMENT CustDiag.DidF15F /end REF_MEASUREMENT /end GROUP
/begin GROUP CustDiag.DidF15FDft "MICROSAR RTE" /begin SUB_GROUP /end SUB_GROUP /begin FUNCTION_LIST /end FUNCTION_LIST /begin REF_CHARACTERISTIC CustDiag.DidF15FDft /end REF_CHARACTERISTIC /begin REF_MEASUREMENT /end REF_MEASUREMENT /end GROUP
/begin GROUP CustDiag.DidF162 "MICROSAR RTE" /begin SUB_GROUP /end SUB_GROUP /begin FUNCTION_LIST /end FUNCTION_LIST /begin REF_CHARACTERISTIC /end REF_CHARACTERISTIC /begin REF_MEASUREMENT CustDiag.DidF162 /end REF_MEASUREMENT /end GROUP
/begin GROUP CustDiag.DidF162Dft "MICROSAR RTE" /begin SUB_GROUP /end SUB_GROUP /begin FUNCTION_LIST /end FUNCTION_LIST /begin REF_CHARACTERISTIC CustDiag.DidF162Dft /end REF_CHARACTERISTIC /begin REF_MEASUREMENT /end REF_MEASUREMENT /end GROUP
/begin GROUP CustDiag.DidF163 "MICROSAR RTE" /begin SUB_GROUP /end SUB_GROUP /begin FUNCTION_LIST /end FUNCTION_LIST /begin REF_CHARACTERISTIC /end REF_CHARACTERISTIC /begin REF_MEASUREMENT CustDiag.DidF163 /end REF_MEASUREMENT /end GROUP
/begin GROUP CustDiag.DidF163Dft "MICROSAR RTE" /begin SUB_GROUP /end SUB_GROUP /begin FUNCTION_LIST /end FUNCTION_LIST /begin REF_CHARACTERISTIC CustDiag.DidF163Dft /end REF_CHARACTERISTIC /begin REF_MEASUREMENT /end REF_MEASUREMENT /end GROUP
/begin GROUP CustDiag.DidF166 "MICROSAR RTE" /begin SUB_GROUP /end SUB_GROUP /begin FUNCTION_LIST /end FUNCTION_LIST /begin REF_CHARACTERISTIC /end REF_CHARACTERISTIC /begin REF_MEASUREMENT CustDiag.DidF166 /end REF_MEASUREMENT /end GROUP
/begin GROUP CustDiag.DidF166Dft "MICROSAR RTE" /begin SUB_GROUP /end SUB_GROUP /begin FUNCTION_LIST /end FUNCTION_LIST /begin REF_CHARACTERISTIC CustDiag.DidF166Dft /end REF_CHARACTERISTIC /begin REF_MEASUREMENT /end REF_MEASUREMENT /end GROUP
/begin GROUP CustDiag.DidF18A "MICROSAR RTE" /begin SUB_GROUP /end SUB_GROUP /begin FUNCTION_LIST /end FUNCTION_LIST /begin REF_CHARACTERISTIC /end REF_CHARACTERISTIC /begin REF_MEASUREMENT CustDiag.DidF18A /end REF_MEASUREMENT /end GROUP
/begin GROUP CustDiag.DidF18ADft "MICROSAR RTE" /begin SUB_GROUP /end SUB_GROUP /begin FUNCTION_LIST /end FUNCTION_LIST /begin REF_CHARACTERISTIC CustDiag.DidF18ADft /end REF_CHARACTERISTIC /begin REF_MEASUREMENT /end REF_MEASUREMENT /end GROUP
/begin GROUP CustDiag.DidF18C "MICROSAR RTE" /begin SUB_GROUP /end SUB_GROUP /begin FUNCTION_LIST /end FUNCTION_LIST /begin REF_CHARACTERISTIC /end REF_CHARACTERISTIC /begin REF_MEASUREMENT CustDiag.DidF18C /end REF_MEASUREMENT /end GROUP
/begin GROUP CustDiag.DidF18CDft "MICROSAR RTE" /begin SUB_GROUP /end SUB_GROUP /begin FUNCTION_LIST /end FUNCTION_LIST /begin REF_CHARACTERISTIC CustDiag.DidF18CDft /end REF_CHARACTERISTIC /begin REF_MEASUREMENT /end REF_MEASUREMENT /end GROUP
/begin GROUP CustDiag.DidF190 "MICROSAR RTE" /begin SUB_GROUP /end SUB_GROUP /begin FUNCTION_LIST /end FUNCTION_LIST /begin REF_CHARACTERISTIC /end REF_CHARACTERISTIC /begin REF_MEASUREMENT CustDiag.DidF190 /end REF_MEASUREMENT /end GROUP
/begin GROUP CustDiag.DidF190Dft "MICROSAR RTE" /begin SUB_GROUP /end SUB_GROUP /begin FUNCTION_LIST /end FUNCTION_LIST /begin REF_CHARACTERISTIC CustDiag.DidF190Dft /end REF_CHARACTERISTIC /begin REF_MEASUREMENT /end REF_MEASUREMENT /end GROUP
/begin GROUP CustDiag.EcuId "MICROSAR RTE" /begin SUB_GROUP /end SUB_GROUP /begin FUNCTION_LIST /end FUNCTION_LIST /begin REF_CHARACTERISTIC /end REF_CHARACTERISTIC /begin REF_MEASUREMENT CustDiag.EcuId /end REF_MEASUREMENT /end GROUP
/begin GROUP CustDiag.EcuId.Val "MICROSAR RTE" /begin SUB_GROUP /end SUB_GROUP /begin FUNCTION_LIST /end FUNCTION_LIST /begin REF_CHARACTERISTIC /end REF_CHARACTERISTIC /begin REF_MEASUREMENT CustDiag.EcuId.Val /end REF_MEASUREMENT /end GROUP
/begin GROUP CustDiag.EcuResetMode "MICROSAR RTE" /begin SUB_GROUP /end SUB_GROUP /begin FUNCTION_LIST /end FUNCTION_LIST /begin REF_CHARACTERISTIC /end REF_CHARACTERISTIC /begin REF_MEASUREMENT CustDiag.EcuResetMode /end REF_MEASUREMENT /end GROUP
/begin GROUP CustDiag.EcuTFild.Val "MICROSAR RTE" /begin SUB_GROUP /end SUB_GROUP /begin FUNCTION_LIST /end FUNCTION_LIST /begin REF_CHARACTERISTIC /end REF_CHARACTERISTIC /begin REF_MEASUREMENT CustDiag.EcuTFild.Val /end REF_MEASUREMENT /end GROUP
/begin GROUP CustDiag.EolByteNTCPara "MICROSAR RTE" /begin SUB_GROUP /end SUB_GROUP /begin FUNCTION_LIST /end FUNCTION_LIST /begin REF_CHARACTERISTIC /end REF_CHARACTERISTIC /begin REF_MEASUREMENT CustDiag.EolByteNTCPara /end REF_MEASUREMENT /end GROUP
/begin GROUP CustDiag.FordAbsPrsnt.Logl "MICROSAR RTE" /begin SUB_GROUP /end SUB_GROUP /begin FUNCTION_LIST /end FUNCTION_LIST /begin REF_CHARACTERISTIC /end REF_CHARACTERISTIC /begin REF_MEASUREMENT CustDiag.FordAbsPrsnt.Logl /end REF_MEASUREMENT /end GROUP
/begin GROUP CustDiag.FordActvNiblCtrlEnad.Logl "MICROSAR RTE" /begin SUB_GROUP /end SUB_GROUP /begin FUNCTION_LIST /end FUNCTION_LIST /begin REF_CHARACTERISTIC /end REF_CHARACTERISTIC /begin REF_MEASUREMENT CustDiag.FordActvNiblCtrlEnad.Logl /end REF_MEASUREMENT /end GROUP
/begin GROUP CustDiag.FordActvParkAssiEnad.Logl "MICROSAR RTE" /begin SUB_GROUP /end SUB_GROUP /begin FUNCTION_LIST /end FUNCTION_LIST /begin REF_CHARACTERISTIC /end REF_CHARACTERISTIC /begin REF_MEASUREMENT CustDiag.FordActvParkAssiEnad.Logl /end REF_MEASUREMENT /end GROUP
/begin GROUP CustDiag.FordActvRtnEnad.Logl "MICROSAR RTE" /begin SUB_GROUP /end SUB_GROUP /begin FUNCTION_LIST /end FUNCTION_LIST /begin REF_CHARACTERISTIC /end REF_CHARACTERISTIC /begin REF_MEASUREMENT CustDiag.FordActvRtnEnad.Logl /end REF_MEASUREMENT /end GROUP
/begin GROUP CustDiag.FordAfsEquid.Logl "MICROSAR RTE" /begin SUB_GROUP /end SUB_GROUP /begin FUNCTION_LIST /end FUNCTION_LIST /begin REF_CHARACTERISTIC /end REF_CHARACTERISTIC /begin REF_MEASUREMENT CustDiag.FordAfsEquid.Logl /end REF_MEASUREMENT /end GROUP
/begin GROUP CustDiag.FordAppldFinalMotTq.Val "MICROSAR RTE" /begin SUB_GROUP /end SUB_GROUP /begin FUNCTION_LIST /end FUNCTION_LIST /begin REF_CHARACTERISTIC /end REF_CHARACTERISTIC /begin REF_MEASUREMENT CustDiag.FordAppldFinalMotTq.Val /end REF_MEASUREMENT /end GROUP
/begin GROUP CustDiag.FordBrkPlsRejctnEnad.Logl "MICROSAR RTE" /begin SUB_GROUP /end SUB_GROUP /begin FUNCTION_LIST /end FUNCTION_LIST /begin REF_CHARACTERISTIC /end REF_CHARACTERISTIC /begin REF_MEASUREMENT CustDiag.FordBrkPlsRejctnEnad.Logl /end REF_MEASUREMENT /end GROUP
/begin GROUP CustDiag.FordCmpdHwPosn.Val "MICROSAR RTE" /begin SUB_GROUP /end SUB_GROUP /begin FUNCTION_LIST /end FUNCTION_LIST /begin REF_CHARACTERISTIC /end REF_CHARACTERISTIC /begin REF_MEASUREMENT CustDiag.FordCmpdHwPosn.Val /end REF_MEASUREMENT /end GROUP
/begin GROUP CustDiag.FordDrvrSteerRcmdnEnad.Logl "MICROSAR RTE" /begin SUB_GROUP /end SUB_GROUP /begin FUNCTION_LIST /end FUNCTION_LIST /begin REF_CHARACTERISTIC /end REF_CHARACTERISTIC /begin REF_MEASUREMENT CustDiag.FordDrvrSteerRcmdnEnad.Logl /end REF_MEASUREMENT /end GROUP
/begin GROUP CustDiag.FordEngTqClass.Val "MICROSAR RTE" /begin SUB_GROUP /end SUB_GROUP /begin FUNCTION_LIST /end FUNCTION_LIST /begin REF_CHARACTERISTIC /end REF_CHARACTERISTIC /begin REF_MEASUREMENT CustDiag.FordEngTqClass.Val /end REF_MEASUREMENT /end GROUP
/begin GROUP CustDiag.FordEpsCurr.Val "MICROSAR RTE" /begin SUB_GROUP /end SUB_GROUP /begin FUNCTION_LIST /end FUNCTION_LIST /begin REF_CHARACTERISTIC /end REF_CHARACTERISTIC /begin REF_MEASUREMENT CustDiag.FordEpsCurr.Val /end REF_MEASUREMENT /end GROUP
/begin GROUP CustDiag.FordEpsLifeCycMod.Val "MICROSAR RTE" /begin SUB_GROUP /end SUB_GROUP /begin FUNCTION_LIST /end FUNCTION_LIST /begin REF_CHARACTERISTIC /end REF_CHARACTERISTIC /begin REF_MEASUREMENT CustDiag.FordEpsLifeCycMod.Val /end REF_MEASUREMENT /end GROUP
/begin GROUP CustDiag.FordEpsSysSt.Val "MICROSAR RTE" /begin SUB_GROUP /end SUB_GROUP /begin FUNCTION_LIST /end FUNCTION_LIST /begin REF_CHARACTERISTIC /end REF_CHARACTERISTIC /begin REF_MEASUREMENT CustDiag.FordEpsSysSt.Val /end REF_MEASUREMENT /end GROUP
/begin GROUP CustDiag.FordEpsVltg.Val "MICROSAR RTE" /begin SUB_GROUP /end SUB_GROUP /begin FUNCTION_LIST /end FUNCTION_LIST /begin REF_CHARACTERISTIC /end REF_CHARACTERISTIC /begin REF_MEASUREMENT CustDiag.FordEpsVltg.Val /end REF_MEASUREMENT /end GROUP
/begin GROUP CustDiag.FordEscPrsnt.Logl "MICROSAR RTE" /begin SUB_GROUP /end SUB_GROUP /begin FUNCTION_LIST /end FUNCTION_LIST /begin REF_CHARACTERISTIC /end REF_CHARACTERISTIC /begin REF_MEASUREMENT CustDiag.FordEscPrsnt.Logl /end REF_MEASUREMENT /end GROUP
/begin GROUP CustDiag.FordEvasSteerAssiEnad.Logl "MICROSAR RTE" /begin SUB_GROUP /end SUB_GROUP /begin FUNCTION_LIST /end FUNCTION_LIST /begin REF_CHARACTERISTIC /end REF_CHARACTERISTIC /begin REF_MEASUREMENT CustDiag.FordEvasSteerAssiEnad.Logl /end REF_MEASUREMENT /end GROUP
/begin GROUP CustDiag.FordInpTqRaw.Val "MICROSAR RTE" /begin SUB_GROUP /end SUB_GROUP /begin FUNCTION_LIST /end FUNCTION_LIST /begin REF_CHARACTERISTIC /end REF_CHARACTERISTIC /begin REF_MEASUREMENT CustDiag.FordInpTqRaw.Val /end REF_MEASUREMENT /end GROUP
/begin GROUP CustDiag.FordLaneCentrAssiEnad.Logl "MICROSAR RTE" /begin SUB_GROUP /end SUB_GROUP /begin FUNCTION_LIST /end FUNCTION_LIST /begin REF_CHARACTERISTIC /end REF_CHARACTERISTIC /begin REF_MEASUREMENT CustDiag.FordLaneCentrAssiEnad.Logl /end REF_MEASUREMENT /end GROUP
/begin GROUP CustDiag.FordLaneDprtrWarnEnad.Logl "MICROSAR RTE" /begin SUB_GROUP /end SUB_GROUP /begin FUNCTION_LIST /end FUNCTION_LIST /begin REF_CHARACTERISTIC /end REF_CHARACTERISTIC /begin REF_MEASUREMENT CustDiag.FordLaneDprtrWarnEnad.Logl /end REF_MEASUREMENT /end GROUP
/begin GROUP CustDiag.FordLaneKeepAssiEnad.Logl "MICROSAR RTE" /begin SUB_GROUP /end SUB_GROUP /begin FUNCTION_LIST /end FUNCTION_LIST /begin REF_CHARACTERISTIC /end REF_CHARACTERISTIC /begin REF_MEASUREMENT CustDiag.FordLaneKeepAssiEnad.Logl /end REF_MEASUREMENT /end GROUP
/begin GROUP CustDiag.FordMaxBattCurr.Val "MICROSAR RTE" /begin SUB_GROUP /end SUB_GROUP /begin FUNCTION_LIST /end FUNCTION_LIST /begin REF_CHARACTERISTIC /end REF_CHARACTERISTIC /begin REF_MEASUREMENT CustDiag.FordMaxBattCurr.Val /end REF_MEASUREMENT /end GROUP
/begin GROUP CustDiag.FordMinBattVltg.Val "MICROSAR RTE" /begin SUB_GROUP /end SUB_GROUP /begin FUNCTION_LIST /end FUNCTION_LIST /begin REF_CHARACTERISTIC /end REF_CHARACTERISTIC /begin REF_MEASUREMENT CustDiag.FordMinBattVltg.Val /end REF_MEASUREMENT /end GROUP
/begin GROUP CustDiag.FordPullDriftCmpEnad.Logl "MICROSAR RTE" /begin SUB_GROUP /end SUB_GROUP /begin FUNCTION_LIST /end FUNCTION_LIST /begin REF_CHARACTERISTIC /end REF_CHARACTERISTIC /begin REF_MEASUREMENT CustDiag.FordPullDriftCmpEnad.Logl /end REF_MEASUREMENT /end GROUP
/begin GROUP CustDiag.FordResrchFctEnad.Logl "MICROSAR RTE" /begin SUB_GROUP /end SUB_GROUP /begin FUNCTION_LIST /end FUNCTION_LIST /begin REF_CHARACTERISTIC /end REF_CHARACTERISTIC /begin REF_MEASUREMENT CustDiag.FordResrchFctEnad.Logl /end REF_MEASUREMENT /end GROUP
/begin GROUP CustDiag.FordSelDrvModEnad.Logl "MICROSAR RTE" /begin SUB_GROUP /end SUB_GROUP /begin FUNCTION_LIST /end FUNCTION_LIST /begin REF_CHARACTERISTIC /end REF_CHARACTERISTIC /begin REF_MEASUREMENT CustDiag.FordSelDrvModEnad.Logl /end REF_MEASUREMENT /end GROUP
/begin GROUP CustDiag.FordSoftEndStopEnad.Logl "MICROSAR RTE" /begin SUB_GROUP /end SUB_GROUP /begin FUNCTION_LIST /end FUNCTION_LIST /begin REF_CHARACTERISTIC /end REF_CHARACTERISTIC /begin REF_MEASUREMENT CustDiag.FordSoftEndStopEnad.Logl /end REF_MEASUREMENT /end GROUP
/begin GROUP CustDiag.FordSrvPullDriftCmpRstVal.Val "MICROSAR RTE" /begin SUB_GROUP /end SUB_GROUP /begin FUNCTION_LIST /end FUNCTION_LIST /begin REF_CHARACTERISTIC /end REF_CHARACTERISTIC /begin REF_MEASUREMENT CustDiag.FordSrvPullDriftCmpRstVal.Val /end REF_MEASUREMENT /end GROUP
/begin GROUP CustDiag.FordStrtStopSt.Val "MICROSAR RTE" /begin SUB_GROUP /end SUB_GROUP /begin FUNCTION_LIST /end FUNCTION_LIST /begin REF_CHARACTERISTIC /end REF_CHARACTERISTIC /begin REF_MEASUREMENT CustDiag.FordStrtStopSt.Val /end REF_MEASUREMENT /end GROUP
/begin GROUP CustDiag.FordTqSteerCmpEnad.Logl "MICROSAR RTE" /begin SUB_GROUP /end SUB_GROUP /begin FUNCTION_LIST /end FUNCTION_LIST /begin REF_CHARACTERISTIC /end REF_CHARACTERISTIC /begin REF_MEASUREMENT CustDiag.FordTqSteerCmpEnad.Logl /end REF_MEASUREMENT /end GROUP
/begin GROUP CustDiag.FordTrfcJamAssiEnad.Logl "MICROSAR RTE" /begin SUB_GROUP /end SUB_GROUP /begin FUNCTION_LIST /end FUNCTION_LIST /begin REF_CHARACTERISTIC /end REF_CHARACTERISTIC /begin REF_MEASUREMENT CustDiag.FordTrfcJamAssiEnad.Logl /end REF_MEASUREMENT /end GROUP
/begin GROUP CustDiag.FordTrlrBackupAssi5WhlEnad.Logl "MICROSAR RTE" /begin SUB_GROUP /end SUB_GROUP /begin FUNCTION_LIST /end FUNCTION_LIST /begin REF_CHARACTERISTIC /end REF_CHARACTERISTIC /begin REF_MEASUREMENT CustDiag.FordTrlrBackupAssi5WhlEnad.Logl /end REF_MEASUREMENT /end GROUP
/begin GROUP CustDiag.FordTrlrBackupAssiEnad.Logl "MICROSAR RTE" /begin SUB_GROUP /end SUB_GROUP /begin FUNCTION_LIST /end FUNCTION_LIST /begin REF_CHARACTERISTIC /end REF_CHARACTERISTIC /begin REF_MEASUREMENT CustDiag.FordTrlrBackupAssiEnad.Logl /end REF_MEASUREMENT /end GROUP
/begin GROUP CustDiag.FordTrlrBackupAssiTrigEnad.Logl "MICROSAR RTE" /begin SUB_GROUP /end SUB_GROUP /begin FUNCTION_LIST /end FUNCTION_LIST /begin REF_CHARACTERISTIC /end REF_CHARACTERISTIC /begin REF_MEASUREMENT CustDiag.FordTrlrBackupAssiTrigEnad.Logl /end REF_MEASUREMENT /end GROUP
/begin GROUP CustDiag.FordVehGlbRealTi.Val "MICROSAR RTE" /begin SUB_GROUP /end SUB_GROUP /begin FUNCTION_LIST /end FUNCTION_LIST /begin REF_CHARACTERISTIC /end REF_CHARACTERISTIC /begin REF_MEASUREMENT CustDiag.FordVehGlbRealTi.Val /end REF_MEASUREMENT /end GROUP
/begin GROUP CustDiag.FordVehIdnNr.Ary1D "MICROSAR RTE" /begin SUB_GROUP /end SUB_GROUP /begin FUNCTION_LIST /end FUNCTION_LIST /begin REF_CHARACTERISTIC /end REF_CHARACTERISTIC /begin REF_MEASUREMENT CustDiag.FordVehIdnNr.Ary1D /end REF_MEASUREMENT /end GROUP
/begin GROUP CustDiag.FordVehOdom.Val "MICROSAR RTE" /begin SUB_GROUP /end SUB_GROUP /begin FUNCTION_LIST /end FUNCTION_LIST /begin REF_CHARACTERISTIC /end REF_CHARACTERISTIC /begin REF_MEASUREMENT CustDiag.FordVehOdom.Val /end REF_MEASUREMENT /end GROUP
/begin GROUP CustDiag.FordVehSpdLoQly.Val "MICROSAR RTE" /begin SUB_GROUP /end SUB_GROUP /begin FUNCTION_LIST /end FUNCTION_LIST /begin REF_CHARACTERISTIC /end REF_CHARACTERISTIC /begin REF_MEASUREMENT CustDiag.FordVehSpdLoQly.Val /end REF_MEASUREMENT /end GROUP
/begin GROUP CustDiag.FordVehSpdLoQlyVld.Logl "MICROSAR RTE" /begin SUB_GROUP /end SUB_GROUP /begin FUNCTION_LIST /end FUNCTION_LIST /begin REF_CHARACTERISTIC /end REF_CHARACTERISTIC /begin REF_MEASUREMENT CustDiag.FordVehSpdLoQlyVld.Logl /end REF_MEASUREMENT /end GROUP
/begin GROUP CustDiag.FordVehSteerPinionAgOffs.Val "MICROSAR RTE" /begin SUB_GROUP /end SUB_GROUP /begin FUNCTION_LIST /end FUNCTION_LIST /begin REF_CHARACTERISTIC /end REF_CHARACTERISTIC /begin REF_MEASUREMENT CustDiag.FordVehSteerPinionAgOffs.Val /end REF_MEASUREMENT /end GROUP
/begin GROUP CustDiag.HwVelToSerlCom.Val "MICROSAR RTE" /begin SUB_GROUP /end SUB_GROUP /begin FUNCTION_LIST /end FUNCTION_LIST /begin REF_CHARACTERISTIC /end REF_CHARACTERISTIC /begin REF_MEASUREMENT CustDiag.HwVelToSerlCom.Val /end REF_MEASUREMENT /end GROUP
/begin GROUP CustDiag.IgnCntr.Val "MICROSAR RTE" /begin SUB_GROUP /end SUB_GROUP /begin FUNCTION_LIST /end FUNCTION_LIST /begin REF_CHARACTERISTIC /end REF_CHARACTERISTIC /begin REF_MEASUREMENT CustDiag.IgnCntr.Val /end REF_MEASUREMENT /end GROUP
/begin GROUP CustDiag.MaxCurr "MICROSAR RTE" /begin SUB_GROUP /end SUB_GROUP /begin FUNCTION_LIST /end FUNCTION_LIST /begin REF_CHARACTERISTIC /end REF_CHARACTERISTIC /begin REF_MEASUREMENT CustDiag.MaxCurr /end REF_MEASUREMENT /end GROUP
/begin GROUP CustDiag.MaxTemp "MICROSAR RTE" /begin SUB_GROUP /end SUB_GROUP /begin FUNCTION_LIST /end FUNCTION_LIST /begin REF_CHARACTERISTIC /end REF_CHARACTERISTIC /begin REF_MEASUREMENT CustDiag.MaxTemp /end REF_MEASUREMENT /end GROUP
/begin GROUP CustDiag.MinVltg "MICROSAR RTE" /begin SUB_GROUP /end SUB_GROUP /begin FUNCTION_LIST /end FUNCTION_LIST /begin REF_CHARACTERISTIC /end REF_CHARACTERISTIC /begin REF_MEASUREMENT CustDiag.MinVltg /end REF_MEASUREMENT /end GROUP
/begin GROUP CustDiag.ModeProvidePorts "MICROSAR RTE"
 /begin SUB_GROUP CustDiag.BswM_MSI_BswMEcuResetMod.BswM_MDGP_BswMEcuResetMod /end SUB_GROUP
 /begin FUNCTION_LIST /end FUNCTION_LIST
 /begin REF_CHARACTERISTIC /end REF_CHARACTERISTIC
 /begin REF_MEASUREMENT /end REF_MEASUREMENT
/end GROUP
/begin GROUP CustDiag.MotCurrQax.Val "MICROSAR RTE" /begin SUB_GROUP /end SUB_GROUP /begin FUNCTION_LIST /end FUNCTION_LIST /begin REF_CHARACTERISTIC /end REF_CHARACTERISTIC /begin REF_MEASUREMENT CustDiag.MotCurrQax.Val /end REF_MEASUREMENT /end GROUP
/begin GROUP CustDiag.NxtrCalIdsCal0DevlpDesc.Ary1D "MICROSAR RTE" /begin SUB_GROUP /end SUB_GROUP /begin FUNCTION_LIST /end FUNCTION_LIST /begin REF_CHARACTERISTIC CustDiag.NxtrCalIdsCal0DevlpDesc.Ary1D /end REF_CHARACTERISTIC /begin REF_MEASUREMENT /end REF_MEASUREMENT /end GROUP
/begin GROUP CustDiag.NxtrCalIdsCal1DevlpDesc.Ary1D "MICROSAR RTE" /begin SUB_GROUP /end SUB_GROUP /begin FUNCTION_LIST /end FUNCTION_LIST /begin REF_CHARACTERISTIC CustDiag.NxtrCalIdsCal1DevlpDesc.Ary1D /end REF_CHARACTERISTIC /begin REF_MEASUREMENT /end REF_MEASUREMENT /end GROUP
/begin GROUP CustDiag.PerInstanceMemories "MICROSAR RTE"
 /begin SUB_GROUP CustDiag.ClrDiagcReq CustDiag.Did205A CustDiag.Did205B CustDiag.Did3003 CustDiag.Did301A CustDiag.Did630F CustDiag.Did630FChk CustDiag.DidDE00 CustDiag.DidDE01 CustDiag.DidDE02 CustDiag.DidDE03 CustDiag.DidDE04 CustDiag.DidDE05 CustDiag.DidEE00 CustDiag.DidEE01 CustDiag.DidEE02 CustDiag.DidEE21 CustDiag.DidEE22 CustDiag.DidEE23 CustDiag.DidEE40 CustDiag.DidEE41 CustDiag.DidEE81 CustDiag.DidEE82 CustDiag.DidEE83 CustDiag.DidEE84 CustDiag.DidEE85 CustDiag.DidEE86 CustDiag.DidEE87 CustDiag.DidEE88 CustDiag.DidEED0 CustDiag.DidF110 CustDiag.DidF111 CustDiag.DidF113 CustDiag.DidF15F CustDiag.DidF162 CustDiag.DidF163 CustDiag.DidF166 CustDiag.DidF18A CustDiag.DidF18C CustDiag.DidF190 CustDiag.EcuId CustDiag.EcuResetMode CustDiag.EolByteNTCPara CustDiag.MaxCurr CustDiag.MaxTemp CustDiag.MinVltg CustDiag.ReqDelayCnt CustDiag.RstReq CustDiag.RstStrt CustDiag.Rtn0202Strt CustDiag.RtnDC00Req /end SUB_GROUP
 /begin FUNCTION_LIST /end FUNCTION_LIST
 /begin REF_CHARACTERISTIC /end REF_CHARACTERISTIC
 /begin REF_MEASUREMENT /end REF_MEASUREMENT
/end GROUP
/begin GROUP CustDiag.ReceiverPorts "MICROSAR RTE"
 /begin SUB_GROUP CustDiag.EcuId.Val CustDiag.EcuTFild.Val CustDiag.FordAppldFinalMotTq.Val CustDiag.FordCmpdHwPosn.Val CustDiag.FordEpsCurr.Val CustDiag.FordEpsLifeCycMod.Val CustDiag.FordEpsSysSt.Val CustDiag.FordEpsVltg.Val CustDiag.FordInpTqRaw.Val CustDiag.FordMaxBattCurr.Val CustDiag.FordMinBattVltg.Val CustDiag.FordVehGlbRealTi.Val CustDiag.FordVehIdnNr.Ary1D CustDiag.FordVehOdom.Val CustDiag.FordVehSpdLoQly.Val CustDiag.FordVehSpdLoQlyVld.Logl CustDiag.FordVehSteerPinionAgOffs.Val CustDiag.HwVelToSerlCom.Val CustDiag.IgnCntr.Val CustDiag.MotCurrQax.Val CustDiag.VehSpd.Val /end SUB_GROUP
 /begin FUNCTION_LIST /end FUNCTION_LIST
 /begin REF_CHARACTERISTIC /end REF_CHARACTERISTIC
 /begin REF_MEASUREMENT /end REF_MEASUREMENT
/end GROUP
/begin GROUP CustDiag.ReqDelayCnt "MICROSAR RTE" /begin SUB_GROUP /end SUB_GROUP /begin FUNCTION_LIST /end FUNCTION_LIST /begin REF_CHARACTERISTIC /end REF_CHARACTERISTIC /begin REF_MEASUREMENT CustDiag.ReqDelayCnt /end REF_MEASUREMENT /end GROUP
/begin GROUP CustDiag.RstReq "MICROSAR RTE" /begin SUB_GROUP /end SUB_GROUP /begin FUNCTION_LIST /end FUNCTION_LIST /begin REF_CHARACTERISTIC /end REF_CHARACTERISTIC /begin REF_MEASUREMENT CustDiag.RstReq /end REF_MEASUREMENT /end GROUP
/begin GROUP CustDiag.RstReq.Val "MICROSAR RTE" /begin SUB_GROUP /end SUB_GROUP /begin FUNCTION_LIST /end FUNCTION_LIST /begin REF_CHARACTERISTIC /end REF_CHARACTERISTIC /begin REF_MEASUREMENT CustDiag.RstReq.Val /end REF_MEASUREMENT /end GROUP
/begin GROUP CustDiag.RstStrt "MICROSAR RTE" /begin SUB_GROUP /end SUB_GROUP /begin FUNCTION_LIST /end FUNCTION_LIST /begin REF_CHARACTERISTIC /end REF_CHARACTERISTIC /begin REF_MEASUREMENT CustDiag.RstStrt /end REF_MEASUREMENT /end GROUP
/begin GROUP CustDiag.Rtn0202Strt "MICROSAR RTE" /begin SUB_GROUP /end SUB_GROUP /begin FUNCTION_LIST /end FUNCTION_LIST /begin REF_CHARACTERISTIC /end REF_CHARACTERISTIC /begin REF_MEASUREMENT CustDiag.Rtn0202Strt /end REF_MEASUREMENT /end GROUP
/begin GROUP CustDiag.RtnDC00Req "MICROSAR RTE" /begin SUB_GROUP /end SUB_GROUP /begin FUNCTION_LIST /end FUNCTION_LIST /begin REF_CHARACTERISTIC /end REF_CHARACTERISTIC /begin REF_MEASUREMENT CustDiag.RtnDC00Req /end REF_MEASUREMENT /end GROUP
/begin GROUP CustDiag.RtnDC00Req.Val "MICROSAR RTE" /begin SUB_GROUP /end SUB_GROUP /begin FUNCTION_LIST /end FUNCTION_LIST /begin REF_CHARACTERISTIC /end REF_CHARACTERISTIC /begin REF_MEASUREMENT CustDiag.RtnDC00Req.Val /end REF_MEASUREMENT /end GROUP
/begin GROUP CustDiag.SenderPorts "MICROSAR RTE"
 /begin SUB_GROUP CustDiag.ClrDiagcReq.Val CustDiag.CustXcpEna.Logl CustDiag.FordAbsPrsnt.Logl CustDiag.FordActvNiblCtrlEnad.Logl CustDiag.FordActvParkAssiEnad.Logl CustDiag.FordActvRtnEnad.Logl CustDiag.FordAfsEquid.Logl CustDiag.FordBrkPlsRejctnEnad.Logl CustDiag.FordDrvrSteerRcmdnEnad.Logl CustDiag.FordEngTqClass.Val CustDiag.FordEscPrsnt.Logl CustDiag.FordEvasSteerAssiEnad.Logl CustDiag.FordLaneCentrAssiEnad.Logl CustDiag.FordLaneDprtrWarnEnad.Logl CustDiag.FordLaneKeepAssiEnad.Logl CustDiag.FordPullDriftCmpEnad.Logl CustDiag.FordResrchFctEnad.Logl CustDiag.FordSelDrvModEnad.Logl CustDiag.FordSoftEndStopEnad.Logl CustDiag.FordSrvPullDriftCmpRstVal.Val CustDiag.FordStrtStopSt.Val CustDiag.FordTqSteerCmpEnad.Logl CustDiag.FordTrfcJamAssiEnad.Logl CustDiag.FordTrlrBackupAssi5WhlEnad.Logl CustDiag.FordTrlrBackupAssiEnad.Logl CustDiag.FordTrlrBackupAssiTrigEnad.Logl CustDiag.RstReq.Val CustDiag.RtnDC00Req.Val /end SUB_GROUP
 /begin FUNCTION_LIST /end FUNCTION_LIST
 /begin REF_CHARACTERISTIC /end REF_CHARACTERISTIC
 /begin REF_MEASUREMENT /end REF_MEASUREMENT
/end GROUP
/begin GROUP CustDiag.VehSpd.Val "MICROSAR RTE" /begin SUB_GROUP /end SUB_GROUP /begin FUNCTION_LIST /end FUNCTION_LIST /begin REF_CHARACTERISTIC /end REF_CHARACTERISTIC /begin REF_MEASUREMENT CustDiag.VehSpd.Val /end REF_MEASUREMENT /end GROUP
/begin GROUP Dampg "MICROSAR RTE"
 /begin SUB_GROUP Dampg.CalibrationPorts Dampg.PerInstanceMemories Dampg.ReceiverPorts Dampg.SenderPorts /end SUB_GROUP
 /begin FUNCTION_LIST /end FUNCTION_LIST
 /begin REF_CHARACTERISTIC /end REF_CHARACTERISTIC
 /begin REF_MEASUREMENT /end REF_MEASUREMENT
/end GROUP
/begin GROUP Dampg.AssiCmdBas.Val "MICROSAR RTE" /begin SUB_GROUP /end SUB_GROUP /begin FUNCTION_LIST /end FUNCTION_LIST /begin REF_CHARACTERISTIC /end REF_CHARACTERISTIC /begin REF_MEASUREMENT Dampg.AssiCmdBas.Val /end REF_MEASUREMENT /end GROUP
/begin GROUP Dampg.AssiMechT.Val "MICROSAR RTE" /begin SUB_GROUP /end SUB_GROUP /begin FUNCTION_LIST /end FUNCTION_LIST /begin REF_CHARACTERISTIC /end REF_CHARACTERISTIC /begin REF_MEASUREMENT Dampg.AssiMechT.Val /end REF_MEASUREMENT /end GROUP
/begin GROUP Dampg.CalibrationPorts "MICROSAR RTE"
 /begin SUB_GROUP Dampg.DampgHwTqX.Ary1D Dampg.DampgHwTqY.Ary1D Dampg.DampgHydAssiLim.Ary1D Dampg.DampgHydBasCoeff1.Val Dampg.DampgHydBasCoeff2.Val Dampg.DampgHydBasCoeff3.Val Dampg.DampgHydBasCoeff4.Val Dampg.DampgHydCoeff1ScaY.Ary1D Dampg.DampgHydCoeff2ScaY.Ary1D Dampg.DampgHydCoeff3ScaY.Ary1D Dampg.DampgHydCoeff4ScaY.Ary1D Dampg.DampgHydOutpLim.Val Dampg.DampgMotVelLpFilFrq.Val Dampg.DampgMotVelX.Ary2D Dampg.DampgMotVelY.Ary2D Dampg.DampgQuad13Mplr.Val Dampg.DampgQuad24Mplr.Val Dampg.DampgQuadHwTqBacklsh.Val Dampg.DampgQuadHwTqLpFilFrq.Val Dampg.DampgQuadMotVelBacklsh.Val Dampg.DampgQuadMotVelLpFilFrq.Val Dampg.DampgQuadScaLpFilFrq.Val Dampg.DampgTScaX.Ary1D Dampg.DampgTScaY.Ary1D Dampg.SysGlbPrmVehSpdBilnrSeln.Ary1D /end SUB_GROUP
 /begin FUNCTION_LIST /end FUNCTION_LIST
 /begin REF_CHARACTERISTIC /end REF_CHARACTERISTIC
 /begin REF_MEASUREMENT /end REF_MEASUREMENT
/end GROUP
/begin GROUP Dampg.DampgCmdBas.Val "MICROSAR RTE" /begin SUB_GROUP /end SUB_GROUP /begin FUNCTION_LIST /end FUNCTION_LIST /begin REF_CHARACTERISTIC /end REF_CHARACTERISTIC /begin REF_MEASUREMENT Dampg.DampgCmdBas.Val /end REF_MEASUREMENT /end GROUP
/begin GROUP Dampg.DampgCmdBasDi.Logl "MICROSAR RTE" /begin SUB_GROUP /end SUB_GROUP /begin FUNCTION_LIST /end FUNCTION_LIST /begin REF_CHARACTERISTIC /end REF_CHARACTERISTIC /begin REF_MEASUREMENT Dampg.DampgCmdBasDi.Logl /end REF_MEASUREMENT /end GROUP
/begin GROUP Dampg.DampgCmdOvrl.Val "MICROSAR RTE" /begin SUB_GROUP /end SUB_GROUP /begin FUNCTION_LIST /end FUNCTION_LIST /begin REF_CHARACTERISTIC /end REF_CHARACTERISTIC /begin REF_MEASUREMENT Dampg.DampgCmdOvrl.Val /end REF_MEASUREMENT /end GROUP
/begin GROUP Dampg.DampgCmdSca.Val "MICROSAR RTE" /begin SUB_GROUP /end SUB_GROUP /begin FUNCTION_LIST /end FUNCTION_LIST /begin REF_CHARACTERISTIC /end REF_CHARACTERISTIC /begin REF_MEASUREMENT Dampg.DampgCmdSca.Val /end REF_MEASUREMENT /end GROUP
/begin GROUP Dampg.DampgHwTqX.Ary1D "MICROSAR RTE" /begin SUB_GROUP /end SUB_GROUP /begin FUNCTION_LIST /end FUNCTION_LIST /begin REF_CHARACTERISTIC Dampg.DampgHwTqX.Ary1D /end REF_CHARACTERISTIC /begin REF_MEASUREMENT /end REF_MEASUREMENT /end GROUP
/begin GROUP Dampg.DampgHwTqY.Ary1D "MICROSAR RTE" /begin SUB_GROUP /end SUB_GROUP /begin FUNCTION_LIST /end FUNCTION_LIST /begin REF_CHARACTERISTIC Dampg.DampgHwTqY.Ary1D /end REF_CHARACTERISTIC /begin REF_MEASUREMENT /end REF_MEASUREMENT /end GROUP
/begin GROUP Dampg.DampgHydAssiLim.Ary1D "MICROSAR RTE" /begin SUB_GROUP /end SUB_GROUP /begin FUNCTION_LIST /end FUNCTION_LIST /begin REF_CHARACTERISTIC Dampg.DampgHydAssiLim.Ary1D /end REF_CHARACTERISTIC /begin REF_MEASUREMENT /end REF_MEASUREMENT /end GROUP
/begin GROUP Dampg.DampgHydBasCoeff1.Val "MICROSAR RTE" /begin SUB_GROUP /end SUB_GROUP /begin FUNCTION_LIST /end FUNCTION_LIST /begin REF_CHARACTERISTIC Dampg.DampgHydBasCoeff1.Val /end REF_CHARACTERISTIC /begin REF_MEASUREMENT /end REF_MEASUREMENT /end GROUP
/begin GROUP Dampg.DampgHydBasCoeff2.Val "MICROSAR RTE" /begin SUB_GROUP /end SUB_GROUP /begin FUNCTION_LIST /end FUNCTION_LIST /begin REF_CHARACTERISTIC Dampg.DampgHydBasCoeff2.Val /end REF_CHARACTERISTIC /begin REF_MEASUREMENT /end REF_MEASUREMENT /end GROUP
/begin GROUP Dampg.DampgHydBasCoeff3.Val "MICROSAR RTE" /begin SUB_GROUP /end SUB_GROUP /begin FUNCTION_LIST /end FUNCTION_LIST /begin REF_CHARACTERISTIC Dampg.DampgHydBasCoeff3.Val /end REF_CHARACTERISTIC /begin REF_MEASUREMENT /end REF_MEASUREMENT /end GROUP
/begin GROUP Dampg.DampgHydBasCoeff4.Val "MICROSAR RTE" /begin SUB_GROUP /end SUB_GROUP /begin FUNCTION_LIST /end FUNCTION_LIST /begin REF_CHARACTERISTIC Dampg.DampgHydBasCoeff4.Val /end REF_CHARACTERISTIC /begin REF_MEASUREMENT /end REF_MEASUREMENT /end GROUP
/begin GROUP Dampg.DampgHydCoeff1ScaY.Ary1D "MICROSAR RTE" /begin SUB_GROUP /end SUB_GROUP /begin FUNCTION_LIST /end FUNCTION_LIST /begin REF_CHARACTERISTIC Dampg.DampgHydCoeff1ScaY.Ary1D /end REF_CHARACTERISTIC /begin REF_MEASUREMENT /end REF_MEASUREMENT /end GROUP
/begin GROUP Dampg.DampgHydCoeff2ScaY.Ary1D "MICROSAR RTE" /begin SUB_GROUP /end SUB_GROUP /begin FUNCTION_LIST /end FUNCTION_LIST /begin REF_CHARACTERISTIC Dampg.DampgHydCoeff2ScaY.Ary1D /end REF_CHARACTERISTIC /begin REF_MEASUREMENT /end REF_MEASUREMENT /end GROUP
/begin GROUP Dampg.DampgHydCoeff3ScaY.Ary1D "MICROSAR RTE" /begin SUB_GROUP /end SUB_GROUP /begin FUNCTION_LIST /end FUNCTION_LIST /begin REF_CHARACTERISTIC Dampg.DampgHydCoeff3ScaY.Ary1D /end REF_CHARACTERISTIC /begin REF_MEASUREMENT /end REF_MEASUREMENT /end GROUP
/begin GROUP Dampg.DampgHydCoeff4ScaY.Ary1D "MICROSAR RTE" /begin SUB_GROUP /end SUB_GROUP /begin FUNCTION_LIST /end FUNCTION_LIST /begin REF_CHARACTERISTIC Dampg.DampgHydCoeff4ScaY.Ary1D /end REF_CHARACTERISTIC /begin REF_MEASUREMENT /end REF_MEASUREMENT /end GROUP
/begin GROUP Dampg.DampgHydOutpLim.Val "MICROSAR RTE" /begin SUB_GROUP /end SUB_GROUP /begin FUNCTION_LIST /end FUNCTION_LIST /begin REF_CHARACTERISTIC Dampg.DampgHydOutpLim.Val /end REF_CHARACTERISTIC /begin REF_MEASUREMENT /end REF_MEASUREMENT /end GROUP
/begin GROUP Dampg.DampgMotVelLpFilFrq.Val "MICROSAR RTE" /begin SUB_GROUP /end SUB_GROUP /begin FUNCTION_LIST /end FUNCTION_LIST /begin REF_CHARACTERISTIC Dampg.DampgMotVelLpFilFrq.Val /end REF_CHARACTERISTIC /begin REF_MEASUREMENT /end REF_MEASUREMENT /end GROUP
/begin GROUP Dampg.DampgMotVelX.Ary2D "MICROSAR RTE" /begin SUB_GROUP /end SUB_GROUP /begin FUNCTION_LIST /end FUNCTION_LIST /begin REF_CHARACTERISTIC Dampg.DampgMotVelX.Ary2D /end REF_CHARACTERISTIC /begin REF_MEASUREMENT /end REF_MEASUREMENT /end GROUP
/begin GROUP Dampg.DampgMotVelY.Ary2D "MICROSAR RTE" /begin SUB_GROUP /end SUB_GROUP /begin FUNCTION_LIST /end FUNCTION_LIST /begin REF_CHARACTERISTIC Dampg.DampgMotVelY.Ary2D /end REF_CHARACTERISTIC /begin REF_MEASUREMENT /end REF_MEASUREMENT /end GROUP
/begin GROUP Dampg.DampgQuad13Mplr.Val "MICROSAR RTE" /begin SUB_GROUP /end SUB_GROUP /begin FUNCTION_LIST /end FUNCTION_LIST /begin REF_CHARACTERISTIC Dampg.DampgQuad13Mplr.Val /end REF_CHARACTERISTIC /begin REF_MEASUREMENT /end REF_MEASUREMENT /end GROUP
/begin GROUP Dampg.DampgQuad24Mplr.Val "MICROSAR RTE" /begin SUB_GROUP /end SUB_GROUP /begin FUNCTION_LIST /end FUNCTION_LIST /begin REF_CHARACTERISTIC Dampg.DampgQuad24Mplr.Val /end REF_CHARACTERISTIC /begin REF_MEASUREMENT /end REF_MEASUREMENT /end GROUP
/begin GROUP Dampg.DampgQuadHwTqBacklsh.Val "MICROSAR RTE" /begin SUB_GROUP /end SUB_GROUP /begin FUNCTION_LIST /end FUNCTION_LIST /begin REF_CHARACTERISTIC Dampg.DampgQuadHwTqBacklsh.Val /end REF_CHARACTERISTIC /begin REF_MEASUREMENT /end REF_MEASUREMENT /end GROUP
/begin GROUP Dampg.DampgQuadHwTqLpFilFrq.Val "MICROSAR RTE" /begin SUB_GROUP /end SUB_GROUP /begin FUNCTION_LIST /end FUNCTION_LIST /begin REF_CHARACTERISTIC Dampg.DampgQuadHwTqLpFilFrq.Val /end REF_CHARACTERISTIC /begin REF_MEASUREMENT /end REF_MEASUREMENT /end GROUP
/begin GROUP Dampg.DampgQuadMotVelBacklsh.Val "MICROSAR RTE" /begin SUB_GROUP /end SUB_GROUP /begin FUNCTION_LIST /end FUNCTION_LIST /begin REF_CHARACTERISTIC Dampg.DampgQuadMotVelBacklsh.Val /end REF_CHARACTERISTIC /begin REF_MEASUREMENT /end REF_MEASUREMENT /end GROUP
/begin GROUP Dampg.DampgQuadMotVelLpFilFrq.Val "MICROSAR RTE" /begin SUB_GROUP /end SUB_GROUP /begin FUNCTION_LIST /end FUNCTION_LIST /begin REF_CHARACTERISTIC Dampg.DampgQuadMotVelLpFilFrq.Val /end REF_CHARACTERISTIC /begin REF_MEASUREMENT /end REF_MEASUREMENT /end GROUP
/begin GROUP Dampg.DampgQuadScaLpFilFrq.Val "MICROSAR RTE" /begin SUB_GROUP /end SUB_GROUP /begin FUNCTION_LIST /end FUNCTION_LIST /begin REF_CHARACTERISTIC Dampg.DampgQuadScaLpFilFrq.Val /end REF_CHARACTERISTIC /begin REF_MEASUREMENT /end REF_MEASUREMENT /end GROUP
/begin GROUP Dampg.DampgTScaX.Ary1D "MICROSAR RTE" /begin SUB_GROUP /end SUB_GROUP /begin FUNCTION_LIST /end FUNCTION_LIST /begin REF_CHARACTERISTIC Dampg.DampgTScaX.Ary1D /end REF_CHARACTERISTIC /begin REF_MEASUREMENT /end REF_MEASUREMENT /end GROUP
/begin GROUP Dampg.DampgTScaY.Ary1D "MICROSAR RTE" /begin SUB_GROUP /end SUB_GROUP /begin FUNCTION_LIST /end FUNCTION_LIST /begin REF_CHARACTERISTIC Dampg.DampgTScaY.Ary1D /end REF_CHARACTERISTIC /begin REF_MEASUREMENT /end REF_MEASUREMENT /end GROUP
/begin GROUP Dampg.HwTq.Val "MICROSAR RTE" /begin SUB_GROUP /end SUB_GROUP /begin FUNCTION_LIST /end FUNCTION_LIST /begin REF_CHARACTERISTIC /end REF_CHARACTERISTIC /begin REF_MEASUREMENT Dampg.HwTq.Val /end REF_MEASUREMENT /end GROUP
/begin GROUP Dampg.MotVelCrf.Val "MICROSAR RTE" /begin SUB_GROUP /end SUB_GROUP /begin FUNCTION_LIST /end FUNCTION_LIST /begin REF_CHARACTERISTIC /end REF_CHARACTERISTIC /begin REF_MEASUREMENT Dampg.MotVelCrf.Val /end REF_MEASUREMENT /end GROUP
/begin GROUP Dampg.MotVelDampgLpFil "MICROSAR RTE" /begin SUB_GROUP /end SUB_GROUP /begin FUNCTION_LIST /end FUNCTION_LIST /begin REF_CHARACTERISTIC /end REF_CHARACTERISTIC
 /begin REF_MEASUREMENT Dampg.MotVelDampgLpFil.FilGain Dampg.MotVelDampgLpFil.FilSt /end REF_MEASUREMENT
/end GROUP
/begin GROUP Dampg.PerInstanceMemories "MICROSAR RTE"
 /begin SUB_GROUP Dampg.MotVelDampgLpFil Dampg.PrevHwTqBacklshOutp Dampg.PrevMotVelBacklshOutp Dampg.QuadDampgHwTqLpFil Dampg.QuadDampgMotVelLpFil Dampg.QuadDampgScaLpFil Dampg.dDampgAssiMechTSca Dampg.dDampgCoeff1Term Dampg.dDampgCoeff2Term Dampg.dDampgCoeff3Term Dampg.dDampgCoeff4Term Dampg.dDampgHwTqSca Dampg.dDampgMotVelDampgCmd Dampg.dDampgQuadHwTqBacklsh Dampg.dDampgQuadMotVelBacklsh /end SUB_GROUP
 /begin FUNCTION_LIST /end FUNCTION_LIST
 /begin REF_CHARACTERISTIC /end REF_CHARACTERISTIC
 /begin REF_MEASUREMENT /end REF_MEASUREMENT
/end GROUP
/begin GROUP Dampg.PrevHwTqBacklshOutp "MICROSAR RTE" /begin SUB_GROUP /end SUB_GROUP /begin FUNCTION_LIST /end FUNCTION_LIST /begin REF_CHARACTERISTIC /end REF_CHARACTERISTIC /begin REF_MEASUREMENT Dampg.PrevHwTqBacklshOutp /end REF_MEASUREMENT /end GROUP
/begin GROUP Dampg.PrevMotVelBacklshOutp "MICROSAR RTE" /begin SUB_GROUP /end SUB_GROUP /begin FUNCTION_LIST /end FUNCTION_LIST /begin REF_CHARACTERISTIC /end REF_CHARACTERISTIC /begin REF_MEASUREMENT Dampg.PrevMotVelBacklshOutp /end REF_MEASUREMENT /end GROUP
/begin GROUP Dampg.QuadDampgHwTqLpFil "MICROSAR RTE" /begin SUB_GROUP /end SUB_GROUP /begin FUNCTION_LIST /end FUNCTION_LIST /begin REF_CHARACTERISTIC /end REF_CHARACTERISTIC
 /begin REF_MEASUREMENT Dampg.QuadDampgHwTqLpFil.FilGain Dampg.QuadDampgHwTqLpFil.FilSt /end REF_MEASUREMENT
/end GROUP
/begin GROUP Dampg.QuadDampgMotVelLpFil "MICROSAR RTE" /begin SUB_GROUP /end SUB_GROUP /begin FUNCTION_LIST /end FUNCTION_LIST /begin REF_CHARACTERISTIC /end REF_CHARACTERISTIC
 /begin REF_MEASUREMENT Dampg.QuadDampgMotVelLpFil.FilGain Dampg.QuadDampgMotVelLpFil.FilSt /end REF_MEASUREMENT
/end GROUP
/begin GROUP Dampg.QuadDampgScaLpFil "MICROSAR RTE" /begin SUB_GROUP /end SUB_GROUP /begin FUNCTION_LIST /end FUNCTION_LIST /begin REF_CHARACTERISTIC /end REF_CHARACTERISTIC
 /begin REF_MEASUREMENT Dampg.QuadDampgScaLpFil.FilGain Dampg.QuadDampgScaLpFil.FilSt /end REF_MEASUREMENT
/end GROUP
/begin GROUP Dampg.ReceiverPorts "MICROSAR RTE"
 /begin SUB_GROUP Dampg.AssiCmdBas.Val Dampg.AssiMechT.Val Dampg.DampgCmdBasDi.Logl Dampg.DampgCmdOvrl.Val Dampg.DampgCmdSca.Val Dampg.HwTq.Val Dampg.MotVelCrf.Val Dampg.VehSpd.Val /end SUB_GROUP
 /begin FUNCTION_LIST /end FUNCTION_LIST
 /begin REF_CHARACTERISTIC /end REF_CHARACTERISTIC
 /begin REF_MEASUREMENT /end REF_MEASUREMENT
/end GROUP
/begin GROUP Dampg.SenderPorts "MICROSAR RTE" /begin SUB_GROUP Dampg.DampgCmdBas.Val /end SUB_GROUP /begin FUNCTION_LIST /end FUNCTION_LIST /begin REF_CHARACTERISTIC /end REF_CHARACTERISTIC /begin REF_MEASUREMENT /end REF_MEASUREMENT /end GROUP
/begin GROUP Dampg.SysGlbPrmVehSpdBilnrSeln.Ary1D "MICROSAR RTE" /begin SUB_GROUP /end SUB_GROUP /begin FUNCTION_LIST /end FUNCTION_LIST /begin REF_CHARACTERISTIC Dampg.SysGlbPrmVehSpdBilnrSeln.Ary1D /end REF_CHARACTERISTIC /begin REF_MEASUREMENT /end REF_MEASUREMENT /end GROUP
/begin GROUP Dampg.VehSpd.Val "MICROSAR RTE" /begin SUB_GROUP /end SUB_GROUP /begin FUNCTION_LIST /end FUNCTION_LIST /begin REF_CHARACTERISTIC /end REF_CHARACTERISTIC /begin REF_MEASUREMENT Dampg.VehSpd.Val /end REF_MEASUREMENT /end GROUP
/begin GROUP Dampg.dDampgAssiMechTSca "MICROSAR RTE" /begin SUB_GROUP /end SUB_GROUP /begin FUNCTION_LIST /end FUNCTION_LIST /begin REF_CHARACTERISTIC /end REF_CHARACTERISTIC /begin REF_MEASUREMENT Dampg.dDampgAssiMechTSca /end REF_MEASUREMENT /end GROUP
/begin GROUP Dampg.dDampgCoeff1Term "MICROSAR RTE" /begin SUB_GROUP /end SUB_GROUP /begin FUNCTION_LIST /end FUNCTION_LIST /begin REF_CHARACTERISTIC /end REF_CHARACTERISTIC /begin REF_MEASUREMENT Dampg.dDampgCoeff1Term /end REF_MEASUREMENT /end GROUP
/begin GROUP Dampg.dDampgCoeff2Term "MICROSAR RTE" /begin SUB_GROUP /end SUB_GROUP /begin FUNCTION_LIST /end FUNCTION_LIST /begin REF_CHARACTERISTIC /end REF_CHARACTERISTIC /begin REF_MEASUREMENT Dampg.dDampgCoeff2Term /end REF_MEASUREMENT /end GROUP
/begin GROUP Dampg.dDampgCoeff3Term "MICROSAR RTE" /begin SUB_GROUP /end SUB_GROUP /begin FUNCTION_LIST /end FUNCTION_LIST /begin REF_CHARACTERISTIC /end REF_CHARACTERISTIC /begin REF_MEASUREMENT Dampg.dDampgCoeff3Term /end REF_MEASUREMENT /end GROUP
/begin GROUP Dampg.dDampgCoeff4Term "MICROSAR RTE" /begin SUB_GROUP /end SUB_GROUP /begin FUNCTION_LIST /end FUNCTION_LIST /begin REF_CHARACTERISTIC /end REF_CHARACTERISTIC /begin REF_MEASUREMENT Dampg.dDampgCoeff4Term /end REF_MEASUREMENT /end GROUP
/begin GROUP Dampg.dDampgHwTqSca "MICROSAR RTE" /begin SUB_GROUP /end SUB_GROUP /begin FUNCTION_LIST /end FUNCTION_LIST /begin REF_CHARACTERISTIC /end REF_CHARACTERISTIC /begin REF_MEASUREMENT Dampg.dDampgHwTqSca /end REF_MEASUREMENT /end GROUP
/begin GROUP Dampg.dDampgMotVelDampgCmd "MICROSAR RTE" /begin SUB_GROUP /end SUB_GROUP /begin FUNCTION_LIST /end FUNCTION_LIST /begin REF_CHARACTERISTIC /end REF_CHARACTERISTIC /begin REF_MEASUREMENT Dampg.dDampgMotVelDampgCmd /end REF_MEASUREMENT /end GROUP
/begin GROUP Dampg.dDampgQuadHwTqBacklsh "MICROSAR RTE" /begin SUB_GROUP /end SUB_GROUP /begin FUNCTION_LIST /end FUNCTION_LIST /begin REF_CHARACTERISTIC /end REF_CHARACTERISTIC /begin REF_MEASUREMENT Dampg.dDampgQuadHwTqBacklsh /end REF_MEASUREMENT /end GROUP
/begin GROUP Dampg.dDampgQuadMotVelBacklsh "MICROSAR RTE" /begin SUB_GROUP /end SUB_GROUP /begin FUNCTION_LIST /end FUNCTION_LIST /begin REF_CHARACTERISTIC /end REF_CHARACTERISTIC /begin REF_MEASUREMENT Dampg.dDampgQuadMotVelBacklsh /end REF_MEASUREMENT /end GROUP
/begin GROUP DampgPahSum "MICROSAR RTE" /begin SUB_GROUP DampgPahSum.ReceiverPorts DampgPahSum.SenderPorts /end SUB_GROUP /begin FUNCTION_LIST /end FUNCTION_LIST /begin REF_CHARACTERISTIC /end REF_CHARACTERISTIC /begin REF_MEASUREMENT /end REF_MEASUREMENT /end GROUP
/begin GROUP DampgPahSum.DampgCmd.Val "MICROSAR RTE" /begin SUB_GROUP /end SUB_GROUP /begin FUNCTION_LIST /end FUNCTION_LIST /begin REF_CHARACTERISTIC /end REF_CHARACTERISTIC /begin REF_MEASUREMENT DampgPahSum.DampgCmd.Val /end REF_MEASUREMENT /end GROUP
/begin GROUP DampgPahSum.DampgCmdBas.Val "MICROSAR RTE" /begin SUB_GROUP /end SUB_GROUP /begin FUNCTION_LIST /end FUNCTION_LIST /begin REF_CHARACTERISTIC /end REF_CHARACTERISTIC /begin REF_MEASUREMENT DampgPahSum.DampgCmdBas.Val /end REF_MEASUREMENT /end GROUP
/begin GROUP DampgPahSum.InertiaCmpVelCmd.Val "MICROSAR RTE" /begin SUB_GROUP /end SUB_GROUP /begin FUNCTION_LIST /end FUNCTION_LIST /begin REF_CHARACTERISTIC /end REF_CHARACTERISTIC /begin REF_MEASUREMENT DampgPahSum.InertiaCmpVelCmd.Val /end REF_MEASUREMENT /end GROUP
/begin GROUP DampgPahSum.ReceiverPorts "MICROSAR RTE"
 /begin SUB_GROUP DampgPahSum.DampgCmdBas.Val DampgPahSum.InertiaCmpVelCmd.Val /end SUB_GROUP
 /begin FUNCTION_LIST /end FUNCTION_LIST
 /begin REF_CHARACTERISTIC /end REF_CHARACTERISTIC
 /begin REF_MEASUREMENT /end REF_MEASUREMENT
/end GROUP
/begin GROUP DampgPahSum.SenderPorts "MICROSAR RTE" /begin SUB_GROUP DampgPahSum.DampgCmd.Val /end SUB_GROUP /begin FUNCTION_LIST /end FUNCTION_LIST /begin REF_CHARACTERISTIC /end REF_CHARACTERISTIC /begin REF_MEASUREMENT /end REF_MEASUREMENT /end GROUP
/begin GROUP Dcm "MICROSAR RTE" /begin SUB_GROUP Dcm.ModeRequirePorts /end SUB_GROUP /begin FUNCTION_LIST /end FUNCTION_LIST /begin REF_CHARACTERISTIC /end REF_CHARACTERISTIC /begin REF_MEASUREMENT /end REF_MEASUREMENT /end GROUP
/begin GROUP Dcm.Dcm_Read_BswM_MDGP_BswMEcuResetMod.Dcm_Read_BswM_MDGP_BswMEcuResetMod "MICROSAR RTE" /begin SUB_GROUP /end SUB_GROUP /begin FUNCTION_LIST /end FUNCTION_LIST /begin REF_CHARACTERISTIC /end REF_CHARACTERISTIC
 /begin REF_MEASUREMENT Dcm.Dcm_Read_BswM_MDGP_BswMEcuResetMod.Dcm_Read_BswM_MDGP_BswMEcuResetMod /end REF_MEASUREMENT
/end GROUP
/begin GROUP Dcm.ModeRequirePorts "MICROSAR RTE"
 /begin SUB_GROUP Dcm.Dcm_Read_BswM_MDGP_BswMEcuResetMod.Dcm_Read_BswM_MDGP_BswMEcuResetMod /end SUB_GROUP
 /begin FUNCTION_LIST /end FUNCTION_LIST
 /begin REF_CHARACTERISTIC /end REF_CHARACTERISTIC
 /begin REF_MEASUREMENT /end REF_MEASUREMENT
/end GROUP
/begin GROUP DiagcMgr "MICROSAR RTE"
 /begin SUB_GROUP DiagcMgr.CalibrationParameters DiagcMgr.CalibrationPorts DiagcMgr.PerInstanceMemories DiagcMgr.ReceiverPorts DiagcMgr.SenderPorts /end SUB_GROUP
 /begin FUNCTION_LIST /end FUNCTION_LIST
 /begin REF_CHARACTERISTIC /end REF_CHARACTERISTIC
 /begin REF_MEASUREMENT /end REF_MEASUREMENT
/end GROUP
/begin GROUP DiagcMgr.BrdgVltg.Val "MICROSAR RTE" /begin SUB_GROUP /end SUB_GROUP /begin FUNCTION_LIST /end FUNCTION_LIST /begin REF_CHARACTERISTIC /end REF_CHARACTERISTIC /begin REF_MEASUREMENT DiagcMgr.BrdgVltg.Val /end REF_MEASUREMENT /end GROUP
/begin GROUP DiagcMgr.CalibrationParameters "MICROSAR RTE" /begin SUB_GROUP DiagcMgr.DiagcMgrApplCrcDft /end SUB_GROUP /begin FUNCTION_LIST /end FUNCTION_LIST /begin REF_CHARACTERISTIC /end REF_CHARACTERISTIC /begin REF_MEASUREMENT /end REF_MEASUREMENT /end GROUP
/begin GROUP DiagcMgr.CalibrationPorts "MICROSAR RTE" /begin SUB_GROUP DiagcMgr.DiagcMgrFltResp.Ary1D /end SUB_GROUP /begin FUNCTION_LIST /end FUNCTION_LIST /begin REF_CHARACTERISTIC /end REF_CHARACTERISTIC /begin REF_MEASUREMENT /end REF_MEASUREMENT /end GROUP
/begin GROUP DiagcMgr.ClrDiagcFlg "MICROSAR RTE" /begin SUB_GROUP /end SUB_GROUP /begin FUNCTION_LIST /end FUNCTION_LIST /begin REF_CHARACTERISTIC /end REF_CHARACTERISTIC /begin REF_MEASUREMENT DiagcMgr.ClrDiagcFlg /end REF_MEASUREMENT /end GROUP
/begin GROUP DiagcMgr.ClrDiagcFlgProxy.Val "MICROSAR RTE" /begin SUB_GROUP /end SUB_GROUP /begin FUNCTION_LIST /end FUNCTION_LIST /begin REF_CHARACTERISTIC /end REF_CHARACTERISTIC /begin REF_MEASUREMENT DiagcMgr.ClrDiagcFlgProxy.Val /end REF_MEASUREMENT /end GROUP
/begin GROUP DiagcMgr.DiagcMgrApplCrc "MICROSAR RTE" /begin SUB_GROUP /end SUB_GROUP /begin FUNCTION_LIST /end FUNCTION_LIST /begin REF_CHARACTERISTIC /end REF_CHARACTERISTIC /begin REF_MEASUREMENT DiagcMgr.DiagcMgrApplCrc /end REF_MEASUREMENT /end GROUP
/begin GROUP DiagcMgr.DiagcMgrApplCrcDft "MICROSAR RTE" /begin SUB_GROUP /end SUB_GROUP /begin FUNCTION_LIST /end FUNCTION_LIST /begin REF_CHARACTERISTIC DiagcMgr.DiagcMgrApplCrcDft /end REF_CHARACTERISTIC /begin REF_MEASUREMENT /end REF_MEASUREMENT /end GROUP
/begin GROUP DiagcMgr.DiagcMgrFltResp.Ary1D "MICROSAR RTE" /begin SUB_GROUP /end SUB_GROUP /begin FUNCTION_LIST /end FUNCTION_LIST /begin REF_CHARACTERISTIC DiagcMgr.DiagcMgrFltResp.Ary1D /end REF_CHARACTERISTIC /begin REF_MEASUREMENT /end REF_MEASUREMENT /end GROUP
/begin GROUP DiagcMgr.DiagcMgrLtchCntrAry "MICROSAR RTE" /begin SUB_GROUP /end SUB_GROUP /begin FUNCTION_LIST /end FUNCTION_LIST /begin REF_CHARACTERISTIC /end REF_CHARACTERISTIC /begin REF_MEASUREMENT DiagcMgr.DiagcMgrLtchCntrAry /end REF_MEASUREMENT /end GROUP
/begin GROUP DiagcMgr.DiagcMgrNtcFltAry "MICROSAR RTE" /begin SUB_GROUP /end SUB_GROUP /begin FUNCTION_LIST /end FUNCTION_LIST /begin REF_CHARACTERISTIC /end REF_CHARACTERISTIC
 /begin REF_MEASUREMENT DiagcMgr.DiagcMgrNtcFltAry[0].AgiCntr DiagcMgr.DiagcMgrNtcFltAry[0].NtcNr DiagcMgr.DiagcMgrNtcFltAry[0].Sts DiagcMgr.DiagcMgrNtcFltAry[10].AgiCntr DiagcMgr.DiagcMgrNtcFltAry[10].NtcNr DiagcMgr.DiagcMgrNtcFltAry[10].Sts DiagcMgr.DiagcMgrNtcFltAry[11].AgiCntr DiagcMgr.DiagcMgrNtcFltAry[11].NtcNr DiagcMgr.DiagcMgrNtcFltAry[11].Sts DiagcMgr.DiagcMgrNtcFltAry[12].AgiCntr DiagcMgr.DiagcMgrNtcFltAry[12].NtcNr DiagcMgr.DiagcMgrNtcFltAry[12].Sts DiagcMgr.DiagcMgrNtcFltAry[13].AgiCntr DiagcMgr.DiagcMgrNtcFltAry[13].NtcNr DiagcMgr.DiagcMgrNtcFltAry[13].Sts DiagcMgr.DiagcMgrNtcFltAry[14].AgiCntr DiagcMgr.DiagcMgrNtcFltAry[14].NtcNr DiagcMgr.DiagcMgrNtcFltAry[14].Sts DiagcMgr.DiagcMgrNtcFltAry[15].AgiCntr DiagcMgr.DiagcMgrNtcFltAry[15].NtcNr DiagcMgr.DiagcMgrNtcFltAry[15].Sts DiagcMgr.DiagcMgrNtcFltAry[16].AgiCntr DiagcMgr.DiagcMgrNtcFltAry[16].NtcNr DiagcMgr.DiagcMgrNtcFltAry[16].Sts DiagcMgr.DiagcMgrNtcFltAry[17].AgiCntr DiagcMgr.DiagcMgrNtcFltAry[17].NtcNr DiagcMgr.DiagcMgrNtcFltAry[17].Sts DiagcMgr.DiagcMgrNtcFltAry[18].AgiCntr DiagcMgr.DiagcMgrNtcFltAry[18].NtcNr DiagcMgr.DiagcMgrNtcFltAry[18].Sts DiagcMgr.DiagcMgrNtcFltAry[19].AgiCntr DiagcMgr.DiagcMgrNtcFltAry[19].NtcNr DiagcMgr.DiagcMgrNtcFltAry[19].Sts DiagcMgr.DiagcMgrNtcFltAry[1].AgiCntr DiagcMgr.DiagcMgrNtcFltAry[1].NtcNr DiagcMgr.DiagcMgrNtcFltAry[1].Sts DiagcMgr.DiagcMgrNtcFltAry[2].AgiCntr DiagcMgr.DiagcMgrNtcFltAry[2].NtcNr DiagcMgr.DiagcMgrNtcFltAry[2].Sts DiagcMgr.DiagcMgrNtcFltAry[3].AgiCntr DiagcMgr.DiagcMgrNtcFltAry[3].NtcNr DiagcMgr.DiagcMgrNtcFltAry[3].Sts DiagcMgr.DiagcMgrNtcFltAry[4].AgiCntr DiagcMgr.DiagcMgrNtcFltAry[4].NtcNr DiagcMgr.DiagcMgrNtcFltAry[4].Sts DiagcMgr.DiagcMgrNtcFltAry[5].AgiCntr DiagcMgr.DiagcMgrNtcFltAry[5].NtcNr DiagcMgr.DiagcMgrNtcFltAry[5].Sts DiagcMgr.DiagcMgrNtcFltAry[6].AgiCntr DiagcMgr.DiagcMgrNtcFltAry[6].NtcNr DiagcMgr.DiagcMgrNtcFltAry[6].Sts DiagcMgr.DiagcMgrNtcFltAry[7].AgiCntr DiagcMgr.DiagcMgrNtcFltAry[7].NtcNr DiagcMgr.DiagcMgrNtcFltAry[7].Sts DiagcMgr.DiagcMgrNtcFltAry[8].AgiCntr DiagcMgr.DiagcMgrNtcFltAry[8].NtcNr DiagcMgr.DiagcMgrNtcFltAry[8].Sts DiagcMgr.DiagcMgrNtcFltAry[9].AgiCntr DiagcMgr.DiagcMgrNtcFltAry[9].NtcNr DiagcMgr.DiagcMgrNtcFltAry[9].Sts /end REF_MEASUREMENT
/end GROUP
/begin GROUP DiagcMgr.DiagcStsCtrldShtDwnFltPrsnt.Logl "MICROSAR RTE" /begin SUB_GROUP /end SUB_GROUP /begin FUNCTION_LIST /end FUNCTION_LIST /begin REF_CHARACTERISTIC /end REF_CHARACTERISTIC /begin REF_MEASUREMENT DiagcMgr.DiagcStsCtrldShtDwnFltPrsnt.Logl /end REF_MEASUREMENT /end GROUP
/begin GROUP DiagcMgr.DiagcStsNonRcvrlReqDiFltPrsnt.Logl "MICROSAR RTE" /begin SUB_GROUP /end SUB_GROUP /begin FUNCTION_LIST /end FUNCTION_LIST /begin REF_CHARACTERISTIC /end REF_CHARACTERISTIC /begin REF_MEASUREMENT DiagcMgr.DiagcStsNonRcvrlReqDiFltPrsnt.Logl /end REF_MEASUREMENT /end GROUP
/begin GROUP DiagcMgr.DtcEnaSts "MICROSAR RTE" /begin SUB_GROUP /end SUB_GROUP /begin FUNCTION_LIST /end FUNCTION_LIST /begin REF_CHARACTERISTIC /end REF_CHARACTERISTIC /begin REF_MEASUREMENT DiagcMgr.DtcEnaSts /end REF_MEASUREMENT /end GROUP
/begin GROUP DiagcMgr.EcuTFild.Val "MICROSAR RTE" /begin SUB_GROUP /end SUB_GROUP /begin FUNCTION_LIST /end FUNCTION_LIST /begin REF_CHARACTERISTIC /end REF_CHARACTERISTIC /begin REF_MEASUREMENT DiagcMgr.EcuTFild.Val /end REF_MEASUREMENT /end GROUP
/begin GROUP DiagcMgr.HwTq.Val "MICROSAR RTE" /begin SUB_GROUP /end SUB_GROUP /begin FUNCTION_LIST /end FUNCTION_LIST /begin REF_CHARACTERISTIC /end REF_CHARACTERISTIC /begin REF_MEASUREMENT DiagcMgr.HwTq.Val /end REF_MEASUREMENT /end GROUP
/begin GROUP DiagcMgr.IgnCntr.Val "MICROSAR RTE" /begin SUB_GROUP /end SUB_GROUP /begin FUNCTION_LIST /end FUNCTION_LIST /begin REF_CHARACTERISTIC /end REF_CHARACTERISTIC /begin REF_MEASUREMENT DiagcMgr.IgnCntr.Val /end REF_MEASUREMENT /end GROUP
/begin GROUP DiagcMgr.MfgDiagcInhb.Logl "MICROSAR RTE" /begin SUB_GROUP /end SUB_GROUP /begin FUNCTION_LIST /end FUNCTION_LIST /begin REF_CHARACTERISTIC /end REF_CHARACTERISTIC /begin REF_MEASUREMENT DiagcMgr.MfgDiagcInhb.Logl /end REF_MEASUREMENT /end GROUP
/begin GROUP DiagcMgr.MotTqCmdMrfScad.Val "MICROSAR RTE" /begin SUB_GROUP /end SUB_GROUP /begin FUNCTION_LIST /end FUNCTION_LIST /begin REF_CHARACTERISTIC /end REF_CHARACTERISTIC /begin REF_MEASUREMENT DiagcMgr.MotTqCmdMrfScad.Val /end REF_MEASUREMENT /end GROUP
/begin GROUP DiagcMgr.PerInstanceMemories "MICROSAR RTE"
 /begin SUB_GROUP DiagcMgr.ClrDiagcFlg DiagcMgr.DiagcMgrApplCrc DiagcMgr.DiagcMgrLtchCntrAry DiagcMgr.DiagcMgrNtcFltAry DiagcMgr.DtcEnaSts DiagcMgr.PrevClrDtcFlg /end SUB_GROUP
 /begin FUNCTION_LIST /end FUNCTION_LIST
 /begin REF_CHARACTERISTIC /end REF_CHARACTERISTIC
 /begin REF_MEASUREMENT /end REF_MEASUREMENT
/end GROUP
/begin GROUP DiagcMgr.PrevClrDtcFlg "MICROSAR RTE" /begin SUB_GROUP /end SUB_GROUP /begin FUNCTION_LIST /end FUNCTION_LIST /begin REF_CHARACTERISTIC /end REF_CHARACTERISTIC /begin REF_MEASUREMENT DiagcMgr.PrevClrDtcFlg /end REF_MEASUREMENT /end GROUP
/begin GROUP DiagcMgr.ReceiverPorts "MICROSAR RTE"
 /begin SUB_GROUP DiagcMgr.BrdgVltg.Val DiagcMgr.EcuTFild.Val DiagcMgr.HwTq.Val DiagcMgr.IgnCntr.Val DiagcMgr.MfgDiagcInhb.Logl DiagcMgr.MotTqCmdMrfScad.Val DiagcMgr.SwApplCrc.Val DiagcMgr.SysSt.Val /end SUB_GROUP
 /begin FUNCTION_LIST /end FUNCTION_LIST
 /begin REF_CHARACTERISTIC /end REF_CHARACTERISTIC
 /begin REF_MEASUREMENT /end REF_MEASUREMENT
/end GROUP
/begin GROUP DiagcMgr.SenderPorts "MICROSAR RTE"
 /begin SUB_GROUP DiagcMgr.ClrDiagcFlgProxy.Val DiagcMgr.DiagcStsCtrldShtDwnFltPrsnt.Logl DiagcMgr.DiagcStsNonRcvrlReqDiFltPrsnt.Logl DiagcMgr.SysDiMotTqCmdSca.Val DiagcMgr.SysDiRampRate.Val DiagcMgr.SysStFltOutpReqDi.Logl /end SUB_GROUP
 /begin FUNCTION_LIST /end FUNCTION_LIST
 /begin REF_CHARACTERISTIC /end REF_CHARACTERISTIC
 /begin REF_MEASUREMENT /end REF_MEASUREMENT
/end GROUP
/begin GROUP DiagcMgr.SwApplCrc.Val "MICROSAR RTE" /begin SUB_GROUP /end SUB_GROUP /begin FUNCTION_LIST /end FUNCTION_LIST /begin REF_CHARACTERISTIC /end REF_CHARACTERISTIC /begin REF_MEASUREMENT DiagcMgr.SwApplCrc.Val /end REF_MEASUREMENT /end GROUP
/begin GROUP DiagcMgr.SysDiMotTqCmdSca.Val "MICROSAR RTE" /begin SUB_GROUP /end SUB_GROUP /begin FUNCTION_LIST /end FUNCTION_LIST /begin REF_CHARACTERISTIC /end REF_CHARACTERISTIC /begin REF_MEASUREMENT DiagcMgr.SysDiMotTqCmdSca.Val /end REF_MEASUREMENT /end GROUP
/begin GROUP DiagcMgr.SysDiRampRate.Val "MICROSAR RTE" /begin SUB_GROUP /end SUB_GROUP /begin FUNCTION_LIST /end FUNCTION_LIST /begin REF_CHARACTERISTIC /end REF_CHARACTERISTIC /begin REF_MEASUREMENT DiagcMgr.SysDiRampRate.Val /end REF_MEASUREMENT /end GROUP
/begin GROUP DiagcMgr.SysSt.Val "MICROSAR RTE" /begin SUB_GROUP /end SUB_GROUP /begin FUNCTION_LIST /end FUNCTION_LIST /begin REF_CHARACTERISTIC /end REF_CHARACTERISTIC /begin REF_MEASUREMENT DiagcMgr.SysSt.Val /end REF_MEASUREMENT /end GROUP
/begin GROUP DiagcMgr.SysStFltOutpReqDi.Logl "MICROSAR RTE" /begin SUB_GROUP /end SUB_GROUP /begin FUNCTION_LIST /end FUNCTION_LIST /begin REF_CHARACTERISTIC /end REF_CHARACTERISTIC /begin REF_MEASUREMENT DiagcMgr.SysStFltOutpReqDi.Logl /end REF_MEASUREMENT /end GROUP
/begin GROUP DiagcMgrProxyAppl10 "MICROSAR RTE"
 /begin SUB_GROUP DiagcMgrProxyAppl10.CalibrationPorts DiagcMgrProxyAppl10.PerInstanceMemories DiagcMgrProxyAppl10.ReceiverPorts /end SUB_GROUP
 /begin FUNCTION_LIST /end FUNCTION_LIST
 /begin REF_CHARACTERISTIC /end REF_CHARACTERISTIC
 /begin REF_MEASUREMENT /end REF_MEASUREMENT
/end GROUP
/begin GROUP DiagcMgrProxyAppl10.CalibrationPorts "MICROSAR RTE" /begin SUB_GROUP DiagcMgrProxyAppl10.DiagcMgrFltResp.Ary1D /end SUB_GROUP /begin FUNCTION_LIST /end FUNCTION_LIST /begin REF_CHARACTERISTIC /end REF_CHARACTERISTIC /begin REF_MEASUREMENT /end REF_MEASUREMENT /end GROUP
/begin GROUP DiagcMgrProxyAppl10.ClrDiagcFlgProxy.Val "MICROSAR RTE" /begin SUB_GROUP /end SUB_GROUP /begin FUNCTION_LIST /end FUNCTION_LIST /begin REF_CHARACTERISTIC /end REF_CHARACTERISTIC /begin REF_MEASUREMENT DiagcMgrProxyAppl10.ClrDiagcFlgProxy.Val /end REF_MEASUREMENT /end GROUP
/begin GROUP DiagcMgrProxyAppl10.DiagcData10 "MICROSAR RTE" /begin SUB_GROUP /end SUB_GROUP /begin FUNCTION_LIST /end FUNCTION_LIST /begin REF_CHARACTERISTIC /end REF_CHARACTERISTIC
 /begin REF_MEASUREMENT DiagcMgrProxyAppl10.DiagcData10.ActvMotTqCmdSca DiagcMgrProxyAppl10.DiagcData10.ActvRampRate DiagcMgrProxyAppl10.DiagcData10.DiagcSts /end REF_MEASUREMENT
/end GROUP
/begin GROUP DiagcMgrProxyAppl10.DiagcMgrFltResp.Ary1D "MICROSAR RTE" /begin SUB_GROUP /end SUB_GROUP /begin FUNCTION_LIST /end FUNCTION_LIST /begin REF_CHARACTERISTIC DiagcMgrProxyAppl10.DiagcMgrFltResp.Ary1D /end REF_CHARACTERISTIC /begin REF_MEASUREMENT /end REF_MEASUREMENT /end GROUP
/begin GROUP DiagcMgrProxyAppl10.PerInstanceMemories "MICROSAR RTE"
 /begin SUB_GROUP DiagcMgrProxyAppl10.DiagcData10 DiagcMgrProxyAppl10.PrevClrNtcFlg10 DiagcMgrProxyAppl10.ProxySetNtcData10 /end SUB_GROUP
 /begin FUNCTION_LIST /end FUNCTION_LIST
 /begin REF_CHARACTERISTIC /end REF_CHARACTERISTIC
 /begin REF_MEASUREMENT /end REF_MEASUREMENT
/end GROUP
/begin GROUP DiagcMgrProxyAppl10.PrevClrNtcFlg10 "MICROSAR RTE" /begin SUB_GROUP /end SUB_GROUP /begin FUNCTION_LIST /end FUNCTION_LIST /begin REF_CHARACTERISTIC /end REF_CHARACTERISTIC /begin REF_MEASUREMENT DiagcMgrProxyAppl10.PrevClrNtcFlg10 /end REF_MEASUREMENT /end GROUP
/begin GROUP DiagcMgrProxyAppl10.ProxySetNtcData10 "MICROSAR RTE" /begin SUB_GROUP /end SUB_GROUP /begin FUNCTION_LIST /end FUNCTION_LIST /begin REF_CHARACTERISTIC /end REF_CHARACTERISTIC
 /begin REF_MEASUREMENT DiagcMgrProxyAppl10.ProxySetNtcData10.ActvMotTqCmdSca DiagcMgrProxyAppl10.ProxySetNtcData10.ActvRampRate DiagcMgrProxyAppl10.ProxySetNtcData10.DiagcSts /end REF_MEASUREMENT
/end GROUP
/begin GROUP DiagcMgrProxyAppl10.ReceiverPorts "MICROSAR RTE" /begin SUB_GROUP DiagcMgrProxyAppl10.ClrDiagcFlgProxy.Val /end SUB_GROUP /begin FUNCTION_LIST /end FUNCTION_LIST /begin REF_CHARACTERISTIC /end REF_CHARACTERISTIC /begin REF_MEASUREMENT /end REF_MEASUREMENT /end GROUP
/begin GROUP DrvrTqEstimn "MICROSAR RTE"
 /begin SUB_GROUP DrvrTqEstimn.CalibrationPorts DrvrTqEstimn.PerInstanceMemories DrvrTqEstimn.ReceiverPorts DrvrTqEstimn.SenderPorts /end SUB_GROUP
 /begin FUNCTION_LIST /end FUNCTION_LIST
 /begin REF_CHARACTERISTIC /end REF_CHARACTERISTIC
 /begin REF_MEASUREMENT /end REF_MEASUREMENT
/end GROUP
/begin GROUP DrvrTqEstimn.AssiMechPolarity.Val "MICROSAR RTE" /begin SUB_GROUP /end SUB_GROUP /begin FUNCTION_LIST /end FUNCTION_LIST /begin REF_CHARACTERISTIC /end REF_CHARACTERISTIC /begin REF_MEASUREMENT DrvrTqEstimn.AssiMechPolarity.Val /end REF_MEASUREMENT /end GROUP
/begin GROUP DrvrTqEstimn.CalibrationPorts "MICROSAR RTE"
 /begin SUB_GROUP DrvrTqEstimn.DrvrTqEstimnMtrxA.Ary2D DrvrTqEstimn.DrvrTqEstimnMtrxB.Ary2D DrvrTqEstimn.DrvrTqEstimnMtrxC.Ary1D DrvrTqEstimn.DrvrTqEstimnMtrxD.Ary1D DrvrTqEstimn.SysGlbPrmSysKineRat.Val DrvrTqEstimn.SysGlbPrmSysTqRat.Val /end SUB_GROUP
 /begin FUNCTION_LIST /end FUNCTION_LIST
 /begin REF_CHARACTERISTIC /end REF_CHARACTERISTIC
 /begin REF_MEASUREMENT /end REF_MEASUREMENT
/end GROUP
/begin GROUP DrvrTqEstimn.DrvrTqEstimd.Val "MICROSAR RTE" /begin SUB_GROUP /end SUB_GROUP /begin FUNCTION_LIST /end FUNCTION_LIST /begin REF_CHARACTERISTIC /end REF_CHARACTERISTIC /begin REF_MEASUREMENT DrvrTqEstimn.DrvrTqEstimd.Val /end REF_MEASUREMENT /end GROUP
/begin GROUP DrvrTqEstimn.DrvrTqEstimnMtrxA.Ary2D "MICROSAR RTE" /begin SUB_GROUP /end SUB_GROUP /begin FUNCTION_LIST /end FUNCTION_LIST /begin REF_CHARACTERISTIC DrvrTqEstimn.DrvrTqEstimnMtrxA.Ary2D /end REF_CHARACTERISTIC /begin REF_MEASUREMENT /end REF_MEASUREMENT /end GROUP
/begin GROUP DrvrTqEstimn.DrvrTqEstimnMtrxB.Ary2D "MICROSAR RTE" /begin SUB_GROUP /end SUB_GROUP /begin FUNCTION_LIST /end FUNCTION_LIST /begin REF_CHARACTERISTIC DrvrTqEstimn.DrvrTqEstimnMtrxB.Ary2D /end REF_CHARACTERISTIC /begin REF_MEASUREMENT /end REF_MEASUREMENT /end GROUP
/begin GROUP DrvrTqEstimn.DrvrTqEstimnMtrxC.Ary1D "MICROSAR RTE" /begin SUB_GROUP /end SUB_GROUP /begin FUNCTION_LIST /end FUNCTION_LIST /begin REF_CHARACTERISTIC DrvrTqEstimn.DrvrTqEstimnMtrxC.Ary1D /end REF_CHARACTERISTIC /begin REF_MEASUREMENT /end REF_MEASUREMENT /end GROUP
/begin GROUP DrvrTqEstimn.DrvrTqEstimnMtrxD.Ary1D "MICROSAR RTE" /begin SUB_GROUP /end SUB_GROUP /begin FUNCTION_LIST /end FUNCTION_LIST /begin REF_CHARACTERISTIC DrvrTqEstimn.DrvrTqEstimnMtrxD.Ary1D /end REF_CHARACTERISTIC /begin REF_MEASUREMENT /end REF_MEASUREMENT /end GROUP
/begin GROUP DrvrTqEstimn.DrvrTqStPrev "MICROSAR RTE" /begin SUB_GROUP /end SUB_GROUP /begin FUNCTION_LIST /end FUNCTION_LIST /begin REF_CHARACTERISTIC /end REF_CHARACTERISTIC /begin REF_MEASUREMENT DrvrTqEstimn.DrvrTqStPrev /end REF_MEASUREMENT /end GROUP
/begin GROUP DrvrTqEstimn.HwAg.Val "MICROSAR RTE" /begin SUB_GROUP /end SUB_GROUP /begin FUNCTION_LIST /end FUNCTION_LIST /begin REF_CHARACTERISTIC /end REF_CHARACTERISTIC /begin REF_MEASUREMENT DrvrTqEstimn.HwAg.Val /end REF_MEASUREMENT /end GROUP
/begin GROUP DrvrTqEstimn.HwTq.Val "MICROSAR RTE" /begin SUB_GROUP /end SUB_GROUP /begin FUNCTION_LIST /end FUNCTION_LIST /begin REF_CHARACTERISTIC /end REF_CHARACTERISTIC /begin REF_MEASUREMENT DrvrTqEstimn.HwTq.Val /end REF_MEASUREMENT /end GROUP
/begin GROUP DrvrTqEstimn.MotTqCmdPwrLimd.Val "MICROSAR RTE" /begin SUB_GROUP /end SUB_GROUP /begin FUNCTION_LIST /end FUNCTION_LIST /begin REF_CHARACTERISTIC /end REF_CHARACTERISTIC /begin REF_MEASUREMENT DrvrTqEstimn.MotTqCmdPwrLimd.Val /end REF_MEASUREMENT /end GROUP
/begin GROUP DrvrTqEstimn.MotVelCrf.Val "MICROSAR RTE" /begin SUB_GROUP /end SUB_GROUP /begin FUNCTION_LIST /end FUNCTION_LIST /begin REF_CHARACTERISTIC /end REF_CHARACTERISTIC /begin REF_MEASUREMENT DrvrTqEstimn.MotVelCrf.Val /end REF_MEASUREMENT /end GROUP
/begin GROUP DrvrTqEstimn.PerInstanceMemories "MICROSAR RTE" /begin SUB_GROUP DrvrTqEstimn.DrvrTqStPrev /end SUB_GROUP /begin FUNCTION_LIST /end FUNCTION_LIST /begin REF_CHARACTERISTIC /end REF_CHARACTERISTIC /begin REF_MEASUREMENT /end REF_MEASUREMENT /end GROUP
/begin GROUP DrvrTqEstimn.ReceiverPorts "MICROSAR RTE"
 /begin SUB_GROUP DrvrTqEstimn.AssiMechPolarity.Val DrvrTqEstimn.HwAg.Val DrvrTqEstimn.HwTq.Val DrvrTqEstimn.MotTqCmdPwrLimd.Val DrvrTqEstimn.MotVelCrf.Val /end SUB_GROUP
 /begin FUNCTION_LIST /end FUNCTION_LIST
 /begin REF_CHARACTERISTIC /end REF_CHARACTERISTIC
 /begin REF_MEASUREMENT /end REF_MEASUREMENT
/end GROUP
/begin GROUP DrvrTqEstimn.SenderPorts "MICROSAR RTE" /begin SUB_GROUP DrvrTqEstimn.DrvrTqEstimd.Val /end SUB_GROUP /begin FUNCTION_LIST /end FUNCTION_LIST /begin REF_CHARACTERISTIC /end REF_CHARACTERISTIC /begin REF_MEASUREMENT /end REF_MEASUREMENT /end GROUP
/begin GROUP DrvrTqEstimn.SysGlbPrmSysKineRat.Val "MICROSAR RTE" /begin SUB_GROUP /end SUB_GROUP /begin FUNCTION_LIST /end FUNCTION_LIST /begin REF_CHARACTERISTIC DrvrTqEstimn.SysGlbPrmSysKineRat.Val /end REF_CHARACTERISTIC /begin REF_MEASUREMENT /end REF_MEASUREMENT /end GROUP
/begin GROUP DrvrTqEstimn.SysGlbPrmSysTqRat.Val "MICROSAR RTE" /begin SUB_GROUP /end SUB_GROUP /begin FUNCTION_LIST /end FUNCTION_LIST /begin REF_CHARACTERISTIC DrvrTqEstimn.SysGlbPrmSysTqRat.Val /end REF_CHARACTERISTIC /begin REF_MEASUREMENT /end REF_MEASUREMENT /end GROUP
/begin GROUP DualCtrlrOutpMgr "MICROSAR RTE"
 /begin SUB_GROUP DualCtrlrOutpMgr.CalibrationPorts DualCtrlrOutpMgr.PerInstanceMemories DualCtrlrOutpMgr.ReceiverPorts DualCtrlrOutpMgr.SenderPorts /end SUB_GROUP
 /begin FUNCTION_LIST /end FUNCTION_LIST
 /begin REF_CHARACTERISTIC /end REF_CHARACTERISTIC
 /begin REF_MEASUREMENT /end REF_MEASUREMENT
/end GROUP
/begin GROUP DualCtrlrOutpMgr.CalibrationPorts "MICROSAR RTE"
 /begin SUB_GROUP DualCtrlrOutpMgr.DualCtrlrOutpMgrConOutpSca.Val DualCtrlrOutpMgr.DualCtrlrOutpMgrDiRateTblY.Ary1D DualCtrlrOutpMgr.DualCtrlrOutpMgrEnaRate.Val DualCtrlrOutpMgr.DualCtrlrOutpMgrFltThdTmr.Val DualCtrlrOutpMgr.DualCtrlrOutpMgrLimdOutpSca.Val DualCtrlrOutpMgr.DualCtrlrOutpMgrMaxOutpSca.Val DualCtrlrOutpMgr.DualCtrlrOutpMgrMaxOutpTmr.Val DualCtrlrOutpMgr.DualCtrlrOutpMgrMinOutpTmr.Val DualCtrlrOutpMgr.DualCtrlrOutpMgrNonRecFltThdTmr.Val DualCtrlrOutpMgr.DualCtrlrOutpMgrThdTmr.Val DualCtrlrOutpMgr.DualCtrlrOutpMgrVehSpdRefTblX.Ary1D DualCtrlrOutpMgr.DualCtrlrOutpMgrVltgModFltThdTmr.Val /end SUB_GROUP
 /begin FUNCTION_LIST /end FUNCTION_LIST
 /begin REF_CHARACTERISTIC /end REF_CHARACTERISTIC
 /begin REF_MEASUREMENT /end REF_MEASUREMENT
/end GROUP
/begin GROUP DualCtrlrOutpMgr.DualCtrlrOutpMgrConOutpSca.Val "MICROSAR RTE" /begin SUB_GROUP /end SUB_GROUP /begin FUNCTION_LIST /end FUNCTION_LIST /begin REF_CHARACTERISTIC DualCtrlrOutpMgr.DualCtrlrOutpMgrConOutpSca.Val /end REF_CHARACTERISTIC /begin REF_MEASUREMENT /end REF_MEASUREMENT /end GROUP
/begin GROUP DualCtrlrOutpMgr.DualCtrlrOutpMgrDiRateTblY.Ary1D "MICROSAR RTE" /begin SUB_GROUP /end SUB_GROUP /begin FUNCTION_LIST /end FUNCTION_LIST /begin REF_CHARACTERISTIC DualCtrlrOutpMgr.DualCtrlrOutpMgrDiRateTblY.Ary1D /end REF_CHARACTERISTIC /begin REF_MEASUREMENT /end REF_MEASUREMENT /end GROUP
/begin GROUP DualCtrlrOutpMgr.DualCtrlrOutpMgrEnaRate.Val "MICROSAR RTE" /begin SUB_GROUP /end SUB_GROUP /begin FUNCTION_LIST /end FUNCTION_LIST /begin REF_CHARACTERISTIC DualCtrlrOutpMgr.DualCtrlrOutpMgrEnaRate.Val /end REF_CHARACTERISTIC /begin REF_MEASUREMENT /end REF_MEASUREMENT /end GROUP
/begin GROUP DualCtrlrOutpMgr.DualCtrlrOutpMgrFltThdTmr.Val "MICROSAR RTE" /begin SUB_GROUP /end SUB_GROUP /begin FUNCTION_LIST /end FUNCTION_LIST /begin REF_CHARACTERISTIC DualCtrlrOutpMgr.DualCtrlrOutpMgrFltThdTmr.Val /end REF_CHARACTERISTIC /begin REF_MEASUREMENT /end REF_MEASUREMENT /end GROUP
/begin GROUP DualCtrlrOutpMgr.DualCtrlrOutpMgrLimdOutpSca.Val "MICROSAR RTE" /begin SUB_GROUP /end SUB_GROUP /begin FUNCTION_LIST /end FUNCTION_LIST /begin REF_CHARACTERISTIC DualCtrlrOutpMgr.DualCtrlrOutpMgrLimdOutpSca.Val /end REF_CHARACTERISTIC /begin REF_MEASUREMENT /end REF_MEASUREMENT /end GROUP
/begin GROUP DualCtrlrOutpMgr.DualCtrlrOutpMgrMaxOutpSca.Val "MICROSAR RTE" /begin SUB_GROUP /end SUB_GROUP /begin FUNCTION_LIST /end FUNCTION_LIST /begin REF_CHARACTERISTIC DualCtrlrOutpMgr.DualCtrlrOutpMgrMaxOutpSca.Val /end REF_CHARACTERISTIC /begin REF_MEASUREMENT /end REF_MEASUREMENT /end GROUP
/begin GROUP DualCtrlrOutpMgr.DualCtrlrOutpMgrMaxOutpTmr.Val "MICROSAR RTE" /begin SUB_GROUP /end SUB_GROUP /begin FUNCTION_LIST /end FUNCTION_LIST /begin REF_CHARACTERISTIC DualCtrlrOutpMgr.DualCtrlrOutpMgrMaxOutpTmr.Val /end REF_CHARACTERISTIC /begin REF_MEASUREMENT /end REF_MEASUREMENT /end GROUP
/begin GROUP DualCtrlrOutpMgr.DualCtrlrOutpMgrMinOutpTmr.Val "MICROSAR RTE" /begin SUB_GROUP /end SUB_GROUP /begin FUNCTION_LIST /end FUNCTION_LIST /begin REF_CHARACTERISTIC DualCtrlrOutpMgr.DualCtrlrOutpMgrMinOutpTmr.Val /end REF_CHARACTERISTIC /begin REF_MEASUREMENT /end REF_MEASUREMENT /end GROUP
/begin GROUP DualCtrlrOutpMgr.DualCtrlrOutpMgrNonRecFltThdTmr.Val "MICROSAR RTE" /begin SUB_GROUP /end SUB_GROUP /begin FUNCTION_LIST /end FUNCTION_LIST /begin REF_CHARACTERISTIC DualCtrlrOutpMgr.DualCtrlrOutpMgrNonRecFltThdTmr.Val /end REF_CHARACTERISTIC /begin REF_MEASUREMENT /end REF_MEASUREMENT /end GROUP
/begin GROUP DualCtrlrOutpMgr.DualCtrlrOutpMgrThdTmr.Val "MICROSAR RTE" /begin SUB_GROUP /end SUB_GROUP /begin FUNCTION_LIST /end FUNCTION_LIST /begin REF_CHARACTERISTIC DualCtrlrOutpMgr.DualCtrlrOutpMgrThdTmr.Val /end REF_CHARACTERISTIC /begin REF_MEASUREMENT /end REF_MEASUREMENT /end GROUP
/begin GROUP DualCtrlrOutpMgr.DualCtrlrOutpMgrVehSpdRefTblX.Ary1D "MICROSAR RTE" /begin SUB_GROUP /end SUB_GROUP /begin FUNCTION_LIST /end FUNCTION_LIST /begin REF_CHARACTERISTIC DualCtrlrOutpMgr.DualCtrlrOutpMgrVehSpdRefTblX.Ary1D /end REF_CHARACTERISTIC /begin REF_MEASUREMENT /end REF_MEASUREMENT /end GROUP
/begin GROUP DualCtrlrOutpMgr.DualCtrlrOutpMgrVltgModFltThdTmr.Val "MICROSAR RTE" /begin SUB_GROUP /end SUB_GROUP /begin FUNCTION_LIST /end FUNCTION_LIST /begin REF_CHARACTERISTIC DualCtrlrOutpMgr.DualCtrlrOutpMgrVltgModFltThdTmr.Val /end REF_CHARACTERISTIC /begin REF_MEASUREMENT /end REF_MEASUREMENT /end GROUP
/begin GROUP DualCtrlrOutpMgr.DualEcuFltMtgtnEna.Logl "MICROSAR RTE" /begin SUB_GROUP /end SUB_GROUP /begin FUNCTION_LIST /end FUNCTION_LIST /begin REF_CHARACTERISTIC /end REF_CHARACTERISTIC /begin REF_MEASUREMENT DualCtrlrOutpMgr.DualEcuFltMtgtnEna.Logl /end REF_MEASUREMENT /end GROUP
/begin GROUP DualCtrlrOutpMgr.DualEcuFltMtgtnSca.Val "MICROSAR RTE" /begin SUB_GROUP /end SUB_GROUP /begin FUNCTION_LIST /end FUNCTION_LIST /begin REF_CHARACTERISTIC /end REF_CHARACTERISTIC /begin REF_MEASUREMENT DualCtrlrOutpMgr.DualEcuFltMtgtnSca.Val /end REF_MEASUREMENT /end GROUP
/begin GROUP DualCtrlrOutpMgr.DualEcuMotCtrlMtgtnEna.Logl "MICROSAR RTE" /begin SUB_GROUP /end SUB_GROUP /begin FUNCTION_LIST /end FUNCTION_LIST /begin REF_CHARACTERISTIC /end REF_CHARACTERISTIC /begin REF_MEASUREMENT DualCtrlrOutpMgr.DualEcuMotCtrlMtgtnEna.Logl /end REF_MEASUREMENT /end GROUP
/begin GROUP DualCtrlrOutpMgr.FltLrngEnaPrev "MICROSAR RTE" /begin SUB_GROUP /end SUB_GROUP /begin FUNCTION_LIST /end FUNCTION_LIST /begin REF_CHARACTERISTIC /end REF_CHARACTERISTIC /begin REF_MEASUREMENT DualCtrlrOutpMgr.FltLrngEnaPrev /end REF_MEASUREMENT /end GROUP
/begin GROUP DualCtrlrOutpMgr.FltRefTiEnaLrng "MICROSAR RTE" /begin SUB_GROUP /end SUB_GROUP /begin FUNCTION_LIST /end FUNCTION_LIST /begin REF_CHARACTERISTIC /end REF_CHARACTERISTIC /begin REF_MEASUREMENT DualCtrlrOutpMgr.FltRefTiEnaLrng /end REF_MEASUREMENT /end GROUP
/begin GROUP DualCtrlrOutpMgr.FltStsPrev "MICROSAR RTE" /begin SUB_GROUP /end SUB_GROUP /begin FUNCTION_LIST /end FUNCTION_LIST /begin REF_CHARACTERISTIC /end REF_CHARACTERISTIC /begin REF_MEASUREMENT DualCtrlrOutpMgr.FltStsPrev /end REF_MEASUREMENT /end GROUP
/begin GROUP DualCtrlrOutpMgr.ImcSysSt.Val "MICROSAR RTE" /begin SUB_GROUP /end SUB_GROUP /begin FUNCTION_LIST /end FUNCTION_LIST /begin REF_CHARACTERISTIC /end REF_CHARACTERISTIC /begin REF_MEASUREMENT DualCtrlrOutpMgr.ImcSysSt.Val /end REF_MEASUREMENT /end GROUP
/begin GROUP DualCtrlrOutpMgr.ImcSysStVld.Val "MICROSAR RTE" /begin SUB_GROUP /end SUB_GROUP /begin FUNCTION_LIST /end FUNCTION_LIST /begin REF_CHARACTERISTIC /end REF_CHARACTERISTIC /begin REF_MEASUREMENT DualCtrlrOutpMgr.ImcSysStVld.Val /end REF_MEASUREMENT /end GROUP
/begin GROUP DualCtrlrOutpMgr.LtchImcDualEcuMotCtrlMtgtnEnaPrev "MICROSAR RTE" /begin SUB_GROUP /end SUB_GROUP /begin FUNCTION_LIST /end FUNCTION_LIST /begin REF_CHARACTERISTIC /end REF_CHARACTERISTIC /begin REF_MEASUREMENT DualCtrlrOutpMgr.LtchImcDualEcuMotCtrlMtgtnEnaPrev /end REF_MEASUREMENT /end GROUP
/begin GROUP DualCtrlrOutpMgr.LtchRefTiEnaLrng "MICROSAR RTE" /begin SUB_GROUP /end SUB_GROUP /begin FUNCTION_LIST /end FUNCTION_LIST /begin REF_CHARACTERISTIC /end REF_CHARACTERISTIC /begin REF_MEASUREMENT DualCtrlrOutpMgr.LtchRefTiEnaLrng /end REF_MEASUREMENT /end GROUP
/begin GROUP DualCtrlrOutpMgr.LtchSysStPrev "MICROSAR RTE" /begin SUB_GROUP /end SUB_GROUP /begin FUNCTION_LIST /end FUNCTION_LIST /begin REF_CHARACTERISTIC /end REF_CHARACTERISTIC /begin REF_MEASUREMENT DualCtrlrOutpMgr.LtchSysStPrev /end REF_MEASUREMENT /end GROUP
/begin GROUP DualCtrlrOutpMgr.MaxOutpRefTiEna "MICROSAR RTE" /begin SUB_GROUP /end SUB_GROUP /begin FUNCTION_LIST /end FUNCTION_LIST /begin REF_CHARACTERISTIC /end REF_CHARACTERISTIC /begin REF_MEASUREMENT DualCtrlrOutpMgr.MaxOutpRefTiEna /end REF_MEASUREMENT /end GROUP
/begin GROUP DualCtrlrOutpMgr.MaxOutpTmrCmpl "MICROSAR RTE" /begin SUB_GROUP /end SUB_GROUP /begin FUNCTION_LIST /end FUNCTION_LIST /begin REF_CHARACTERISTIC /end REF_CHARACTERISTIC /begin REF_MEASUREMENT DualCtrlrOutpMgr.MaxOutpTmrCmpl /end REF_MEASUREMENT /end GROUP
/begin GROUP DualCtrlrOutpMgr.MotAndThermProtnLoaMod.Val "MICROSAR RTE" /begin SUB_GROUP /end SUB_GROUP /begin FUNCTION_LIST /end FUNCTION_LIST /begin REF_CHARACTERISTIC /end REF_CHARACTERISTIC /begin REF_MEASUREMENT DualCtrlrOutpMgr.MotAndThermProtnLoaMod.Val /end REF_MEASUREMENT /end GROUP
/begin GROUP DualCtrlrOutpMgr.NonRecFltEnaPrev "MICROSAR RTE" /begin SUB_GROUP /end SUB_GROUP /begin FUNCTION_LIST /end FUNCTION_LIST /begin REF_CHARACTERISTIC /end REF_CHARACTERISTIC /begin REF_MEASUREMENT DualCtrlrOutpMgr.NonRecFltEnaPrev /end REF_MEASUREMENT /end GROUP
/begin GROUP DualCtrlrOutpMgr.NonRecFltRefTiEnaLrng "MICROSAR RTE" /begin SUB_GROUP /end SUB_GROUP /begin FUNCTION_LIST /end FUNCTION_LIST /begin REF_CHARACTERISTIC /end REF_CHARACTERISTIC /begin REF_MEASUREMENT DualCtrlrOutpMgr.NonRecFltRefTiEnaLrng /end REF_MEASUREMENT /end GROUP
/begin GROUP DualCtrlrOutpMgr.OutpSca "MICROSAR RTE" /begin SUB_GROUP /end SUB_GROUP /begin FUNCTION_LIST /end FUNCTION_LIST /begin REF_CHARACTERISTIC /end REF_CHARACTERISTIC /begin REF_MEASUREMENT DualCtrlrOutpMgr.OutpSca /end REF_MEASUREMENT /end GROUP
/begin GROUP DualCtrlrOutpMgr.PerInstanceMemories "MICROSAR RTE"
 /begin SUB_GROUP DualCtrlrOutpMgr.FltLrngEnaPrev DualCtrlrOutpMgr.FltRefTiEnaLrng DualCtrlrOutpMgr.FltStsPrev DualCtrlrOutpMgr.LtchImcDualEcuMotCtrlMtgtnEnaPrev DualCtrlrOutpMgr.LtchRefTiEnaLrng DualCtrlrOutpMgr.LtchSysStPrev DualCtrlrOutpMgr.MaxOutpRefTiEna DualCtrlrOutpMgr.MaxOutpTmrCmpl DualCtrlrOutpMgr.NonRecFltEnaPrev DualCtrlrOutpMgr.NonRecFltRefTiEnaLrng DualCtrlrOutpMgr.OutpSca DualCtrlrOutpMgr.PrevLtch DualCtrlrOutpMgr.PrevLtchNonRecFlt DualCtrlrOutpMgr.RefTiEnaLrng DualCtrlrOutpMgr.SysStLrngEnaPrev DualCtrlrOutpMgr.SysStRefTiEnaLrng /end SUB_GROUP
 /begin FUNCTION_LIST /end FUNCTION_LIST
 /begin REF_CHARACTERISTIC /end REF_CHARACTERISTIC
 /begin REF_MEASUREMENT /end REF_MEASUREMENT
/end GROUP
/begin GROUP DualCtrlrOutpMgr.PrevLtch "MICROSAR RTE" /begin SUB_GROUP /end SUB_GROUP /begin FUNCTION_LIST /end FUNCTION_LIST /begin REF_CHARACTERISTIC /end REF_CHARACTERISTIC /begin REF_MEASUREMENT DualCtrlrOutpMgr.PrevLtch /end REF_MEASUREMENT /end GROUP
/begin GROUP DualCtrlrOutpMgr.PrevLtchNonRecFlt "MICROSAR RTE" /begin SUB_GROUP /end SUB_GROUP /begin FUNCTION_LIST /end FUNCTION_LIST /begin REF_CHARACTERISTIC /end REF_CHARACTERISTIC /begin REF_MEASUREMENT DualCtrlrOutpMgr.PrevLtchNonRecFlt /end REF_MEASUREMENT /end GROUP
/begin GROUP DualCtrlrOutpMgr.ReceiverPorts "MICROSAR RTE"
 /begin SUB_GROUP DualCtrlrOutpMgr.ImcSysSt.Val DualCtrlrOutpMgr.ImcSysStVld.Val DualCtrlrOutpMgr.MotAndThermProtnLoaMod.Val DualCtrlrOutpMgr.SysSt.Val DualCtrlrOutpMgr.VehSpd.Val /end SUB_GROUP
 /begin FUNCTION_LIST /end FUNCTION_LIST
 /begin REF_CHARACTERISTIC /end REF_CHARACTERISTIC
 /begin REF_MEASUREMENT /end REF_MEASUREMENT
/end GROUP
/begin GROUP DualCtrlrOutpMgr.RefTiEnaLrng "MICROSAR RTE" /begin SUB_GROUP /end SUB_GROUP /begin FUNCTION_LIST /end FUNCTION_LIST /begin REF_CHARACTERISTIC /end REF_CHARACTERISTIC /begin REF_MEASUREMENT DualCtrlrOutpMgr.RefTiEnaLrng /end REF_MEASUREMENT /end GROUP
/begin GROUP DualCtrlrOutpMgr.SenderPorts "MICROSAR RTE"
 /begin SUB_GROUP DualCtrlrOutpMgr.DualEcuFltMtgtnEna.Logl DualCtrlrOutpMgr.DualEcuFltMtgtnSca.Val DualCtrlrOutpMgr.DualEcuMotCtrlMtgtnEna.Logl /end SUB_GROUP
 /begin FUNCTION_LIST /end FUNCTION_LIST
 /begin REF_CHARACTERISTIC /end REF_CHARACTERISTIC
 /begin REF_MEASUREMENT /end REF_MEASUREMENT
/end GROUP
/begin GROUP DualCtrlrOutpMgr.SysSt.Val "MICROSAR RTE" /begin SUB_GROUP /end SUB_GROUP /begin FUNCTION_LIST /end FUNCTION_LIST /begin REF_CHARACTERISTIC /end REF_CHARACTERISTIC /begin REF_MEASUREMENT DualCtrlrOutpMgr.SysSt.Val /end REF_MEASUREMENT /end GROUP
/begin GROUP DualCtrlrOutpMgr.SysStLrngEnaPrev "MICROSAR RTE" /begin SUB_GROUP /end SUB_GROUP /begin FUNCTION_LIST /end FUNCTION_LIST /begin REF_CHARACTERISTIC /end REF_CHARACTERISTIC /begin REF_MEASUREMENT DualCtrlrOutpMgr.SysStLrngEnaPrev /end REF_MEASUREMENT /end GROUP
/begin GROUP DualCtrlrOutpMgr.SysStRefTiEnaLrng "MICROSAR RTE" /begin SUB_GROUP /end SUB_GROUP /begin FUNCTION_LIST /end FUNCTION_LIST /begin REF_CHARACTERISTIC /end REF_CHARACTERISTIC /begin REF_MEASUREMENT DualCtrlrOutpMgr.SysStRefTiEnaLrng /end REF_MEASUREMENT /end GROUP
/begin GROUP DualCtrlrOutpMgr.VehSpd.Val "MICROSAR RTE" /begin SUB_GROUP /end SUB_GROUP /begin FUNCTION_LIST /end FUNCTION_LIST /begin REF_CHARACTERISTIC /end REF_CHARACTERISTIC /begin REF_MEASUREMENT DualCtrlrOutpMgr.VehSpd.Val /end REF_MEASUREMENT /end GROUP
/begin GROUP DualEcuIdn "MICROSAR RTE"
 /begin SUB_GROUP DualEcuIdn.PerInstanceMemories DualEcuIdn.ReceiverPorts DualEcuIdn.SenderPorts /end SUB_GROUP
 /begin FUNCTION_LIST /end FUNCTION_LIST
 /begin REF_CHARACTERISTIC /end REF_CHARACTERISTIC
 /begin REF_MEASUREMENT /end REF_MEASUREMENT
/end GROUP
/begin GROUP DualEcuIdn.EcuComTiOut.Logl "MICROSAR RTE" /begin SUB_GROUP /end SUB_GROUP /begin FUNCTION_LIST /end FUNCTION_LIST /begin REF_CHARACTERISTIC /end REF_CHARACTERISTIC /begin REF_MEASUREMENT DualEcuIdn.EcuComTiOut.Logl /end REF_MEASUREMENT /end GROUP
/begin GROUP DualEcuIdn.EcuId.Val "MICROSAR RTE" /begin SUB_GROUP /end SUB_GROUP /begin FUNCTION_LIST /end FUNCTION_LIST /begin REF_CHARACTERISTIC /end REF_CHARACTERISTIC /begin REF_MEASUREMENT DualEcuIdn.EcuId.Val /end REF_MEASUREMENT /end GROUP
/begin GROUP DualEcuIdn.EcuIdInt "MICROSAR RTE" /begin SUB_GROUP /end SUB_GROUP /begin FUNCTION_LIST /end FUNCTION_LIST /begin REF_CHARACTERISTIC /end REF_CHARACTERISTIC /begin REF_MEASUREMENT DualEcuIdn.EcuIdInt /end REF_MEASUREMENT /end GROUP
/begin GROUP DualEcuIdn.EcuIdnEvlnCmpl "MICROSAR RTE" /begin SUB_GROUP /end SUB_GROUP /begin FUNCTION_LIST /end FUNCTION_LIST /begin REF_CHARACTERISTIC /end REF_CHARACTERISTIC /begin REF_MEASUREMENT DualEcuIdn.EcuIdnEvlnCmpl /end REF_MEASUREMENT /end GROUP
/begin GROUP DualEcuIdn.PerInstanceMemories "MICROSAR RTE"
 /begin SUB_GROUP DualEcuIdn.EcuIdInt DualEcuIdn.EcuIdnEvlnCmpl DualEcuIdn.SecdryEcuIdnReqTiOutCntr /end SUB_GROUP
 /begin FUNCTION_LIST /end FUNCTION_LIST
 /begin REF_CHARACTERISTIC /end REF_CHARACTERISTIC
 /begin REF_MEASUREMENT /end REF_MEASUREMENT
/end GROUP
/begin GROUP DualEcuIdn.ReceiverPorts "MICROSAR RTE" /begin SUB_GROUP DualEcuIdn.EcuComTiOut.Logl /end SUB_GROUP /begin FUNCTION_LIST /end FUNCTION_LIST /begin REF_CHARACTERISTIC /end REF_CHARACTERISTIC /begin REF_MEASUREMENT /end REF_MEASUREMENT /end GROUP
/begin GROUP DualEcuIdn.SecdryEcuIdnReqTiOutCntr "MICROSAR RTE" /begin SUB_GROUP /end SUB_GROUP /begin FUNCTION_LIST /end FUNCTION_LIST /begin REF_CHARACTERISTIC /end REF_CHARACTERISTIC /begin REF_MEASUREMENT DualEcuIdn.SecdryEcuIdnReqTiOutCntr /end REF_MEASUREMENT /end GROUP
/begin GROUP DualEcuIdn.SenderPorts "MICROSAR RTE" /begin SUB_GROUP DualEcuIdn.EcuId.Val /end SUB_GROUP /begin FUNCTION_LIST /end FUNCTION_LIST /begin REF_CHARACTERISTIC /end REF_CHARACTERISTIC /begin REF_MEASUREMENT /end REF_MEASUREMENT /end GROUP
/begin GROUP DutyCycThermProtn "MICROSAR RTE"
 /begin SUB_GROUP DutyCycThermProtn.CalibrationPorts DutyCycThermProtn.PerInstanceMemories DutyCycThermProtn.ReceiverPorts DutyCycThermProtn.SenderPorts /end SUB_GROUP
 /begin FUNCTION_LIST /end FUNCTION_LIST
 /begin REF_CHARACTERISTIC /end REF_CHARACTERISTIC
 /begin REF_MEASUREMENT /end REF_MEASUREMENT
/end GROUP
/begin GROUP DutyCycThermProtn.AbsltTLimSlewStVari "MICROSAR RTE" /begin SUB_GROUP /end SUB_GROUP /begin FUNCTION_LIST /end FUNCTION_LIST /begin REF_CHARACTERISTIC /end REF_CHARACTERISTIC /begin REF_MEASUREMENT DutyCycThermProtn.AbsltTLimSlewStVari /end REF_MEASUREMENT /end GROUP
/**********************************************************************************************************************
* RECORD_LAYOUT
*********************************************************************************************************************/
/begin RECORD_LAYOUT RTE_RL_UBYTE FNC_VALUES 1 UBYTE ROW_DIR DIRECT /end RECORD_LAYOUT
/begin RECORD_LAYOUT RTE_RL_UWORD FNC_VALUES 1 UWORD ROW_DIR DIRECT /end RECORD_LAYOUT
/begin RECORD_LAYOUT RTE_RL_ULONG FNC_VALUES 1 ULONG ROW_DIR DIRECT /end RECORD_LAYOUT
/begin RECORD_LAYOUT RTE_RL_SWORD FNC_VALUES 1 SWORD ROW_DIR DIRECT /end RECORD_LAYOUT
/begin RECORD_LAYOUT RTE_RL_FLOAT32_IEEE FNC_VALUES 1 FLOAT32_IEEE ROW_DIR DIRECT /end RECORD_LAYOUT
/**********************************************************************************************************************
* COMPU_METHOD / COMPU_VTAB_RANGE
*********************************************************************************************************************/
/begin COMPU_METHOD RTE_CM_BOOLEAN "" TAB_VERB "%3.1" "" COMPU_TAB_REF RTE_CM_BOOLEAN /end COMPU_METHOD
/begin COMPU_VTAB_RANGE RTE_CM_BOOLEAN "" 2 0 0 "false" 1 255 "true" /end COMPU_VTAB_RANGE
/begin COMPU_METHOD RTE_CM_ENUM_SysSt1 "" TAB_VERB "%.1" "" COMPU_TAB_REF RTE_CM_ENUM_SysSt1 /end COMPU_METHOD
/begin COMPU_VTAB_RANGE RTE_CM_ENUM_SysSt1 "" 4 0 0 "SYSST_DI" 1 1 "SYSST_OFF" 2 2 "SYSST_ENA" 3 3 "SYSST_WRMININ" /end COMPU_VTAB_RANGE
/begin COMPU_METHOD RTE_CM_ENUM_BswMEcuResetMod "" TAB_VERB "%.1" "" COMPU_TAB_REF RTE_CM_ENUM_BswMEcuResetMod /end COMPU_METHOD
/begin COMPU_VTAB_RANGE RTE_CM_ENUM_BswMEcuResetMod "" 4 0 0 "RTE_MODE_BswMEcuResetMod_EcuResetDisabled" 1 1 "RTE_MODE_BswMEcuResetMod_EcuResetEnabled" 2 2 "RTE_MODE_BswMEcuResetMod_EcuResetStarted" 3 3 "RTE_TRANSITION_BswMEcuResetMod" /end COMPU_VTAB_RANGE
/begin COMPU_METHOD RTE_CM_ENUM_BswM_BswMEcuResetMod "" TAB_VERB "%.1" "" COMPU_TAB_REF RTE_CM_ENUM_BswM_BswMEcuResetMod /end COMPU_METHOD
/begin COMPU_VTAB_RANGE RTE_CM_ENUM_BswM_BswMEcuResetMod "" 3 0 0 "EcuResetDisabled" 1 1 "EcuResetEnabled" 2 2 "EcuResetStarted" /end COMPU_VTAB_RANGE
/begin COMPU_METHOD RTE_CM_ENUM_FordEpsSysSt1 "" TAB_VERB "%.1" "" COMPU_TAB_REF RTE_CM_ENUM_FordEpsSysSt1 /end COMPU_METHOD
/begin COMPU_VTAB_RANGE RTE_CM_ENUM_FordEpsSysSt1 "" 9 0 0 "FORDEPSSYSST_EPS_ININ" 1 1 "FORDEPSSYSST_EPS_NORM_OP_LIMD_ASSI" 2 2 "FORDEPSSYSST_EPS_NORM_OP_FULL_ASSI" 3 3 "FORDEPSSYSST_EPS_SYST_FAILR_LIMPHOME" 4 4 "FORDEPSSYSST_EPS_SYST_FAILR_LIMPASIDE" 5 5 "FORDEPSSYSST_EPS_SYST_FAILR_RAMPOUT" 6 6 "FORDEPSSYSST_EPS_SYST_FAILR_ASSISTOFF" 7 7 "FORDEPSSYSST_EPS_SHTDWN" 8 8 "FORDEPSSYSST_EPS_PWRDWN" /end COMPU_VTAB_RANGE
/begin COMPU_METHOD RTE_CM_ENUM_NtcNrWithResd1 "" TAB_VERB "%.1" "" COMPU_TAB_REF RTE_CM_ENUM_NtcNrWithResd1 /end COMPU_METHOD
/begin COMPU_VTAB_RANGE RTE_CM_ENUM_NtcNrWithResd1 "" 512 0 0 "NTCNR_RESD" 1 1 "NTCNR_0X001" 2 2 "NTCNR_0X002" 3 3 "NTCNR_0X003" 4 4 "NTCNR_0X004" 5 5 "NTCNR_0X005" 6 6 "NTCNR_0X006" 7 7 "NTCNR_0X007" 8 8 "NTCNR_0X008" 9 9 "NTCNR_0X009" 10 10 "NTCNR_0X00A" 11 11 "NTCNR_0X00B" 12 12 "NTCNR_0X00C" 13 13 "NTCNR_0X00D" 14 14 "NTCNR_0X00E" 15 15 "NTCNR_0X00F" 16 16 "NTCNR_0X010" 17 17 "NTCNR_0X011" 18 18 "NTCNR_0X012" 19 19 "NTCNR_0X013" 20 20 "NTCNR_0X014" 21 21 "NTCNR_0X015" 22 22 "NTCNR_0X016" 23 23 "NTCNR_0X017" 24 24 "NTCNR_0X018" 25 25 "NTCNR_0X019" 26 26 "NTCNR_0X01A" 27 27 "NTCNR_0X01B" 28 28 "NTCNR_0X01C" 29 29 "NTCNR_0X01D" 30 30 "NTCNR_0X01E" 31 31 "NTCNR_0X01F" 32 32 "NTCNR_0X020" 33 33 "NTCNR_0X021" 34 34 "NTCNR_0X022" 35 35 "NTCNR_0X023" 36 36 "NTCNR_0X024" 37 37 "NTCNR_0X025" 38 38 "NTCNR_0X026" 39 39 "NTCNR_0X027" 40 40 "NTCNR_0X028" 41 41 "NTCNR_0X029" 42 42 "NTCNR_0X02A" 43 43 "NTCNR_0X02B" 44 44 "NTCNR_0X02C" 45 45 "NTCNR_0X02D" 46 46 "NTCNR_0X02E" 47 47 "NTCNR_0X02F" 48 48 "NTCNR_0X030" 49 49 "NTCNR_0X031" 50 50 "NTCNR_0X032" 51 51 "NTCNR_0X033" 52 52 "NTCNR_0X034" 53 53 "NTCNR_0X035" 54 54 "NTCNR_0X036" 55 55 "NTCNR_0X037" 56 56 "NTCNR_0X038" 57 57 "NTCNR_0X039" 58 58 "NTCNR_0X03A" 59 59 "NTCNR_0X03B" 60 60 "NTCNR_0X03C" 61 61 "NTCNR_0X03D" 62 62 "NTCNR_0X03E" 63 63 "NTCNR_0X03F" 64 64 "NTCNR_0X040" 65 65 "NTCNR_0X041" 66 66 "NTCNR_0X042" 67 67 "NTCNR_0X043" 68 68 "NTCNR_0X044" 69 69 "NTCNR_0X045" 70 70 "NTCNR_0X046" 71 71 "NTCNR_0X047" 72 72 "NTCNR_0X048" 73 73 "NTCNR_0X049" 74 74 "NTCNR_0X04A" 75 75 "NTCNR_0X04B" 76 76 "NTCNR_0X04C" 77 77 "NTCNR_0X04D" 78 78 "NTCNR_0X04E" 79 79 "NTCNR_0X04F" 80 80 "NTCNR_0X050" 81 81 "NTCNR_0X051" 82 82 "NTCNR_0X052" 83 83 "NTCNR_0X053" 84 84 "NTCNR_0X054" 85 85 "NTCNR_0X055" 86 86 "NTCNR_0X056" 87 87 "NTCNR_0X057" 88 88 "NTCNR_0X058" 89 89 "NTCNR_0X059" 90 90 "NTCNR_0X05A" 91 91 "NTCNR_0X05B" 92 92 "NTCNR_0X05C" 93 93 "NTCNR_0X05D" 94 94 "NTCNR_0X05E" 95 95 "NTCNR_0X05F" 96 96 "NTCNR_0X060" 97 97 "NTCNR_0X061" 98 98 "NTCNR_0X062" 99 99 "NTCNR_0X063" 100 100 "NTCNR_0X064" 101 101 "NTCNR_0X065" 102 102 "NTCNR_0X066" 103 103 "NTCNR_0X067" 104 104 "NTCNR_0X068" 105 105 "NTCNR_0X069" 106 106 "NTCNR_0X06A" 107 107 "NTCNR_0X06B" 108 108 "NTCNR_0X06C" 109 109 "NTCNR_0X06D" 110 110 "NTCNR_0X06E" 111 111 "NTCNR_0X06F" 112 112 "NTCNR_0X070" 113 113 "NTCNR_0X071" 114 114 "NTCNR_0X072" 115 115 "NTCNR_0X073" 116 116 "NTCNR_0X074" 117 117 "NTCNR_0X075" 118 118 "NTCNR_0X076" 119 119 "NTCNR_0X077" 120 120 "NTCNR_0X078" 121 121 "NTCNR_0X079" 122 122 "NTCNR_0X07A" 123 123 "NTCNR_0X07B" 124 124 "NTCNR_0X07C" 125 125 "NTCNR_0X07D" 126 126 "NTCNR_0X07E" 127 127 "NTCNR_0X07F" 128 128 "NTCNR_0X080" 129 129 "NTCNR_0X081" 130 130 "NTCNR_0X082" 131 131 "NTCNR_0X083" 132 132 "NTCNR_0X084" 133 133 "NTCNR_0X085" 134 134 "NTCNR_0X086" 135 135 "NTCNR_0X087" 136 136 "NTCNR_0X088" 137 137 "NTCNR_0X089" 138 138 "NTCNR_0X08A" 139 139 "NTCNR_0X08B" 140 140 "NTCNR_0X08C" 141 141 "NTCNR_0X08D" 142 142 "NTCNR_0X08E" 143 143 "NTCNR_0X08F" 144 144 "NTCNR_0X090" 145 145 "NTCNR_0X091" 146 146 "NTCNR_0X092" 147 147 "NTCNR_0X093" 148 148 "NTCNR_0X094" 149 149 "NTCNR_0X095" 150 150 "NTCNR_0X096" 151 151 "NTCNR_0X097" 152 152 "NTCNR_0X098" 153 153 "NTCNR_0X099" 154 154 "NTCNR_0X09A" 155 155 "NTCNR_0X09B" 156 156 "NTCNR_0X09C" 157 157 "NTCNR_0X09D" 158 158 "NTCNR_0X09E" 159 159 "NTCNR_0X09F" 160 160 "NTCNR_0X0A0" 161 161 "NTCNR_0X0A1" 162 162 "NTCNR_0X0A2" 163 163 "NTCNR_0X0A3" 164 164 "NTCNR_0X0A4" 165 165 "NTCNR_0X0A5" 166 166 "NTCNR_0X0A6" 167 167 "NTCNR_0X0A7" 168 168 "NTCNR_0X0A8" 169 169 "NTCNR_0X0A9" 170 170 "NTCNR_0X0AA" 171 171 "NTCNR_0X0AB" 172 172 "NTCNR_0X0AC" 173 173 "NTCNR_0X0AD" 174 174 "NTCNR_0X0AE" 175 175 "NTCNR_0X0AF" 176 176 "NTCNR_0X0B0" 177 177 "NTCNR_0X0B1" 178 178 "NTCNR_0X0B2" 179 179 "NTCNR_0X0B3" 180 180 "NTCNR_0X0B4" 181 181 "NTCNR_0X0B5" 182 182 "NTCNR_0X0B6" 183 183 "NTCNR_0X0B7" 184 184 "NTCNR_0X0B8" 185 185 "NTCNR_0X0B9" 186 186 "NTCNR_0X0BA" 187 187 "NTCNR_0X0BB" 188 188 "NTCNR_0X0BC" 189 189 "NTCNR_0X0BD" 190 190 "NTCNR_0X0BE" 191 191 "NTCNR_0X0BF" 192 192 "NTCNR_0X0C0" 193 193 "NTCNR_0X0C1" 194 194 "NTCNR_0X0C2" 195 195 "NTCNR_0X0C3" 196 196 "NTCNR_0X0C4" 197 197 "NTCNR_0X0C5" 198 198 "NTCNR_0X0C6" 199 199 "NTCNR_0X0C7" 200 200 "NTCNR_0X0C8" 201 201 "NTCNR_0X0C9" 202 202 "NTCNR_0X0CA" 203 203 "NTCNR_0X0CB" 204 204 "NTCNR_0X0CC" 205 205 "NTCNR_0X0CD" 206 206 "NTCNR_0X0CE" 207 207 "NTCNR_0X0CF" 208 208 "NTCNR_0X0D0" 209 209 "NTCNR_0X0D1" 210 210 "NTCNR_0X0D2" 211 211 "NTCNR_0X0D3" 212 212 "NTCNR_0X0D4" 213 213 "NTCNR_0X0D5" 214 214 "NTCNR_0X0D6" 215 215 "NTCNR_0X0D7" 216 216 "NTCNR_0X0D8" 217 217 "NTCNR_0X0D9" 218 218 "NTCNR_0X0DA" 219 219 "NTCNR_0X0DB" 220 220 "NTCNR_0X0DC" 221 221 "NTCNR_0X0DD" 222 222 "NTCNR_0X0DE" 223 223 "NTCNR_0X0DF" 224 224 "NTCNR_0X0E0" 225 225 "NTCNR_0X0E1" 226 226 "NTCNR_0X0E2" 227 227 "NTCNR_0X0E3" 228 228 "NTCNR_0X0E4" 229 229 "NTCNR_0X0E5" 230 230 "NTCNR_0X0E6" 231 231 "NTCNR_0X0E7" 232 232 "NTCNR_0X0E8" 233 233 "NTCNR_0X0E9" 234 234 "NTCNR_0X0EA" 235 235 "NTCNR_0X0EB" 236 236 "NTCNR_0X0EC" 237 237 "NTCNR_0X0ED" 238 238 "NTCNR_0X0EE" 239 239 "NTCNR_0X0EF" 240 240 "NTCNR_0X0F0" 241 241 "NTCNR_0X0F1" 242 242 "NTCNR_0X0F2" 243 243 "NTCNR_0X0F3" 244 244 "NTCNR_0X0F4" 245 245 "NTCNR_0X0F5" 246 246 "NTCNR_0X0F6" 247 247 "NTCNR_0X0F7" 248 248 "NTCNR_0X0F8" 249 249 "NTCNR_0X0F9" 250 250 "NTCNR_0X0FA" 251 251 "NTCNR_0X0FB" 252 252 "NTCNR_0X0FC" 253 253 "NTCNR_0X0FD" 254 254 "NTCNR_0X0FE" 255 255 "NTCNR_0X0FF" 256 256 "NTCNR_0X100" 257 257 "NTCNR_0X101" 258 258 "NTCNR_0X102" 259 259 "NTCNR_0X103" 260 260 "NTCNR_0X104" 261 261 "NTCNR_0X105" 262 262 "NTCNR_0X106" 263 263 "NTCNR_0X107" 264 264 "NTCNR_0X108" 265 265 "NTCNR_0X109" 266 266 "NTCNR_0X10A" 267 267 "NTCNR_0X10B" 268 268 "NTCNR_0X10C" 269 269 "NTCNR_0X10D" 270 270 "NTCNR_0X10E" 271 271 "NTCNR_0X10F" 272 272 "NTCNR_0X110" 273 273 "NTCNR_0X111" 274 274 "NTCNR_0X112" 275 275 "NTCNR_0X113" 276 276 "NTCNR_0X114" 277 277 "NTCNR_0X115" 278 278 "NTCNR_0X116" 279 279 "NTCNR_0X117" 280 280 "NTCNR_0X118" 281 281 "NTCNR_0X119" 282 282 "NTCNR_0X11A" 283 283 "NTCNR_0X11B" 284 284 "NTCNR_0X11C" 285 285 "NTCNR_0X11D" 286 286 "NTCNR_0X11E" 287 287 "NTCNR_0X11F" 288 288 "NTCNR_0X120" 289 289 "NTCNR_0X121" 290 290 "NTCNR_0X122" 291 291 "NTCNR_0X123" 292 292 "NTCNR_0X124" 293 293 "NTCNR_0X125" 294 294 "NTCNR_0X126" 295 295 "NTCNR_0X127" 296 296 "NTCNR_0X128" 297 297 "NTCNR_0X129" 298 298 "NTCNR_0X12A" 299 299 "NTCNR_0X12B" 300 300 "NTCNR_0X12C" 301 301 "NTCNR_0X12D" 302 302 "NTCNR_0X12E" 303 303 "NTCNR_0X12F" 304 304 "NTCNR_0X130" 305 305 "NTCNR_0X131" 306 306 "NTCNR_0X132" 307 307 "NTCNR_0X133" 308 308 "NTCNR_0X134" 309 309 "NTCNR_0X135" 310 310 "NTCNR_0X136" 311 311 "NTCNR_0X137" 312 312 "NTCNR_0X138" 313 313 "NTCNR_0X139" 314 314 "NTCNR_0X13A" 315 315 "NTCNR_0X13B" 316 316 "NTCNR_0X13C" 317 317 "NTCNR_0X13D" 318 318 "NTCNR_0X13E" 319 319 "NTCNR_0X13F" 320 320 "NTCNR_0X140" 321 321 "NTCNR_0X141" 322 322 "NTCNR_0X142" 323 323 "NTCNR_0X143" 324 324 "NTCNR_0X144" 325 325 "NTCNR_0X145" 326 326 "NTCNR_0X146" 327 327 "NTCNR_0X147" 328 328 "NTCNR_0X148" 329 329 "NTCNR_0X149" 330 330 "NTCNR_0X14A" 331 331 "NTCNR_0X14B" 332 332 "NTCNR_0X14C" 333 333 "NTCNR_0X14D" 334 334 "NTCNR_0X14E" 335 335 "NTCNR_0X14F" 336 336 "NTCNR_0X150" 337 337 "NTCNR_0X151" 338 338 "NTCNR_0X152" 339 339 "NTCNR_0X153" 340 340 "NTCNR_0X154" 341 341 "NTCNR_0X155" 342 342 "NTCNR_0X156" 343 343 "NTCNR_0X157" 344 344 "NTCNR_0X158" 345 345 "NTCNR_0X159" 346 346 "NTCNR_0X15A" 347 347 "NTCNR_0X15B" 348 348 "NTCNR_0X15C" 349 349 "NTCNR_0X15D" 350 350 "NTCNR_0X15E" 351 351 "NTCNR_0X15F" 352 352 "NTCNR_0X160" 353 353 "NTCNR_0X161" 354 354 "NTCNR_0X162" 355 355 "NTCNR_0X163" 356 356 "NTCNR_0X164" 357 357 "NTCNR_0X165" 358 358 "NTCNR_0X166" 359 359 "NTCNR_0X167" 360 360 "NTCNR_0X168" 361 361 "NTCNR_0X169" 362 362 "NTCNR_0X16A" 363 363 "NTCNR_0X16B" 364 364 "NTCNR_0X16C" 365 365 "NTCNR_0X16D" 366 366 "NTCNR_0X16E" 367 367 "NTCNR_0X16F" 368 368 "NTCNR_0X170" 369 369 "NTCNR_0X171" 370 370 "NTCNR_0X172" 371 371 "NTCNR_0X173" 372 372 "NTCNR_0X174" 373 373 "NTCNR_0X175" 374 374 "NTCNR_0X176" 375 375 "NTCNR_0X177" 376 376 "NTCNR_0X178" 377 377 "NTCNR_0X179" 378 378 "NTCNR_0X17A" 379 379 "NTCNR_0X17B" 380 380 "NTCNR_0X17C" 381 381 "NTCNR_0X17D" 382 382 "NTCNR_0X17E" 383 383 "NTCNR_0X17F" 384 384 "NTCNR_0X180" 385 385 "NTCNR_0X181" 386 386 "NTCNR_0X182" 387 387 "NTCNR_0X183" 388 388 "NTCNR_0X184" 389 389 "NTCNR_0X185" 390 390 "NTCNR_0X186" 391 391 "NTCNR_0X187" 392 392 "NTCNR_0X188" 393 393 "NTCNR_0X189" 394 394 "NTCNR_0X18A" 395 395 "NTCNR_0X18B" 396 396 "NTCNR_0X18C" 397 397 "NTCNR_0X18D" 398 398 "NTCNR_0X18E" 399 399 "NTCNR_0X18F" 400 400 "NTCNR_0X190" 401 401 "NTCNR_0X191" 402 402 "NTCNR_0X192" 403 403 "NTCNR_0X193" 404 404 "NTCNR_0X194" 405 405 "NTCNR_0X195" 406 406 "NTCNR_0X196" 407 407 "NTCNR_0X197" 408 408 "NTCNR_0X198" 409 409 "NTCNR_0X199" 410 410 "NTCNR_0X19A" 411 411 "NTCNR_0X19B" 412 412 "NTCNR_0X19C" 413 413 "NTCNR_0X19D" 414 414 "NTCNR_0X19E" 415 415 "NTCNR_0X19F" 416 416 "NTCNR_0X1A0" 417 417 "NTCNR_0X1A1" 418 418 "NTCNR_0X1A2" 419 419 "NTCNR_0X1A3" 420 420 "NTCNR_0X1A4" 421 421 "NTCNR_0X1A5" 422 422 "NTCNR_0X1A6" 423 423 "NTCNR_0X1A7" 424 424 "NTCNR_0X1A8" 425 425 "NTCNR_0X1A9" 426 426 "NTCNR_0X1AA" 427 427 "NTCNR_0X1AB" 428 428 "NTCNR_0X1AC" 429 429 "NTCNR_0X1AD" 430 430 "NTCNR_0X1AE" 431 431 "NTCNR_0X1AF" 432 432 "NTCNR_0X1B0" 433 433 "NTCNR_0X1B1" 434 434 "NTCNR_0X1B2" 435 435 "NTCNR_0X1B3" 436 436 "NTCNR_0X1B4" 437 437 "NTCNR_0X1B5" 438 438 "NTCNR_0X1B6" 439 439 "NTCNR_0X1B7" 440 440 "NTCNR_0X1B8" 441 441 "NTCNR_0X1B9" 442 442 "NTCNR_0X1BA" 443 443 "NTCNR_0X1BB" 444 444 "NTCNR_0X1BC" 445 445 "NTCNR_0X1BD" 446 446 "NTCNR_0X1BE" 447 447 "NTCNR_0X1BF" 448 448 "NTCNR_0X1C0" 449 449 "NTCNR_0X1C1" 450 450 "NTCNR_0X1C2" 451 451 "NTCNR_0X1C3" 452 452 "NTCNR_0X1C4" 453 453 "NTCNR_0X1C5" 454 454 "NTCNR_0X1C6" 455 455 "NTCNR_0X1C7" 456 456 "NTCNR_0X1C8" 457 457 "NTCNR_0X1C9" 458 458 "NTCNR_0X1CA" 459 459 "NTCNR_0X1CB" 460 460 "NTCNR_0X1CC" 461 461 "NTCNR_0X1CD" 462 462 "NTCNR_0X1CE" 463 463 "NTCNR_0X1CF" 464 464 "NTCNR_0X1D0" 465 465 "NTCNR_0X1D1" 466 466 "NTCNR_0X1D2" 467 467 "NTCNR_0X1D3" 468 468 "NTCNR_0X1D4" 469 469 "NTCNR_0X1D5" 470 470 "NTCNR_0X1D6" 471 471 "NTCNR_0X1D7" 472 472 "NTCNR_0X1D8" 473 473 "NTCNR_0X1D9" 474 474 "NTCNR_0X1DA" 475 475 "NTCNR_0X1DB" 476 476 "NTCNR_0X1DC" 477 477 "NTCNR_0X1DD" 478 478 "NTCNR_0X1DE" 479 479 "NTCNR_0X1DF" 480 480 "NTCNR_0X1E0" 481 481 "NTCNR_0X1E1" 482 482 "NTCNR_0X1E2" 483 483 "NTCNR_0X1E3" 484 484 "NTCNR_0X1E4" 485 485 "NTCNR_0X1E5" 486 486 "NTCNR_0X1E6" 487 487 "NTCNR_0X1E7" 488 488 "NTCNR_0X1E8" 489 489 "NTCNR_0X1E9" 490 490 "NTCNR_0X1EA" 491 491 "NTCNR_0X1EB" 492 492 "NTCNR_0X1EC" 493 493 "NTCNR_0X1ED" 494 494 "NTCNR_0X1EE" 495 495 "NTCNR_0X1EF" 496 496 "NTCNR_0X1F0" 497 497 "NTCNR_0X1F1" 498 498 "NTCNR_0X1F2" 499 499 "NTCNR_0X1F3" 500 500 "NTCNR_0X1F4" 501 501 "NTCNR_0X1F5" 502 502 "NTCNR_0X1F6" 503 503 "NTCNR_0X1F7" 504 504 "NTCNR_0X1F8" 505 505 "NTCNR_0X1F9" 506 506 "NTCNR_0X1FA" 507 507 "NTCNR_0X1FB" 508 508 "NTCNR_0X1FC" 509 509 "NTCNR_0X1FD" 510 510 "NTCNR_0X1FE" 511 511 "NTCNR_0X1FF" /end COMPU_VTAB_RANGE
/begin COMPU_METHOD RTE_CM_ENUM_ImcArbnRxSts1 "" TAB_VERB "%.1" "" COMPU_TAB_REF RTE_CM_ENUM_ImcArbnRxSts1 /end COMPU_METHOD
/begin COMPU_VTAB_RANGE RTE_CM_ENUM_ImcArbnRxSts1 "" 3 0 0 "IMCARBNRXSTS_NODATA" 1 1 "IMCARBNRXSTS_VLD" 2 2 "IMCARBNRXSTS_INVLD" /end COMPU_VTAB_RANGE
