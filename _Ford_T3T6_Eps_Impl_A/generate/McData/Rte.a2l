/begin CHARACTERISTIC AAACalRegn02Rt03GroupB_Dummy.EotProtnSoftEndStopAuthyThd.Val "MICROSAR RTE" VALUE 0x0 RTE_RL_FLOAT32_IEEE 0 NO_COMPU_METHOD -3.402823466e+38 3.402823466e+38 SYMBOL_LINK "Rte_CalprmRom_CalRegn02Rt03GroupB_DEFAULT_RTE_CALPRM_GROUP.EotProtnSoftEndStopAuthyThd_Val" 0 DISPLAY_IDENTIFIER AAACalRegn02Rt03GroupB_Dummy.CalibrationPorts.EotProtnSoftEndStopAuthyThd.Val /end CHARACTERISTIC
/begin CHARACTERISTIC AAACalRegn02Rt03GroupB_Dummy.RtnHwAgOffsCalcdX.Ary2D "MICROSAR RTE" VAL_BLK 0x0 RTE_RL_UWORD 0 NO_COMPU_METHOD 0 65535 MATRIX_DIM 16 9 1 SYMBOL_LINK "Rte_CalprmRom_CalRegn02Rt03GroupB_DEFAULT_RTE_CALPRM_GROUP.RtnHwAgOffsCalcdX_Ary2D" 0 DISPLAY_IDENTIFIER AAACalRegn02Rt03GroupB_Dummy.CalibrationPorts.RtnHwAgOffsCalcdX.Ary2D /end CHARACTERISTIC
/begin CHARACTERISTIC AAACalRegn02Rt03GroupB_Dummy.RtnHwAgOffsCalcdY.Ary2D "MICROSAR RTE" VAL_BLK 0x0 RTE_RL_UWORD 0 NO_COMPU_METHOD 0 65535 MATRIX_DIM 16 9 1 SYMBOL_LINK "Rte_CalprmRom_CalRegn02Rt03GroupB_DEFAULT_RTE_CALPRM_GROUP.RtnHwAgOffsCalcdY_Ary2D" 0 DISPLAY_IDENTIFIER AAACalRegn02Rt03GroupB_Dummy.CalibrationPorts.RtnHwAgOffsCalcdY.Ary2D /end CHARACTERISTIC
/begin CHARACTERISTIC AAACalRegn02Rt03GroupB_Dummy.RtnScaTqX.Ary2D "MICROSAR RTE" VAL_BLK 0x0 RTE_RL_UWORD 0 NO_COMPU_METHOD 0 65535 MATRIX_DIM 8 9 1 SYMBOL_LINK "Rte_CalprmRom_CalRegn02Rt03GroupB_DEFAULT_RTE_CALPRM_GROUP.RtnScaTqX_Ary2D" 0 DISPLAY_IDENTIFIER AAACalRegn02Rt03GroupB_Dummy.CalibrationPorts.RtnScaTqX.Ary2D /end CHARACTERISTIC
/begin CHARACTERISTIC AAACalRegn02Rt03GroupB_Dummy.RtnScaTqY.Ary2D "MICROSAR RTE" VAL_BLK 0x0 RTE_RL_UWORD 0 NO_COMPU_METHOD 0 65535 MATRIX_DIM 8 9 1 SYMBOL_LINK "Rte_CalprmRom_CalRegn02Rt03GroupB_DEFAULT_RTE_CALPRM_GROUP.RtnScaTqY_Ary2D" 0 DISPLAY_IDENTIFIER AAACalRegn02Rt03GroupB_Dummy.CalibrationPorts.RtnScaTqY.Ary2D /end CHARACTERISTIC
/begin CHARACTERISTIC AAACalRegn02Rt03GroupB_Dummy.RtnScaVelX.Ary2D "MICROSAR RTE" VAL_BLK 0x0 RTE_RL_UWORD 0 NO_COMPU_METHOD 0 65535 MATRIX_DIM 4 9 1 SYMBOL_LINK "Rte_CalprmRom_CalRegn02Rt03GroupB_DEFAULT_RTE_CALPRM_GROUP.RtnScaVelX_Ary2D" 0 DISPLAY_IDENTIFIER AAACalRegn02Rt03GroupB_Dummy.CalibrationPorts.RtnScaVelX.Ary2D /end CHARACTERISTIC
/begin CHARACTERISTIC AAACalRegn02Rt03GroupB_Dummy.RtnScaVelY.Ary2D "MICROSAR RTE" VAL_BLK 0x0 RTE_RL_UWORD 0 NO_COMPU_METHOD 0 65535 MATRIX_DIM 4 9 1 SYMBOL_LINK "Rte_CalprmRom_CalRegn02Rt03GroupB_DEFAULT_RTE_CALPRM_GROUP.RtnScaVelY_Ary2D" 0 DISPLAY_IDENTIFIER AAACalRegn02Rt03GroupB_Dummy.CalibrationPorts.RtnScaVelY.Ary2D /end CHARACTERISTIC
/begin CHARACTERISTIC AAACalRegn02Rt03GroupB_Dummy.RtnVehSpdSeln.Ary1D "MICROSAR RTE" VAL_BLK 0x0 RTE_RL_UWORD 0 NO_COMPU_METHOD 0 65535 MATRIX_DIM 9 1 1 SYMBOL_LINK "Rte_CalprmRom_CalRegn02Rt03GroupB_DEFAULT_RTE_CALPRM_GROUP.RtnVehSpdSeln_Ary1D" 0 DISPLAY_IDENTIFIER AAACalRegn02Rt03GroupB_Dummy.CalibrationPorts.RtnVehSpdSeln.Ary1D /end CHARACTERISTIC
/begin CHARACTERISTIC AAACalRegn02Rt04GroupA_Dummy.AssiHiFrqGainY.Ary2D "MICROSAR RTE" VAL_BLK 0x0 RTE_RL_UWORD 0 NO_COMPU_METHOD 0 65535 MATRIX_DIM 13 12 1 SYMBOL_LINK "Rte_CalprmRom_CalRegn02Rt04GroupA_DEFAULT_RTE_CALPRM_GROUP.AssiHiFrqGainY_Ary2D" 0 DISPLAY_IDENTIFIER AAACalRegn02Rt04GroupA_Dummy.CalibrationPorts.AssiHiFrqGainY.Ary2D /end CHARACTERISTIC
/begin CHARACTERISTIC AAACalRegn02Rt04GroupA_Dummy.AssiHiFrqHpFilFrqY.Ary1D "MICROSAR RTE" VAL_BLK 0x0 RTE_RL_UWORD 0 NO_COMPU_METHOD 0 65535 MATRIX_DIM 12 1 1 SYMBOL_LINK "Rte_CalprmRom_CalRegn02Rt04GroupA_DEFAULT_RTE_CALPRM_GROUP.AssiHiFrqHpFilFrqY_Ary1D" 0 DISPLAY_IDENTIFIER AAACalRegn02Rt04GroupA_Dummy.CalibrationPorts.AssiHiFrqHpFilFrqY.Ary1D /end CHARACTERISTIC
/begin CHARACTERISTIC AAACalRegn02Rt04GroupA_Dummy.AssiHiFrqTqWhlImbRejctnTqX.Ary2D "MICROSAR RTE" VAL_BLK 0x0 RTE_RL_UWORD 0 NO_COMPU_METHOD 0 65535 MATRIX_DIM 13 12 1 SYMBOL_LINK "Rte_CalprmRom_CalRegn02Rt04GroupA_DEFAULT_RTE_CALPRM_GROUP.AssiHiFrqTqWhlImbRejctnTqX_Ary2D" 0 DISPLAY_IDENTIFIER AAACalRegn02Rt04GroupA_Dummy.CalibrationPorts.AssiHiFrqTqWhlImbRejctnTqX.Ary2D /end CHARACTERISTIC
/begin CHARACTERISTIC AAACalRegn02Rt04GroupA_Dummy.AssiHiFrqTqX.Ary2D "MICROSAR RTE" VAL_BLK 0x0 RTE_RL_UWORD 0 NO_COMPU_METHOD 0 65535 MATRIX_DIM 13 12 1 SYMBOL_LINK "Rte_CalprmRom_CalRegn02Rt04GroupA_DEFAULT_RTE_CALPRM_GROUP.AssiHiFrqTqX_Ary2D" 0 DISPLAY_IDENTIFIER AAACalRegn02Rt04GroupA_Dummy.CalibrationPorts.AssiHiFrqTqX.Ary2D /end CHARACTERISTIC
/begin CHARACTERISTIC AAACalRegn02Rt04GroupA_Dummy.AssiHiFrqWhlImbRejctnBlndX.Ary2D "MICROSAR RTE" VAL_BLK 0x0 RTE_RL_UWORD 0 NO_COMPU_METHOD 0 65535 MATRIX_DIM 5 12 1 SYMBOL_LINK "Rte_CalprmRom_CalRegn02Rt04GroupA_DEFAULT_RTE_CALPRM_GROUP.AssiHiFrqWhlImbRejctnBlndX_Ary2D" 0 DISPLAY_IDENTIFIER AAACalRegn02Rt04GroupA_Dummy.CalibrationPorts.AssiHiFrqWhlImbRejctnBlndX.Ary2D /end CHARACTERISTIC
/begin CHARACTERISTIC AAACalRegn02Rt04GroupA_Dummy.AssiHiFrqWhlImbRejctnBlndY.Ary2D "MICROSAR RTE" VAL_BLK 0x0 RTE_RL_UWORD 0 NO_COMPU_METHOD 0 65535 MATRIX_DIM 5 12 1 SYMBOL_LINK "Rte_CalprmRom_CalRegn02Rt04GroupA_DEFAULT_RTE_CALPRM_GROUP.AssiHiFrqWhlImbRejctnBlndY_Ary2D" 0 DISPLAY_IDENTIFIER AAACalRegn02Rt04GroupA_Dummy.CalibrationPorts.AssiHiFrqWhlImbRejctnBlndY.Ary2D /end CHARACTERISTIC
/begin CHARACTERISTIC AAACalRegn02Rt04GroupA_Dummy.AssiHiFrqWhlImbRejctnGainY.Ary2D "MICROSAR RTE" VAL_BLK 0x0 RTE_RL_UWORD 0 NO_COMPU_METHOD 0 65535 MATRIX_DIM 13 12 1 SYMBOL_LINK "Rte_CalprmRom_CalRegn02Rt04GroupA_DEFAULT_RTE_CALPRM_GROUP.AssiHiFrqWhlImbRejctnGainY_Ary2D" 0 DISPLAY_IDENTIFIER AAACalRegn02Rt04GroupA_Dummy.CalibrationPorts.AssiHiFrqWhlImbRejctnGainY.Ary2D /end CHARACTERISTIC
/begin CHARACTERISTIC AAACalRegn02Rt04GroupA_Dummy.AssiMotTqWhlImbRejctnMaxX.Ary2D "MICROSAR RTE" VAL_BLK 0x0 RTE_RL_UWORD 0 NO_COMPU_METHOD 0 65535 MATRIX_DIM 20 12 1 SYMBOL_LINK "Rte_CalprmRom_CalRegn02Rt04GroupA_DEFAULT_RTE_CALPRM_GROUP.AssiMotTqWhlImbRejctnMaxX_Ary2D" 0 DISPLAY_IDENTIFIER AAACalRegn02Rt04GroupA_Dummy.CalibrationPorts.AssiMotTqWhlImbRejctnMaxX.Ary2D /end CHARACTERISTIC
/begin CHARACTERISTIC AAACalRegn02Rt04GroupA_Dummy.AssiMotTqWhlImbRejctnMaxY.Ary2D "MICROSAR RTE" VAL_BLK 0x0 RTE_RL_SWORD 0 NO_COMPU_METHOD -32768 32767 MATRIX_DIM 20 12 1 SYMBOL_LINK "Rte_CalprmRom_CalRegn02Rt04GroupA_DEFAULT_RTE_CALPRM_GROUP.AssiMotTqWhlImbRejctnMaxY_Ary2D" 0 DISPLAY_IDENTIFIER AAACalRegn02Rt04GroupA_Dummy.CalibrationPorts.AssiMotTqWhlImbRejctnMaxY.Ary2D /end CHARACTERISTIC
/begin CHARACTERISTIC AAACalRegn02Rt04GroupA_Dummy.AssiMotTqWhlImbRejctnMinX.Ary2D "MICROSAR RTE" VAL_BLK 0x0 RTE_RL_UWORD 0 NO_COMPU_METHOD 0 65535 MATRIX_DIM 20 12 1 SYMBOL_LINK "Rte_CalprmRom_CalRegn02Rt04GroupA_DEFAULT_RTE_CALPRM_GROUP.AssiMotTqWhlImbRejctnMinX_Ary2D" 0 DISPLAY_IDENTIFIER AAACalRegn02Rt04GroupA_Dummy.CalibrationPorts.AssiMotTqWhlImbRejctnMinX.Ary2D /end CHARACTERISTIC
/begin CHARACTERISTIC AAACalRegn02Rt04GroupA_Dummy.AssiMotTqWhlImbRejctnMinY.Ary2D "MICROSAR RTE" VAL_BLK 0x0 RTE_RL_SWORD 0 NO_COMPU_METHOD -32768 32767 MATRIX_DIM 20 12 1 SYMBOL_LINK "Rte_CalprmRom_CalRegn02Rt04GroupA_DEFAULT_RTE_CALPRM_GROUP.AssiMotTqWhlImbRejctnMinY_Ary2D" 0 DISPLAY_IDENTIFIER AAACalRegn02Rt04GroupA_Dummy.CalibrationPorts.AssiMotTqWhlImbRejctnMinY.Ary2D /end CHARACTERISTIC
/begin CHARACTERISTIC AAACalRegn02Rt04GroupA_Dummy.AssiWhlImbRejctnBlndScaX.Ary2D "MICROSAR RTE" VAL_BLK 0x0 RTE_RL_UWORD 0 NO_COMPU_METHOD 0 65535 MATRIX_DIM 5 12 1 SYMBOL_LINK "Rte_CalprmRom_CalRegn02Rt04GroupA_DEFAULT_RTE_CALPRM_GROUP.AssiWhlImbRejctnBlndScaX_Ary2D" 0 DISPLAY_IDENTIFIER AAACalRegn02Rt04GroupA_Dummy.CalibrationPorts.AssiWhlImbRejctnBlndScaX.Ary2D /end CHARACTERISTIC
/begin CHARACTERISTIC AAACalRegn02Rt04GroupA_Dummy.AssiWhlImbRejctnBlndScaY.Ary2D "MICROSAR RTE" VAL_BLK 0x0 RTE_RL_UWORD 0 NO_COMPU_METHOD 0 65535 MATRIX_DIM 5 12 1 SYMBOL_LINK "Rte_CalprmRom_CalRegn02Rt04GroupA_DEFAULT_RTE_CALPRM_GROUP.AssiWhlImbRejctnBlndScaY_Ary2D" 0 DISPLAY_IDENTIFIER AAACalRegn02Rt04GroupA_Dummy.CalibrationPorts.AssiWhlImbRejctnBlndScaY.Ary2D /end CHARACTERISTIC
/begin CHARACTERISTIC AAACalRegn02Rt04GroupA_Dummy.DampgHwTqX.Ary1D "MICROSAR RTE" VAL_BLK 0x0 RTE_RL_UWORD 0 NO_COMPU_METHOD 0 65535 MATRIX_DIM 2 1 1 SYMBOL_LINK "Rte_CalprmRom_CalRegn02Rt04GroupA_DEFAULT_RTE_CALPRM_GROUP.DampgHwTqX_Ary1D" 0 DISPLAY_IDENTIFIER AAACalRegn02Rt04GroupA_Dummy.CalibrationPorts.DampgHwTqX.Ary1D /end CHARACTERISTIC
/begin CHARACTERISTIC AAACalRegn02Rt04GroupA_Dummy.DampgHwTqY.Ary1D "MICROSAR RTE" VAL_BLK 0x0 RTE_RL_UWORD 0 NO_COMPU_METHOD 0 65535 MATRIX_DIM 2 1 1 SYMBOL_LINK "Rte_CalprmRom_CalRegn02Rt04GroupA_DEFAULT_RTE_CALPRM_GROUP.DampgHwTqY_Ary1D" 0 DISPLAY_IDENTIFIER AAACalRegn02Rt04GroupA_Dummy.CalibrationPorts.DampgHwTqY.Ary1D /end CHARACTERISTIC
/begin CHARACTERISTIC AAACalRegn02Rt04GroupA_Dummy.DampgHydCoeff1ScaY.Ary1D "MICROSAR RTE" VAL_BLK 0x0 RTE_RL_UWORD 0 NO_COMPU_METHOD 0 65535 MATRIX_DIM 12 1 1 SYMBOL_LINK "Rte_CalprmRom_CalRegn02Rt04GroupA_DEFAULT_RTE_CALPRM_GROUP.DampgHydCoeff1ScaY_Ary1D" 0 DISPLAY_IDENTIFIER AAACalRegn02Rt04GroupA_Dummy.CalibrationPorts.DampgHydCoeff1ScaY.Ary1D /end CHARACTERISTIC
/begin CHARACTERISTIC AAACalRegn02Rt04GroupA_Dummy.DampgHydCoeff2ScaY.Ary1D "MICROSAR RTE" VAL_BLK 0x0 RTE_RL_UWORD 0 NO_COMPU_METHOD 0 65535 MATRIX_DIM 12 1 1 SYMBOL_LINK "Rte_CalprmRom_CalRegn02Rt04GroupA_DEFAULT_RTE_CALPRM_GROUP.DampgHydCoeff2ScaY_Ary1D" 0 DISPLAY_IDENTIFIER AAACalRegn02Rt04GroupA_Dummy.CalibrationPorts.DampgHydCoeff2ScaY.Ary1D /end CHARACTERISTIC
/begin CHARACTERISTIC AAACalRegn02Rt04GroupA_Dummy.DampgHydCoeff3ScaY.Ary1D "MICROSAR RTE" VAL_BLK 0x0 RTE_RL_UWORD 0 NO_COMPU_METHOD 0 65535 MATRIX_DIM 12 1 1 SYMBOL_LINK "Rte_CalprmRom_CalRegn02Rt04GroupA_DEFAULT_RTE_CALPRM_GROUP.DampgHydCoeff3ScaY_Ary1D" 0 DISPLAY_IDENTIFIER AAACalRegn02Rt04GroupA_Dummy.CalibrationPorts.DampgHydCoeff3ScaY.Ary1D /end CHARACTERISTIC
/begin CHARACTERISTIC AAACalRegn02Rt04GroupA_Dummy.DampgHydCoeff4ScaY.Ary1D "MICROSAR RTE" VAL_BLK 0x0 RTE_RL_UWORD 0 NO_COMPU_METHOD 0 65535 MATRIX_DIM 12 1 1 SYMBOL_LINK "Rte_CalprmRom_CalRegn02Rt04GroupA_DEFAULT_RTE_CALPRM_GROUP.DampgHydCoeff4ScaY_Ary1D" 0 DISPLAY_IDENTIFIER AAACalRegn02Rt04GroupA_Dummy.CalibrationPorts.DampgHydCoeff4ScaY.Ary1D /end CHARACTERISTIC
/begin CHARACTERISTIC AAACalRegn02Rt04GroupA_Dummy.DampgMotVelX.Ary2D "MICROSAR RTE" VAL_BLK 0x0 RTE_RL_UWORD 0 NO_COMPU_METHOD 0 65535 MATRIX_DIM 13 12 1 SYMBOL_LINK "Rte_CalprmRom_CalRegn02Rt04GroupA_DEFAULT_RTE_CALPRM_GROUP.DampgMotVelX_Ary2D" 0 DISPLAY_IDENTIFIER AAACalRegn02Rt04GroupA_Dummy.CalibrationPorts.DampgMotVelX.Ary2D /end CHARACTERISTIC
/begin CHARACTERISTIC AAACalRegn02Rt04GroupA_Dummy.DampgMotVelY.Ary2D "MICROSAR RTE" VAL_BLK 0x0 RTE_RL_UWORD 0 NO_COMPU_METHOD 0 65535 MATRIX_DIM 13 12 1 SYMBOL_LINK "Rte_CalprmRom_CalRegn02Rt04GroupA_DEFAULT_RTE_CALPRM_GROUP.DampgMotVelY_Ary2D" 0 DISPLAY_IDENTIFIER AAACalRegn02Rt04GroupA_Dummy.CalibrationPorts.DampgMotVelY.Ary2D /end CHARACTERISTIC
/begin CHARACTERISTIC AAACalRegn02Rt04GroupA_Dummy.HysCmpEffLossY.Ary1D "MICROSAR RTE" VAL_BLK 0x0 RTE_RL_UWORD 0 NO_COMPU_METHOD 0 65535 MATRIX_DIM 12 1 1 SYMBOL_LINK "Rte_CalprmRom_CalRegn02Rt04GroupA_DEFAULT_RTE_CALPRM_GROUP.HysCmpEffLossY_Ary1D" 0 DISPLAY_IDENTIFIER AAACalRegn02Rt04GroupA_Dummy.CalibrationPorts.HysCmpEffLossY.Ary1D /end CHARACTERISTIC
/begin CHARACTERISTIC AAACalRegn02Rt04GroupA_Dummy.HysCmpEffOffsY.Ary1D "MICROSAR RTE" VAL_BLK 0x0 RTE_RL_UWORD 0 NO_COMPU_METHOD 0 65535 MATRIX_DIM 12 1 1 SYMBOL_LINK "Rte_CalprmRom_CalRegn02Rt04GroupA_DEFAULT_RTE_CALPRM_GROUP.HysCmpEffOffsY_Ary1D" 0 DISPLAY_IDENTIFIER AAACalRegn02Rt04GroupA_Dummy.CalibrationPorts.HysCmpEffOffsY.Ary1D /end CHARACTERISTIC
/begin CHARACTERISTIC AAACalRegn02Rt04GroupA_Dummy.HysCmpFricWhlImbRejctnBlndX.Ary1D "MICROSAR RTE" VAL_BLK 0x0 RTE_RL_UWORD 0 NO_COMPU_METHOD 0 65535 MATRIX_DIM 6 1 1 SYMBOL_LINK "Rte_CalprmRom_CalRegn02Rt04GroupA_DEFAULT_RTE_CALPRM_GROUP.HysCmpFricWhlImbRejctnBlndX_Ary1D" 0 DISPLAY_IDENTIFIER AAACalRegn02Rt04GroupA_Dummy.CalibrationPorts.HysCmpFricWhlImbRejctnBlndX.Ary1D /end CHARACTERISTIC
/begin CHARACTERISTIC AAACalRegn02Rt04GroupA_Dummy.HysCmpFricWhlImbRejctnBlndY.Ary1D "MICROSAR RTE" VAL_BLK 0x0 RTE_RL_UWORD 0 NO_COMPU_METHOD 0 65535 MATRIX_DIM 6 1 1 SYMBOL_LINK "Rte_CalprmRom_CalRegn02Rt04GroupA_DEFAULT_RTE_CALPRM_GROUP.HysCmpFricWhlImbRejctnBlndY_Ary1D" 0 DISPLAY_IDENTIFIER AAACalRegn02Rt04GroupA_Dummy.CalibrationPorts.HysCmpFricWhlImbRejctnBlndY.Ary1D /end CHARACTERISTIC
/begin CHARACTERISTIC AAACalRegn02Rt04GroupA_Dummy.HysCmpFricWhlImbRejctnOffY.Ary1D "MICROSAR RTE" VAL_BLK 0x0 RTE_RL_UWORD 0 NO_COMPU_METHOD 0 65535 MATRIX_DIM 12 1 1 SYMBOL_LINK "Rte_CalprmRom_CalRegn02Rt04GroupA_DEFAULT_RTE_CALPRM_GROUP.HysCmpFricWhlImbRejctnOffY_Ary1D" 0 DISPLAY_IDENTIFIER AAACalRegn02Rt04GroupA_Dummy.CalibrationPorts.HysCmpFricWhlImbRejctnOffY.Ary1D /end CHARACTERISTIC
/begin CHARACTERISTIC AAACalRegn02Rt04GroupA_Dummy.HysCmpFricWhlImbRejctnOnY.Ary1D "MICROSAR RTE" VAL_BLK 0x0 RTE_RL_UWORD 0 NO_COMPU_METHOD 0 65535 MATRIX_DIM 12 1 1 SYMBOL_LINK "Rte_CalprmRom_CalRegn02Rt04GroupA_DEFAULT_RTE_CALPRM_GROUP.HysCmpFricWhlImbRejctnOnY_Ary1D" 0 DISPLAY_IDENTIFIER AAACalRegn02Rt04GroupA_Dummy.CalibrationPorts.HysCmpFricWhlImbRejctnOnY.Ary1D /end CHARACTERISTIC
/begin CHARACTERISTIC AAACalRegn02Rt04GroupA_Dummy.HysCmpHwTqScaX.Ary2D "MICROSAR RTE" VAL_BLK 0x0 RTE_RL_UWORD 0 NO_COMPU_METHOD 0 65535 MATRIX_DIM 8 12 1 SYMBOL_LINK "Rte_CalprmRom_CalRegn02Rt04GroupA_DEFAULT_RTE_CALPRM_GROUP.HysCmpHwTqScaX_Ary2D" 0 DISPLAY_IDENTIFIER AAACalRegn02Rt04GroupA_Dummy.CalibrationPorts.HysCmpHwTqScaX.Ary2D /end CHARACTERISTIC
/begin CHARACTERISTIC AAACalRegn02Rt04GroupA_Dummy.HysCmpHwTqScaY.Ary2D "MICROSAR RTE" VAL_BLK 0x0 RTE_RL_UWORD 0 NO_COMPU_METHOD 0 65535 MATRIX_DIM 8 12 1 SYMBOL_LINK "Rte_CalprmRom_CalRegn02Rt04GroupA_DEFAULT_RTE_CALPRM_GROUP.HysCmpHwTqScaY_Ary2D" 0 DISPLAY_IDENTIFIER AAACalRegn02Rt04GroupA_Dummy.CalibrationPorts.HysCmpHwTqScaY.Ary2D /end CHARACTERISTIC
/begin CHARACTERISTIC AAACalRegn02Rt04GroupA_Dummy.HysCmpHysSatnY.Ary1D "MICROSAR RTE" VAL_BLK 0x0 RTE_RL_UWORD 0 NO_COMPU_METHOD 0 65535 MATRIX_DIM 12 1 1 SYMBOL_LINK "Rte_CalprmRom_CalRegn02Rt04GroupA_DEFAULT_RTE_CALPRM_GROUP.HysCmpHysSatnY_Ary1D" 0 DISPLAY_IDENTIFIER AAACalRegn02Rt04GroupA_Dummy.CalibrationPorts.HysCmpHysSatnY.Ary1D /end CHARACTERISTIC
/begin CHARACTERISTIC AAACalRegn02Rt04GroupA_Dummy.HysCmpNegHysCmpScaX.Ary1D "MICROSAR RTE" VAL_BLK 0x0 RTE_RL_UWORD 0 NO_COMPU_METHOD 0 65535 MATRIX_DIM 5 1 1 SYMBOL_LINK "Rte_CalprmRom_CalRegn02Rt04GroupA_DEFAULT_RTE_CALPRM_GROUP.HysCmpNegHysCmpScaX_Ary1D" 0 DISPLAY_IDENTIFIER AAACalRegn02Rt04GroupA_Dummy.CalibrationPorts.HysCmpNegHysCmpScaX.Ary1D /end CHARACTERISTIC
/begin CHARACTERISTIC AAACalRegn02Rt04GroupA_Dummy.HysCmpNegHysCmpScaY.Ary1D "MICROSAR RTE" VAL_BLK 0x0 RTE_RL_UWORD 0 NO_COMPU_METHOD 0 65535 MATRIX_DIM 5 1 1 SYMBOL_LINK "Rte_CalprmRom_CalRegn02Rt04GroupA_DEFAULT_RTE_CALPRM_GROUP.HysCmpNegHysCmpScaY_Ary1D" 0 DISPLAY_IDENTIFIER AAACalRegn02Rt04GroupA_Dummy.CalibrationPorts.HysCmpNegHysCmpScaY.Ary1D /end CHARACTERISTIC
/begin CHARACTERISTIC AAACalRegn02Rt04GroupA_Dummy.HysCmpNegHysCmpX.Ary1D "MICROSAR RTE" VAL_BLK 0x0 RTE_RL_UWORD 0 NO_COMPU_METHOD 0 65535 MATRIX_DIM 8 1 1 SYMBOL_LINK "Rte_CalprmRom_CalRegn02Rt04GroupA_DEFAULT_RTE_CALPRM_GROUP.HysCmpNegHysCmpX_Ary1D" 0 DISPLAY_IDENTIFIER AAACalRegn02Rt04GroupA_Dummy.CalibrationPorts.HysCmpNegHysCmpX.Ary1D /end CHARACTERISTIC
/begin CHARACTERISTIC AAACalRegn02Rt04GroupA_Dummy.HysCmpNegHysCmpY.Ary1D "MICROSAR RTE" VAL_BLK 0x0 RTE_RL_UWORD 0 NO_COMPU_METHOD 0 65535 MATRIX_DIM 8 1 1 SYMBOL_LINK "Rte_CalprmRom_CalRegn02Rt04GroupA_DEFAULT_RTE_CALPRM_GROUP.HysCmpNegHysCmpY_Ary1D" 0 DISPLAY_IDENTIFIER AAACalRegn02Rt04GroupA_Dummy.CalibrationPorts.HysCmpNegHysCmpY.Ary1D /end CHARACTERISTIC
/begin CHARACTERISTIC AAACalRegn02Rt04GroupA_Dummy.HysCmpOutpLim.Val "MICROSAR RTE" VALUE 0x0 RTE_RL_FLOAT32_IEEE 0 NO_COMPU_METHOD -3.402823466e+38 3.402823466e+38 SYMBOL_LINK "Rte_CalprmRom_CalRegn02Rt04GroupA_DEFAULT_RTE_CALPRM_GROUP.HysCmpOutpLim_Val" 0 DISPLAY_IDENTIFIER AAACalRegn02Rt04GroupA_Dummy.CalibrationPorts.HysCmpOutpLim.Val /end CHARACTERISTIC
/begin CHARACTERISTIC AAACalRegn02Rt04GroupA_Dummy.HysCmpRevGain.Val "MICROSAR RTE" VALUE 0x0 RTE_RL_FLOAT32_IEEE 0 NO_COMPU_METHOD -3.402823466e+38 3.402823466e+38 SYMBOL_LINK "Rte_CalprmRom_CalRegn02Rt04GroupA_DEFAULT_RTE_CALPRM_GROUP.HysCmpRevGain_Val" 0 DISPLAY_IDENTIFIER AAACalRegn02Rt04GroupA_Dummy.CalibrationPorts.HysCmpRevGain.Val /end CHARACTERISTIC
/begin CHARACTERISTIC AAACalRegn02Rt04GroupA_Dummy.HysCmpRiseX.Ary1D "MICROSAR RTE" VAL_BLK 0x0 RTE_RL_UWORD 0 NO_COMPU_METHOD 0 65535 MATRIX_DIM 6 1 1 SYMBOL_LINK "Rte_CalprmRom_CalRegn02Rt04GroupA_DEFAULT_RTE_CALPRM_GROUP.HysCmpRiseX_Ary1D" 0 DISPLAY_IDENTIFIER AAACalRegn02Rt04GroupA_Dummy.CalibrationPorts.HysCmpRiseX.Ary1D /end CHARACTERISTIC
/begin CHARACTERISTIC AAACalRegn02Rt04GroupA_Dummy.HysCmpRiseY.Ary1D "MICROSAR RTE" VAL_BLK 0x0 RTE_RL_UWORD 0 NO_COMPU_METHOD 0 65535 MATRIX_DIM 6 1 1 SYMBOL_LINK "Rte_CalprmRom_CalRegn02Rt04GroupA_DEFAULT_RTE_CALPRM_GROUP.HysCmpRiseY_Ary1D" 0 DISPLAY_IDENTIFIER AAACalRegn02Rt04GroupA_Dummy.CalibrationPorts.HysCmpRiseY.Ary1D /end CHARACTERISTIC
/begin CHARACTERISTIC AAACalRegn02Rt04GroupA_Dummy.InertiaCmpVelAssiBasdDampgStatY.Ary1D "MICROSAR RTE" VAL_BLK 0x0 RTE_RL_UWORD 0 NO_COMPU_METHOD 0 65535 MATRIX_DIM 10 1 1 SYMBOL_LINK "Rte_CalprmRom_CalRegn02Rt04GroupA_DEFAULT_RTE_CALPRM_GROUP.InertiaCmpVelAssiBasdDampgStatY_Ary1D" 0 DISPLAY_IDENTIFIER AAACalRegn02Rt04GroupA_Dummy.CalibrationPorts.InertiaCmpVelAssiBasdDampgStatY.Ary1D /end CHARACTERISTIC
/begin CHARACTERISTIC AAACalRegn02Rt04GroupA_Dummy.InertiaCmpVelDampgFilFrq.Ary1D "MICROSAR RTE" VAL_BLK 0x0 RTE_RL_UWORD 0 NO_COMPU_METHOD 0 65535 MATRIX_DIM 12 1 1 SYMBOL_LINK "Rte_CalprmRom_CalRegn02Rt04GroupA_DEFAULT_RTE_CALPRM_GROUP.InertiaCmpVelDampgFilFrq_Ary1D" 0 DISPLAY_IDENTIFIER AAACalRegn02Rt04GroupA_Dummy.CalibrationPorts.InertiaCmpVelDampgFilFrq.Ary1D /end CHARACTERISTIC
/begin CHARACTERISTIC AAACalRegn02Rt04GroupA_Dummy.InertiaCmpVelDampgFilFrqWhlImbRejctnOn.Ary1D "MICROSAR RTE" VAL_BLK 0x0 RTE_RL_UWORD 0 NO_COMPU_METHOD 0 65535 MATRIX_DIM 12 1 1 SYMBOL_LINK "Rte_CalprmRom_CalRegn02Rt04GroupA_DEFAULT_RTE_CALPRM_GROUP.InertiaCmpVelDampgFilFrqWhlImbRejctnOn_Ary1D" 0 DISPLAY_IDENTIFIER AAACalRegn02Rt04GroupA_Dummy.CalibrationPorts.InertiaCmpVelDampgFilFrqWhlImbRejctnOn.Ary1D /end CHARACTERISTIC
/begin CHARACTERISTIC AAACalRegn02Rt04GroupA_Dummy.InertiaCmpVelDampgSpdBlndY.Ary1D "MICROSAR RTE" VAL_BLK 0x0 RTE_RL_UWORD 0 NO_COMPU_METHOD 0 65535 MATRIX_DIM 12 1 1 SYMBOL_LINK "Rte_CalprmRom_CalRegn02Rt04GroupA_DEFAULT_RTE_CALPRM_GROUP.InertiaCmpVelDampgSpdBlndY_Ary1D" 0 DISPLAY_IDENTIFIER AAACalRegn02Rt04GroupA_Dummy.CalibrationPorts.InertiaCmpVelDampgSpdBlndY.Ary1D /end CHARACTERISTIC
/begin CHARACTERISTIC AAACalRegn02Rt04GroupA_Dummy.InertiaCmpVelDampgWhlImbRejctnBlndX.Ary1D "MICROSAR RTE" VAL_BLK 0x0 RTE_RL_UWORD 0 NO_COMPU_METHOD 0 65535 MATRIX_DIM 5 1 1 SYMBOL_LINK "Rte_CalprmRom_CalRegn02Rt04GroupA_DEFAULT_RTE_CALPRM_GROUP.InertiaCmpVelDampgWhlImbRejctnBlndX_Ary1D" 0 DISPLAY_IDENTIFIER AAACalRegn02Rt04GroupA_Dummy.CalibrationPorts.InertiaCmpVelDampgWhlImbRejctnBlndX.Ary1D /end CHARACTERISTIC
/begin CHARACTERISTIC AAACalRegn02Rt04GroupA_Dummy.InertiaCmpVelDampgWhlImbRejctnBlndY.Ary1D "MICROSAR RTE" VAL_BLK 0x0 RTE_RL_UWORD 0 NO_COMPU_METHOD 0 65535 MATRIX_DIM 5 1 1 SYMBOL_LINK "Rte_CalprmRom_CalRegn02Rt04GroupA_DEFAULT_RTE_CALPRM_GROUP.InertiaCmpVelDampgWhlImbRejctnBlndY_Ary1D" 0 DISPLAY_IDENTIFIER AAACalRegn02Rt04GroupA_Dummy.CalibrationPorts.InertiaCmpVelDampgWhlImbRejctnBlndY.Ary1D /end CHARACTERISTIC
/begin CHARACTERISTIC AAACalRegn02Rt04GroupB_Dummy.EotProtnDampgVehSpdTbl.Ary1D "MICROSAR RTE" VAL_BLK 0x0 RTE_RL_UWORD 0 NO_COMPU_METHOD 0 65535 MATRIX_DIM 4 1 1 SYMBOL_LINK "Rte_CalprmRom_CalRegn02Rt04GroupB_DEFAULT_RTE_CALPRM_GROUP.EotProtnDampgVehSpdTbl_Ary1D" 0 DISPLAY_IDENTIFIER AAACalRegn02Rt04GroupB_Dummy.CalibrationPorts.EotProtnDampgVehSpdTbl.Ary1D /end CHARACTERISTIC
/begin CHARACTERISTIC AAACalRegn02Rt04GroupB_Dummy.EotProtnDeltaTqThd.Val "MICROSAR RTE" VALUE 0x0 RTE_RL_FLOAT32_IEEE 0 NO_COMPU_METHOD -3.402823466e+38 3.402823466e+38 SYMBOL_LINK "Rte_CalprmRom_CalRegn02Rt04GroupB_DEFAULT_RTE_CALPRM_GROUP.EotProtnDeltaTqThd_Val" 0 DISPLAY_IDENTIFIER AAACalRegn02Rt04GroupB_Dummy.CalibrationPorts.EotProtnDeltaTqThd.Val /end CHARACTERISTIC
/begin CHARACTERISTIC AAACalRegn02Rt04GroupB_Dummy.EotProtnEntrGainVehSpdTbl.Ary1D "MICROSAR RTE" VAL_BLK 0x0 RTE_RL_UWORD 0 NO_COMPU_METHOD 0 65535 MATRIX_DIM 5 1 1 SYMBOL_LINK "Rte_CalprmRom_CalRegn02Rt04GroupB_DEFAULT_RTE_CALPRM_GROUP.EotProtnEntrGainVehSpdTbl_Ary1D" 0 DISPLAY_IDENTIFIER AAACalRegn02Rt04GroupB_Dummy.CalibrationPorts.EotProtnEntrGainVehSpdTbl.Ary1D /end CHARACTERISTIC
/begin CHARACTERISTIC AAACalRegn02Rt04GroupB_Dummy.EotProtnEntrGainY.Ary2D "MICROSAR RTE" VAL_BLK 0x0 RTE_RL_UWORD 0 NO_COMPU_METHOD 0 65535 MATRIX_DIM 4 5 1 SYMBOL_LINK "Rte_CalprmRom_CalRegn02Rt04GroupB_DEFAULT_RTE_CALPRM_GROUP.EotProtnEntrGainY_Ary2D" 0 DISPLAY_IDENTIFIER AAACalRegn02Rt04GroupB_Dummy.CalibrationPorts.EotProtnEntrGainY.Ary2D /end CHARACTERISTIC
/begin CHARACTERISTIC AAACalRegn02Rt04GroupB_Dummy.EotProtnLoAuthyEntrGainY.Ary2D "MICROSAR RTE" VAL_BLK 0x0 RTE_RL_UWORD 0 NO_COMPU_METHOD 0 65535 MATRIX_DIM 4 5 1 SYMBOL_LINK "Rte_CalprmRom_CalRegn02Rt04GroupB_DEFAULT_RTE_CALPRM_GROUP.EotProtnLoAuthyEntrGainY_Ary2D" 0 DISPLAY_IDENTIFIER AAACalRegn02Rt04GroupB_Dummy.CalibrationPorts.EotProtnLoAuthyEntrGainY.Ary2D /end CHARACTERISTIC
/begin CHARACTERISTIC AAACalRegn02Rt04GroupB_Dummy.EotProtnMotSpdIncptY.Ary1D "MICROSAR RTE" VAL_BLK 0x0 RTE_RL_UWORD 0 NO_COMPU_METHOD 0 65535 MATRIX_DIM 2 1 1 SYMBOL_LINK "Rte_CalprmRom_CalRegn02Rt04GroupB_DEFAULT_RTE_CALPRM_GROUP.EotProtnMotSpdIncptY_Ary1D" 0 DISPLAY_IDENTIFIER AAACalRegn02Rt04GroupB_Dummy.CalibrationPorts.EotProtnMotSpdIncptY.Ary1D /end CHARACTERISTIC
/begin CHARACTERISTIC AAACalRegn02Rt04GroupB_Dummy.EotProtnNormDampgY.Ary2D "MICROSAR RTE" VAL_BLK 0x0 RTE_RL_UWORD 0 NO_COMPU_METHOD 0 65535 MATRIX_DIM 2 4 1 SYMBOL_LINK "Rte_CalprmRom_CalRegn02Rt04GroupB_DEFAULT_RTE_CALPRM_GROUP.EotProtnNormDampgY_Ary2D" 0 DISPLAY_IDENTIFIER AAACalRegn02Rt04GroupB_Dummy.CalibrationPorts.EotProtnNormDampgY.Ary2D /end CHARACTERISTIC
/begin CHARACTERISTIC AAACalRegn02Rt04GroupB_Dummy.EotProtnSoftEndStopAuthyThd.Val "MICROSAR RTE" VALUE 0x0 RTE_RL_FLOAT32_IEEE 0 NO_COMPU_METHOD -3.402823466e+38 3.402823466e+38 SYMBOL_LINK "Rte_CalprmRom_CalRegn02Rt04GroupB_DEFAULT_RTE_CALPRM_GROUP.EotProtnSoftEndStopAuthyThd_Val" 0 DISPLAY_IDENTIFIER AAACalRegn02Rt04GroupB_Dummy.CalibrationPorts.EotProtnSoftEndStopAuthyThd.Val /end CHARACTERISTIC
/begin CHARACTERISTIC AAACalRegn02Rt04GroupB_Dummy.RtnHwAgOffsCalcdX.Ary2D "MICROSAR RTE" VAL_BLK 0x0 RTE_RL_UWORD 0 NO_COMPU_METHOD 0 65535 MATRIX_DIM 16 9 1 SYMBOL_LINK "Rte_CalprmRom_CalRegn02Rt04GroupB_DEFAULT_RTE_CALPRM_GROUP.RtnHwAgOffsCalcdX_Ary2D" 0 DISPLAY_IDENTIFIER AAACalRegn02Rt04GroupB_Dummy.CalibrationPorts.RtnHwAgOffsCalcdX.Ary2D /end CHARACTERISTIC
/begin CHARACTERISTIC AAACalRegn02Rt04GroupB_Dummy.RtnHwAgOffsCalcdY.Ary2D "MICROSAR RTE" VAL_BLK 0x0 RTE_RL_UWORD 0 NO_COMPU_METHOD 0 65535 MATRIX_DIM 16 9 1 SYMBOL_LINK "Rte_CalprmRom_CalRegn02Rt04GroupB_DEFAULT_RTE_CALPRM_GROUP.RtnHwAgOffsCalcdY_Ary2D" 0 DISPLAY_IDENTIFIER AAACalRegn02Rt04GroupB_Dummy.CalibrationPorts.RtnHwAgOffsCalcdY.Ary2D /end CHARACTERISTIC
/begin CHARACTERISTIC AAACalRegn02Rt04GroupB_Dummy.RtnScaTqX.Ary2D "MICROSAR RTE" VAL_BLK 0x0 RTE_RL_UWORD 0 NO_COMPU_METHOD 0 65535 MATRIX_DIM 8 9 1 SYMBOL_LINK "Rte_CalprmRom_CalRegn02Rt04GroupB_DEFAULT_RTE_CALPRM_GROUP.RtnScaTqX_Ary2D" 0 DISPLAY_IDENTIFIER AAACalRegn02Rt04GroupB_Dummy.CalibrationPorts.RtnScaTqX.Ary2D /end CHARACTERISTIC
/begin CHARACTERISTIC AAACalRegn02Rt04GroupB_Dummy.RtnScaTqY.Ary2D "MICROSAR RTE" VAL_BLK 0x0 RTE_RL_UWORD 0 NO_COMPU_METHOD 0 65535 MATRIX_DIM 8 9 1 SYMBOL_LINK "Rte_CalprmRom_CalRegn02Rt04GroupB_DEFAULT_RTE_CALPRM_GROUP.RtnScaTqY_Ary2D" 0 DISPLAY_IDENTIFIER AAACalRegn02Rt04GroupB_Dummy.CalibrationPorts.RtnScaTqY.Ary2D /end CHARACTERISTIC
/begin CHARACTERISTIC AAACalRegn02Rt04GroupB_Dummy.RtnScaVelX.Ary2D "MICROSAR RTE" VAL_BLK 0x0 RTE_RL_UWORD 0 NO_COMPU_METHOD 0 65535 MATRIX_DIM 4 9 1 SYMBOL_LINK "Rte_CalprmRom_CalRegn02Rt04GroupB_DEFAULT_RTE_CALPRM_GROUP.RtnScaVelX_Ary2D" 0 DISPLAY_IDENTIFIER AAACalRegn02Rt04GroupB_Dummy.CalibrationPorts.RtnScaVelX.Ary2D /end CHARACTERISTIC
/begin CHARACTERISTIC AAACalRegn02Rt04GroupB_Dummy.RtnScaVelY.Ary2D "MICROSAR RTE" VAL_BLK 0x0 RTE_RL_UWORD 0 NO_COMPU_METHOD 0 65535 MATRIX_DIM 4 9 1 SYMBOL_LINK "Rte_CalprmRom_CalRegn02Rt04GroupB_DEFAULT_RTE_CALPRM_GROUP.RtnScaVelY_Ary2D" 0 DISPLAY_IDENTIFIER AAACalRegn02Rt04GroupB_Dummy.CalibrationPorts.RtnScaVelY.Ary2D /end CHARACTERISTIC
/begin CHARACTERISTIC AAACalRegn02Rt04GroupB_Dummy.RtnVehSpdSeln.Ary1D "MICROSAR RTE" VAL_BLK 0x0 RTE_RL_UWORD 0 NO_COMPU_METHOD 0 65535 MATRIX_DIM 9 1 1 SYMBOL_LINK "Rte_CalprmRom_CalRegn02Rt04GroupB_DEFAULT_RTE_CALPRM_GROUP.RtnVehSpdSeln_Ary1D" 0 DISPLAY_IDENTIFIER AAACalRegn02Rt04GroupB_Dummy.CalibrationPorts.RtnVehSpdSeln.Ary1D /end CHARACTERISTIC
/begin CHARACTERISTIC AAACalRegn02Rt05GroupA_Dummy.AssiHiFrqGainY.Ary2D "MICROSAR RTE" VAL_BLK 0x0 RTE_RL_UWORD 0 NO_COMPU_METHOD 0 65535 MATRIX_DIM 13 12 1 SYMBOL_LINK "Rte_CalprmRom_CalRegn02Rt05GroupA_DEFAULT_RTE_CALPRM_GROUP.AssiHiFrqGainY_Ary2D" 0 DISPLAY_IDENTIFIER AAACalRegn02Rt05GroupA_Dummy.CalibrationPorts.AssiHiFrqGainY.Ary2D /end CHARACTERISTIC
/begin CHARACTERISTIC AAACalRegn02Rt05GroupA_Dummy.AssiHiFrqHpFilFrqY.Ary1D "MICROSAR RTE" VAL_BLK 0x0 RTE_RL_UWORD 0 NO_COMPU_METHOD 0 65535 MATRIX_DIM 12 1 1 SYMBOL_LINK "Rte_CalprmRom_CalRegn02Rt05GroupA_DEFAULT_RTE_CALPRM_GROUP.AssiHiFrqHpFilFrqY_Ary1D" 0 DISPLAY_IDENTIFIER AAACalRegn02Rt05GroupA_Dummy.CalibrationPorts.AssiHiFrqHpFilFrqY.Ary1D /end CHARACTERISTIC
/begin CHARACTERISTIC AAACalRegn02Rt05GroupA_Dummy.AssiHiFrqTqWhlImbRejctnTqX.Ary2D "MICROSAR RTE" VAL_BLK 0x0 RTE_RL_UWORD 0 NO_COMPU_METHOD 0 65535 MATRIX_DIM 13 12 1 SYMBOL_LINK "Rte_CalprmRom_CalRegn02Rt05GroupA_DEFAULT_RTE_CALPRM_GROUP.AssiHiFrqTqWhlImbRejctnTqX_Ary2D" 0 DISPLAY_IDENTIFIER AAACalRegn02Rt05GroupA_Dummy.CalibrationPorts.AssiHiFrqTqWhlImbRejctnTqX.Ary2D /end CHARACTERISTIC
/begin CHARACTERISTIC AAACalRegn02Rt05GroupA_Dummy.AssiHiFrqTqX.Ary2D "MICROSAR RTE" VAL_BLK 0x0 RTE_RL_UWORD 0 NO_COMPU_METHOD 0 65535 MATRIX_DIM 13 12 1 SYMBOL_LINK "Rte_CalprmRom_CalRegn02Rt05GroupA_DEFAULT_RTE_CALPRM_GROUP.AssiHiFrqTqX_Ary2D" 0 DISPLAY_IDENTIFIER AAACalRegn02Rt05GroupA_Dummy.CalibrationPorts.AssiHiFrqTqX.Ary2D /end CHARACTERISTIC
/begin CHARACTERISTIC AAACalRegn02Rt05GroupA_Dummy.AssiHiFrqWhlImbRejctnBlndX.Ary2D "MICROSAR RTE" VAL_BLK 0x0 RTE_RL_UWORD 0 NO_COMPU_METHOD 0 65535 MATRIX_DIM 5 12 1 SYMBOL_LINK "Rte_CalprmRom_CalRegn02Rt05GroupA_DEFAULT_RTE_CALPRM_GROUP.AssiHiFrqWhlImbRejctnBlndX_Ary2D" 0 DISPLAY_IDENTIFIER AAACalRegn02Rt05GroupA_Dummy.CalibrationPorts.AssiHiFrqWhlImbRejctnBlndX.Ary2D /end CHARACTERISTIC
/begin CHARACTERISTIC AAACalRegn02Rt05GroupA_Dummy.AssiHiFrqWhlImbRejctnBlndY.Ary2D "MICROSAR RTE" VAL_BLK 0x0 RTE_RL_UWORD 0 NO_COMPU_METHOD 0 65535 MATRIX_DIM 5 12 1 SYMBOL_LINK "Rte_CalprmRom_CalRegn02Rt05GroupA_DEFAULT_RTE_CALPRM_GROUP.AssiHiFrqWhlImbRejctnBlndY_Ary2D" 0 DISPLAY_IDENTIFIER AAACalRegn02Rt05GroupA_Dummy.CalibrationPorts.AssiHiFrqWhlImbRejctnBlndY.Ary2D /end CHARACTERISTIC
/begin CHARACTERISTIC AAACalRegn02Rt05GroupA_Dummy.AssiHiFrqWhlImbRejctnGainY.Ary2D "MICROSAR RTE" VAL_BLK 0x0 RTE_RL_UWORD 0 NO_COMPU_METHOD 0 65535 MATRIX_DIM 13 12 1 SYMBOL_LINK "Rte_CalprmRom_CalRegn02Rt05GroupA_DEFAULT_RTE_CALPRM_GROUP.AssiHiFrqWhlImbRejctnGainY_Ary2D" 0 DISPLAY_IDENTIFIER AAACalRegn02Rt05GroupA_Dummy.CalibrationPorts.AssiHiFrqWhlImbRejctnGainY.Ary2D /end CHARACTERISTIC
/begin CHARACTERISTIC AAACalRegn02Rt05GroupA_Dummy.AssiMotTqWhlImbRejctnMaxX.Ary2D "MICROSAR RTE" VAL_BLK 0x0 RTE_RL_UWORD 0 NO_COMPU_METHOD 0 65535 MATRIX_DIM 20 12 1 SYMBOL_LINK "Rte_CalprmRom_CalRegn02Rt05GroupA_DEFAULT_RTE_CALPRM_GROUP.AssiMotTqWhlImbRejctnMaxX_Ary2D" 0 DISPLAY_IDENTIFIER AAACalRegn02Rt05GroupA_Dummy.CalibrationPorts.AssiMotTqWhlImbRejctnMaxX.Ary2D /end CHARACTERISTIC
/begin CHARACTERISTIC AAACalRegn02Rt05GroupA_Dummy.AssiMotTqWhlImbRejctnMaxY.Ary2D "MICROSAR RTE" VAL_BLK 0x0 RTE_RL_SWORD 0 NO_COMPU_METHOD -32768 32767 MATRIX_DIM 20 12 1 SYMBOL_LINK "Rte_CalprmRom_CalRegn02Rt05GroupA_DEFAULT_RTE_CALPRM_GROUP.AssiMotTqWhlImbRejctnMaxY_Ary2D" 0 DISPLAY_IDENTIFIER AAACalRegn02Rt05GroupA_Dummy.CalibrationPorts.AssiMotTqWhlImbRejctnMaxY.Ary2D /end CHARACTERISTIC
/begin CHARACTERISTIC AAACalRegn02Rt05GroupA_Dummy.AssiMotTqWhlImbRejctnMinX.Ary2D "MICROSAR RTE" VAL_BLK 0x0 RTE_RL_UWORD 0 NO_COMPU_METHOD 0 65535 MATRIX_DIM 20 12 1 SYMBOL_LINK "Rte_CalprmRom_CalRegn02Rt05GroupA_DEFAULT_RTE_CALPRM_GROUP.AssiMotTqWhlImbRejctnMinX_Ary2D" 0 DISPLAY_IDENTIFIER AAACalRegn02Rt05GroupA_Dummy.CalibrationPorts.AssiMotTqWhlImbRejctnMinX.Ary2D /end CHARACTERISTIC
/begin CHARACTERISTIC AAACalRegn02Rt05GroupA_Dummy.AssiMotTqWhlImbRejctnMinY.Ary2D "MICROSAR RTE" VAL_BLK 0x0 RTE_RL_SWORD 0 NO_COMPU_METHOD -32768 32767 MATRIX_DIM 20 12 1 SYMBOL_LINK "Rte_CalprmRom_CalRegn02Rt05GroupA_DEFAULT_RTE_CALPRM_GROUP.AssiMotTqWhlImbRejctnMinY_Ary2D" 0 DISPLAY_IDENTIFIER AAACalRegn02Rt05GroupA_Dummy.CalibrationPorts.AssiMotTqWhlImbRejctnMinY.Ary2D /end CHARACTERISTIC
/begin CHARACTERISTIC AAACalRegn02Rt05GroupA_Dummy.AssiWhlImbRejctnBlndScaX.Ary2D "MICROSAR RTE" VAL_BLK 0x0 RTE_RL_UWORD 0 NO_COMPU_METHOD 0 65535 MATRIX_DIM 5 12 1 SYMBOL_LINK "Rte_CalprmRom_CalRegn02Rt05GroupA_DEFAULT_RTE_CALPRM_GROUP.AssiWhlImbRejctnBlndScaX_Ary2D" 0 DISPLAY_IDENTIFIER AAACalRegn02Rt05GroupA_Dummy.CalibrationPorts.AssiWhlImbRejctnBlndScaX.Ary2D /end CHARACTERISTIC
/begin CHARACTERISTIC AAACalRegn02Rt05GroupA_Dummy.AssiWhlImbRejctnBlndScaY.Ary2D "MICROSAR RTE" VAL_BLK 0x0 RTE_RL_UWORD 0 NO_COMPU_METHOD 0 65535 MATRIX_DIM 5 12 1 SYMBOL_LINK "Rte_CalprmRom_CalRegn02Rt05GroupA_DEFAULT_RTE_CALPRM_GROUP.AssiWhlImbRejctnBlndScaY_Ary2D" 0 DISPLAY_IDENTIFIER AAACalRegn02Rt05GroupA_Dummy.CalibrationPorts.AssiWhlImbRejctnBlndScaY.Ary2D /end CHARACTERISTIC
/begin CHARACTERISTIC AAACalRegn02Rt05GroupA_Dummy.DampgHwTqX.Ary1D "MICROSAR RTE" VAL_BLK 0x0 RTE_RL_UWORD 0 NO_COMPU_METHOD 0 65535 MATRIX_DIM 2 1 1 SYMBOL_LINK "Rte_CalprmRom_CalRegn02Rt05GroupA_DEFAULT_RTE_CALPRM_GROUP.DampgHwTqX_Ary1D" 0 DISPLAY_IDENTIFIER AAACalRegn02Rt05GroupA_Dummy.CalibrationPorts.DampgHwTqX.Ary1D /end CHARACTERISTIC
/begin CHARACTERISTIC AAACalRegn02Rt05GroupA_Dummy.DampgHwTqY.Ary1D "MICROSAR RTE" VAL_BLK 0x0 RTE_RL_UWORD 0 NO_COMPU_METHOD 0 65535 MATRIX_DIM 2 1 1 SYMBOL_LINK "Rte_CalprmRom_CalRegn02Rt05GroupA_DEFAULT_RTE_CALPRM_GROUP.DampgHwTqY_Ary1D" 0 DISPLAY_IDENTIFIER AAACalRegn02Rt05GroupA_Dummy.CalibrationPorts.DampgHwTqY.Ary1D /end CHARACTERISTIC
/begin CHARACTERISTIC AAACalRegn02Rt05GroupA_Dummy.DampgHydCoeff1ScaY.Ary1D "MICROSAR RTE" VAL_BLK 0x0 RTE_RL_UWORD 0 NO_COMPU_METHOD 0 65535 MATRIX_DIM 12 1 1 SYMBOL_LINK "Rte_CalprmRom_CalRegn02Rt05GroupA_DEFAULT_RTE_CALPRM_GROUP.DampgHydCoeff1ScaY_Ary1D" 0 DISPLAY_IDENTIFIER AAACalRegn02Rt05GroupA_Dummy.CalibrationPorts.DampgHydCoeff1ScaY.Ary1D /end CHARACTERISTIC
/begin CHARACTERISTIC AAACalRegn02Rt05GroupA_Dummy.DampgHydCoeff2ScaY.Ary1D "MICROSAR RTE" VAL_BLK 0x0 RTE_RL_UWORD 0 NO_COMPU_METHOD 0 65535 MATRIX_DIM 12 1 1 SYMBOL_LINK "Rte_CalprmRom_CalRegn02Rt05GroupA_DEFAULT_RTE_CALPRM_GROUP.DampgHydCoeff2ScaY_Ary1D" 0 DISPLAY_IDENTIFIER AAACalRegn02Rt05GroupA_Dummy.CalibrationPorts.DampgHydCoeff2ScaY.Ary1D /end CHARACTERISTIC
/begin CHARACTERISTIC AAACalRegn02Rt05GroupA_Dummy.DampgHydCoeff3ScaY.Ary1D "MICROSAR RTE" VAL_BLK 0x0 RTE_RL_UWORD 0 NO_COMPU_METHOD 0 65535 MATRIX_DIM 12 1 1 SYMBOL_LINK "Rte_CalprmRom_CalRegn02Rt05GroupA_DEFAULT_RTE_CALPRM_GROUP.DampgHydCoeff3ScaY_Ary1D" 0 DISPLAY_IDENTIFIER AAACalRegn02Rt05GroupA_Dummy.CalibrationPorts.DampgHydCoeff3ScaY.Ary1D /end CHARACTERISTIC
/begin CHARACTERISTIC AAACalRegn02Rt05GroupA_Dummy.DampgHydCoeff4ScaY.Ary1D "MICROSAR RTE" VAL_BLK 0x0 RTE_RL_UWORD 0 NO_COMPU_METHOD 0 65535 MATRIX_DIM 12 1 1 SYMBOL_LINK "Rte_CalprmRom_CalRegn02Rt05GroupA_DEFAULT_RTE_CALPRM_GROUP.DampgHydCoeff4ScaY_Ary1D" 0 DISPLAY_IDENTIFIER AAACalRegn02Rt05GroupA_Dummy.CalibrationPorts.DampgHydCoeff4ScaY.Ary1D /end CHARACTERISTIC
/begin CHARACTERISTIC AAACalRegn02Rt05GroupA_Dummy.DampgMotVelX.Ary2D "MICROSAR RTE" VAL_BLK 0x0 RTE_RL_UWORD 0 NO_COMPU_METHOD 0 65535 MATRIX_DIM 13 12 1 SYMBOL_LINK "Rte_CalprmRom_CalRegn02Rt05GroupA_DEFAULT_RTE_CALPRM_GROUP.DampgMotVelX_Ary2D" 0 DISPLAY_IDENTIFIER AAACalRegn02Rt05GroupA_Dummy.CalibrationPorts.DampgMotVelX.Ary2D /end CHARACTERISTIC
/begin CHARACTERISTIC AAACalRegn02Rt05GroupA_Dummy.DampgMotVelY.Ary2D "MICROSAR RTE" VAL_BLK 0x0 RTE_RL_UWORD 0 NO_COMPU_METHOD 0 65535 MATRIX_DIM 13 12 1 SYMBOL_LINK "Rte_CalprmRom_CalRegn02Rt05GroupA_DEFAULT_RTE_CALPRM_GROUP.DampgMotVelY_Ary2D" 0 DISPLAY_IDENTIFIER AAACalRegn02Rt05GroupA_Dummy.CalibrationPorts.DampgMotVelY.Ary2D /end CHARACTERISTIC
/begin CHARACTERISTIC AAACalRegn02Rt05GroupA_Dummy.HysCmpEffLossY.Ary1D "MICROSAR RTE" VAL_BLK 0x0 RTE_RL_UWORD 0 NO_COMPU_METHOD 0 65535 MATRIX_DIM 12 1 1 SYMBOL_LINK "Rte_CalprmRom_CalRegn02Rt05GroupA_DEFAULT_RTE_CALPRM_GROUP.HysCmpEffLossY_Ary1D" 0 DISPLAY_IDENTIFIER AAACalRegn02Rt05GroupA_Dummy.CalibrationPorts.HysCmpEffLossY.Ary1D /end CHARACTERISTIC
/begin CHARACTERISTIC AAACalRegn02Rt05GroupA_Dummy.HysCmpEffOffsY.Ary1D "MICROSAR RTE" VAL_BLK 0x0 RTE_RL_UWORD 0 NO_COMPU_METHOD 0 65535 MATRIX_DIM 12 1 1 SYMBOL_LINK "Rte_CalprmRom_CalRegn02Rt05GroupA_DEFAULT_RTE_CALPRM_GROUP.HysCmpEffOffsY_Ary1D" 0 DISPLAY_IDENTIFIER AAACalRegn02Rt05GroupA_Dummy.CalibrationPorts.HysCmpEffOffsY.Ary1D /end CHARACTERISTIC
/begin CHARACTERISTIC AAACalRegn02Rt05GroupA_Dummy.HysCmpFricWhlImbRejctnBlndX.Ary1D "MICROSAR RTE" VAL_BLK 0x0 RTE_RL_UWORD 0 NO_COMPU_METHOD 0 65535 MATRIX_DIM 6 1 1 SYMBOL_LINK "Rte_CalprmRom_CalRegn02Rt05GroupA_DEFAULT_RTE_CALPRM_GROUP.HysCmpFricWhlImbRejctnBlndX_Ary1D" 0 DISPLAY_IDENTIFIER AAACalRegn02Rt05GroupA_Dummy.CalibrationPorts.HysCmpFricWhlImbRejctnBlndX.Ary1D /end CHARACTERISTIC
/begin CHARACTERISTIC AAACalRegn02Rt05GroupA_Dummy.HysCmpFricWhlImbRejctnBlndY.Ary1D "MICROSAR RTE" VAL_BLK 0x0 RTE_RL_UWORD 0 NO_COMPU_METHOD 0 65535 MATRIX_DIM 6 1 1 SYMBOL_LINK "Rte_CalprmRom_CalRegn02Rt05GroupA_DEFAULT_RTE_CALPRM_GROUP.HysCmpFricWhlImbRejctnBlndY_Ary1D" 0 DISPLAY_IDENTIFIER AAACalRegn02Rt05GroupA_Dummy.CalibrationPorts.HysCmpFricWhlImbRejctnBlndY.Ary1D /end CHARACTERISTIC
/begin CHARACTERISTIC AAACalRegn02Rt05GroupA_Dummy.HysCmpFricWhlImbRejctnOffY.Ary1D "MICROSAR RTE" VAL_BLK 0x0 RTE_RL_UWORD 0 NO_COMPU_METHOD 0 65535 MATRIX_DIM 12 1 1 SYMBOL_LINK "Rte_CalprmRom_CalRegn02Rt05GroupA_DEFAULT_RTE_CALPRM_GROUP.HysCmpFricWhlImbRejctnOffY_Ary1D" 0 DISPLAY_IDENTIFIER AAACalRegn02Rt05GroupA_Dummy.CalibrationPorts.HysCmpFricWhlImbRejctnOffY.Ary1D /end CHARACTERISTIC
/begin CHARACTERISTIC AAACalRegn02Rt05GroupA_Dummy.HysCmpFricWhlImbRejctnOnY.Ary1D "MICROSAR RTE" VAL_BLK 0x0 RTE_RL_UWORD 0 NO_COMPU_METHOD 0 65535 MATRIX_DIM 12 1 1 SYMBOL_LINK "Rte_CalprmRom_CalRegn02Rt05GroupA_DEFAULT_RTE_CALPRM_GROUP.HysCmpFricWhlImbRejctnOnY_Ary1D" 0 DISPLAY_IDENTIFIER AAACalRegn02Rt05GroupA_Dummy.CalibrationPorts.HysCmpFricWhlImbRejctnOnY.Ary1D /end CHARACTERISTIC
/begin CHARACTERISTIC AAACalRegn02Rt05GroupA_Dummy.HysCmpHwTqScaX.Ary2D "MICROSAR RTE" VAL_BLK 0x0 RTE_RL_UWORD 0 NO_COMPU_METHOD 0 65535 MATRIX_DIM 8 12 1 SYMBOL_LINK "Rte_CalprmRom_CalRegn02Rt05GroupA_DEFAULT_RTE_CALPRM_GROUP.HysCmpHwTqScaX_Ary2D" 0 DISPLAY_IDENTIFIER AAACalRegn02Rt05GroupA_Dummy.CalibrationPorts.HysCmpHwTqScaX.Ary2D /end CHARACTERISTIC
/begin CHARACTERISTIC AAACalRegn02Rt05GroupA_Dummy.HysCmpHwTqScaY.Ary2D "MICROSAR RTE" VAL_BLK 0x0 RTE_RL_UWORD 0 NO_COMPU_METHOD 0 65535 MATRIX_DIM 8 12 1 SYMBOL_LINK "Rte_CalprmRom_CalRegn02Rt05GroupA_DEFAULT_RTE_CALPRM_GROUP.HysCmpHwTqScaY_Ary2D" 0 DISPLAY_IDENTIFIER AAACalRegn02Rt05GroupA_Dummy.CalibrationPorts.HysCmpHwTqScaY.Ary2D /end CHARACTERISTIC
/begin CHARACTERISTIC AAACalRegn02Rt05GroupA_Dummy.HysCmpHysSatnY.Ary1D "MICROSAR RTE" VAL_BLK 0x0 RTE_RL_UWORD 0 NO_COMPU_METHOD 0 65535 MATRIX_DIM 12 1 1 SYMBOL_LINK "Rte_CalprmRom_CalRegn02Rt05GroupA_DEFAULT_RTE_CALPRM_GROUP.HysCmpHysSatnY_Ary1D" 0 DISPLAY_IDENTIFIER AAACalRegn02Rt05GroupA_Dummy.CalibrationPorts.HysCmpHysSatnY.Ary1D /end CHARACTERISTIC
/begin CHARACTERISTIC AAACalRegn02Rt05GroupA_Dummy.HysCmpNegHysCmpScaX.Ary1D "MICROSAR RTE" VAL_BLK 0x0 RTE_RL_UWORD 0 NO_COMPU_METHOD 0 65535 MATRIX_DIM 5 1 1 SYMBOL_LINK "Rte_CalprmRom_CalRegn02Rt05GroupA_DEFAULT_RTE_CALPRM_GROUP.HysCmpNegHysCmpScaX_Ary1D" 0 DISPLAY_IDENTIFIER AAACalRegn02Rt05GroupA_Dummy.CalibrationPorts.HysCmpNegHysCmpScaX.Ary1D /end CHARACTERISTIC
/begin CHARACTERISTIC AAACalRegn02Rt05GroupA_Dummy.HysCmpNegHysCmpScaY.Ary1D "MICROSAR RTE" VAL_BLK 0x0 RTE_RL_UWORD 0 NO_COMPU_METHOD 0 65535 MATRIX_DIM 5 1 1 SYMBOL_LINK "Rte_CalprmRom_CalRegn02Rt05GroupA_DEFAULT_RTE_CALPRM_GROUP.HysCmpNegHysCmpScaY_Ary1D" 0 DISPLAY_IDENTIFIER AAACalRegn02Rt05GroupA_Dummy.CalibrationPorts.HysCmpNegHysCmpScaY.Ary1D /end CHARACTERISTIC
/begin CHARACTERISTIC AAACalRegn02Rt05GroupA_Dummy.HysCmpNegHysCmpX.Ary1D "MICROSAR RTE" VAL_BLK 0x0 RTE_RL_UWORD 0 NO_COMPU_METHOD 0 65535 MATRIX_DIM 8 1 1 SYMBOL_LINK "Rte_CalprmRom_CalRegn02Rt05GroupA_DEFAULT_RTE_CALPRM_GROUP.HysCmpNegHysCmpX_Ary1D" 0 DISPLAY_IDENTIFIER AAACalRegn02Rt05GroupA_Dummy.CalibrationPorts.HysCmpNegHysCmpX.Ary1D /end CHARACTERISTIC
/begin CHARACTERISTIC AAACalRegn02Rt05GroupA_Dummy.HysCmpNegHysCmpY.Ary1D "MICROSAR RTE" VAL_BLK 0x0 RTE_RL_UWORD 0 NO_COMPU_METHOD 0 65535 MATRIX_DIM 8 1 1 SYMBOL_LINK "Rte_CalprmRom_CalRegn02Rt05GroupA_DEFAULT_RTE_CALPRM_GROUP.HysCmpNegHysCmpY_Ary1D" 0 DISPLAY_IDENTIFIER AAACalRegn02Rt05GroupA_Dummy.CalibrationPorts.HysCmpNegHysCmpY.Ary1D /end CHARACTERISTIC
/begin CHARACTERISTIC AAACalRegn02Rt05GroupA_Dummy.HysCmpOutpLim.Val "MICROSAR RTE" VALUE 0x0 RTE_RL_FLOAT32_IEEE 0 NO_COMPU_METHOD -3.402823466e+38 3.402823466e+38 SYMBOL_LINK "Rte_CalprmRom_CalRegn02Rt05GroupA_DEFAULT_RTE_CALPRM_GROUP.HysCmpOutpLim_Val" 0 DISPLAY_IDENTIFIER AAACalRegn02Rt05GroupA_Dummy.CalibrationPorts.HysCmpOutpLim.Val /end CHARACTERISTIC
/begin CHARACTERISTIC AAACalRegn02Rt05GroupA_Dummy.HysCmpRevGain.Val "MICROSAR RTE" VALUE 0x0 RTE_RL_FLOAT32_IEEE 0 NO_COMPU_METHOD -3.402823466e+38 3.402823466e+38 SYMBOL_LINK "Rte_CalprmRom_CalRegn02Rt05GroupA_DEFAULT_RTE_CALPRM_GROUP.HysCmpRevGain_Val" 0 DISPLAY_IDENTIFIER AAACalRegn02Rt05GroupA_Dummy.CalibrationPorts.HysCmpRevGain.Val /end CHARACTERISTIC
/begin CHARACTERISTIC AAACalRegn02Rt05GroupA_Dummy.HysCmpRiseX.Ary1D "MICROSAR RTE" VAL_BLK 0x0 RTE_RL_UWORD 0 NO_COMPU_METHOD 0 65535 MATRIX_DIM 6 1 1 SYMBOL_LINK "Rte_CalprmRom_CalRegn02Rt05GroupA_DEFAULT_RTE_CALPRM_GROUP.HysCmpRiseX_Ary1D" 0 DISPLAY_IDENTIFIER AAACalRegn02Rt05GroupA_Dummy.CalibrationPorts.HysCmpRiseX.Ary1D /end CHARACTERISTIC
/begin CHARACTERISTIC AAACalRegn02Rt05GroupA_Dummy.HysCmpRiseY.Ary1D "MICROSAR RTE" VAL_BLK 0x0 RTE_RL_UWORD 0 NO_COMPU_METHOD 0 65535 MATRIX_DIM 6 1 1 SYMBOL_LINK "Rte_CalprmRom_CalRegn02Rt05GroupA_DEFAULT_RTE_CALPRM_GROUP.HysCmpRiseY_Ary1D" 0 DISPLAY_IDENTIFIER AAACalRegn02Rt05GroupA_Dummy.CalibrationPorts.HysCmpRiseY.Ary1D /end CHARACTERISTIC
/begin CHARACTERISTIC AAACalRegn02Rt05GroupA_Dummy.InertiaCmpVelAssiBasdDampgStatY.Ary1D "MICROSAR RTE" VAL_BLK 0x0 RTE_RL_UWORD 0 NO_COMPU_METHOD 0 65535 MATRIX_DIM 10 1 1 SYMBOL_LINK "Rte_CalprmRom_CalRegn02Rt05GroupA_DEFAULT_RTE_CALPRM_GROUP.InertiaCmpVelAssiBasdDampgStatY_Ary1D" 0 DISPLAY_IDENTIFIER AAACalRegn02Rt05GroupA_Dummy.CalibrationPorts.InertiaCmpVelAssiBasdDampgStatY.Ary1D /end CHARACTERISTIC
/begin CHARACTERISTIC AAACalRegn02Rt05GroupA_Dummy.InertiaCmpVelDampgFilFrq.Ary1D "MICROSAR RTE" VAL_BLK 0x0 RTE_RL_UWORD 0 NO_COMPU_METHOD 0 65535 MATRIX_DIM 12 1 1 SYMBOL_LINK "Rte_CalprmRom_CalRegn02Rt05GroupA_DEFAULT_RTE_CALPRM_GROUP.InertiaCmpVelDampgFilFrq_Ary1D" 0 DISPLAY_IDENTIFIER AAACalRegn02Rt05GroupA_Dummy.CalibrationPorts.InertiaCmpVelDampgFilFrq.Ary1D /end CHARACTERISTIC
/begin CHARACTERISTIC AAACalRegn02Rt05GroupA_Dummy.InertiaCmpVelDampgFilFrqWhlImbRejctnOn.Ary1D "MICROSAR RTE" VAL_BLK 0x0 RTE_RL_UWORD 0 NO_COMPU_METHOD 0 65535 MATRIX_DIM 12 1 1 SYMBOL_LINK "Rte_CalprmRom_CalRegn02Rt05GroupA_DEFAULT_RTE_CALPRM_GROUP.InertiaCmpVelDampgFilFrqWhlImbRejctnOn_Ary1D" 0 DISPLAY_IDENTIFIER AAACalRegn02Rt05GroupA_Dummy.CalibrationPorts.InertiaCmpVelDampgFilFrqWhlImbRejctnOn.Ary1D /end CHARACTERISTIC
/begin CHARACTERISTIC AAACalRegn02Rt05GroupA_Dummy.InertiaCmpVelDampgSpdBlndY.Ary1D "MICROSAR RTE" VAL_BLK 0x0 RTE_RL_UWORD 0 NO_COMPU_METHOD 0 65535 MATRIX_DIM 12 1 1 SYMBOL_LINK "Rte_CalprmRom_CalRegn02Rt05GroupA_DEFAULT_RTE_CALPRM_GROUP.InertiaCmpVelDampgSpdBlndY_Ary1D" 0 DISPLAY_IDENTIFIER AAACalRegn02Rt05GroupA_Dummy.CalibrationPorts.InertiaCmpVelDampgSpdBlndY.Ary1D /end CHARACTERISTIC
/begin CHARACTERISTIC AAACalRegn02Rt05GroupA_Dummy.InertiaCmpVelDampgWhlImbRejctnBlndX.Ary1D "MICROSAR RTE" VAL_BLK 0x0 RTE_RL_UWORD 0 NO_COMPU_METHOD 0 65535 MATRIX_DIM 5 1 1 SYMBOL_LINK "Rte_CalprmRom_CalRegn02Rt05GroupA_DEFAULT_RTE_CALPRM_GROUP.InertiaCmpVelDampgWhlImbRejctnBlndX_Ary1D" 0 DISPLAY_IDENTIFIER AAACalRegn02Rt05GroupA_Dummy.CalibrationPorts.InertiaCmpVelDampgWhlImbRejctnBlndX.Ary1D /end CHARACTERISTIC
/begin CHARACTERISTIC AAACalRegn02Rt05GroupA_Dummy.InertiaCmpVelDampgWhlImbRejctnBlndY.Ary1D "MICROSAR RTE" VAL_BLK 0x0 RTE_RL_UWORD 0 NO_COMPU_METHOD 0 65535 MATRIX_DIM 5 1 1 SYMBOL_LINK "Rte_CalprmRom_CalRegn02Rt05GroupA_DEFAULT_RTE_CALPRM_GROUP.InertiaCmpVelDampgWhlImbRejctnBlndY_Ary1D" 0 DISPLAY_IDENTIFIER AAACalRegn02Rt05GroupA_Dummy.CalibrationPorts.InertiaCmpVelDampgWhlImbRejctnBlndY.Ary1D /end CHARACTERISTIC
/begin CHARACTERISTIC AAACalRegn02Rt05GroupB_Dummy.EotProtnDampgVehSpdTbl.Ary1D "MICROSAR RTE" VAL_BLK 0x0 RTE_RL_UWORD 0 NO_COMPU_METHOD 0 65535 MATRIX_DIM 4 1 1 SYMBOL_LINK "Rte_CalprmRom_CalRegn02Rt05GroupB_DEFAULT_RTE_CALPRM_GROUP.EotProtnDampgVehSpdTbl_Ary1D" 0 DISPLAY_IDENTIFIER AAACalRegn02Rt05GroupB_Dummy.CalibrationPorts.EotProtnDampgVehSpdTbl.Ary1D /end CHARACTERISTIC
/begin CHARACTERISTIC AAACalRegn02Rt05GroupB_Dummy.EotProtnDeltaTqThd.Val "MICROSAR RTE" VALUE 0x0 RTE_RL_FLOAT32_IEEE 0 NO_COMPU_METHOD -3.402823466e+38 3.402823466e+38 SYMBOL_LINK "Rte_CalprmRom_CalRegn02Rt05GroupB_DEFAULT_RTE_CALPRM_GROUP.EotProtnDeltaTqThd_Val" 0 DISPLAY_IDENTIFIER AAACalRegn02Rt05GroupB_Dummy.CalibrationPorts.EotProtnDeltaTqThd.Val /end CHARACTERISTIC
/begin CHARACTERISTIC AAACalRegn02Rt05GroupB_Dummy.EotProtnEntrGainVehSpdTbl.Ary1D "MICROSAR RTE" VAL_BLK 0x0 RTE_RL_UWORD 0 NO_COMPU_METHOD 0 65535 MATRIX_DIM 5 1 1 SYMBOL_LINK "Rte_CalprmRom_CalRegn02Rt05GroupB_DEFAULT_RTE_CALPRM_GROUP.EotProtnEntrGainVehSpdTbl_Ary1D" 0 DISPLAY_IDENTIFIER AAACalRegn02Rt05GroupB_Dummy.CalibrationPorts.EotProtnEntrGainVehSpdTbl.Ary1D /end CHARACTERISTIC
/begin CHARACTERISTIC AAACalRegn02Rt05GroupB_Dummy.EotProtnEntrGainY.Ary2D "MICROSAR RTE" VAL_BLK 0x0 RTE_RL_UWORD 0 NO_COMPU_METHOD 0 65535 MATRIX_DIM 4 5 1 SYMBOL_LINK "Rte_CalprmRom_CalRegn02Rt05GroupB_DEFAULT_RTE_CALPRM_GROUP.EotProtnEntrGainY_Ary2D" 0 DISPLAY_IDENTIFIER AAACalRegn02Rt05GroupB_Dummy.CalibrationPorts.EotProtnEntrGainY.Ary2D /end CHARACTERISTIC
/begin CHARACTERISTIC AAACalRegn02Rt05GroupB_Dummy.EotProtnLoAuthyEntrGainY.Ary2D "MICROSAR RTE" VAL_BLK 0x0 RTE_RL_UWORD 0 NO_COMPU_METHOD 0 65535 MATRIX_DIM 4 5 1 SYMBOL_LINK "Rte_CalprmRom_CalRegn02Rt05GroupB_DEFAULT_RTE_CALPRM_GROUP.EotProtnLoAuthyEntrGainY_Ary2D" 0 DISPLAY_IDENTIFIER AAACalRegn02Rt05GroupB_Dummy.CalibrationPorts.EotProtnLoAuthyEntrGainY.Ary2D /end CHARACTERISTIC
/begin CHARACTERISTIC AAACalRegn02Rt05GroupB_Dummy.EotProtnMotSpdIncptY.Ary1D "MICROSAR RTE" VAL_BLK 0x0 RTE_RL_UWORD 0 NO_COMPU_METHOD 0 65535 MATRIX_DIM 2 1 1 SYMBOL_LINK "Rte_CalprmRom_CalRegn02Rt05GroupB_DEFAULT_RTE_CALPRM_GROUP.EotProtnMotSpdIncptY_Ary1D" 0 DISPLAY_IDENTIFIER AAACalRegn02Rt05GroupB_Dummy.CalibrationPorts.EotProtnMotSpdIncptY.Ary1D /end CHARACTERISTIC
/begin CHARACTERISTIC AAACalRegn02Rt05GroupB_Dummy.EotProtnNormDampgY.Ary2D "MICROSAR RTE" VAL_BLK 0x0 RTE_RL_UWORD 0 NO_COMPU_METHOD 0 65535 MATRIX_DIM 2 4 1 SYMBOL_LINK "Rte_CalprmRom_CalRegn02Rt05GroupB_DEFAULT_RTE_CALPRM_GROUP.EotProtnNormDampgY_Ary2D" 0 DISPLAY_IDENTIFIER AAACalRegn02Rt05GroupB_Dummy.CalibrationPorts.EotProtnNormDampgY.Ary2D /end CHARACTERISTIC
/begin CHARACTERISTIC AAACalRegn02Rt05GroupB_Dummy.EotProtnSoftEndStopAuthyThd.Val "MICROSAR RTE" VALUE 0x0 RTE_RL_FLOAT32_IEEE 0 NO_COMPU_METHOD -3.402823466e+38 3.402823466e+38 SYMBOL_LINK "Rte_CalprmRom_CalRegn02Rt05GroupB_DEFAULT_RTE_CALPRM_GROUP.EotProtnSoftEndStopAuthyThd_Val" 0 DISPLAY_IDENTIFIER AAACalRegn02Rt05GroupB_Dummy.CalibrationPorts.EotProtnSoftEndStopAuthyThd.Val /end CHARACTERISTIC
/begin CHARACTERISTIC AAACalRegn02Rt05GroupB_Dummy.RtnHwAgOffsCalcdX.Ary2D "MICROSAR RTE" VAL_BLK 0x0 RTE_RL_UWORD 0 NO_COMPU_METHOD 0 65535 MATRIX_DIM 16 9 1 SYMBOL_LINK "Rte_CalprmRom_CalRegn02Rt05GroupB_DEFAULT_RTE_CALPRM_GROUP.RtnHwAgOffsCalcdX_Ary2D" 0 DISPLAY_IDENTIFIER AAACalRegn02Rt05GroupB_Dummy.CalibrationPorts.RtnHwAgOffsCalcdX.Ary2D /end CHARACTERISTIC
/begin CHARACTERISTIC AAACalRegn02Rt05GroupB_Dummy.RtnHwAgOffsCalcdY.Ary2D "MICROSAR RTE" VAL_BLK 0x0 RTE_RL_UWORD 0 NO_COMPU_METHOD 0 65535 MATRIX_DIM 16 9 1 SYMBOL_LINK "Rte_CalprmRom_CalRegn02Rt05GroupB_DEFAULT_RTE_CALPRM_GROUP.RtnHwAgOffsCalcdY_Ary2D" 0 DISPLAY_IDENTIFIER AAACalRegn02Rt05GroupB_Dummy.CalibrationPorts.RtnHwAgOffsCalcdY.Ary2D /end CHARACTERISTIC
/begin CHARACTERISTIC AAACalRegn02Rt05GroupB_Dummy.RtnScaTqX.Ary2D "MICROSAR RTE" VAL_BLK 0x0 RTE_RL_UWORD 0 NO_COMPU_METHOD 0 65535 MATRIX_DIM 8 9 1 SYMBOL_LINK "Rte_CalprmRom_CalRegn02Rt05GroupB_DEFAULT_RTE_CALPRM_GROUP.RtnScaTqX_Ary2D" 0 DISPLAY_IDENTIFIER AAACalRegn02Rt05GroupB_Dummy.CalibrationPorts.RtnScaTqX.Ary2D /end CHARACTERISTIC
/begin CHARACTERISTIC AAACalRegn02Rt05GroupB_Dummy.RtnScaTqY.Ary2D "MICROSAR RTE" VAL_BLK 0x0 RTE_RL_UWORD 0 NO_COMPU_METHOD 0 65535 MATRIX_DIM 8 9 1 SYMBOL_LINK "Rte_CalprmRom_CalRegn02Rt05GroupB_DEFAULT_RTE_CALPRM_GROUP.RtnScaTqY_Ary2D" 0 DISPLAY_IDENTIFIER AAACalRegn02Rt05GroupB_Dummy.CalibrationPorts.RtnScaTqY.Ary2D /end CHARACTERISTIC
/begin CHARACTERISTIC AAACalRegn02Rt05GroupB_Dummy.RtnScaVelX.Ary2D "MICROSAR RTE" VAL_BLK 0x0 RTE_RL_UWORD 0 NO_COMPU_METHOD 0 65535 MATRIX_DIM 4 9 1 SYMBOL_LINK "Rte_CalprmRom_CalRegn02Rt05GroupB_DEFAULT_RTE_CALPRM_GROUP.RtnScaVelX_Ary2D" 0 DISPLAY_IDENTIFIER AAACalRegn02Rt05GroupB_Dummy.CalibrationPorts.RtnScaVelX.Ary2D /end CHARACTERISTIC
/begin CHARACTERISTIC AAACalRegn02Rt05GroupB_Dummy.RtnScaVelY.Ary2D "MICROSAR RTE" VAL_BLK 0x0 RTE_RL_UWORD 0 NO_COMPU_METHOD 0 65535 MATRIX_DIM 4 9 1 SYMBOL_LINK "Rte_CalprmRom_CalRegn02Rt05GroupB_DEFAULT_RTE_CALPRM_GROUP.RtnScaVelY_Ary2D" 0 DISPLAY_IDENTIFIER AAACalRegn02Rt05GroupB_Dummy.CalibrationPorts.RtnScaVelY.Ary2D /end CHARACTERISTIC
/begin CHARACTERISTIC AAACalRegn02Rt05GroupB_Dummy.RtnVehSpdSeln.Ary1D "MICROSAR RTE" VAL_BLK 0x0 RTE_RL_UWORD 0 NO_COMPU_METHOD 0 65535 MATRIX_DIM 9 1 1 SYMBOL_LINK "Rte_CalprmRom_CalRegn02Rt05GroupB_DEFAULT_RTE_CALPRM_GROUP.RtnVehSpdSeln_Ary1D" 0 DISPLAY_IDENTIFIER AAACalRegn02Rt05GroupB_Dummy.CalibrationPorts.RtnVehSpdSeln.Ary1D /end CHARACTERISTIC
/begin CHARACTERISTIC Assi.AssiMotTqWhlImbRejctnMaxX.Ary2D "MICROSAR RTE" VAL_BLK 0x0 RTE_RL_UWORD 0 NO_COMPU_METHOD 0 65535 MATRIX_DIM 20 12 1 SYMBOL_LINK "Rte_CalprmRom_CalRegn02Rt00GroupA_DEFAULT_RTE_CALPRM_GROUP.AssiMotTqWhlImbRejctnMaxX_Ary2D" 0 DISPLAY_IDENTIFIER Assi.CalibrationPorts.AssiMotTqWhlImbRejctnMaxX.Ary2D /end CHARACTERISTIC
/begin CHARACTERISTIC Assi.AssiMotTqWhlImbRejctnMaxY.Ary2D "MICROSAR RTE" VAL_BLK 0x0 RTE_RL_SWORD 0 NO_COMPU_METHOD -32768 32767 MATRIX_DIM 20 12 1 SYMBOL_LINK "Rte_CalprmRom_CalRegn02Rt00GroupA_DEFAULT_RTE_CALPRM_GROUP.AssiMotTqWhlImbRejctnMaxY_Ary2D" 0 DISPLAY_IDENTIFIER Assi.CalibrationPorts.AssiMotTqWhlImbRejctnMaxY.Ary2D /end CHARACTERISTIC
/begin CHARACTERISTIC Assi.AssiMotTqWhlImbRejctnMinX.Ary2D "MICROSAR RTE" VAL_BLK 0x0 RTE_RL_UWORD 0 NO_COMPU_METHOD 0 65535 MATRIX_DIM 20 12 1 SYMBOL_LINK "Rte_CalprmRom_CalRegn02Rt00GroupA_DEFAULT_RTE_CALPRM_GROUP.AssiMotTqWhlImbRejctnMinX_Ary2D" 0 DISPLAY_IDENTIFIER Assi.CalibrationPorts.AssiMotTqWhlImbRejctnMinX.Ary2D /end CHARACTERISTIC
/begin CHARACTERISTIC Assi.AssiMotTqWhlImbRejctnMinY.Ary2D "MICROSAR RTE" VAL_BLK 0x0 RTE_RL_SWORD 0 NO_COMPU_METHOD -32768 32767 MATRIX_DIM 20 12 1 SYMBOL_LINK "Rte_CalprmRom_CalRegn02Rt00GroupA_DEFAULT_RTE_CALPRM_GROUP.AssiMotTqWhlImbRejctnMinY_Ary2D" 0 DISPLAY_IDENTIFIER Assi.CalibrationPorts.AssiMotTqWhlImbRejctnMinY.Ary2D /end CHARACTERISTIC
/begin CHARACTERISTIC Assi.AssiThermScaX.Ary1D "MICROSAR RTE" VAL_BLK 0x0 RTE_RL_UWORD 0 NO_COMPU_METHOD 0 65535 MATRIX_DIM 2 1 1 SYMBOL_LINK "Rte_CalprmRom_CalRegn02CmnGroupA_DEFAULT_RTE_CALPRM_GROUP.AssiThermScaX_Ary1D" 0 DISPLAY_IDENTIFIER Assi.CalibrationPorts.AssiThermScaX.Ary1D /end CHARACTERISTIC
/begin CHARACTERISTIC Assi.AssiThermScaY.Ary1D "MICROSAR RTE" VAL_BLK 0x0 RTE_RL_UWORD 0 NO_COMPU_METHOD 0 65535 MATRIX_DIM 2 1 1 SYMBOL_LINK "Rte_CalprmRom_CalRegn02CmnGroupA_DEFAULT_RTE_CALPRM_GROUP.AssiThermScaY_Ary1D" 0 DISPLAY_IDENTIFIER Assi.CalibrationPorts.AssiThermScaY.Ary1D /end CHARACTERISTIC
/begin CHARACTERISTIC Assi.AssiWhlImbRejctnBlndScaX.Ary2D "MICROSAR RTE" VAL_BLK 0x0 RTE_RL_UWORD 0 NO_COMPU_METHOD 0 65535 MATRIX_DIM 5 12 1 SYMBOL_LINK "Rte_CalprmRom_CalRegn02Rt00GroupA_DEFAULT_RTE_CALPRM_GROUP.AssiWhlImbRejctnBlndScaX_Ary2D" 0 DISPLAY_IDENTIFIER Assi.CalibrationPorts.AssiWhlImbRejctnBlndScaX.Ary2D /end CHARACTERISTIC
/begin CHARACTERISTIC Assi.AssiWhlImbRejctnBlndScaY.Ary2D "MICROSAR RTE" VAL_BLK 0x0 RTE_RL_UWORD 0 NO_COMPU_METHOD 0 65535 MATRIX_DIM 5 12 1 SYMBOL_LINK "Rte_CalprmRom_CalRegn02Rt00GroupA_DEFAULT_RTE_CALPRM_GROUP.AssiWhlImbRejctnBlndScaY_Ary2D" 0 DISPLAY_IDENTIFIER Assi.CalibrationPorts.AssiWhlImbRejctnBlndScaY.Ary2D /end CHARACTERISTIC
/begin CHARACTERISTIC Assi.SysGlbPrmVehSpdBilnrSeln.Ary1D "MICROSAR RTE" VAL_BLK 0x0 RTE_RL_UWORD 0 NO_COMPU_METHOD 0 65535 MATRIX_DIM 12 1 1 SYMBOL_LINK "Rte_CalprmRom_CalRegn01Inin00_DEFAULT_RTE_CALPRM_GROUP.SysGlbPrmVehSpdBilnrSeln_Ary1D" 0 DISPLAY_IDENTIFIER Assi.CalibrationPorts.SysGlbPrmVehSpdBilnrSeln.Ary1D /end CHARACTERISTIC
/begin CHARACTERISTIC AssiHiFrq.AssiHiFrqGainY.Ary2D "MICROSAR RTE" VAL_BLK 0x0 RTE_RL_UWORD 0 NO_COMPU_METHOD 0 65535 MATRIX_DIM 13 12 1 SYMBOL_LINK "Rte_CalprmRom_CalRegn02Rt00GroupA_DEFAULT_RTE_CALPRM_GROUP.AssiHiFrqGainY_Ary2D" 0 DISPLAY_IDENTIFIER AssiHiFrq.CalibrationPorts.AssiHiFrqGainY.Ary2D /end CHARACTERISTIC
/begin CHARACTERISTIC AssiHiFrq.AssiHiFrqHpFilFrq.Val "MICROSAR RTE" VALUE 0x0 RTE_RL_FLOAT32_IEEE 0 NO_COMPU_METHOD -3.402823466e+38 3.402823466e+38 SYMBOL_LINK "Rte_CalprmRom_CalRegn02Inin00GroupA_DEFAULT_RTE_CALPRM_GROUP.AssiHiFrqHpFilFrq_Val" 0 DISPLAY_IDENTIFIER AssiHiFrq.CalibrationPorts.AssiHiFrqHpFilFrq.Val /end CHARACTERISTIC
/begin CHARACTERISTIC AssiHiFrq.AssiHiFrqHpFilFrqY.Ary1D "MICROSAR RTE" VAL_BLK 0x0 RTE_RL_UWORD 0 NO_COMPU_METHOD 0 65535 MATRIX_DIM 12 1 1 SYMBOL_LINK "Rte_CalprmRom_CalRegn02Rt00GroupA_DEFAULT_RTE_CALPRM_GROUP.AssiHiFrqHpFilFrqY_Ary1D" 0 DISPLAY_IDENTIFIER AssiHiFrq.CalibrationPorts.AssiHiFrqHpFilFrqY.Ary1D /end CHARACTERISTIC
/begin CHARACTERISTIC AssiHiFrq.AssiHiFrqTqWhlImbRejctnTqX.Ary2D "MICROSAR RTE" VAL_BLK 0x0 RTE_RL_UWORD 0 NO_COMPU_METHOD 0 65535 MATRIX_DIM 13 12 1 SYMBOL_LINK "Rte_CalprmRom_CalRegn02Rt00GroupA_DEFAULT_RTE_CALPRM_GROUP.AssiHiFrqTqWhlImbRejctnTqX_Ary2D" 0 DISPLAY_IDENTIFIER AssiHiFrq.CalibrationPorts.AssiHiFrqTqWhlImbRejctnTqX.Ary2D /end CHARACTERISTIC
/begin CHARACTERISTIC AssiHiFrq.AssiHiFrqTqX.Ary2D "MICROSAR RTE" VAL_BLK 0x0 RTE_RL_UWORD 0 NO_COMPU_METHOD 0 65535 MATRIX_DIM 13 12 1 SYMBOL_LINK "Rte_CalprmRom_CalRegn02Rt00GroupA_DEFAULT_RTE_CALPRM_GROUP.AssiHiFrqTqX_Ary2D" 0 DISPLAY_IDENTIFIER AssiHiFrq.CalibrationPorts.AssiHiFrqTqX.Ary2D /end CHARACTERISTIC
/begin CHARACTERISTIC AssiHiFrq.AssiHiFrqWhlImbRejctnBlndX.Ary2D "MICROSAR RTE" VAL_BLK 0x0 RTE_RL_UWORD 0 NO_COMPU_METHOD 0 65535 MATRIX_DIM 5 12 1 SYMBOL_LINK "Rte_CalprmRom_CalRegn02Rt00GroupA_DEFAULT_RTE_CALPRM_GROUP.AssiHiFrqWhlImbRejctnBlndX_Ary2D" 0 DISPLAY_IDENTIFIER AssiHiFrq.CalibrationPorts.AssiHiFrqWhlImbRejctnBlndX.Ary2D /end CHARACTERISTIC
/begin CHARACTERISTIC AssiHiFrq.AssiHiFrqWhlImbRejctnBlndY.Ary2D "MICROSAR RTE" VAL_BLK 0x0 RTE_RL_UWORD 0 NO_COMPU_METHOD 0 65535 MATRIX_DIM 5 12 1 SYMBOL_LINK "Rte_CalprmRom_CalRegn02Rt00GroupA_DEFAULT_RTE_CALPRM_GROUP.AssiHiFrqWhlImbRejctnBlndY_Ary2D" 0 DISPLAY_IDENTIFIER AssiHiFrq.CalibrationPorts.AssiHiFrqWhlImbRejctnBlndY.Ary2D /end CHARACTERISTIC
/begin CHARACTERISTIC AssiHiFrq.AssiHiFrqWhlImbRejctnGainY.Ary2D "MICROSAR RTE" VAL_BLK 0x0 RTE_RL_UWORD 0 NO_COMPU_METHOD 0 65535 MATRIX_DIM 13 12 1 SYMBOL_LINK "Rte_CalprmRom_CalRegn02Rt00GroupA_DEFAULT_RTE_CALPRM_GROUP.AssiHiFrqWhlImbRejctnGainY_Ary2D" 0 DISPLAY_IDENTIFIER AssiHiFrq.CalibrationPorts.AssiHiFrqWhlImbRejctnGainY.Ary2D /end CHARACTERISTIC
/begin CHARACTERISTIC AssiHiFrq.SysGlbPrmVehSpdBilnrSeln.Ary1D "MICROSAR RTE" VAL_BLK 0x0 RTE_RL_UWORD 0 NO_COMPU_METHOD 0 65535 MATRIX_DIM 12 1 1 SYMBOL_LINK "Rte_CalprmRom_CalRegn01Inin00_DEFAULT_RTE_CALPRM_GROUP.SysGlbPrmVehSpdBilnrSeln_Ary1D" 0 DISPLAY_IDENTIFIER AssiHiFrq.CalibrationPorts.SysGlbPrmVehSpdBilnrSeln.Ary1D /end CHARACTERISTIC
/begin CHARACTERISTIC AssiPahSum.AssiPahSumHysCmpLim.Val "MICROSAR RTE" VALUE 0x0 RTE_RL_FLOAT32_IEEE 0 NO_COMPU_METHOD -3.402823466e+38 3.402823466e+38 SYMBOL_LINK "Rte_CalprmRom_CalRegn01Inin00GroupA_DEFAULT_RTE_CALPRM_GROUP.AssiPahSumHysCmpLim_Val" 0 DISPLAY_IDENTIFIER AssiPahSum.CalibrationPorts.AssiPahSumHysCmpLim.Val /end CHARACTERISTIC
/begin CHARACTERISTIC AssiSumLim.AssiSumLimBlndCmdSumFrqLimX.Ary1D "MICROSAR RTE" VAL_BLK 0x0 RTE_RL_UWORD 0 NO_COMPU_METHOD 0 65535 MATRIX_DIM 2 1 1 SYMBOL_LINK "Rte_CalprmRom_CalRegn01Inin00_DEFAULT_RTE_CALPRM_GROUP.AssiSumLimBlndCmdSumFrqLimX_Ary1D" 0 DISPLAY_IDENTIFIER AssiSumLim.CalibrationPorts.AssiSumLimBlndCmdSumFrqLimX.Ary1D /end CHARACTERISTIC
/begin CHARACTERISTIC AssiSumLim.AssiSumLimBlndCmdSumFrqLimY.Ary1D "MICROSAR RTE" VAL_BLK 0x0 RTE_RL_UWORD 0 NO_COMPU_METHOD 0 65535 MATRIX_DIM 2 1 1 SYMBOL_LINK "Rte_CalprmRom_CalRegn01Inin00_DEFAULT_RTE_CALPRM_GROUP.AssiSumLimBlndCmdSumFrqLimY_Ary1D" 0 DISPLAY_IDENTIFIER AssiSumLim.CalibrationPorts.AssiSumLimBlndCmdSumFrqLimY.Ary1D /end CHARACTERISTIC
/begin CHARACTERISTIC AssiSumLim.AssiSumLimCmdSumFilActv.Logl "MICROSAR RTE" VALUE 0x0 RTE_RL_BOOLEAN 0 RTE_CM_BOOLEAN 0 255 SYMBOL_LINK "Rte_CalprmRom_CalRegn01Cmn_DEFAULT_RTE_CALPRM_GROUP.AssiSumLimCmdSumFilActv_Logl" 0 DISPLAY_IDENTIFIER AssiSumLim.CalibrationPorts.AssiSumLimCmdSumFilActv.Logl /end CHARACTERISTIC
/begin CHARACTERISTIC AssiSumLim.AssiSumLimHiSpdCmdSumFrqLimX.Ary1D "MICROSAR RTE" VAL_BLK 0x0 RTE_RL_UWORD 0 NO_COMPU_METHOD 0 65535 MATRIX_DIM 8 1 1 SYMBOL_LINK "Rte_CalprmRom_CalRegn01Inin00_DEFAULT_RTE_CALPRM_GROUP.AssiSumLimHiSpdCmdSumFrqLimX_Ary1D" 0 DISPLAY_IDENTIFIER AssiSumLim.CalibrationPorts.AssiSumLimHiSpdCmdSumFrqLimX.Ary1D /end CHARACTERISTIC
/begin CHARACTERISTIC AssiSumLim.AssiSumLimHiSpdCmdSumFrqLimY.Ary1D "MICROSAR RTE" VAL_BLK 0x0 RTE_RL_UWORD 0 NO_COMPU_METHOD 0 65535 MATRIX_DIM 8 1 1 SYMBOL_LINK "Rte_CalprmRom_CalRegn01Inin00_DEFAULT_RTE_CALPRM_GROUP.AssiSumLimHiSpdCmdSumFrqLimY_Ary1D" 0 DISPLAY_IDENTIFIER AssiSumLim.CalibrationPorts.AssiSumLimHiSpdCmdSumFrqLimY.Ary1D /end CHARACTERISTIC
/begin CHARACTERISTIC AssiSumLim.AssiSumLimLoSpdCmdSumFrqLimX.Ary1D "MICROSAR RTE" VAL_BLK 0x0 RTE_RL_UWORD 0 NO_COMPU_METHOD 0 65535 MATRIX_DIM 8 1 1 SYMBOL_LINK "Rte_CalprmRom_CalRegn01Inin00_DEFAULT_RTE_CALPRM_GROUP.AssiSumLimLoSpdCmdSumFrqLimX_Ary1D" 0 DISPLAY_IDENTIFIER AssiSumLim.CalibrationPorts.AssiSumLimLoSpdCmdSumFrqLimX.Ary1D /end CHARACTERISTIC
/begin CHARACTERISTIC AssiSumLim.AssiSumLimLoSpdCmdSumFrqLimY.Ary1D "MICROSAR RTE" VAL_BLK 0x0 RTE_RL_UWORD 0 NO_COMPU_METHOD 0 65535 MATRIX_DIM 8 1 1 SYMBOL_LINK "Rte_CalprmRom_CalRegn01Inin00_DEFAULT_RTE_CALPRM_GROUP.AssiSumLimLoSpdCmdSumFrqLimY_Ary1D" 0 DISPLAY_IDENTIFIER AssiSumLim.CalibrationPorts.AssiSumLimLoSpdCmdSumFrqLimY.Ary1D /end CHARACTERISTIC
/begin CHARACTERISTIC AssiSumLim.AssiSumLimMotVelLpFilFrq.Val "MICROSAR RTE" VALUE 0x0 RTE_RL_FLOAT32_IEEE 0 NO_COMPU_METHOD -3.402823466e+38 3.402823466e+38 SYMBOL_LINK "Rte_CalprmRom_CalRegn01Inin00_DEFAULT_RTE_CALPRM_GROUP.AssiSumLimMotVelLpFilFrq_Val" 0 DISPLAY_IDENTIFIER AssiSumLim.CalibrationPorts.AssiSumLimMotVelLpFilFrq.Val /end CHARACTERISTIC
/begin CHARACTERISTIC AssiSumLim.AssiSumLimNtc0x0C4FailStep.Val "MICROSAR RTE" VALUE 0x0 RTE_RL_UWORD 0 NO_COMPU_METHOD 0 65535 SYMBOL_LINK "Rte_CalprmRom_CalRegn01Cmn_DEFAULT_RTE_CALPRM_GROUP.AssiSumLimNtc0x0C4FailStep_Val" 0 DISPLAY_IDENTIFIER AssiSumLim.CalibrationPorts.AssiSumLimNtc0x0C4FailStep.Val /end CHARACTERISTIC
/begin CHARACTERISTIC AssiSumLim.AssiSumLimNtc0x0C4PassStep.Val "MICROSAR RTE" VALUE 0x0 RTE_RL_UWORD 0 NO_COMPU_METHOD 0 65535 SYMBOL_LINK "Rte_CalprmRom_CalRegn01Cmn_DEFAULT_RTE_CALPRM_GROUP.AssiSumLimNtc0x0C4PassStep_Val" 0 DISPLAY_IDENTIFIER AssiSumLim.CalibrationPorts.AssiSumLimNtc0x0C4PassStep.Val /end CHARACTERISTIC
/begin CHARACTERISTIC AssiSumLim.AssiSumLimPullCmpLim.Val "MICROSAR RTE" VALUE 0x0 RTE_RL_FLOAT32_IEEE 0 NO_COMPU_METHOD -3.402823466e+38 3.402823466e+38 SYMBOL_LINK "Rte_CalprmRom_CalRegn01Cmn_DEFAULT_RTE_CALPRM_GROUP.AssiSumLimPullCmpLim_Val" 0 DISPLAY_IDENTIFIER AssiSumLim.CalibrationPorts.AssiSumLimPullCmpLim.Val /end CHARACTERISTIC
/begin CHARACTERISTIC BattVltg.BattVltgSwdMax.Val "MICROSAR RTE" VALUE 0x0 RTE_RL_FLOAT32_IEEE 0 NO_COMPU_METHOD -3.402823466e+38 3.402823466e+38 SYMBOL_LINK "Rte_CalprmRom_CalRegn01Cmn_DEFAULT_RTE_CALPRM_GROUP.BattVltgSwdMax_Val" 0 DISPLAY_IDENTIFIER BattVltg.CalibrationPorts.BattVltgSwdMax.Val /end CHARACTERISTIC
/begin CHARACTERISTIC BattVltgCorrln.BattVltgCorrlnAllwdVltgDif.Val "MICROSAR RTE" VALUE 0x0 RTE_RL_FLOAT32_IEEE 0 NO_COMPU_METHOD -3.402823466e+38 3.402823466e+38 SYMBOL_LINK "Rte_CalprmRom_CalRegn01Cmn_DEFAULT_RTE_CALPRM_GROUP.BattVltgCorrlnAllwdVltgDif_Val" 0 DISPLAY_IDENTIFIER BattVltgCorrln.CalibrationPorts.BattVltgCorrlnAllwdVltgDif.Val /end CHARACTERISTIC
/begin CHARACTERISTIC BattVltgCorrln.BattVltgCorrlnBattLoVltg.Val "MICROSAR RTE" VALUE 0x0 RTE_RL_FLOAT32_IEEE 0 NO_COMPU_METHOD -3.402823466e+38 3.402823466e+38 SYMBOL_LINK "Rte_CalprmRom_CalRegn01Cmn_DEFAULT_RTE_CALPRM_GROUP.BattVltgCorrlnBattLoVltg_Val" 0 DISPLAY_IDENTIFIER BattVltgCorrln.CalibrationPorts.BattVltgCorrlnBattLoVltg.Val /end CHARACTERISTIC
/begin CHARACTERISTIC BattVltgCorrln.BattVltgCorrlnBattOverVltg.Val "MICROSAR RTE" VALUE 0x0 RTE_RL_FLOAT32_IEEE 0 NO_COMPU_METHOD -3.402823466e+38 3.402823466e+38 SYMBOL_LINK "Rte_CalprmRom_CalRegn01Cmn_DEFAULT_RTE_CALPRM_GROUP.BattVltgCorrlnBattOverVltg_Val" 0 DISPLAY_IDENTIFIER BattVltgCorrln.CalibrationPorts.BattVltgCorrlnBattOverVltg.Val /end CHARACTERISTIC
/begin CHARACTERISTIC BattVltgCorrln.BattVltgCorrlnBattUnderVltg.Val "MICROSAR RTE" VALUE 0x0 RTE_RL_FLOAT32_IEEE 0 NO_COMPU_METHOD -3.402823466e+38 3.402823466e+38 SYMBOL_LINK "Rte_CalprmRom_CalRegn01Cmn_DEFAULT_RTE_CALPRM_GROUP.BattVltgCorrlnBattUnderVltg_Val" 0 DISPLAY_IDENTIFIER BattVltgCorrln.CalibrationPorts.BattVltgCorrlnBattUnderVltg.Val /end CHARACTERISTIC
/begin CHARACTERISTIC BattVltgCorrln.BattVltgCorrlnNtc0x03C0x044FailStep.Val "MICROSAR RTE" VALUE 0x0 RTE_RL_UWORD 0 NO_COMPU_METHOD 0 65535 SYMBOL_LINK "Rte_CalprmRom_CalRegn01Cmn_DEFAULT_RTE_CALPRM_GROUP.BattVltgCorrlnNtc0x03C0x044FailStep_Val" 0 DISPLAY_IDENTIFIER BattVltgCorrln.CalibrationPorts.BattVltgCorrlnNtc0x03C0x044FailStep.Val /end CHARACTERISTIC
/begin CHARACTERISTIC BattVltgCorrln.BattVltgCorrlnNtc0x03C0x044PassStep.Val "MICROSAR RTE" VALUE 0x0 RTE_RL_UWORD 0 NO_COMPU_METHOD 0 65535 SYMBOL_LINK "Rte_CalprmRom_CalRegn01Cmn_DEFAULT_RTE_CALPRM_GROUP.BattVltgCorrlnNtc0x03C0x044PassStep_Val" 0 DISPLAY_IDENTIFIER BattVltgCorrln.CalibrationPorts.BattVltgCorrlnNtc0x03C0x044PassStep.Val /end CHARACTERISTIC
/begin CHARACTERISTIC BattVltgCorrln.BattVltgCorrlnNtc0x0B0FailStep.Val "MICROSAR RTE" VALUE 0x0 RTE_RL_UWORD 0 NO_COMPU_METHOD 0 65535 SYMBOL_LINK "Rte_CalprmRom_CalRegn01Cmn_DEFAULT_RTE_CALPRM_GROUP.BattVltgCorrlnNtc0x0B0FailStep_Val" 0 DISPLAY_IDENTIFIER BattVltgCorrln.CalibrationPorts.BattVltgCorrlnNtc0x0B0FailStep.Val /end CHARACTERISTIC
/begin CHARACTERISTIC BattVltgCorrln.BattVltgCorrlnNtc0x0B0PassStep.Val "MICROSAR RTE" VALUE 0x0 RTE_RL_UWORD 0 NO_COMPU_METHOD 0 65535 SYMBOL_LINK "Rte_CalprmRom_CalRegn01Cmn_DEFAULT_RTE_CALPRM_GROUP.BattVltgCorrlnNtc0x0B0PassStep_Val" 0 DISPLAY_IDENTIFIER BattVltgCorrln.CalibrationPorts.BattVltgCorrlnNtc0x0B0PassStep.Val /end CHARACTERISTIC
/begin CHARACTERISTIC BattVltgCorrln.BattVltgCorrlnNtc0x0B1FailStep.Val "MICROSAR RTE" VALUE 0x0 RTE_RL_UWORD 0 NO_COMPU_METHOD 0 65535 SYMBOL_LINK "Rte_CalprmRom_CalRegn01Cmn_DEFAULT_RTE_CALPRM_GROUP.BattVltgCorrlnNtc0x0B1FailStep_Val" 0 DISPLAY_IDENTIFIER BattVltgCorrln.CalibrationPorts.BattVltgCorrlnNtc0x0B1FailStep.Val /end CHARACTERISTIC
/begin CHARACTERISTIC BattVltgCorrln.BattVltgCorrlnNtc0x0B1PassStep.Val "MICROSAR RTE" VALUE 0x0 RTE_RL_UWORD 0 NO_COMPU_METHOD 0 65535 SYMBOL_LINK "Rte_CalprmRom_CalRegn01Cmn_DEFAULT_RTE_CALPRM_GROUP.BattVltgCorrlnNtc0x0B1PassStep_Val" 0 DISPLAY_IDENTIFIER BattVltgCorrln.CalibrationPorts.BattVltgCorrlnNtc0x0B1PassStep.Val /end CHARACTERISTIC
/begin CHARACTERISTIC BattVltgCorrln.BattVltgCorrlnNtc0x0B5FailStep.Val "MICROSAR RTE" VALUE 0x0 RTE_RL_UWORD 0 NO_COMPU_METHOD 0 65535 SYMBOL_LINK "Rte_CalprmRom_CalRegn01Cmn_DEFAULT_RTE_CALPRM_GROUP.BattVltgCorrlnNtc0x0B5FailStep_Val" 0 DISPLAY_IDENTIFIER BattVltgCorrln.CalibrationPorts.BattVltgCorrlnNtc0x0B5FailStep.Val /end CHARACTERISTIC
/begin CHARACTERISTIC BattVltgCorrln.BattVltgCorrlnNtc0x0B5PassStep.Val "MICROSAR RTE" VALUE 0x0 RTE_RL_UWORD 0 NO_COMPU_METHOD 0 65535 SYMBOL_LINK "Rte_CalprmRom_CalRegn01Cmn_DEFAULT_RTE_CALPRM_GROUP.BattVltgCorrlnNtc0x0B5PassStep_Val" 0 DISPLAY_IDENTIFIER BattVltgCorrln.CalibrationPorts.BattVltgCorrlnNtc0x0B5PassStep.Val /end CHARACTERISTIC
/begin CHARACTERISTIC BattVltgCorrln.BattVltgCorrlnRcvrlBattLoVltg.Val "MICROSAR RTE" VALUE 0x0 RTE_RL_FLOAT32_IEEE 0 NO_COMPU_METHOD -3.402823466e+38 3.402823466e+38 SYMBOL_LINK "Rte_CalprmRom_CalRegn01Cmn_DEFAULT_RTE_CALPRM_GROUP.BattVltgCorrlnRcvrlBattLoVltg_Val" 0 DISPLAY_IDENTIFIER BattVltgCorrln.CalibrationPorts.BattVltgCorrlnRcvrlBattLoVltg.Val /end CHARACTERISTIC
/begin CHARACTERISTIC BattVltgCorrln.BattVltgCorrlnRcvrlBattOverVltg.Val "MICROSAR RTE" VALUE 0x0 RTE_RL_FLOAT32_IEEE 0 NO_COMPU_METHOD -3.402823466e+38 3.402823466e+38 SYMBOL_LINK "Rte_CalprmRom_CalRegn01Cmn_DEFAULT_RTE_CALPRM_GROUP.BattVltgCorrlnRcvrlBattOverVltg_Val" 0 DISPLAY_IDENTIFIER BattVltgCorrln.CalibrationPorts.BattVltgCorrlnRcvrlBattOverVltg.Val /end CHARACTERISTIC
/begin CHARACTERISTIC BattVltgCorrln.BattVltgCorrlnRcvrlBattUnderVltg.Val "MICROSAR RTE" VALUE 0x0 RTE_RL_FLOAT32_IEEE 0 NO_COMPU_METHOD -3.402823466e+38 3.402823466e+38 SYMBOL_LINK "Rte_CalprmRom_CalRegn01Cmn_DEFAULT_RTE_CALPRM_GROUP.BattVltgCorrlnRcvrlBattUnderVltg_Val" 0 DISPLAY_IDENTIFIER BattVltgCorrln.CalibrationPorts.BattVltgCorrlnRcvrlBattUnderVltg.Val /end CHARACTERISTIC
/begin CHARACTERISTIC BattVltgCorrln.BattVltgCorrlnSwdMax.Val "MICROSAR RTE" VALUE 0x0 RTE_RL_FLOAT32_IEEE 0 NO_COMPU_METHOD -3.402823466e+38 3.402823466e+38 SYMBOL_LINK "Rte_CalprmRom_CalRegn01Cmn_DEFAULT_RTE_CALPRM_GROUP.BattVltgCorrlnSwdMax_Val" 0 DISPLAY_IDENTIFIER BattVltgCorrln.CalibrationPorts.BattVltgCorrlnSwdMax.Val /end CHARACTERISTIC
/begin CHARACTERISTIC BattVltgCorrln.BattVltgCorrlnSysMinVltg.Val "MICROSAR RTE" VALUE 0x0 RTE_RL_FLOAT32_IEEE 0 NO_COMPU_METHOD -3.402823466e+38 3.402823466e+38 SYMBOL_LINK "Rte_CalprmRom_CalRegn01Cmn_DEFAULT_RTE_CALPRM_GROUP.BattVltgCorrlnSysMinVltg_Val" 0 DISPLAY_IDENTIFIER BattVltgCorrln.CalibrationPorts.BattVltgCorrlnSysMinVltg.Val /end CHARACTERISTIC
/**********************************************************************************************************************
* MEASUREMENT
*********************************************************************************************************************/
/begin MEASUREMENT Adcf1CfgAndUse.AdcDiagcEndPtrOutp.Val "MICROSAR RTE" UBYTE NO_COMPU_METHOD 0 0 0 255 ECU_ADDRESS 0 SYMBOL_LINK "Rte_Adcf1CfgAndUse_AdcDiagcEndPtrOutp_Val" 0 DISPLAY_IDENTIFIER Adcf1CfgAndUse.ReceiverPorts.AdcDiagcEndPtrOutp.Val /end MEASUREMENT
/begin MEASUREMENT Adcf1CfgAndUse.AdcDiagcStrtPtrOutp.Val "MICROSAR RTE" UBYTE NO_COMPU_METHOD 0 0 0 255 ECU_ADDRESS 0 SYMBOL_LINK "Rte_Adcf1CfgAndUse_AdcDiagcStrtPtrOutp_Val" 0 DISPLAY_IDENTIFIER Adcf1CfgAndUse.ReceiverPorts.AdcDiagcStrtPtrOutp.Val /end MEASUREMENT
/begin MEASUREMENT Adcf1CfgAndUse.Adcf1DiagcEndPtr "MICROSAR RTE" UBYTE NO_COMPU_METHOD 0 0 0 255 ECU_ADDRESS 0 SYMBOL_LINK "Rte_Adcf1CfgAndUse_Adcf1DiagcEndPtr" 0 DISPLAY_IDENTIFIER Adcf1CfgAndUse.PerInstanceMemories.Adcf1DiagcEndPtr /end MEASUREMENT
/begin MEASUREMENT Adcf1CfgAndUse.Adcf1DiagcStrtPtr "MICROSAR RTE" UBYTE NO_COMPU_METHOD 0 0 0 255 ECU_ADDRESS 0 SYMBOL_LINK "Rte_Adcf1CfgAndUse_Adcf1DiagcStrtPtr" 0 DISPLAY_IDENTIFIER Adcf1CfgAndUse.PerInstanceMemories.Adcf1DiagcStrtPtr /end MEASUREMENT
/begin MEASUREMENT Assi.AssiCmdBas.Val "MICROSAR RTE" FLOAT32_IEEE NO_COMPU_METHOD 0 0 -3.402823466e+38 3.402823466e+38 ECU_ADDRESS 0 SYMBOL_LINK "Rte_Assi_AssiCmdBas_Val" 0 DISPLAY_IDENTIFIER Assi.SenderPorts.AssiCmdBas.Val /end MEASUREMENT
/begin MEASUREMENT Assi.AssiCmdBasSca.Val "MICROSAR RTE" FLOAT32_IEEE NO_COMPU_METHOD 0 0 -3.402823466e+38 3.402823466e+38 ECU_ADDRESS 0 SYMBOL_LINK "Rte_Assi_AssiCmdBasSca_Val" 0 DISPLAY_IDENTIFIER Assi.ReceiverPorts.AssiCmdBasSca.Val /end MEASUREMENT
/begin MEASUREMENT Assi.AssiLnrGain.Val "MICROSAR RTE" FLOAT32_IEEE NO_COMPU_METHOD 0 0 -3.402823466e+38 3.402823466e+38 ECU_ADDRESS 0 SYMBOL_LINK "Rte_CmnMfgSrv_AssiLnrGain_Val" 0 DISPLAY_IDENTIFIER Assi.ReceiverPorts.AssiLnrGain.Val /end MEASUREMENT
/begin MEASUREMENT Assi.AssiLnrGainEna.Logl "MICROSAR RTE" UBYTE RTE_CM_BOOLEAN 0 0 0 255 ECU_ADDRESS 0 SYMBOL_LINK "Rte_CmnMfgSrv_AssiLnrGainEna_Logl" 0 DISPLAY_IDENTIFIER Assi.ReceiverPorts.AssiLnrGainEna.Logl /end MEASUREMENT
/begin MEASUREMENT Assi.HwTq.Val "MICROSAR RTE" FLOAT32_IEEE NO_COMPU_METHOD 0 0 -3.402823466e+38 3.402823466e+38 ECU_ADDRESS 0 SYMBOL_LINK "Rte_ImcSigArbn_HwTqImcCorrd_Val" 0 DISPLAY_IDENTIFIER Assi.ReceiverPorts.HwTq.Val /end MEASUREMENT
/begin MEASUREMENT Assi.HwTqHysOvrl.Val "MICROSAR RTE" FLOAT32_IEEE NO_COMPU_METHOD 0 0 -3.402823466e+38 3.402823466e+38 ECU_ADDRESS 0 SYMBOL_LINK "Rte_Assi_HwTqHysOvrl_Val" 0 DISPLAY_IDENTIFIER Assi.ReceiverPorts.HwTqHysOvrl.Val /end MEASUREMENT
/begin MEASUREMENT Assi.HwTqOvrl.Val "MICROSAR RTE" FLOAT32_IEEE NO_COMPU_METHOD 0 0 -3.402823466e+38 3.402823466e+38 ECU_ADDRESS 0 SYMBOL_LINK "Rte_FordHwTqCmdOvrlLimr_FordColTqOvrl_Val" 0 DISPLAY_IDENTIFIER Assi.ReceiverPorts.HwTqOvrl.Val /end MEASUREMENT
/begin MEASUREMENT Assi.ThermLimSlowFilMax.Val "MICROSAR RTE" FLOAT32_IEEE NO_COMPU_METHOD 0 0 -3.402823466e+38 3.402823466e+38 ECU_ADDRESS 0 SYMBOL_LINK "Rte_DutyCycThermProtn_ThermLimSlowFilMax_Val" 0 DISPLAY_IDENTIFIER Assi.ReceiverPorts.ThermLimSlowFilMax.Val /end MEASUREMENT
/begin MEASUREMENT Assi.VehSpd.Val "MICROSAR RTE" FLOAT32_IEEE NO_COMPU_METHOD 0 0 -3.402823466e+38 3.402823466e+38 ECU_ADDRESS 0 SYMBOL_LINK "Rte_ImcSigArbn_VehSpdImcCorrd_Val" 0 DISPLAY_IDENTIFIER Assi.ReceiverPorts.VehSpd.Val /end MEASUREMENT
/begin MEASUREMENT Assi.WhlImbRejctnAmp.Val "MICROSAR RTE" FLOAT32_IEEE NO_COMPU_METHOD 0 0 -3.402823466e+38 3.402823466e+38 ECU_ADDRESS 0 SYMBOL_LINK "Rte_Assi_WhlImbRejctnAmp_Val" 0 DISPLAY_IDENTIFIER Assi.ReceiverPorts.WhlImbRejctnAmp.Val /end MEASUREMENT
/begin MEASUREMENT Assi.dAssiThermAssiSca "MICROSAR RTE" FLOAT32_IEEE NO_COMPU_METHOD 0 0 -3.402823466e+38 3.402823466e+38 ECU_ADDRESS 0 SYMBOL_LINK "Rte_Assi_dAssiThermAssiSca" 0 DISPLAY_IDENTIFIER Assi.PerInstanceMemories.dAssiThermAssiSca /end MEASUREMENT
/begin MEASUREMENT Assi.dAssiWhlImbRejctnBlnd "MICROSAR RTE" FLOAT32_IEEE NO_COMPU_METHOD 0 0 -3.402823466e+38 3.402823466e+38 ECU_ADDRESS 0 SYMBOL_LINK "Rte_Assi_dAssiWhlImbRejctnBlnd" 0 DISPLAY_IDENTIFIER Assi.PerInstanceMemories.dAssiWhlImbRejctnBlnd /end MEASUREMENT
/begin MEASUREMENT AssiHiFrq.AssiHiFrqCmd.Val "MICROSAR RTE" FLOAT32_IEEE NO_COMPU_METHOD 0 0 -3.402823466e+38 3.402823466e+38 ECU_ADDRESS 0 SYMBOL_LINK "Rte_AssiHiFrq_AssiHiFrqCmd_Val" 0 DISPLAY_IDENTIFIER AssiHiFrq.SenderPorts.AssiHiFrqCmd.Val /end MEASUREMENT
/begin MEASUREMENT AssiHiFrq.HwTq.Val "MICROSAR RTE" FLOAT32_IEEE NO_COMPU_METHOD 0 0 -3.402823466e+38 3.402823466e+38 ECU_ADDRESS 0 SYMBOL_LINK "Rte_ImcSigArbn_HwTqImcCorrd_Val" 0 DISPLAY_IDENTIFIER AssiHiFrq.ReceiverPorts.HwTq.Val /end MEASUREMENT
/begin MEASUREMENT AssiHiFrq.HwTqHpFil.CorrnFac "MICROSAR RTE" FLOAT32_IEEE NO_COMPU_METHOD 0 0 -3.402823466e+38 3.402823466e+38 ECU_ADDRESS 0 SYMBOL_LINK "Rte_AssiHiFrq_HwTqHpFil.CorrnFac" 0 DISPLAY_IDENTIFIER AssiHiFrq.PerInstanceMemories.HwTqHpFil.CorrnFac /end MEASUREMENT
/begin MEASUREMENT AssiHiFrq.HwTqHpFil.FilLpRec.FilGain "MICROSAR RTE" FLOAT32_IEEE NO_COMPU_METHOD 0 0 -3.402823466e+38 3.402823466e+38 ECU_ADDRESS 0 SYMBOL_LINK "Rte_AssiHiFrq_HwTqHpFil.FilLpRec.FilGain" 0 DISPLAY_IDENTIFIER AssiHiFrq.PerInstanceMemories.HwTqHpFil.FilLpRec.FilGain /end MEASUREMENT
/begin MEASUREMENT AssiHiFrq.HwTqHpFil.FilLpRec.FilSt "MICROSAR RTE" FLOAT32_IEEE NO_COMPU_METHOD 0 0 -3.402823466e+38 3.402823466e+38 ECU_ADDRESS 0 SYMBOL_LINK "Rte_AssiHiFrq_HwTqHpFil.FilLpRec.FilSt" 0 DISPLAY_IDENTIFIER AssiHiFrq.PerInstanceMemories.HwTqHpFil.FilLpRec.FilSt /end MEASUREMENT
/begin MEASUREMENT AssiHiFrq.VehSpd.Val "MICROSAR RTE" FLOAT32_IEEE NO_COMPU_METHOD 0 0 -3.402823466e+38 3.402823466e+38 ECU_ADDRESS 0 SYMBOL_LINK "Rte_ImcSigArbn_VehSpdImcCorrd_Val" 0 DISPLAY_IDENTIFIER AssiHiFrq.ReceiverPorts.VehSpd.Val /end MEASUREMENT
/begin MEASUREMENT AssiHiFrq.WhlImbRejctnAmp.Val "MICROSAR RTE" FLOAT32_IEEE NO_COMPU_METHOD 0 0 -3.402823466e+38 3.402823466e+38 ECU_ADDRESS 0 SYMBOL_LINK "Rte_AssiHiFrq_WhlImbRejctnAmp_Val" 0 DISPLAY_IDENTIFIER AssiHiFrq.ReceiverPorts.WhlImbRejctnAmp.Val /end MEASUREMENT
/begin MEASUREMENT AssiHiFrq.dAssiHiFrqGain "MICROSAR RTE" FLOAT32_IEEE NO_COMPU_METHOD 0 0 -3.402823466e+38 3.402823466e+38 ECU_ADDRESS 0 SYMBOL_LINK "Rte_AssiHiFrq_dAssiHiFrqGain" 0 DISPLAY_IDENTIFIER AssiHiFrq.PerInstanceMemories.dAssiHiFrqGain /end MEASUREMENT
/begin MEASUREMENT AssiHiFrq.dAssiHiFrqGainBlnd "MICROSAR RTE" FLOAT32_IEEE NO_COMPU_METHOD 0 0 -3.402823466e+38 3.402823466e+38 ECU_ADDRESS 0 SYMBOL_LINK "Rte_AssiHiFrq_dAssiHiFrqGainBlnd" 0 DISPLAY_IDENTIFIER AssiHiFrq.PerInstanceMemories.dAssiHiFrqGainBlnd /end MEASUREMENT
/begin MEASUREMENT AssiHiFrq.dAssiHiFrqGainWhlImbRejtcnZero "MICROSAR RTE" FLOAT32_IEEE NO_COMPU_METHOD 0 0 -3.402823466e+38 3.402823466e+38 ECU_ADDRESS 0 SYMBOL_LINK "Rte_AssiHiFrq_dAssiHiFrqGainWhlImbRejtcnZero" 0 DISPLAY_IDENTIFIER AssiHiFrq.PerInstanceMemories.dAssiHiFrqGainWhlImbRejtcnZero /end MEASUREMENT
/begin MEASUREMENT AssiPahSum.AssiCmdBas.Val "MICROSAR RTE" FLOAT32_IEEE NO_COMPU_METHOD 0 0 -3.402823466e+38 3.402823466e+38 ECU_ADDRESS 0 SYMBOL_LINK "Rte_Assi_AssiCmdBas_Val" 0 DISPLAY_IDENTIFIER AssiPahSum.ReceiverPorts.AssiCmdBas.Val /end MEASUREMENT
/begin MEASUREMENT AssiPahSum.AssiCmdSum.Val "MICROSAR RTE" FLOAT32_IEEE NO_COMPU_METHOD 0 0 -3.402823466e+38 3.402823466e+38 ECU_ADDRESS 0 SYMBOL_LINK "Rte_AssiPahSum_AssiCmdSum_Val" 0 DISPLAY_IDENTIFIER AssiPahSum.SenderPorts.AssiCmdSum.Val /end MEASUREMENT
/begin MEASUREMENT AssiPahSum.AssiHiFrqCmd.Val "MICROSAR RTE" FLOAT32_IEEE NO_COMPU_METHOD 0 0 -3.402823466e+38 3.402823466e+38 ECU_ADDRESS 0 SYMBOL_LINK "Rte_AssiHiFrq_AssiHiFrqCmd_Val" 0 DISPLAY_IDENTIFIER AssiPahSum.ReceiverPorts.AssiHiFrqCmd.Val /end MEASUREMENT
/begin MEASUREMENT AssiPahSum.HysCmpCmd.Val "MICROSAR RTE" FLOAT32_IEEE NO_COMPU_METHOD 0 0 -3.402823466e+38 3.402823466e+38 ECU_ADDRESS 0 SYMBOL_LINK "Rte_HysCmp_HysCmpCmd_Val" 0 DISPLAY_IDENTIFIER AssiPahSum.ReceiverPorts.HysCmpCmd.Val /end MEASUREMENT
/begin MEASUREMENT AssiSumLim.AssiCmd.Val "MICROSAR RTE" FLOAT32_IEEE NO_COMPU_METHOD 0 0 -3.402823466e+38 3.402823466e+38 ECU_ADDRESS 0 SYMBOL_LINK "Rte_StabyCmp_AssiCmd_Val" 0 DISPLAY_IDENTIFIER AssiSumLim.ReceiverPorts.AssiCmd.Val /end MEASUREMENT
/begin MEASUREMENT AssiSumLim.CmdSumInpPrev "MICROSAR RTE" FLOAT32_IEEE NO_COMPU_METHOD 0 0 -3.402823466e+38 3.402823466e+38 ECU_ADDRESS 0 SYMBOL_LINK "Rte_AssiSumLim_CmdSumInpPrev" 0 DISPLAY_IDENTIFIER AssiSumLim.PerInstanceMemories.CmdSumInpPrev /end MEASUREMENT
/begin MEASUREMENT AssiSumLim.CmdSumOutpPrev "MICROSAR RTE" FLOAT32_IEEE NO_COMPU_METHOD 0 0 -3.402823466e+38 3.402823466e+38 ECU_ADDRESS 0 SYMBOL_LINK "Rte_AssiSumLim_CmdSumOutpPrev" 0 DISPLAY_IDENTIFIER AssiSumLim.PerInstanceMemories.CmdSumOutpPrev /end MEASUREMENT
/begin MEASUREMENT AssiSumLim.DampgCmd.Val "MICROSAR RTE" FLOAT32_IEEE NO_COMPU_METHOD 0 0 -3.402823466e+38 3.402823466e+38 ECU_ADDRESS 0 SYMBOL_LINK "Rte_DampgPahSum_DampgCmd_Val" 0 DISPLAY_IDENTIFIER AssiSumLim.ReceiverPorts.DampgCmd.Val /end MEASUREMENT
/begin MEASUREMENT AssiSumLim.EotActvCmd.Val "MICROSAR RTE" FLOAT32_IEEE NO_COMPU_METHOD 0 0 -3.402823466e+38 3.402823466e+38 ECU_ADDRESS 0 SYMBOL_LINK "Rte_EotProtnFwl_EotActvCmdLimd_Val" 0 DISPLAY_IDENTIFIER AssiSumLim.ReceiverPorts.EotActvCmd.Val /end MEASUREMENT
/begin MEASUREMENT AssiSumLim.EotAssiSca.Val "MICROSAR RTE" FLOAT32_IEEE NO_COMPU_METHOD 0 0 -3.402823466e+38 3.402823466e+38 ECU_ADDRESS 0 SYMBOL_LINK "Rte_LimrCdng_EotAssiScaCdnd_Val" 0 DISPLAY_IDENTIFIER AssiSumLim.ReceiverPorts.EotAssiSca.Val /end MEASUREMENT
/begin MEASUREMENT AssiSumLim.EotDampgCmd.Val "MICROSAR RTE" FLOAT32_IEEE NO_COMPU_METHOD 0 0 -3.402823466e+38 3.402823466e+38 ECU_ADDRESS 0 SYMBOL_LINK "Rte_EotProtnFwl_EotDampgCmdLimd_Val" 0 DISPLAY_IDENTIFIER AssiSumLim.ReceiverPorts.EotDampgCmd.Val /end MEASUREMENT
/begin MEASUREMENT AssiSumLim.EotMotTqLim.Val "MICROSAR RTE" FLOAT32_IEEE NO_COMPU_METHOD 0 0 -3.402823466e+38 3.402823466e+38 ECU_ADDRESS 0 SYMBOL_LINK "Rte_LimrCdng_EotMotTqLimCdnd_Val" 0 DISPLAY_IDENTIFIER AssiSumLim.ReceiverPorts.EotMotTqLim.Val /end MEASUREMENT
/begin MEASUREMENT AssiSumLim.HwTqLoaMtgtnEna.Logl "MICROSAR RTE" UBYTE RTE_CM_BOOLEAN 0 0 0 255 ECU_ADDRESS 0 SYMBOL_LINK "Rte_LoaMgr_HwTqLoaMtgtnEna_Logl" 0 DISPLAY_IDENTIFIER AssiSumLim.ReceiverPorts.HwTqLoaMtgtnEna.Logl /end MEASUREMENT
/begin MEASUREMENT AssiSumLim.MotTqCmd.Val "MICROSAR RTE" FLOAT32_IEEE NO_COMPU_METHOD 0 0 -3.402823466e+38 3.402823466e+38 ECU_ADDRESS 0 SYMBOL_LINK "Rte_AssiSumLim_MotTqCmd_Val" 0 DISPLAY_IDENTIFIER AssiSumLim.SenderPorts.MotTqCmd.Val /end MEASUREMENT
/begin MEASUREMENT AssiSumLim.MotTqCmdLimDi.Logl "MICROSAR RTE" UBYTE RTE_CM_BOOLEAN 0 0 0 255 ECU_ADDRESS 0 SYMBOL_LINK "Rte_AssiSumLim_MotTqCmdLimDi_Logl" 0 DISPLAY_IDENTIFIER AssiSumLim.ReceiverPorts.MotTqCmdLimDi.Logl /end MEASUREMENT
/begin MEASUREMENT AssiSumLim.MotTqCmdLimdPreStall.Val "MICROSAR RTE" FLOAT32_IEEE NO_COMPU_METHOD 0 0 -3.402823466e+38 3.402823466e+38 ECU_ADDRESS 0 SYMBOL_LINK "Rte_AssiSumLim_MotTqCmdLimdPreStall_Val" 0 DISPLAY_IDENTIFIER AssiSumLim.SenderPorts.MotTqCmdLimdPreStall.Val /end MEASUREMENT
/begin MEASUREMENT AssiSumLim.MotTqCmdLimrMin.Val "MICROSAR RTE" FLOAT32_IEEE NO_COMPU_METHOD 0 0 -3.402823466e+38 3.402823466e+38 ECU_ADDRESS 0 SYMBOL_LINK "Rte_AssiSumLim_MotTqCmdLimrMin_Val" 0 DISPLAY_IDENTIFIER AssiSumLim.SenderPorts.MotTqCmdLimrMin.Val /end MEASUREMENT
/begin MEASUREMENT AssiSumLim.MotTqCmdOvrl.Val "MICROSAR RTE" FLOAT32_IEEE NO_COMPU_METHOD 0 0 -3.402823466e+38 3.402823466e+38 ECU_ADDRESS 0 SYMBOL_LINK "Rte_FordMotTqCmdOvrlLimr_FordMotTqCmdOvrl_Val" 0 DISPLAY_IDENTIFIER AssiSumLim.ReceiverPorts.MotTqCmdOvrl.Val /end MEASUREMENT
/begin MEASUREMENT AssiSumLim.MotTqCmdPreLim.Val "MICROSAR RTE" FLOAT32_IEEE NO_COMPU_METHOD 0 0 -3.402823466e+38 3.402823466e+38 ECU_ADDRESS 0 SYMBOL_LINK "Rte_AssiSumLim_MotTqCmdPreLim_Val" 0 DISPLAY_IDENTIFIER AssiSumLim.SenderPorts.MotTqCmdPreLim.Val /end MEASUREMENT
/begin MEASUREMENT AssiSumLim.MotVelFilLp.FilGain "MICROSAR RTE" FLOAT32_IEEE NO_COMPU_METHOD 0 0 -3.402823466e+38 3.402823466e+38 ECU_ADDRESS 0 SYMBOL_LINK "Rte_AssiSumLim_MotVelFilLp.FilGain" 0 DISPLAY_IDENTIFIER AssiSumLim.PerInstanceMemories.MotVelFilLp.FilGain /end MEASUREMENT
/begin MEASUREMENT AssiSumLim.MotVelFilLp.FilSt "MICROSAR RTE" FLOAT32_IEEE NO_COMPU_METHOD 0 0 -3.402823466e+38 3.402823466e+38 ECU_ADDRESS 0 SYMBOL_LINK "Rte_AssiSumLim_MotVelFilLp.FilSt" 0 DISPLAY_IDENTIFIER AssiSumLim.PerInstanceMemories.MotVelFilLp.FilSt /end MEASUREMENT
/begin MEASUREMENT AssiSumLim.MotVelMrf.Val "MICROSAR RTE" FLOAT32_IEEE NO_COMPU_METHOD 0 0 -3.402823466e+38 3.402823466e+38 ECU_ADDRESS 0 SYMBOL_LINK "Rte_CDD_MotVel_MotVelMrf_Val" 0 DISPLAY_IDENTIFIER AssiSumLim.ReceiverPorts.MotVelMrf.Val /end MEASUREMENT
/begin MEASUREMENT AssiSumLim.PinionCentrLrnCmd.Val "MICROSAR RTE" FLOAT32_IEEE NO_COMPU_METHOD 0 0 -3.402823466e+38 3.402823466e+38 ECU_ADDRESS 0 SYMBOL_LINK "Rte_AssiSumLim_PinionCentrLrnCmd_Val" 0 DISPLAY_IDENTIFIER AssiSumLim.ReceiverPorts.PinionCentrLrnCmd.Val /end MEASUREMENT
/begin MEASUREMENT AssiSumLim.PinionCentrLrnEna.Logl "MICROSAR RTE" UBYTE RTE_CM_BOOLEAN 0 0 0 255 ECU_ADDRESS 0 SYMBOL_LINK "Rte_AssiSumLim_PinionCentrLrnEna_Logl" 0 DISPLAY_IDENTIFIER AssiSumLim.ReceiverPorts.PinionCentrLrnEna.Logl /end MEASUREMENT
/begin MEASUREMENT AssiSumLim.PullCmpCmd.Val "MICROSAR RTE" FLOAT32_IEEE NO_COMPU_METHOD 0 0 -3.402823466e+38 3.402823466e+38 ECU_ADDRESS 0 SYMBOL_LINK "Rte_AssiSumLim_PullCmpCmd_Val" 0 DISPLAY_IDENTIFIER AssiSumLim.ReceiverPorts.PullCmpCmd.Val /end MEASUREMENT
/begin MEASUREMENT AssiSumLim.PwrLimrRednFac.Val "MICROSAR RTE" FLOAT32_IEEE NO_COMPU_METHOD 0 0 -3.402823466e+38 3.402823466e+38 ECU_ADDRESS 0 SYMBOL_LINK "Rte_PwrLimr_PwrLimrRednFac_Val" 0 DISPLAY_IDENTIFIER AssiSumLim.ReceiverPorts.PwrLimrRednFac.Val /end MEASUREMENT
/begin MEASUREMENT AssiSumLim.RtnCmd.Val "MICROSAR RTE" FLOAT32_IEEE NO_COMPU_METHOD 0 0 -3.402823466e+38 3.402823466e+38 ECU_ADDRESS 0 SYMBOL_LINK "Rte_RtnPahFwl_RtnCmdLimd_Val" 0 DISPLAY_IDENTIFIER AssiSumLim.ReceiverPorts.RtnCmd.Val /end MEASUREMENT
/begin MEASUREMENT AssiSumLim.StallMotTqLim.Val "MICROSAR RTE" FLOAT32_IEEE NO_COMPU_METHOD 0 0 -3.402823466e+38 3.402823466e+38 ECU_ADDRESS 0 SYMBOL_LINK "Rte_LimrCdng_StallMotTqLimCdnd_Val" 0 DISPLAY_IDENTIFIER AssiSumLim.ReceiverPorts.StallMotTqLim.Val /end MEASUREMENT
/begin MEASUREMENT AssiSumLim.SysMotTqCmdSca.Val "MICROSAR RTE" FLOAT32_IEEE NO_COMPU_METHOD 0 0 -3.402823466e+38 3.402823466e+38 ECU_ADDRESS 0 SYMBOL_LINK "Rte_LimrCdng_SysMotTqCmdScaCdnd_Val" 0 DISPLAY_IDENTIFIER AssiSumLim.ReceiverPorts.SysMotTqCmdSca.Val /end MEASUREMENT
/begin MEASUREMENT AssiSumLim.SysProtnRednFac.Val "MICROSAR RTE" FLOAT32_IEEE NO_COMPU_METHOD 0 0 -3.402823466e+38 3.402823466e+38 ECU_ADDRESS 0 SYMBOL_LINK "Rte_AssiSumLim_SysProtnRednFac_Val" 0 DISPLAY_IDENTIFIER AssiSumLim.SenderPorts.SysProtnRednFac.Val /end MEASUREMENT
/begin MEASUREMENT AssiSumLim.ThermMotTqLim.Val "MICROSAR RTE" FLOAT32_IEEE NO_COMPU_METHOD 0 0 -3.402823466e+38 3.402823466e+38 ECU_ADDRESS 0 SYMBOL_LINK "Rte_LimrCdng_ThermMotTqLimCdnd_Val" 0 DISPLAY_IDENTIFIER AssiSumLim.ReceiverPorts.ThermMotTqLim.Val /end MEASUREMENT
/begin MEASUREMENT AssiSumLim.ThermRednFac.Val "MICROSAR RTE" FLOAT32_IEEE NO_COMPU_METHOD 0 0 -3.402823466e+38 3.402823466e+38 ECU_ADDRESS 0 SYMBOL_LINK "Rte_DutyCycThermProtn_ThermRednFac_Val" 0 DISPLAY_IDENTIFIER AssiSumLim.ReceiverPorts.ThermRednFac.Val /end MEASUREMENT
/begin MEASUREMENT AssiSumLim.TqLoaCmd.Val "MICROSAR RTE" FLOAT32_IEEE NO_COMPU_METHOD 0 0 -3.402823466e+38 3.402823466e+38 ECU_ADDRESS 0 SYMBOL_LINK "Rte_TqLoa_TqLoaCmd_Val" 0 DISPLAY_IDENTIFIER AssiSumLim.ReceiverPorts.TqLoaCmd.Val /end MEASUREMENT
/begin MEASUREMENT AssiSumLim.TqSteerMtgtnCmd.Val "MICROSAR RTE" FLOAT32_IEEE NO_COMPU_METHOD 0 0 -3.402823466e+38 3.402823466e+38 ECU_ADDRESS 0 SYMBOL_LINK "Rte_AssiSumLim_TqSteerMtgtnCmd_Val" 0 DISPLAY_IDENTIFIER AssiSumLim.ReceiverPorts.TqSteerMtgtnCmd.Val /end MEASUREMENT
/begin MEASUREMENT AssiSumLim.VehSpd.Val "MICROSAR RTE" FLOAT32_IEEE NO_COMPU_METHOD 0 0 -3.402823466e+38 3.402823466e+38 ECU_ADDRESS 0 SYMBOL_LINK "Rte_ImcSigArbn_VehSpdImcCorrd_Val" 0 DISPLAY_IDENTIFIER AssiSumLim.ReceiverPorts.VehSpd.Val /end MEASUREMENT
/begin MEASUREMENT AssiSumLim.VehSpdMotTqLim.Val "MICROSAR RTE" FLOAT32_IEEE NO_COMPU_METHOD 0 0 -3.402823466e+38 3.402823466e+38 ECU_ADDRESS 0 SYMBOL_LINK "Rte_LimrCdng_VehSpdMotTqLimCdnd_Val" 0 DISPLAY_IDENTIFIER AssiSumLim.ReceiverPorts.VehSpdMotTqLim.Val /end MEASUREMENT
/begin MEASUREMENT AssiSumLim.WhlImbRejctnCmd.Val "MICROSAR RTE" FLOAT32_IEEE NO_COMPU_METHOD 0 0 -3.402823466e+38 3.402823466e+38 ECU_ADDRESS 0 SYMBOL_LINK "Rte_AssiSumLim_WhlImbRejctnCmd_Val" 0 DISPLAY_IDENTIFIER AssiSumLim.ReceiverPorts.WhlImbRejctnCmd.Val /end MEASUREMENT
/begin MEASUREMENT BattVltg.BattSwdVltgCorrlnSts.Val "MICROSAR RTE" UBYTE NO_COMPU_METHOD 0 0 0 255 ECU_ADDRESS 0 SYMBOL_LINK "Rte_BattVltgCorrln_BattSwdVltgCorrlnSts_Val" 0 DISPLAY_IDENTIFIER BattVltg.ReceiverPorts.BattSwdVltgCorrlnSts.Val /end MEASUREMENT
/begin MEASUREMENT BattVltg.BattVltg.Val "MICROSAR RTE" FLOAT32_IEEE NO_COMPU_METHOD 0 0 -3.402823466e+38 3.402823466e+38 ECU_ADDRESS 0 SYMBOL_LINK "Rte_CDD_FordT3T6McuCfg_BattVltg_Val" 0 DISPLAY_IDENTIFIER BattVltg.ReceiverPorts.BattVltg.Val /end MEASUREMENT
/begin MEASUREMENT BattVltg.BattVltgPrevBattVltg "MICROSAR RTE" FLOAT32_IEEE NO_COMPU_METHOD 0 0 -3.402823466e+38 3.402823466e+38 ECU_ADDRESS 0 SYMBOL_LINK "Rte_BattVltg_BattVltgPrevBattVltg" 0 DISPLAY_IDENTIFIER BattVltg.PerInstanceMemories.BattVltgPrevBattVltg /end MEASUREMENT
/begin MEASUREMENT BattVltg.BattVltgSwd1.Val "MICROSAR RTE" FLOAT32_IEEE NO_COMPU_METHOD 0 0 -3.402823466e+38 3.402823466e+38 ECU_ADDRESS 0 SYMBOL_LINK "Rte_CDD_FordT3T6McuCfg_BattVltgSwd1_Val" 0 DISPLAY_IDENTIFIER BattVltg.ReceiverPorts.BattVltgSwd1.Val /end MEASUREMENT
/begin MEASUREMENT BattVltg.BrdgVltg.Val "MICROSAR RTE" FLOAT32_IEEE NO_COMPU_METHOD 0 0 -3.402823466e+38 3.402823466e+38 ECU_ADDRESS 0 SYMBOL_LINK "Rte_BattVltg_BrdgVltg_Val" 0 DISPLAY_IDENTIFIER BattVltg.SenderPorts.BrdgVltg.Val /end MEASUREMENT
/begin MEASUREMENT BattVltgCorrln.BattSwdVltgCorrlnSts.Val "MICROSAR RTE" UBYTE NO_COMPU_METHOD 0 0 0 255 ECU_ADDRESS 0 SYMBOL_LINK "Rte_BattVltgCorrln_BattSwdVltgCorrlnSts_Val" 0 DISPLAY_IDENTIFIER BattVltgCorrln.SenderPorts.BattSwdVltgCorrlnSts.Val /end MEASUREMENT
/begin MEASUREMENT BattVltgCorrln.BattVltg.Val "MICROSAR RTE" FLOAT32_IEEE NO_COMPU_METHOD 0 0 -3.402823466e+38 3.402823466e+38 ECU_ADDRESS 0 SYMBOL_LINK "Rte_CDD_FordT3T6McuCfg_BattVltg_Val" 0 DISPLAY_IDENTIFIER BattVltgCorrln.ReceiverPorts.BattVltg.Val /end MEASUREMENT
/begin MEASUREMENT BattVltgCorrln.BattVltgAdcFaild.Logl "MICROSAR RTE" UBYTE RTE_CM_BOOLEAN 0 0 0 255 ECU_ADDRESS 0 SYMBOL_LINK "Rte_CDD_FordT3T6McuCfg_BattVltgAdcFaild_Logl" 0 DISPLAY_IDENTIFIER BattVltgCorrln.ReceiverPorts.BattVltgAdcFaild.Logl /end MEASUREMENT
/begin MEASUREMENT BattVltgCorrln.BattVltgCorrlnIdptSig.Val "MICROSAR RTE" UBYTE NO_COMPU_METHOD 0 0 0 255 ECU_ADDRESS 0 SYMBOL_LINK "Rte_BattVltgCorrln_BattVltgCorrlnIdptSig_Val" 0 DISPLAY_IDENTIFIER BattVltgCorrln.SenderPorts.BattVltgCorrlnIdptSig.Val /end MEASUREMENT
/begin MEASUREMENT BattVltgCorrln.BattVltgSwd1.Val "MICROSAR RTE" FLOAT32_IEEE NO_COMPU_METHOD 0 0 -3.402823466e+38 3.402823466e+38 ECU_ADDRESS 0 SYMBOL_LINK "Rte_CDD_FordT3T6McuCfg_BattVltgSwd1_Val" 0 DISPLAY_IDENTIFIER BattVltgCorrln.ReceiverPorts.BattVltgSwd1.Val /end MEASUREMENT
/begin MEASUREMENT BattVltgCorrln.BattVltgSwd1AdcFaild.Logl "MICROSAR RTE" UBYTE RTE_CM_BOOLEAN 0 0 0 255 ECU_ADDRESS 0 SYMBOL_LINK "Rte_CDD_FordT3T6McuCfg_BattVltgSwd1AdcFaild_Logl" 0 DISPLAY_IDENTIFIER BattVltgCorrln.ReceiverPorts.BattVltgSwd1AdcFaild.Logl /end MEASUREMENT
/begin MEASUREMENT BattVltgCorrln.DftBrdgVltgActv.Logl "MICROSAR RTE" UBYTE RTE_CM_BOOLEAN 0 0 0 255 ECU_ADDRESS 0 SYMBOL_LINK "Rte_BattVltgCorrln_DftBrdgVltgActv_Logl" 0 DISPLAY_IDENTIFIER BattVltgCorrln.SenderPorts.DftBrdgVltgActv.Logl /end MEASUREMENT
/begin MEASUREMENT BattVltgCorrln.DiagcStsIvtr1Inactv.Logl "MICROSAR RTE" UBYTE RTE_CM_BOOLEAN 0 0 0 255 ECU_ADDRESS 0 SYMBOL_LINK "Rte_GateDrv0Ctrl_DiagcStsIvtr1Inactv_Logl" 0 DISPLAY_IDENTIFIER BattVltgCorrln.ReceiverPorts.DiagcStsIvtr1Inactv.Logl /end MEASUREMENT
/begin MEASUREMENT BattVltgCorrln.InhbBattVltgDiagc.Logl "MICROSAR RTE" UBYTE RTE_CM_BOOLEAN 0 0 0 255 ECU_ADDRESS 0 SYMBOL_LINK "Rte_FordVltgIf_FordInhbBattVltgDiagc_Logl" 0 DISPLAY_IDENTIFIER BattVltgCorrln.ReceiverPorts.InhbBattVltgDiagc.Logl /end MEASUREMENT
/begin MEASUREMENT BattVltgCorrln.StrtUpSt.Val "MICROSAR RTE" UBYTE NO_COMPU_METHOD 0 0 0 255 ECU_ADDRESS 0 SYMBOL_LINK "Rte_PwrUpSeq_StrtUpSt_Val" 0 DISPLAY_IDENTIFIER BattVltgCorrln.ReceiverPorts.StrtUpSt.Val /end MEASUREMENT
/begin MEASUREMENT BattVltgCorrln.SwdVltgLimd.Logl "MICROSAR RTE" UBYTE RTE_CM_BOOLEAN 0 0 0 255 ECU_ADDRESS 0 SYMBOL_LINK "Rte_BattVltgCorrln_SwdVltgLimd_Logl" 0 DISPLAY_IDENTIFIER BattVltgCorrln.SenderPorts.SwdVltgLimd.Logl /end MEASUREMENT
/begin MEASUREMENT BattVltgCorrln.SysSt.Val "MICROSAR RTE" UBYTE RTE_CM_ENUM_SysSt1 0 0 0 255 ECU_ADDRESS 0 SYMBOL_LINK "Rte_SysStMod_SysSt_Val" 0 DISPLAY_IDENTIFIER BattVltgCorrln.ReceiverPorts.SysSt.Val /end MEASUREMENT
/begin MEASUREMENT BattVltgCorrln.dBattVltgCorrlnBattVltgAndSwd1Ok "MICROSAR RTE" UBYTE RTE_CM_BOOLEAN 0 0 0 255 ECU_ADDRESS 0 SYMBOL_LINK "Rte_BattVltgCorrln_dBattVltgCorrlnBattVltgAndSwd1Ok" 0 DISPLAY_IDENTIFIER BattVltgCorrln.PerInstanceMemories.dBattVltgCorrlnBattVltgAndSwd1Ok /end MEASUREMENT
/begin MEASUREMENT BattVltgCorrln.dBattVltgCorrlnBattVltgRngOk "MICROSAR RTE" UBYTE NO_COMPU_METHOD 0 0 0 255 ECU_ADDRESS 0 SYMBOL_LINK "Rte_BattVltgCorrln_dBattVltgCorrlnBattVltgRngOk" 0 DISPLAY_IDENTIFIER BattVltgCorrln.PerInstanceMemories.dBattVltgCorrlnBattVltgRngOk /end MEASUREMENT
/begin MEASUREMENT BattVltgCorrln.dBattVltgCorrlnBattVltgSwd1RngOk "MICROSAR RTE" UBYTE NO_COMPU_METHOD 0 0 0 255 ECU_ADDRESS 0 SYMBOL_LINK "Rte_BattVltgCorrln_dBattVltgCorrlnBattVltgSwd1RngOk" 0 DISPLAY_IDENTIFIER BattVltgCorrln.PerInstanceMemories.dBattVltgCorrlnBattVltgSwd1RngOk /end MEASUREMENT
/begin GROUP AAACalRegn02Rt03GroupB_Dummy.EotProtnSoftEndStopAuthyThd.Val "MICROSAR RTE" /begin SUB_GROUP /end SUB_GROUP /begin FUNCTION_LIST /end FUNCTION_LIST
 /begin REF_CHARACTERISTIC AAACalRegn02Rt03GroupB_Dummy.EotProtnSoftEndStopAuthyThd.Val /end REF_CHARACTERISTIC
 /begin REF_MEASUREMENT /end REF_MEASUREMENT
/end GROUP
/begin GROUP AAACalRegn02Rt03GroupB_Dummy.RtnHwAgOffsCalcdX.Ary2D "MICROSAR RTE" /begin SUB_GROUP /end SUB_GROUP /begin FUNCTION_LIST /end FUNCTION_LIST /begin REF_CHARACTERISTIC AAACalRegn02Rt03GroupB_Dummy.RtnHwAgOffsCalcdX.Ary2D /end REF_CHARACTERISTIC /begin REF_MEASUREMENT /end REF_MEASUREMENT /end GROUP
/begin GROUP AAACalRegn02Rt03GroupB_Dummy.RtnHwAgOffsCalcdY.Ary2D "MICROSAR RTE" /begin SUB_GROUP /end SUB_GROUP /begin FUNCTION_LIST /end FUNCTION_LIST /begin REF_CHARACTERISTIC AAACalRegn02Rt03GroupB_Dummy.RtnHwAgOffsCalcdY.Ary2D /end REF_CHARACTERISTIC /begin REF_MEASUREMENT /end REF_MEASUREMENT /end GROUP
/begin GROUP AAACalRegn02Rt03GroupB_Dummy.RtnScaTqX.Ary2D "MICROSAR RTE" /begin SUB_GROUP /end SUB_GROUP /begin FUNCTION_LIST /end FUNCTION_LIST /begin REF_CHARACTERISTIC AAACalRegn02Rt03GroupB_Dummy.RtnScaTqX.Ary2D /end REF_CHARACTERISTIC /begin REF_MEASUREMENT /end REF_MEASUREMENT /end GROUP
/begin GROUP AAACalRegn02Rt03GroupB_Dummy.RtnScaTqY.Ary2D "MICROSAR RTE" /begin SUB_GROUP /end SUB_GROUP /begin FUNCTION_LIST /end FUNCTION_LIST /begin REF_CHARACTERISTIC AAACalRegn02Rt03GroupB_Dummy.RtnScaTqY.Ary2D /end REF_CHARACTERISTIC /begin REF_MEASUREMENT /end REF_MEASUREMENT /end GROUP
/begin GROUP AAACalRegn02Rt03GroupB_Dummy.RtnScaVelX.Ary2D "MICROSAR RTE" /begin SUB_GROUP /end SUB_GROUP /begin FUNCTION_LIST /end FUNCTION_LIST /begin REF_CHARACTERISTIC AAACalRegn02Rt03GroupB_Dummy.RtnScaVelX.Ary2D /end REF_CHARACTERISTIC /begin REF_MEASUREMENT /end REF_MEASUREMENT /end GROUP
/begin GROUP AAACalRegn02Rt03GroupB_Dummy.RtnScaVelY.Ary2D "MICROSAR RTE" /begin SUB_GROUP /end SUB_GROUP /begin FUNCTION_LIST /end FUNCTION_LIST /begin REF_CHARACTERISTIC AAACalRegn02Rt03GroupB_Dummy.RtnScaVelY.Ary2D /end REF_CHARACTERISTIC /begin REF_MEASUREMENT /end REF_MEASUREMENT /end GROUP
/begin GROUP AAACalRegn02Rt03GroupB_Dummy.RtnVehSpdSeln.Ary1D "MICROSAR RTE" /begin SUB_GROUP /end SUB_GROUP /begin FUNCTION_LIST /end FUNCTION_LIST /begin REF_CHARACTERISTIC AAACalRegn02Rt03GroupB_Dummy.RtnVehSpdSeln.Ary1D /end REF_CHARACTERISTIC /begin REF_MEASUREMENT /end REF_MEASUREMENT /end GROUP
/begin GROUP AAACalRegn02Rt04GroupA_Dummy "MICROSAR RTE" /begin SUB_GROUP AAACalRegn02Rt04GroupA_Dummy.CalibrationPorts /end SUB_GROUP /begin FUNCTION_LIST /end FUNCTION_LIST /begin REF_CHARACTERISTIC /end REF_CHARACTERISTIC /begin REF_MEASUREMENT /end REF_MEASUREMENT /end GROUP
/begin GROUP AAACalRegn02Rt04GroupA_Dummy.AssiHiFrqGainY.Ary2D "MICROSAR RTE" /begin SUB_GROUP /end SUB_GROUP /begin FUNCTION_LIST /end FUNCTION_LIST /begin REF_CHARACTERISTIC AAACalRegn02Rt04GroupA_Dummy.AssiHiFrqGainY.Ary2D /end REF_CHARACTERISTIC /begin REF_MEASUREMENT /end REF_MEASUREMENT /end GROUP
/begin GROUP AAACalRegn02Rt04GroupA_Dummy.AssiHiFrqHpFilFrqY.Ary1D "MICROSAR RTE" /begin SUB_GROUP /end SUB_GROUP /begin FUNCTION_LIST /end FUNCTION_LIST /begin REF_CHARACTERISTIC AAACalRegn02Rt04GroupA_Dummy.AssiHiFrqHpFilFrqY.Ary1D /end REF_CHARACTERISTIC /begin REF_MEASUREMENT /end REF_MEASUREMENT /end GROUP
/begin GROUP AAACalRegn02Rt04GroupA_Dummy.AssiHiFrqTqWhlImbRejctnTqX.Ary2D "MICROSAR RTE" /begin SUB_GROUP /end SUB_GROUP /begin FUNCTION_LIST /end FUNCTION_LIST
 /begin REF_CHARACTERISTIC AAACalRegn02Rt04GroupA_Dummy.AssiHiFrqTqWhlImbRejctnTqX.Ary2D /end REF_CHARACTERISTIC
 /begin REF_MEASUREMENT /end REF_MEASUREMENT
/end GROUP
/begin GROUP AAACalRegn02Rt04GroupA_Dummy.AssiHiFrqTqX.Ary2D "MICROSAR RTE" /begin SUB_GROUP /end SUB_GROUP /begin FUNCTION_LIST /end FUNCTION_LIST /begin REF_CHARACTERISTIC AAACalRegn02Rt04GroupA_Dummy.AssiHiFrqTqX.Ary2D /end REF_CHARACTERISTIC /begin REF_MEASUREMENT /end REF_MEASUREMENT /end GROUP
/begin GROUP AAACalRegn02Rt04GroupA_Dummy.AssiHiFrqWhlImbRejctnBlndX.Ary2D "MICROSAR RTE" /begin SUB_GROUP /end SUB_GROUP /begin FUNCTION_LIST /end FUNCTION_LIST
 /begin REF_CHARACTERISTIC AAACalRegn02Rt04GroupA_Dummy.AssiHiFrqWhlImbRejctnBlndX.Ary2D /end REF_CHARACTERISTIC
 /begin REF_MEASUREMENT /end REF_MEASUREMENT
/end GROUP
/begin GROUP AAACalRegn02Rt04GroupA_Dummy.AssiHiFrqWhlImbRejctnBlndY.Ary2D "MICROSAR RTE" /begin SUB_GROUP /end SUB_GROUP /begin FUNCTION_LIST /end FUNCTION_LIST
 /begin REF_CHARACTERISTIC AAACalRegn02Rt04GroupA_Dummy.AssiHiFrqWhlImbRejctnBlndY.Ary2D /end REF_CHARACTERISTIC
 /begin REF_MEASUREMENT /end REF_MEASUREMENT
/end GROUP
/begin GROUP AAACalRegn02Rt04GroupA_Dummy.AssiHiFrqWhlImbRejctnGainY.Ary2D "MICROSAR RTE" /begin SUB_GROUP /end SUB_GROUP /begin FUNCTION_LIST /end FUNCTION_LIST
 /begin REF_CHARACTERISTIC AAACalRegn02Rt04GroupA_Dummy.AssiHiFrqWhlImbRejctnGainY.Ary2D /end REF_CHARACTERISTIC
 /begin REF_MEASUREMENT /end REF_MEASUREMENT
/end GROUP
/begin GROUP AAACalRegn02Rt04GroupA_Dummy.AssiMotTqWhlImbRejctnMaxX.Ary2D "MICROSAR RTE" /begin SUB_GROUP /end SUB_GROUP /begin FUNCTION_LIST /end FUNCTION_LIST
 /begin REF_CHARACTERISTIC AAACalRegn02Rt04GroupA_Dummy.AssiMotTqWhlImbRejctnMaxX.Ary2D /end REF_CHARACTERISTIC
 /begin REF_MEASUREMENT /end REF_MEASUREMENT
/end GROUP
/begin GROUP AAACalRegn02Rt04GroupA_Dummy.AssiMotTqWhlImbRejctnMaxY.Ary2D "MICROSAR RTE" /begin SUB_GROUP /end SUB_GROUP /begin FUNCTION_LIST /end FUNCTION_LIST
 /begin REF_CHARACTERISTIC AAACalRegn02Rt04GroupA_Dummy.AssiMotTqWhlImbRejctnMaxY.Ary2D /end REF_CHARACTERISTIC
 /begin REF_MEASUREMENT /end REF_MEASUREMENT
/end GROUP
/begin GROUP AAACalRegn02Rt04GroupA_Dummy.AssiMotTqWhlImbRejctnMinX.Ary2D "MICROSAR RTE" /begin SUB_GROUP /end SUB_GROUP /begin FUNCTION_LIST /end FUNCTION_LIST
 /begin REF_CHARACTERISTIC AAACalRegn02Rt04GroupA_Dummy.AssiMotTqWhlImbRejctnMinX.Ary2D /end REF_CHARACTERISTIC
 /begin REF_MEASUREMENT /end REF_MEASUREMENT
/end GROUP
/begin GROUP AAACalRegn02Rt04GroupA_Dummy.AssiMotTqWhlImbRejctnMinY.Ary2D "MICROSAR RTE" /begin SUB_GROUP /end SUB_GROUP /begin FUNCTION_LIST /end FUNCTION_LIST
 /begin REF_CHARACTERISTIC AAACalRegn02Rt04GroupA_Dummy.AssiMotTqWhlImbRejctnMinY.Ary2D /end REF_CHARACTERISTIC
 /begin REF_MEASUREMENT /end REF_MEASUREMENT
/end GROUP
/begin GROUP AAACalRegn02Rt04GroupA_Dummy.AssiWhlImbRejctnBlndScaX.Ary2D "MICROSAR RTE" /begin SUB_GROUP /end SUB_GROUP /begin FUNCTION_LIST /end FUNCTION_LIST
 /begin REF_CHARACTERISTIC AAACalRegn02Rt04GroupA_Dummy.AssiWhlImbRejctnBlndScaX.Ary2D /end REF_CHARACTERISTIC
 /begin REF_MEASUREMENT /end REF_MEASUREMENT
/end GROUP
/begin GROUP AAACalRegn02Rt04GroupA_Dummy.AssiWhlImbRejctnBlndScaY.Ary2D "MICROSAR RTE" /begin SUB_GROUP /end SUB_GROUP /begin FUNCTION_LIST /end FUNCTION_LIST
 /begin REF_CHARACTERISTIC AAACalRegn02Rt04GroupA_Dummy.AssiWhlImbRejctnBlndScaY.Ary2D /end REF_CHARACTERISTIC
 /begin REF_MEASUREMENT /end REF_MEASUREMENT
/end GROUP
/begin GROUP AAACalRegn02Rt04GroupA_Dummy.CalibrationPorts "MICROSAR RTE"
 /begin SUB_GROUP AAACalRegn02Rt04GroupA_Dummy.AssiHiFrqGainY.Ary2D AAACalRegn02Rt04GroupA_Dummy.AssiHiFrqHpFilFrqY.Ary1D AAACalRegn02Rt04GroupA_Dummy.AssiHiFrqTqWhlImbRejctnTqX.Ary2D AAACalRegn02Rt04GroupA_Dummy.AssiHiFrqTqX.Ary2D AAACalRegn02Rt04GroupA_Dummy.AssiHiFrqWhlImbRejctnBlndX.Ary2D AAACalRegn02Rt04GroupA_Dummy.AssiHiFrqWhlImbRejctnBlndY.Ary2D AAACalRegn02Rt04GroupA_Dummy.AssiHiFrqWhlImbRejctnGainY.Ary2D AAACalRegn02Rt04GroupA_Dummy.AssiMotTqWhlImbRejctnMaxX.Ary2D AAACalRegn02Rt04GroupA_Dummy.AssiMotTqWhlImbRejctnMaxY.Ary2D AAACalRegn02Rt04GroupA_Dummy.AssiMotTqWhlImbRejctnMinX.Ary2D AAACalRegn02Rt04GroupA_Dummy.AssiMotTqWhlImbRejctnMinY.Ary2D AAACalRegn02Rt04GroupA_Dummy.AssiWhlImbRejctnBlndScaX.Ary2D AAACalRegn02Rt04GroupA_Dummy.AssiWhlImbRejctnBlndScaY.Ary2D AAACalRegn02Rt04GroupA_Dummy.DampgHwTqX.Ary1D AAACalRegn02Rt04GroupA_Dummy.DampgHwTqY.Ary1D AAACalRegn02Rt04GroupA_Dummy.DampgHydCoeff1ScaY.Ary1D AAACalRegn02Rt04GroupA_Dummy.DampgHydCoeff2ScaY.Ary1D AAACalRegn02Rt04GroupA_Dummy.DampgHydCoeff3ScaY.Ary1D AAACalRegn02Rt04GroupA_Dummy.DampgHydCoeff4ScaY.Ary1D AAACalRegn02Rt04GroupA_Dummy.DampgMotVelX.Ary2D AAACalRegn02Rt04GroupA_Dummy.DampgMotVelY.Ary2D AAACalRegn02Rt04GroupA_Dummy.HysCmpEffLossY.Ary1D AAACalRegn02Rt04GroupA_Dummy.HysCmpEffOffsY.Ary1D AAACalRegn02Rt04GroupA_Dummy.HysCmpFricWhlImbRejctnBlndX.Ary1D AAACalRegn02Rt04GroupA_Dummy.HysCmpFricWhlImbRejctnBlndY.Ary1D AAACalRegn02Rt04GroupA_Dummy.HysCmpFricWhlImbRejctnOffY.Ary1D AAACalRegn02Rt04GroupA_Dummy.HysCmpFricWhlImbRejctnOnY.Ary1D AAACalRegn02Rt04GroupA_Dummy.HysCmpHwTqScaX.Ary2D AAACalRegn02Rt04GroupA_Dummy.HysCmpHwTqScaY.Ary2D AAACalRegn02Rt04GroupA_Dummy.HysCmpHysSatnY.Ary1D AAACalRegn02Rt04GroupA_Dummy.HysCmpNegHysCmpScaX.Ary1D AAACalRegn02Rt04GroupA_Dummy.HysCmpNegHysCmpScaY.Ary1D AAACalRegn02Rt04GroupA_Dummy.HysCmpNegHysCmpX.Ary1D AAACalRegn02Rt04GroupA_Dummy.HysCmpNegHysCmpY.Ary1D AAACalRegn02Rt04GroupA_Dummy.HysCmpOutpLim.Val AAACalRegn02Rt04GroupA_Dummy.HysCmpRevGain.Val AAACalRegn02Rt04GroupA_Dummy.HysCmpRiseX.Ary1D AAACalRegn02Rt04GroupA_Dummy.HysCmpRiseY.Ary1D AAACalRegn02Rt04GroupA_Dummy.InertiaCmpVelAssiBasdDampgStatY.Ary1D AAACalRegn02Rt04GroupA_Dummy.InertiaCmpVelDampgFilFrq.Ary1D AAACalRegn02Rt04GroupA_Dummy.InertiaCmpVelDampgFilFrqWhlImbRejctnOn.Ary1D AAACalRegn02Rt04GroupA_Dummy.InertiaCmpVelDampgSpdBlndY.Ary1D AAACalRegn02Rt04GroupA_Dummy.InertiaCmpVelDampgWhlImbRejctnBlndX.Ary1D AAACalRegn02Rt04GroupA_Dummy.InertiaCmpVelDampgWhlImbRejctnBlndY.Ary1D /end SUB_GROUP
 /begin FUNCTION_LIST /end FUNCTION_LIST
 /begin REF_CHARACTERISTIC /end REF_CHARACTERISTIC
 /begin REF_MEASUREMENT /end REF_MEASUREMENT
/end GROUP
/begin GROUP AAACalRegn02Rt04GroupA_Dummy.DampgHwTqX.Ary1D "MICROSAR RTE" /begin SUB_GROUP /end SUB_GROUP /begin FUNCTION_LIST /end FUNCTION_LIST /begin REF_CHARACTERISTIC AAACalRegn02Rt04GroupA_Dummy.DampgHwTqX.Ary1D /end REF_CHARACTERISTIC /begin REF_MEASUREMENT /end REF_MEASUREMENT /end GROUP
/begin GROUP AAACalRegn02Rt04GroupA_Dummy.DampgHwTqY.Ary1D "MICROSAR RTE" /begin SUB_GROUP /end SUB_GROUP /begin FUNCTION_LIST /end FUNCTION_LIST /begin REF_CHARACTERISTIC AAACalRegn02Rt04GroupA_Dummy.DampgHwTqY.Ary1D /end REF_CHARACTERISTIC /begin REF_MEASUREMENT /end REF_MEASUREMENT /end GROUP
/begin GROUP AAACalRegn02Rt04GroupA_Dummy.DampgHydCoeff1ScaY.Ary1D "MICROSAR RTE" /begin SUB_GROUP /end SUB_GROUP /begin FUNCTION_LIST /end FUNCTION_LIST /begin REF_CHARACTERISTIC AAACalRegn02Rt04GroupA_Dummy.DampgHydCoeff1ScaY.Ary1D /end REF_CHARACTERISTIC /begin REF_MEASUREMENT /end REF_MEASUREMENT /end GROUP
/begin GROUP AAACalRegn02Rt04GroupA_Dummy.DampgHydCoeff2ScaY.Ary1D "MICROSAR RTE" /begin SUB_GROUP /end SUB_GROUP /begin FUNCTION_LIST /end FUNCTION_LIST /begin REF_CHARACTERISTIC AAACalRegn02Rt04GroupA_Dummy.DampgHydCoeff2ScaY.Ary1D /end REF_CHARACTERISTIC /begin REF_MEASUREMENT /end REF_MEASUREMENT /end GROUP
/begin GROUP AAACalRegn02Rt04GroupA_Dummy.DampgHydCoeff3ScaY.Ary1D "MICROSAR RTE" /begin SUB_GROUP /end SUB_GROUP /begin FUNCTION_LIST /end FUNCTION_LIST /begin REF_CHARACTERISTIC AAACalRegn02Rt04GroupA_Dummy.DampgHydCoeff3ScaY.Ary1D /end REF_CHARACTERISTIC /begin REF_MEASUREMENT /end REF_MEASUREMENT /end GROUP
/begin GROUP AAACalRegn02Rt04GroupA_Dummy.DampgHydCoeff4ScaY.Ary1D "MICROSAR RTE" /begin SUB_GROUP /end SUB_GROUP /begin FUNCTION_LIST /end FUNCTION_LIST /begin REF_CHARACTERISTIC AAACalRegn02Rt04GroupA_Dummy.DampgHydCoeff4ScaY.Ary1D /end REF_CHARACTERISTIC /begin REF_MEASUREMENT /end REF_MEASUREMENT /end GROUP
/begin GROUP AAACalRegn02Rt04GroupA_Dummy.DampgMotVelX.Ary2D "MICROSAR RTE" /begin SUB_GROUP /end SUB_GROUP /begin FUNCTION_LIST /end FUNCTION_LIST /begin REF_CHARACTERISTIC AAACalRegn02Rt04GroupA_Dummy.DampgMotVelX.Ary2D /end REF_CHARACTERISTIC /begin REF_MEASUREMENT /end REF_MEASUREMENT /end GROUP
/begin GROUP AAACalRegn02Rt04GroupA_Dummy.DampgMotVelY.Ary2D "MICROSAR RTE" /begin SUB_GROUP /end SUB_GROUP /begin FUNCTION_LIST /end FUNCTION_LIST /begin REF_CHARACTERISTIC AAACalRegn02Rt04GroupA_Dummy.DampgMotVelY.Ary2D /end REF_CHARACTERISTIC /begin REF_MEASUREMENT /end REF_MEASUREMENT /end GROUP
/begin GROUP AAACalRegn02Rt04GroupA_Dummy.HysCmpEffLossY.Ary1D "MICROSAR RTE" /begin SUB_GROUP /end SUB_GROUP /begin FUNCTION_LIST /end FUNCTION_LIST /begin REF_CHARACTERISTIC AAACalRegn02Rt04GroupA_Dummy.HysCmpEffLossY.Ary1D /end REF_CHARACTERISTIC /begin REF_MEASUREMENT /end REF_MEASUREMENT /end GROUP
/begin GROUP AAACalRegn02Rt04GroupA_Dummy.HysCmpEffOffsY.Ary1D "MICROSAR RTE" /begin SUB_GROUP /end SUB_GROUP /begin FUNCTION_LIST /end FUNCTION_LIST /begin REF_CHARACTERISTIC AAACalRegn02Rt04GroupA_Dummy.HysCmpEffOffsY.Ary1D /end REF_CHARACTERISTIC /begin REF_MEASUREMENT /end REF_MEASUREMENT /end GROUP
/begin GROUP AAACalRegn02Rt04GroupA_Dummy.HysCmpFricWhlImbRejctnBlndX.Ary1D "MICROSAR RTE" /begin SUB_GROUP /end SUB_GROUP /begin FUNCTION_LIST /end FUNCTION_LIST
 /begin REF_CHARACTERISTIC AAACalRegn02Rt04GroupA_Dummy.HysCmpFricWhlImbRejctnBlndX.Ary1D /end REF_CHARACTERISTIC
 /begin REF_MEASUREMENT /end REF_MEASUREMENT
/end GROUP
/begin GROUP AAACalRegn02Rt04GroupA_Dummy.HysCmpFricWhlImbRejctnBlndY.Ary1D "MICROSAR RTE" /begin SUB_GROUP /end SUB_GROUP /begin FUNCTION_LIST /end FUNCTION_LIST
 /begin REF_CHARACTERISTIC AAACalRegn02Rt04GroupA_Dummy.HysCmpFricWhlImbRejctnBlndY.Ary1D /end REF_CHARACTERISTIC
 /begin REF_MEASUREMENT /end REF_MEASUREMENT
/end GROUP
/begin GROUP AAACalRegn02Rt04GroupA_Dummy.HysCmpFricWhlImbRejctnOffY.Ary1D "MICROSAR RTE" /begin SUB_GROUP /end SUB_GROUP /begin FUNCTION_LIST /end FUNCTION_LIST
 /begin REF_CHARACTERISTIC AAACalRegn02Rt04GroupA_Dummy.HysCmpFricWhlImbRejctnOffY.Ary1D /end REF_CHARACTERISTIC
 /begin REF_MEASUREMENT /end REF_MEASUREMENT
/end GROUP
/begin GROUP AAACalRegn02Rt04GroupA_Dummy.HysCmpFricWhlImbRejctnOnY.Ary1D "MICROSAR RTE" /begin SUB_GROUP /end SUB_GROUP /begin FUNCTION_LIST /end FUNCTION_LIST
 /begin REF_CHARACTERISTIC AAACalRegn02Rt04GroupA_Dummy.HysCmpFricWhlImbRejctnOnY.Ary1D /end REF_CHARACTERISTIC
 /begin REF_MEASUREMENT /end REF_MEASUREMENT
/end GROUP
/begin GROUP AAACalRegn02Rt04GroupA_Dummy.HysCmpHwTqScaX.Ary2D "MICROSAR RTE" /begin SUB_GROUP /end SUB_GROUP /begin FUNCTION_LIST /end FUNCTION_LIST /begin REF_CHARACTERISTIC AAACalRegn02Rt04GroupA_Dummy.HysCmpHwTqScaX.Ary2D /end REF_CHARACTERISTIC /begin REF_MEASUREMENT /end REF_MEASUREMENT /end GROUP
/begin GROUP AAACalRegn02Rt04GroupA_Dummy.HysCmpHwTqScaY.Ary2D "MICROSAR RTE" /begin SUB_GROUP /end SUB_GROUP /begin FUNCTION_LIST /end FUNCTION_LIST /begin REF_CHARACTERISTIC AAACalRegn02Rt04GroupA_Dummy.HysCmpHwTqScaY.Ary2D /end REF_CHARACTERISTIC /begin REF_MEASUREMENT /end REF_MEASUREMENT /end GROUP
/begin GROUP AAACalRegn02Rt04GroupA_Dummy.HysCmpHysSatnY.Ary1D "MICROSAR RTE" /begin SUB_GROUP /end SUB_GROUP /begin FUNCTION_LIST /end FUNCTION_LIST /begin REF_CHARACTERISTIC AAACalRegn02Rt04GroupA_Dummy.HysCmpHysSatnY.Ary1D /end REF_CHARACTERISTIC /begin REF_MEASUREMENT /end REF_MEASUREMENT /end GROUP
/begin GROUP AAACalRegn02Rt04GroupA_Dummy.HysCmpNegHysCmpScaX.Ary1D "MICROSAR RTE" /begin SUB_GROUP /end SUB_GROUP /begin FUNCTION_LIST /end FUNCTION_LIST /begin REF_CHARACTERISTIC AAACalRegn02Rt04GroupA_Dummy.HysCmpNegHysCmpScaX.Ary1D /end REF_CHARACTERISTIC /begin REF_MEASUREMENT /end REF_MEASUREMENT /end GROUP
/begin GROUP AAACalRegn02Rt04GroupA_Dummy.HysCmpNegHysCmpScaY.Ary1D "MICROSAR RTE" /begin SUB_GROUP /end SUB_GROUP /begin FUNCTION_LIST /end FUNCTION_LIST /begin REF_CHARACTERISTIC AAACalRegn02Rt04GroupA_Dummy.HysCmpNegHysCmpScaY.Ary1D /end REF_CHARACTERISTIC /begin REF_MEASUREMENT /end REF_MEASUREMENT /end GROUP
/begin GROUP AAACalRegn02Rt04GroupA_Dummy.HysCmpNegHysCmpX.Ary1D "MICROSAR RTE" /begin SUB_GROUP /end SUB_GROUP /begin FUNCTION_LIST /end FUNCTION_LIST /begin REF_CHARACTERISTIC AAACalRegn02Rt04GroupA_Dummy.HysCmpNegHysCmpX.Ary1D /end REF_CHARACTERISTIC /begin REF_MEASUREMENT /end REF_MEASUREMENT /end GROUP
/begin GROUP AAACalRegn02Rt04GroupA_Dummy.HysCmpNegHysCmpY.Ary1D "MICROSAR RTE" /begin SUB_GROUP /end SUB_GROUP /begin FUNCTION_LIST /end FUNCTION_LIST /begin REF_CHARACTERISTIC AAACalRegn02Rt04GroupA_Dummy.HysCmpNegHysCmpY.Ary1D /end REF_CHARACTERISTIC /begin REF_MEASUREMENT /end REF_MEASUREMENT /end GROUP
/begin GROUP AAACalRegn02Rt04GroupA_Dummy.HysCmpOutpLim.Val "MICROSAR RTE" /begin SUB_GROUP /end SUB_GROUP /begin FUNCTION_LIST /end FUNCTION_LIST /begin REF_CHARACTERISTIC AAACalRegn02Rt04GroupA_Dummy.HysCmpOutpLim.Val /end REF_CHARACTERISTIC /begin REF_MEASUREMENT /end REF_MEASUREMENT /end GROUP
/begin GROUP AAACalRegn02Rt04GroupA_Dummy.HysCmpRevGain.Val "MICROSAR RTE" /begin SUB_GROUP /end SUB_GROUP /begin FUNCTION_LIST /end FUNCTION_LIST /begin REF_CHARACTERISTIC AAACalRegn02Rt04GroupA_Dummy.HysCmpRevGain.Val /end REF_CHARACTERISTIC /begin REF_MEASUREMENT /end REF_MEASUREMENT /end GROUP
/begin GROUP AAACalRegn02Rt04GroupA_Dummy.HysCmpRiseX.Ary1D "MICROSAR RTE" /begin SUB_GROUP /end SUB_GROUP /begin FUNCTION_LIST /end FUNCTION_LIST /begin REF_CHARACTERISTIC AAACalRegn02Rt04GroupA_Dummy.HysCmpRiseX.Ary1D /end REF_CHARACTERISTIC /begin REF_MEASUREMENT /end REF_MEASUREMENT /end GROUP
/begin GROUP AAACalRegn02Rt04GroupA_Dummy.HysCmpRiseY.Ary1D "MICROSAR RTE" /begin SUB_GROUP /end SUB_GROUP /begin FUNCTION_LIST /end FUNCTION_LIST /begin REF_CHARACTERISTIC AAACalRegn02Rt04GroupA_Dummy.HysCmpRiseY.Ary1D /end REF_CHARACTERISTIC /begin REF_MEASUREMENT /end REF_MEASUREMENT /end GROUP
/begin GROUP AAACalRegn02Rt04GroupA_Dummy.InertiaCmpVelAssiBasdDampgStatY.Ary1D "MICROSAR RTE" /begin SUB_GROUP /end SUB_GROUP /begin FUNCTION_LIST /end FUNCTION_LIST
 /begin REF_CHARACTERISTIC AAACalRegn02Rt04GroupA_Dummy.InertiaCmpVelAssiBasdDampgStatY.Ary1D /end REF_CHARACTERISTIC
 /begin REF_MEASUREMENT /end REF_MEASUREMENT
/end GROUP
/begin GROUP AAACalRegn02Rt04GroupA_Dummy.InertiaCmpVelDampgFilFrq.Ary1D "MICROSAR RTE" /begin SUB_GROUP /end SUB_GROUP /begin FUNCTION_LIST /end FUNCTION_LIST
 /begin REF_CHARACTERISTIC AAACalRegn02Rt04GroupA_Dummy.InertiaCmpVelDampgFilFrq.Ary1D /end REF_CHARACTERISTIC
 /begin REF_MEASUREMENT /end REF_MEASUREMENT
/end GROUP
/begin GROUP AAACalRegn02Rt04GroupA_Dummy.InertiaCmpVelDampgFilFrqWhlImbRejctnOn.Ary1D "MICROSAR RTE" /begin SUB_GROUP /end SUB_GROUP /begin FUNCTION_LIST /end FUNCTION_LIST
 /begin REF_CHARACTERISTIC AAACalRegn02Rt04GroupA_Dummy.InertiaCmpVelDampgFilFrqWhlImbRejctnOn.Ary1D /end REF_CHARACTERISTIC
 /begin REF_MEASUREMENT /end REF_MEASUREMENT
/end GROUP
/begin GROUP AAACalRegn02Rt04GroupA_Dummy.InertiaCmpVelDampgSpdBlndY.Ary1D "MICROSAR RTE" /begin SUB_GROUP /end SUB_GROUP /begin FUNCTION_LIST /end FUNCTION_LIST
 /begin REF_CHARACTERISTIC AAACalRegn02Rt04GroupA_Dummy.InertiaCmpVelDampgSpdBlndY.Ary1D /end REF_CHARACTERISTIC
 /begin REF_MEASUREMENT /end REF_MEASUREMENT
/end GROUP
/begin GROUP AAACalRegn02Rt04GroupA_Dummy.InertiaCmpVelDampgWhlImbRejctnBlndX.Ary1D "MICROSAR RTE" /begin SUB_GROUP /end SUB_GROUP /begin FUNCTION_LIST /end FUNCTION_LIST
 /begin REF_CHARACTERISTIC AAACalRegn02Rt04GroupA_Dummy.InertiaCmpVelDampgWhlImbRejctnBlndX.Ary1D /end REF_CHARACTERISTIC
 /begin REF_MEASUREMENT /end REF_MEASUREMENT
/end GROUP
/begin GROUP AAACalRegn02Rt04GroupA_Dummy.InertiaCmpVelDampgWhlImbRejctnBlndY.Ary1D "MICROSAR RTE" /begin SUB_GROUP /end SUB_GROUP /begin FUNCTION_LIST /end FUNCTION_LIST
 /begin REF_CHARACTERISTIC AAACalRegn02Rt04GroupA_Dummy.InertiaCmpVelDampgWhlImbRejctnBlndY.Ary1D /end REF_CHARACTERISTIC
 /begin REF_MEASUREMENT /end REF_MEASUREMENT
/end GROUP
/begin GROUP AAACalRegn02Rt04GroupB_Dummy "MICROSAR RTE" /begin SUB_GROUP AAACalRegn02Rt04GroupB_Dummy.CalibrationPorts /end SUB_GROUP /begin FUNCTION_LIST /end FUNCTION_LIST /begin REF_CHARACTERISTIC /end REF_CHARACTERISTIC /begin REF_MEASUREMENT /end REF_MEASUREMENT /end GROUP
/begin GROUP AAACalRegn02Rt04GroupB_Dummy.CalibrationPorts "MICROSAR RTE"
 /begin SUB_GROUP AAACalRegn02Rt04GroupB_Dummy.EotProtnDampgVehSpdTbl.Ary1D AAACalRegn02Rt04GroupB_Dummy.EotProtnDeltaTqThd.Val AAACalRegn02Rt04GroupB_Dummy.EotProtnEntrGainVehSpdTbl.Ary1D AAACalRegn02Rt04GroupB_Dummy.EotProtnEntrGainY.Ary2D AAACalRegn02Rt04GroupB_Dummy.EotProtnLoAuthyEntrGainY.Ary2D AAACalRegn02Rt04GroupB_Dummy.EotProtnMotSpdIncptY.Ary1D AAACalRegn02Rt04GroupB_Dummy.EotProtnNormDampgY.Ary2D AAACalRegn02Rt04GroupB_Dummy.EotProtnSoftEndStopAuthyThd.Val AAACalRegn02Rt04GroupB_Dummy.RtnHwAgOffsCalcdX.Ary2D AAACalRegn02Rt04GroupB_Dummy.RtnHwAgOffsCalcdY.Ary2D AAACalRegn02Rt04GroupB_Dummy.RtnScaTqX.Ary2D AAACalRegn02Rt04GroupB_Dummy.RtnScaTqY.Ary2D AAACalRegn02Rt04GroupB_Dummy.RtnScaVelX.Ary2D AAACalRegn02Rt04GroupB_Dummy.RtnScaVelY.Ary2D AAACalRegn02Rt04GroupB_Dummy.RtnVehSpdSeln.Ary1D /end SUB_GROUP
 /begin FUNCTION_LIST /end FUNCTION_LIST
 /begin REF_CHARACTERISTIC /end REF_CHARACTERISTIC
 /begin REF_MEASUREMENT /end REF_MEASUREMENT
/end GROUP
/begin GROUP AAACalRegn02Rt04GroupB_Dummy.EotProtnDampgVehSpdTbl.Ary1D "MICROSAR RTE" /begin SUB_GROUP /end SUB_GROUP /begin FUNCTION_LIST /end FUNCTION_LIST /begin REF_CHARACTERISTIC AAACalRegn02Rt04GroupB_Dummy.EotProtnDampgVehSpdTbl.Ary1D /end REF_CHARACTERISTIC /begin REF_MEASUREMENT /end REF_MEASUREMENT /end GROUP
/begin GROUP AAACalRegn02Rt04GroupB_Dummy.EotProtnDeltaTqThd.Val "MICROSAR RTE" /begin SUB_GROUP /end SUB_GROUP /begin FUNCTION_LIST /end FUNCTION_LIST /begin REF_CHARACTERISTIC AAACalRegn02Rt04GroupB_Dummy.EotProtnDeltaTqThd.Val /end REF_CHARACTERISTIC /begin REF_MEASUREMENT /end REF_MEASUREMENT /end GROUP
/begin GROUP AAACalRegn02Rt04GroupB_Dummy.EotProtnEntrGainVehSpdTbl.Ary1D "MICROSAR RTE" /begin SUB_GROUP /end SUB_GROUP /begin FUNCTION_LIST /end FUNCTION_LIST
 /begin REF_CHARACTERISTIC AAACalRegn02Rt04GroupB_Dummy.EotProtnEntrGainVehSpdTbl.Ary1D /end REF_CHARACTERISTIC
 /begin REF_MEASUREMENT /end REF_MEASUREMENT
/end GROUP
/begin GROUP AAACalRegn02Rt04GroupB_Dummy.EotProtnEntrGainY.Ary2D "MICROSAR RTE" /begin SUB_GROUP /end SUB_GROUP /begin FUNCTION_LIST /end FUNCTION_LIST /begin REF_CHARACTERISTIC AAACalRegn02Rt04GroupB_Dummy.EotProtnEntrGainY.Ary2D /end REF_CHARACTERISTIC /begin REF_MEASUREMENT /end REF_MEASUREMENT /end GROUP
/begin GROUP AAACalRegn02Rt04GroupB_Dummy.EotProtnLoAuthyEntrGainY.Ary2D "MICROSAR RTE" /begin SUB_GROUP /end SUB_GROUP /begin FUNCTION_LIST /end FUNCTION_LIST
 /begin REF_CHARACTERISTIC AAACalRegn02Rt04GroupB_Dummy.EotProtnLoAuthyEntrGainY.Ary2D /end REF_CHARACTERISTIC
 /begin REF_MEASUREMENT /end REF_MEASUREMENT
/end GROUP
/begin GROUP AAACalRegn02Rt04GroupB_Dummy.EotProtnMotSpdIncptY.Ary1D "MICROSAR RTE" /begin SUB_GROUP /end SUB_GROUP /begin FUNCTION_LIST /end FUNCTION_LIST /begin REF_CHARACTERISTIC AAACalRegn02Rt04GroupB_Dummy.EotProtnMotSpdIncptY.Ary1D /end REF_CHARACTERISTIC /begin REF_MEASUREMENT /end REF_MEASUREMENT /end GROUP
/begin GROUP AAACalRegn02Rt04GroupB_Dummy.EotProtnNormDampgY.Ary2D "MICROSAR RTE" /begin SUB_GROUP /end SUB_GROUP /begin FUNCTION_LIST /end FUNCTION_LIST /begin REF_CHARACTERISTIC AAACalRegn02Rt04GroupB_Dummy.EotProtnNormDampgY.Ary2D /end REF_CHARACTERISTIC /begin REF_MEASUREMENT /end REF_MEASUREMENT /end GROUP
/begin GROUP AAACalRegn02Rt04GroupB_Dummy.EotProtnSoftEndStopAuthyThd.Val "MICROSAR RTE" /begin SUB_GROUP /end SUB_GROUP /begin FUNCTION_LIST /end FUNCTION_LIST
 /begin REF_CHARACTERISTIC AAACalRegn02Rt04GroupB_Dummy.EotProtnSoftEndStopAuthyThd.Val /end REF_CHARACTERISTIC
 /begin REF_MEASUREMENT /end REF_MEASUREMENT
/end GROUP
/begin GROUP AAACalRegn02Rt04GroupB_Dummy.RtnHwAgOffsCalcdX.Ary2D "MICROSAR RTE" /begin SUB_GROUP /end SUB_GROUP /begin FUNCTION_LIST /end FUNCTION_LIST /begin REF_CHARACTERISTIC AAACalRegn02Rt04GroupB_Dummy.RtnHwAgOffsCalcdX.Ary2D /end REF_CHARACTERISTIC /begin REF_MEASUREMENT /end REF_MEASUREMENT /end GROUP
/begin GROUP AAACalRegn02Rt04GroupB_Dummy.RtnHwAgOffsCalcdY.Ary2D "MICROSAR RTE" /begin SUB_GROUP /end SUB_GROUP /begin FUNCTION_LIST /end FUNCTION_LIST /begin REF_CHARACTERISTIC AAACalRegn02Rt04GroupB_Dummy.RtnHwAgOffsCalcdY.Ary2D /end REF_CHARACTERISTIC /begin REF_MEASUREMENT /end REF_MEASUREMENT /end GROUP
/begin GROUP AAACalRegn02Rt04GroupB_Dummy.RtnScaTqX.Ary2D "MICROSAR RTE" /begin SUB_GROUP /end SUB_GROUP /begin FUNCTION_LIST /end FUNCTION_LIST /begin REF_CHARACTERISTIC AAACalRegn02Rt04GroupB_Dummy.RtnScaTqX.Ary2D /end REF_CHARACTERISTIC /begin REF_MEASUREMENT /end REF_MEASUREMENT /end GROUP
/begin GROUP AAACalRegn02Rt04GroupB_Dummy.RtnScaTqY.Ary2D "MICROSAR RTE" /begin SUB_GROUP /end SUB_GROUP /begin FUNCTION_LIST /end FUNCTION_LIST /begin REF_CHARACTERISTIC AAACalRegn02Rt04GroupB_Dummy.RtnScaTqY.Ary2D /end REF_CHARACTERISTIC /begin REF_MEASUREMENT /end REF_MEASUREMENT /end GROUP
/begin GROUP AAACalRegn02Rt04GroupB_Dummy.RtnScaVelX.Ary2D "MICROSAR RTE" /begin SUB_GROUP /end SUB_GROUP /begin FUNCTION_LIST /end FUNCTION_LIST /begin REF_CHARACTERISTIC AAACalRegn02Rt04GroupB_Dummy.RtnScaVelX.Ary2D /end REF_CHARACTERISTIC /begin REF_MEASUREMENT /end REF_MEASUREMENT /end GROUP
/begin GROUP AAACalRegn02Rt04GroupB_Dummy.RtnScaVelY.Ary2D "MICROSAR RTE" /begin SUB_GROUP /end SUB_GROUP /begin FUNCTION_LIST /end FUNCTION_LIST /begin REF_CHARACTERISTIC AAACalRegn02Rt04GroupB_Dummy.RtnScaVelY.Ary2D /end REF_CHARACTERISTIC /begin REF_MEASUREMENT /end REF_MEASUREMENT /end GROUP
/begin GROUP AAACalRegn02Rt04GroupB_Dummy.RtnVehSpdSeln.Ary1D "MICROSAR RTE" /begin SUB_GROUP /end SUB_GROUP /begin FUNCTION_LIST /end FUNCTION_LIST /begin REF_CHARACTERISTIC AAACalRegn02Rt04GroupB_Dummy.RtnVehSpdSeln.Ary1D /end REF_CHARACTERISTIC /begin REF_MEASUREMENT /end REF_MEASUREMENT /end GROUP
/begin GROUP AAACalRegn02Rt05GroupA_Dummy "MICROSAR RTE" /begin SUB_GROUP AAACalRegn02Rt05GroupA_Dummy.CalibrationPorts /end SUB_GROUP /begin FUNCTION_LIST /end FUNCTION_LIST /begin REF_CHARACTERISTIC /end REF_CHARACTERISTIC /begin REF_MEASUREMENT /end REF_MEASUREMENT /end GROUP
/begin GROUP AAACalRegn02Rt05GroupA_Dummy.AssiHiFrqGainY.Ary2D "MICROSAR RTE" /begin SUB_GROUP /end SUB_GROUP /begin FUNCTION_LIST /end FUNCTION_LIST /begin REF_CHARACTERISTIC AAACalRegn02Rt05GroupA_Dummy.AssiHiFrqGainY.Ary2D /end REF_CHARACTERISTIC /begin REF_MEASUREMENT /end REF_MEASUREMENT /end GROUP
/begin GROUP AAACalRegn02Rt05GroupA_Dummy.AssiHiFrqHpFilFrqY.Ary1D "MICROSAR RTE" /begin SUB_GROUP /end SUB_GROUP /begin FUNCTION_LIST /end FUNCTION_LIST /begin REF_CHARACTERISTIC AAACalRegn02Rt05GroupA_Dummy.AssiHiFrqHpFilFrqY.Ary1D /end REF_CHARACTERISTIC /begin REF_MEASUREMENT /end REF_MEASUREMENT /end GROUP
/begin GROUP AAACalRegn02Rt05GroupA_Dummy.AssiHiFrqTqWhlImbRejctnTqX.Ary2D "MICROSAR RTE" /begin SUB_GROUP /end SUB_GROUP /begin FUNCTION_LIST /end FUNCTION_LIST
 /begin REF_CHARACTERISTIC AAACalRegn02Rt05GroupA_Dummy.AssiHiFrqTqWhlImbRejctnTqX.Ary2D /end REF_CHARACTERISTIC
 /begin REF_MEASUREMENT /end REF_MEASUREMENT
/end GROUP
/begin GROUP AAACalRegn02Rt05GroupA_Dummy.AssiHiFrqTqX.Ary2D "MICROSAR RTE" /begin SUB_GROUP /end SUB_GROUP /begin FUNCTION_LIST /end FUNCTION_LIST /begin REF_CHARACTERISTIC AAACalRegn02Rt05GroupA_Dummy.AssiHiFrqTqX.Ary2D /end REF_CHARACTERISTIC /begin REF_MEASUREMENT /end REF_MEASUREMENT /end GROUP
/begin GROUP AAACalRegn02Rt05GroupA_Dummy.AssiHiFrqWhlImbRejctnBlndX.Ary2D "MICROSAR RTE" /begin SUB_GROUP /end SUB_GROUP /begin FUNCTION_LIST /end FUNCTION_LIST
 /begin REF_CHARACTERISTIC AAACalRegn02Rt05GroupA_Dummy.AssiHiFrqWhlImbRejctnBlndX.Ary2D /end REF_CHARACTERISTIC
 /begin REF_MEASUREMENT /end REF_MEASUREMENT
/end GROUP
/begin GROUP AAACalRegn02Rt05GroupA_Dummy.AssiHiFrqWhlImbRejctnBlndY.Ary2D "MICROSAR RTE" /begin SUB_GROUP /end SUB_GROUP /begin FUNCTION_LIST /end FUNCTION_LIST
 /begin REF_CHARACTERISTIC AAACalRegn02Rt05GroupA_Dummy.AssiHiFrqWhlImbRejctnBlndY.Ary2D /end REF_CHARACTERISTIC
 /begin REF_MEASUREMENT /end REF_MEASUREMENT
/end GROUP
/begin GROUP AAACalRegn02Rt05GroupA_Dummy.AssiHiFrqWhlImbRejctnGainY.Ary2D "MICROSAR RTE" /begin SUB_GROUP /end SUB_GROUP /begin FUNCTION_LIST /end FUNCTION_LIST
 /begin REF_CHARACTERISTIC AAACalRegn02Rt05GroupA_Dummy.AssiHiFrqWhlImbRejctnGainY.Ary2D /end REF_CHARACTERISTIC
 /begin REF_MEASUREMENT /end REF_MEASUREMENT
/end GROUP
/begin GROUP AAACalRegn02Rt05GroupA_Dummy.AssiMotTqWhlImbRejctnMaxX.Ary2D "MICROSAR RTE" /begin SUB_GROUP /end SUB_GROUP /begin FUNCTION_LIST /end FUNCTION_LIST
 /begin REF_CHARACTERISTIC AAACalRegn02Rt05GroupA_Dummy.AssiMotTqWhlImbRejctnMaxX.Ary2D /end REF_CHARACTERISTIC
 /begin REF_MEASUREMENT /end REF_MEASUREMENT
/end GROUP
/begin GROUP AAACalRegn02Rt05GroupA_Dummy.AssiMotTqWhlImbRejctnMaxY.Ary2D "MICROSAR RTE" /begin SUB_GROUP /end SUB_GROUP /begin FUNCTION_LIST /end FUNCTION_LIST
 /begin REF_CHARACTERISTIC AAACalRegn02Rt05GroupA_Dummy.AssiMotTqWhlImbRejctnMaxY.Ary2D /end REF_CHARACTERISTIC
 /begin REF_MEASUREMENT /end REF_MEASUREMENT
/end GROUP
/begin GROUP AAACalRegn02Rt05GroupA_Dummy.AssiMotTqWhlImbRejctnMinX.Ary2D "MICROSAR RTE" /begin SUB_GROUP /end SUB_GROUP /begin FUNCTION_LIST /end FUNCTION_LIST
 /begin REF_CHARACTERISTIC AAACalRegn02Rt05GroupA_Dummy.AssiMotTqWhlImbRejctnMinX.Ary2D /end REF_CHARACTERISTIC
 /begin REF_MEASUREMENT /end REF_MEASUREMENT
/end GROUP
/begin GROUP AAACalRegn02Rt05GroupA_Dummy.AssiMotTqWhlImbRejctnMinY.Ary2D "MICROSAR RTE" /begin SUB_GROUP /end SUB_GROUP /begin FUNCTION_LIST /end FUNCTION_LIST
 /begin REF_CHARACTERISTIC AAACalRegn02Rt05GroupA_Dummy.AssiMotTqWhlImbRejctnMinY.Ary2D /end REF_CHARACTERISTIC
 /begin REF_MEASUREMENT /end REF_MEASUREMENT
/end GROUP
/begin GROUP AAACalRegn02Rt05GroupA_Dummy.AssiWhlImbRejctnBlndScaX.Ary2D "MICROSAR RTE" /begin SUB_GROUP /end SUB_GROUP /begin FUNCTION_LIST /end FUNCTION_LIST
 /begin REF_CHARACTERISTIC AAACalRegn02Rt05GroupA_Dummy.AssiWhlImbRejctnBlndScaX.Ary2D /end REF_CHARACTERISTIC
 /begin REF_MEASUREMENT /end REF_MEASUREMENT
/end GROUP
/begin GROUP AAACalRegn02Rt05GroupA_Dummy.AssiWhlImbRejctnBlndScaY.Ary2D "MICROSAR RTE" /begin SUB_GROUP /end SUB_GROUP /begin FUNCTION_LIST /end FUNCTION_LIST
 /begin REF_CHARACTERISTIC AAACalRegn02Rt05GroupA_Dummy.AssiWhlImbRejctnBlndScaY.Ary2D /end REF_CHARACTERISTIC
 /begin REF_MEASUREMENT /end REF_MEASUREMENT
/end GROUP
/begin GROUP AAACalRegn02Rt05GroupA_Dummy.CalibrationPorts "MICROSAR RTE"
 /begin SUB_GROUP AAACalRegn02Rt05GroupA_Dummy.AssiHiFrqGainY.Ary2D AAACalRegn02Rt05GroupA_Dummy.AssiHiFrqHpFilFrqY.Ary1D AAACalRegn02Rt05GroupA_Dummy.AssiHiFrqTqWhlImbRejctnTqX.Ary2D AAACalRegn02Rt05GroupA_Dummy.AssiHiFrqTqX.Ary2D AAACalRegn02Rt05GroupA_Dummy.AssiHiFrqWhlImbRejctnBlndX.Ary2D AAACalRegn02Rt05GroupA_Dummy.AssiHiFrqWhlImbRejctnBlndY.Ary2D AAACalRegn02Rt05GroupA_Dummy.AssiHiFrqWhlImbRejctnGainY.Ary2D AAACalRegn02Rt05GroupA_Dummy.AssiMotTqWhlImbRejctnMaxX.Ary2D AAACalRegn02Rt05GroupA_Dummy.AssiMotTqWhlImbRejctnMaxY.Ary2D AAACalRegn02Rt05GroupA_Dummy.AssiMotTqWhlImbRejctnMinX.Ary2D AAACalRegn02Rt05GroupA_Dummy.AssiMotTqWhlImbRejctnMinY.Ary2D AAACalRegn02Rt05GroupA_Dummy.AssiWhlImbRejctnBlndScaX.Ary2D AAACalRegn02Rt05GroupA_Dummy.AssiWhlImbRejctnBlndScaY.Ary2D AAACalRegn02Rt05GroupA_Dummy.DampgHwTqX.Ary1D AAACalRegn02Rt05GroupA_Dummy.DampgHwTqY.Ary1D AAACalRegn02Rt05GroupA_Dummy.DampgHydCoeff1ScaY.Ary1D AAACalRegn02Rt05GroupA_Dummy.DampgHydCoeff2ScaY.Ary1D AAACalRegn02Rt05GroupA_Dummy.DampgHydCoeff3ScaY.Ary1D AAACalRegn02Rt05GroupA_Dummy.DampgHydCoeff4ScaY.Ary1D AAACalRegn02Rt05GroupA_Dummy.DampgMotVelX.Ary2D AAACalRegn02Rt05GroupA_Dummy.DampgMotVelY.Ary2D AAACalRegn02Rt05GroupA_Dummy.HysCmpEffLossY.Ary1D AAACalRegn02Rt05GroupA_Dummy.HysCmpEffOffsY.Ary1D AAACalRegn02Rt05GroupA_Dummy.HysCmpFricWhlImbRejctnBlndX.Ary1D AAACalRegn02Rt05GroupA_Dummy.HysCmpFricWhlImbRejctnBlndY.Ary1D AAACalRegn02Rt05GroupA_Dummy.HysCmpFricWhlImbRejctnOffY.Ary1D AAACalRegn02Rt05GroupA_Dummy.HysCmpFricWhlImbRejctnOnY.Ary1D AAACalRegn02Rt05GroupA_Dummy.HysCmpHwTqScaX.Ary2D AAACalRegn02Rt05GroupA_Dummy.HysCmpHwTqScaY.Ary2D AAACalRegn02Rt05GroupA_Dummy.HysCmpHysSatnY.Ary1D AAACalRegn02Rt05GroupA_Dummy.HysCmpNegHysCmpScaX.Ary1D AAACalRegn02Rt05GroupA_Dummy.HysCmpNegHysCmpScaY.Ary1D AAACalRegn02Rt05GroupA_Dummy.HysCmpNegHysCmpX.Ary1D AAACalRegn02Rt05GroupA_Dummy.HysCmpNegHysCmpY.Ary1D AAACalRegn02Rt05GroupA_Dummy.HysCmpOutpLim.Val AAACalRegn02Rt05GroupA_Dummy.HysCmpRevGain.Val AAACalRegn02Rt05GroupA_Dummy.HysCmpRiseX.Ary1D AAACalRegn02Rt05GroupA_Dummy.HysCmpRiseY.Ary1D AAACalRegn02Rt05GroupA_Dummy.InertiaCmpVelAssiBasdDampgStatY.Ary1D AAACalRegn02Rt05GroupA_Dummy.InertiaCmpVelDampgFilFrq.Ary1D AAACalRegn02Rt05GroupA_Dummy.InertiaCmpVelDampgFilFrqWhlImbRejctnOn.Ary1D AAACalRegn02Rt05GroupA_Dummy.InertiaCmpVelDampgSpdBlndY.Ary1D AAACalRegn02Rt05GroupA_Dummy.InertiaCmpVelDampgWhlImbRejctnBlndX.Ary1D AAACalRegn02Rt05GroupA_Dummy.InertiaCmpVelDampgWhlImbRejctnBlndY.Ary1D /end SUB_GROUP
 /begin FUNCTION_LIST /end FUNCTION_LIST
 /begin REF_CHARACTERISTIC /end REF_CHARACTERISTIC
 /begin REF_MEASUREMENT /end REF_MEASUREMENT
/end GROUP
/begin GROUP AAACalRegn02Rt05GroupA_Dummy.DampgHwTqX.Ary1D "MICROSAR RTE" /begin SUB_GROUP /end SUB_GROUP /begin FUNCTION_LIST /end FUNCTION_LIST /begin REF_CHARACTERISTIC AAACalRegn02Rt05GroupA_Dummy.DampgHwTqX.Ary1D /end REF_CHARACTERISTIC /begin REF_MEASUREMENT /end REF_MEASUREMENT /end GROUP
/begin GROUP AAACalRegn02Rt05GroupA_Dummy.DampgHwTqY.Ary1D "MICROSAR RTE" /begin SUB_GROUP /end SUB_GROUP /begin FUNCTION_LIST /end FUNCTION_LIST /begin REF_CHARACTERISTIC AAACalRegn02Rt05GroupA_Dummy.DampgHwTqY.Ary1D /end REF_CHARACTERISTIC /begin REF_MEASUREMENT /end REF_MEASUREMENT /end GROUP
/begin GROUP AAACalRegn02Rt05GroupA_Dummy.DampgHydCoeff1ScaY.Ary1D "MICROSAR RTE" /begin SUB_GROUP /end SUB_GROUP /begin FUNCTION_LIST /end FUNCTION_LIST /begin REF_CHARACTERISTIC AAACalRegn02Rt05GroupA_Dummy.DampgHydCoeff1ScaY.Ary1D /end REF_CHARACTERISTIC /begin REF_MEASUREMENT /end REF_MEASUREMENT /end GROUP
/begin GROUP AAACalRegn02Rt05GroupA_Dummy.DampgHydCoeff2ScaY.Ary1D "MICROSAR RTE" /begin SUB_GROUP /end SUB_GROUP /begin FUNCTION_LIST /end FUNCTION_LIST /begin REF_CHARACTERISTIC AAACalRegn02Rt05GroupA_Dummy.DampgHydCoeff2ScaY.Ary1D /end REF_CHARACTERISTIC /begin REF_MEASUREMENT /end REF_MEASUREMENT /end GROUP
/begin GROUP AAACalRegn02Rt05GroupA_Dummy.DampgHydCoeff3ScaY.Ary1D "MICROSAR RTE" /begin SUB_GROUP /end SUB_GROUP /begin FUNCTION_LIST /end FUNCTION_LIST /begin REF_CHARACTERISTIC AAACalRegn02Rt05GroupA_Dummy.DampgHydCoeff3ScaY.Ary1D /end REF_CHARACTERISTIC /begin REF_MEASUREMENT /end REF_MEASUREMENT /end GROUP
/begin GROUP AAACalRegn02Rt05GroupA_Dummy.DampgHydCoeff4ScaY.Ary1D "MICROSAR RTE" /begin SUB_GROUP /end SUB_GROUP /begin FUNCTION_LIST /end FUNCTION_LIST /begin REF_CHARACTERISTIC AAACalRegn02Rt05GroupA_Dummy.DampgHydCoeff4ScaY.Ary1D /end REF_CHARACTERISTIC /begin REF_MEASUREMENT /end REF_MEASUREMENT /end GROUP
/begin GROUP AAACalRegn02Rt05GroupA_Dummy.DampgMotVelX.Ary2D "MICROSAR RTE" /begin SUB_GROUP /end SUB_GROUP /begin FUNCTION_LIST /end FUNCTION_LIST /begin REF_CHARACTERISTIC AAACalRegn02Rt05GroupA_Dummy.DampgMotVelX.Ary2D /end REF_CHARACTERISTIC /begin REF_MEASUREMENT /end REF_MEASUREMENT /end GROUP
/begin GROUP AAACalRegn02Rt05GroupA_Dummy.DampgMotVelY.Ary2D "MICROSAR RTE" /begin SUB_GROUP /end SUB_GROUP /begin FUNCTION_LIST /end FUNCTION_LIST /begin REF_CHARACTERISTIC AAACalRegn02Rt05GroupA_Dummy.DampgMotVelY.Ary2D /end REF_CHARACTERISTIC /begin REF_MEASUREMENT /end REF_MEASUREMENT /end GROUP
/begin GROUP AAACalRegn02Rt05GroupA_Dummy.HysCmpEffLossY.Ary1D "MICROSAR RTE" /begin SUB_GROUP /end SUB_GROUP /begin FUNCTION_LIST /end FUNCTION_LIST /begin REF_CHARACTERISTIC AAACalRegn02Rt05GroupA_Dummy.HysCmpEffLossY.Ary1D /end REF_CHARACTERISTIC /begin REF_MEASUREMENT /end REF_MEASUREMENT /end GROUP
/begin GROUP AAACalRegn02Rt05GroupA_Dummy.HysCmpEffOffsY.Ary1D "MICROSAR RTE" /begin SUB_GROUP /end SUB_GROUP /begin FUNCTION_LIST /end FUNCTION_LIST /begin REF_CHARACTERISTIC AAACalRegn02Rt05GroupA_Dummy.HysCmpEffOffsY.Ary1D /end REF_CHARACTERISTIC /begin REF_MEASUREMENT /end REF_MEASUREMENT /end GROUP
/begin GROUP AAACalRegn02Rt05GroupA_Dummy.HysCmpFricWhlImbRejctnBlndX.Ary1D "MICROSAR RTE" /begin SUB_GROUP /end SUB_GROUP /begin FUNCTION_LIST /end FUNCTION_LIST
 /begin REF_CHARACTERISTIC AAACalRegn02Rt05GroupA_Dummy.HysCmpFricWhlImbRejctnBlndX.Ary1D /end REF_CHARACTERISTIC
 /begin REF_MEASUREMENT /end REF_MEASUREMENT
/end GROUP
/begin GROUP AAACalRegn02Rt05GroupA_Dummy.HysCmpFricWhlImbRejctnBlndY.Ary1D "MICROSAR RTE" /begin SUB_GROUP /end SUB_GROUP /begin FUNCTION_LIST /end FUNCTION_LIST
 /begin REF_CHARACTERISTIC AAACalRegn02Rt05GroupA_Dummy.HysCmpFricWhlImbRejctnBlndY.Ary1D /end REF_CHARACTERISTIC
 /begin REF_MEASUREMENT /end REF_MEASUREMENT
/end GROUP
/begin GROUP AAACalRegn02Rt05GroupA_Dummy.HysCmpFricWhlImbRejctnOffY.Ary1D "MICROSAR RTE" /begin SUB_GROUP /end SUB_GROUP /begin FUNCTION_LIST /end FUNCTION_LIST
 /begin REF_CHARACTERISTIC AAACalRegn02Rt05GroupA_Dummy.HysCmpFricWhlImbRejctnOffY.Ary1D /end REF_CHARACTERISTIC
 /begin REF_MEASUREMENT /end REF_MEASUREMENT
/end GROUP
/begin GROUP AAACalRegn02Rt05GroupA_Dummy.HysCmpFricWhlImbRejctnOnY.Ary1D "MICROSAR RTE" /begin SUB_GROUP /end SUB_GROUP /begin FUNCTION_LIST /end FUNCTION_LIST
 /begin REF_CHARACTERISTIC AAACalRegn02Rt05GroupA_Dummy.HysCmpFricWhlImbRejctnOnY.Ary1D /end REF_CHARACTERISTIC
 /begin REF_MEASUREMENT /end REF_MEASUREMENT
/end GROUP
/begin GROUP AAACalRegn02Rt05GroupA_Dummy.HysCmpHwTqScaX.Ary2D "MICROSAR RTE" /begin SUB_GROUP /end SUB_GROUP /begin FUNCTION_LIST /end FUNCTION_LIST /begin REF_CHARACTERISTIC AAACalRegn02Rt05GroupA_Dummy.HysCmpHwTqScaX.Ary2D /end REF_CHARACTERISTIC /begin REF_MEASUREMENT /end REF_MEASUREMENT /end GROUP
/begin GROUP AAACalRegn02Rt05GroupA_Dummy.HysCmpHwTqScaY.Ary2D "MICROSAR RTE" /begin SUB_GROUP /end SUB_GROUP /begin FUNCTION_LIST /end FUNCTION_LIST /begin REF_CHARACTERISTIC AAACalRegn02Rt05GroupA_Dummy.HysCmpHwTqScaY.Ary2D /end REF_CHARACTERISTIC /begin REF_MEASUREMENT /end REF_MEASUREMENT /end GROUP
/begin GROUP AAACalRegn02Rt05GroupA_Dummy.HysCmpHysSatnY.Ary1D "MICROSAR RTE" /begin SUB_GROUP /end SUB_GROUP /begin FUNCTION_LIST /end FUNCTION_LIST /begin REF_CHARACTERISTIC AAACalRegn02Rt05GroupA_Dummy.HysCmpHysSatnY.Ary1D /end REF_CHARACTERISTIC /begin REF_MEASUREMENT /end REF_MEASUREMENT /end GROUP
/begin GROUP AAACalRegn02Rt05GroupA_Dummy.HysCmpNegHysCmpScaX.Ary1D "MICROSAR RTE" /begin SUB_GROUP /end SUB_GROUP /begin FUNCTION_LIST /end FUNCTION_LIST /begin REF_CHARACTERISTIC AAACalRegn02Rt05GroupA_Dummy.HysCmpNegHysCmpScaX.Ary1D /end REF_CHARACTERISTIC /begin REF_MEASUREMENT /end REF_MEASUREMENT /end GROUP
/begin GROUP AAACalRegn02Rt05GroupA_Dummy.HysCmpNegHysCmpScaY.Ary1D "MICROSAR RTE" /begin SUB_GROUP /end SUB_GROUP /begin FUNCTION_LIST /end FUNCTION_LIST /begin REF_CHARACTERISTIC AAACalRegn02Rt05GroupA_Dummy.HysCmpNegHysCmpScaY.Ary1D /end REF_CHARACTERISTIC /begin REF_MEASUREMENT /end REF_MEASUREMENT /end GROUP
/begin GROUP AAACalRegn02Rt05GroupA_Dummy.HysCmpNegHysCmpX.Ary1D "MICROSAR RTE" /begin SUB_GROUP /end SUB_GROUP /begin FUNCTION_LIST /end FUNCTION_LIST /begin REF_CHARACTERISTIC AAACalRegn02Rt05GroupA_Dummy.HysCmpNegHysCmpX.Ary1D /end REF_CHARACTERISTIC /begin REF_MEASUREMENT /end REF_MEASUREMENT /end GROUP
/begin GROUP AAACalRegn02Rt05GroupA_Dummy.HysCmpNegHysCmpY.Ary1D "MICROSAR RTE" /begin SUB_GROUP /end SUB_GROUP /begin FUNCTION_LIST /end FUNCTION_LIST /begin REF_CHARACTERISTIC AAACalRegn02Rt05GroupA_Dummy.HysCmpNegHysCmpY.Ary1D /end REF_CHARACTERISTIC /begin REF_MEASUREMENT /end REF_MEASUREMENT /end GROUP
/begin GROUP AAACalRegn02Rt05GroupA_Dummy.HysCmpOutpLim.Val "MICROSAR RTE" /begin SUB_GROUP /end SUB_GROUP /begin FUNCTION_LIST /end FUNCTION_LIST /begin REF_CHARACTERISTIC AAACalRegn02Rt05GroupA_Dummy.HysCmpOutpLim.Val /end REF_CHARACTERISTIC /begin REF_MEASUREMENT /end REF_MEASUREMENT /end GROUP
/begin GROUP AAACalRegn02Rt05GroupA_Dummy.HysCmpRevGain.Val "MICROSAR RTE" /begin SUB_GROUP /end SUB_GROUP /begin FUNCTION_LIST /end FUNCTION_LIST /begin REF_CHARACTERISTIC AAACalRegn02Rt05GroupA_Dummy.HysCmpRevGain.Val /end REF_CHARACTERISTIC /begin REF_MEASUREMENT /end REF_MEASUREMENT /end GROUP
/begin GROUP AAACalRegn02Rt05GroupA_Dummy.HysCmpRiseX.Ary1D "MICROSAR RTE" /begin SUB_GROUP /end SUB_GROUP /begin FUNCTION_LIST /end FUNCTION_LIST /begin REF_CHARACTERISTIC AAACalRegn02Rt05GroupA_Dummy.HysCmpRiseX.Ary1D /end REF_CHARACTERISTIC /begin REF_MEASUREMENT /end REF_MEASUREMENT /end GROUP
/begin GROUP AAACalRegn02Rt05GroupA_Dummy.HysCmpRiseY.Ary1D "MICROSAR RTE" /begin SUB_GROUP /end SUB_GROUP /begin FUNCTION_LIST /end FUNCTION_LIST /begin REF_CHARACTERISTIC AAACalRegn02Rt05GroupA_Dummy.HysCmpRiseY.Ary1D /end REF_CHARACTERISTIC /begin REF_MEASUREMENT /end REF_MEASUREMENT /end GROUP
/begin GROUP AAACalRegn02Rt05GroupA_Dummy.InertiaCmpVelAssiBasdDampgStatY.Ary1D "MICROSAR RTE" /begin SUB_GROUP /end SUB_GROUP /begin FUNCTION_LIST /end FUNCTION_LIST
 /begin REF_CHARACTERISTIC AAACalRegn02Rt05GroupA_Dummy.InertiaCmpVelAssiBasdDampgStatY.Ary1D /end REF_CHARACTERISTIC
 /begin REF_MEASUREMENT /end REF_MEASUREMENT
/end GROUP
/begin GROUP AAACalRegn02Rt05GroupA_Dummy.InertiaCmpVelDampgFilFrq.Ary1D "MICROSAR RTE" /begin SUB_GROUP /end SUB_GROUP /begin FUNCTION_LIST /end FUNCTION_LIST
 /begin REF_CHARACTERISTIC AAACalRegn02Rt05GroupA_Dummy.InertiaCmpVelDampgFilFrq.Ary1D /end REF_CHARACTERISTIC
 /begin REF_MEASUREMENT /end REF_MEASUREMENT
/end GROUP
/begin GROUP AAACalRegn02Rt05GroupA_Dummy.InertiaCmpVelDampgFilFrqWhlImbRejctnOn.Ary1D "MICROSAR RTE" /begin SUB_GROUP /end SUB_GROUP /begin FUNCTION_LIST /end FUNCTION_LIST
 /begin REF_CHARACTERISTIC AAACalRegn02Rt05GroupA_Dummy.InertiaCmpVelDampgFilFrqWhlImbRejctnOn.Ary1D /end REF_CHARACTERISTIC
 /begin REF_MEASUREMENT /end REF_MEASUREMENT
/end GROUP
/begin GROUP AAACalRegn02Rt05GroupA_Dummy.InertiaCmpVelDampgSpdBlndY.Ary1D "MICROSAR RTE" /begin SUB_GROUP /end SUB_GROUP /begin FUNCTION_LIST /end FUNCTION_LIST
 /begin REF_CHARACTERISTIC AAACalRegn02Rt05GroupA_Dummy.InertiaCmpVelDampgSpdBlndY.Ary1D /end REF_CHARACTERISTIC
 /begin REF_MEASUREMENT /end REF_MEASUREMENT
/end GROUP
/begin GROUP AAACalRegn02Rt05GroupA_Dummy.InertiaCmpVelDampgWhlImbRejctnBlndX.Ary1D "MICROSAR RTE" /begin SUB_GROUP /end SUB_GROUP /begin FUNCTION_LIST /end FUNCTION_LIST
 /begin REF_CHARACTERISTIC AAACalRegn02Rt05GroupA_Dummy.InertiaCmpVelDampgWhlImbRejctnBlndX.Ary1D /end REF_CHARACTERISTIC
 /begin REF_MEASUREMENT /end REF_MEASUREMENT
/end GROUP
/begin GROUP AAACalRegn02Rt05GroupA_Dummy.InertiaCmpVelDampgWhlImbRejctnBlndY.Ary1D "MICROSAR RTE" /begin SUB_GROUP /end SUB_GROUP /begin FUNCTION_LIST /end FUNCTION_LIST
 /begin REF_CHARACTERISTIC AAACalRegn02Rt05GroupA_Dummy.InertiaCmpVelDampgWhlImbRejctnBlndY.Ary1D /end REF_CHARACTERISTIC
 /begin REF_MEASUREMENT /end REF_MEASUREMENT
/end GROUP
/begin GROUP AAACalRegn02Rt05GroupB_Dummy "MICROSAR RTE" /begin SUB_GROUP AAACalRegn02Rt05GroupB_Dummy.CalibrationPorts /end SUB_GROUP /begin FUNCTION_LIST /end FUNCTION_LIST /begin REF_CHARACTERISTIC /end REF_CHARACTERISTIC /begin REF_MEASUREMENT /end REF_MEASUREMENT /end GROUP
/begin GROUP AAACalRegn02Rt05GroupB_Dummy.CalibrationPorts "MICROSAR RTE"
 /begin SUB_GROUP AAACalRegn02Rt05GroupB_Dummy.EotProtnDampgVehSpdTbl.Ary1D AAACalRegn02Rt05GroupB_Dummy.EotProtnDeltaTqThd.Val AAACalRegn02Rt05GroupB_Dummy.EotProtnEntrGainVehSpdTbl.Ary1D AAACalRegn02Rt05GroupB_Dummy.EotProtnEntrGainY.Ary2D AAACalRegn02Rt05GroupB_Dummy.EotProtnLoAuthyEntrGainY.Ary2D AAACalRegn02Rt05GroupB_Dummy.EotProtnMotSpdIncptY.Ary1D AAACalRegn02Rt05GroupB_Dummy.EotProtnNormDampgY.Ary2D AAACalRegn02Rt05GroupB_Dummy.EotProtnSoftEndStopAuthyThd.Val AAACalRegn02Rt05GroupB_Dummy.RtnHwAgOffsCalcdX.Ary2D AAACalRegn02Rt05GroupB_Dummy.RtnHwAgOffsCalcdY.Ary2D AAACalRegn02Rt05GroupB_Dummy.RtnScaTqX.Ary2D AAACalRegn02Rt05GroupB_Dummy.RtnScaTqY.Ary2D AAACalRegn02Rt05GroupB_Dummy.RtnScaVelX.Ary2D AAACalRegn02Rt05GroupB_Dummy.RtnScaVelY.Ary2D AAACalRegn02Rt05GroupB_Dummy.RtnVehSpdSeln.Ary1D /end SUB_GROUP
 /begin FUNCTION_LIST /end FUNCTION_LIST
 /begin REF_CHARACTERISTIC /end REF_CHARACTERISTIC
 /begin REF_MEASUREMENT /end REF_MEASUREMENT
/end GROUP
/begin GROUP AAACalRegn02Rt05GroupB_Dummy.EotProtnDampgVehSpdTbl.Ary1D "MICROSAR RTE" /begin SUB_GROUP /end SUB_GROUP /begin FUNCTION_LIST /end FUNCTION_LIST /begin REF_CHARACTERISTIC AAACalRegn02Rt05GroupB_Dummy.EotProtnDampgVehSpdTbl.Ary1D /end REF_CHARACTERISTIC /begin REF_MEASUREMENT /end REF_MEASUREMENT /end GROUP
/begin GROUP AAACalRegn02Rt05GroupB_Dummy.EotProtnDeltaTqThd.Val "MICROSAR RTE" /begin SUB_GROUP /end SUB_GROUP /begin FUNCTION_LIST /end FUNCTION_LIST /begin REF_CHARACTERISTIC AAACalRegn02Rt05GroupB_Dummy.EotProtnDeltaTqThd.Val /end REF_CHARACTERISTIC /begin REF_MEASUREMENT /end REF_MEASUREMENT /end GROUP
/begin GROUP AAACalRegn02Rt05GroupB_Dummy.EotProtnEntrGainVehSpdTbl.Ary1D "MICROSAR RTE" /begin SUB_GROUP /end SUB_GROUP /begin FUNCTION_LIST /end FUNCTION_LIST
 /begin REF_CHARACTERISTIC AAACalRegn02Rt05GroupB_Dummy.EotProtnEntrGainVehSpdTbl.Ary1D /end REF_CHARACTERISTIC
 /begin REF_MEASUREMENT /end REF_MEASUREMENT
/end GROUP
/begin GROUP AAACalRegn02Rt05GroupB_Dummy.EotProtnEntrGainY.Ary2D "MICROSAR RTE" /begin SUB_GROUP /end SUB_GROUP /begin FUNCTION_LIST /end FUNCTION_LIST /begin REF_CHARACTERISTIC AAACalRegn02Rt05GroupB_Dummy.EotProtnEntrGainY.Ary2D /end REF_CHARACTERISTIC /begin REF_MEASUREMENT /end REF_MEASUREMENT /end GROUP
/begin GROUP AAACalRegn02Rt05GroupB_Dummy.EotProtnLoAuthyEntrGainY.Ary2D "MICROSAR RTE" /begin SUB_GROUP /end SUB_GROUP /begin FUNCTION_LIST /end FUNCTION_LIST
 /begin REF_CHARACTERISTIC AAACalRegn02Rt05GroupB_Dummy.EotProtnLoAuthyEntrGainY.Ary2D /end REF_CHARACTERISTIC
 /begin REF_MEASUREMENT /end REF_MEASUREMENT
/end GROUP
/begin GROUP AAACalRegn02Rt05GroupB_Dummy.EotProtnMotSpdIncptY.Ary1D "MICROSAR RTE" /begin SUB_GROUP /end SUB_GROUP /begin FUNCTION_LIST /end FUNCTION_LIST /begin REF_CHARACTERISTIC AAACalRegn02Rt05GroupB_Dummy.EotProtnMotSpdIncptY.Ary1D /end REF_CHARACTERISTIC /begin REF_MEASUREMENT /end REF_MEASUREMENT /end GROUP
/begin GROUP AAACalRegn02Rt05GroupB_Dummy.EotProtnNormDampgY.Ary2D "MICROSAR RTE" /begin SUB_GROUP /end SUB_GROUP /begin FUNCTION_LIST /end FUNCTION_LIST /begin REF_CHARACTERISTIC AAACalRegn02Rt05GroupB_Dummy.EotProtnNormDampgY.Ary2D /end REF_CHARACTERISTIC /begin REF_MEASUREMENT /end REF_MEASUREMENT /end GROUP
/begin GROUP AAACalRegn02Rt05GroupB_Dummy.EotProtnSoftEndStopAuthyThd.Val "MICROSAR RTE" /begin SUB_GROUP /end SUB_GROUP /begin FUNCTION_LIST /end FUNCTION_LIST
 /begin REF_CHARACTERISTIC AAACalRegn02Rt05GroupB_Dummy.EotProtnSoftEndStopAuthyThd.Val /end REF_CHARACTERISTIC
 /begin REF_MEASUREMENT /end REF_MEASUREMENT
/end GROUP
/begin GROUP AAACalRegn02Rt05GroupB_Dummy.RtnHwAgOffsCalcdX.Ary2D "MICROSAR RTE" /begin SUB_GROUP /end SUB_GROUP /begin FUNCTION_LIST /end FUNCTION_LIST /begin REF_CHARACTERISTIC AAACalRegn02Rt05GroupB_Dummy.RtnHwAgOffsCalcdX.Ary2D /end REF_CHARACTERISTIC /begin REF_MEASUREMENT /end REF_MEASUREMENT /end GROUP
/begin GROUP AAACalRegn02Rt05GroupB_Dummy.RtnHwAgOffsCalcdY.Ary2D "MICROSAR RTE" /begin SUB_GROUP /end SUB_GROUP /begin FUNCTION_LIST /end FUNCTION_LIST /begin REF_CHARACTERISTIC AAACalRegn02Rt05GroupB_Dummy.RtnHwAgOffsCalcdY.Ary2D /end REF_CHARACTERISTIC /begin REF_MEASUREMENT /end REF_MEASUREMENT /end GROUP
/begin GROUP AAACalRegn02Rt05GroupB_Dummy.RtnScaTqX.Ary2D "MICROSAR RTE" /begin SUB_GROUP /end SUB_GROUP /begin FUNCTION_LIST /end FUNCTION_LIST /begin REF_CHARACTERISTIC AAACalRegn02Rt05GroupB_Dummy.RtnScaTqX.Ary2D /end REF_CHARACTERISTIC /begin REF_MEASUREMENT /end REF_MEASUREMENT /end GROUP
/begin GROUP AAACalRegn02Rt05GroupB_Dummy.RtnScaTqY.Ary2D "MICROSAR RTE" /begin SUB_GROUP /end SUB_GROUP /begin FUNCTION_LIST /end FUNCTION_LIST /begin REF_CHARACTERISTIC AAACalRegn02Rt05GroupB_Dummy.RtnScaTqY.Ary2D /end REF_CHARACTERISTIC /begin REF_MEASUREMENT /end REF_MEASUREMENT /end GROUP
/begin GROUP AAACalRegn02Rt05GroupB_Dummy.RtnScaVelX.Ary2D "MICROSAR RTE" /begin SUB_GROUP /end SUB_GROUP /begin FUNCTION_LIST /end FUNCTION_LIST /begin REF_CHARACTERISTIC AAACalRegn02Rt05GroupB_Dummy.RtnScaVelX.Ary2D /end REF_CHARACTERISTIC /begin REF_MEASUREMENT /end REF_MEASUREMENT /end GROUP
/begin GROUP AAACalRegn02Rt05GroupB_Dummy.RtnScaVelY.Ary2D "MICROSAR RTE" /begin SUB_GROUP /end SUB_GROUP /begin FUNCTION_LIST /end FUNCTION_LIST /begin REF_CHARACTERISTIC AAACalRegn02Rt05GroupB_Dummy.RtnScaVelY.Ary2D /end REF_CHARACTERISTIC /begin REF_MEASUREMENT /end REF_MEASUREMENT /end GROUP
/begin GROUP AAACalRegn02Rt05GroupB_Dummy.RtnVehSpdSeln.Ary1D "MICROSAR RTE" /begin SUB_GROUP /end SUB_GROUP /begin FUNCTION_LIST /end FUNCTION_LIST /begin REF_CHARACTERISTIC AAACalRegn02Rt05GroupB_Dummy.RtnVehSpdSeln.Ary1D /end REF_CHARACTERISTIC /begin REF_MEASUREMENT /end REF_MEASUREMENT /end GROUP
/begin GROUP Adcf1CfgAndUse "MICROSAR RTE"
 /begin SUB_GROUP Adcf1CfgAndUse.PerInstanceMemories Adcf1CfgAndUse.ReceiverPorts /end SUB_GROUP
 /begin FUNCTION_LIST /end FUNCTION_LIST
 /begin REF_CHARACTERISTIC /end REF_CHARACTERISTIC
 /begin REF_MEASUREMENT /end REF_MEASUREMENT
/end GROUP
/begin GROUP Adcf1CfgAndUse.AdcDiagcEndPtrOutp.Val "MICROSAR RTE" /begin SUB_GROUP /end SUB_GROUP /begin FUNCTION_LIST /end FUNCTION_LIST /begin REF_CHARACTERISTIC /end REF_CHARACTERISTIC /begin REF_MEASUREMENT Adcf1CfgAndUse.AdcDiagcEndPtrOutp.Val /end REF_MEASUREMENT /end GROUP
/begin GROUP Adcf1CfgAndUse.AdcDiagcStrtPtrOutp.Val "MICROSAR RTE" /begin SUB_GROUP /end SUB_GROUP /begin FUNCTION_LIST /end FUNCTION_LIST /begin REF_CHARACTERISTIC /end REF_CHARACTERISTIC /begin REF_MEASUREMENT Adcf1CfgAndUse.AdcDiagcStrtPtrOutp.Val /end REF_MEASUREMENT /end GROUP
/begin GROUP Adcf1CfgAndUse.Adcf1DiagcEndPtr "MICROSAR RTE" /begin SUB_GROUP /end SUB_GROUP /begin FUNCTION_LIST /end FUNCTION_LIST /begin REF_CHARACTERISTIC /end REF_CHARACTERISTIC /begin REF_MEASUREMENT Adcf1CfgAndUse.Adcf1DiagcEndPtr /end REF_MEASUREMENT /end GROUP
/begin GROUP Adcf1CfgAndUse.Adcf1DiagcStrtPtr "MICROSAR RTE" /begin SUB_GROUP /end SUB_GROUP /begin FUNCTION_LIST /end FUNCTION_LIST /begin REF_CHARACTERISTIC /end REF_CHARACTERISTIC /begin REF_MEASUREMENT Adcf1CfgAndUse.Adcf1DiagcStrtPtr /end REF_MEASUREMENT /end GROUP
/begin GROUP Adcf1CfgAndUse.PerInstanceMemories "MICROSAR RTE"
 /begin SUB_GROUP Adcf1CfgAndUse.Adcf1DiagcEndPtr Adcf1CfgAndUse.Adcf1DiagcStrtPtr /end SUB_GROUP
 /begin FUNCTION_LIST /end FUNCTION_LIST
 /begin REF_CHARACTERISTIC /end REF_CHARACTERISTIC
 /begin REF_MEASUREMENT /end REF_MEASUREMENT
/end GROUP
/begin GROUP Adcf1CfgAndUse.ReceiverPorts "MICROSAR RTE"
 /begin SUB_GROUP Adcf1CfgAndUse.AdcDiagcEndPtrOutp.Val Adcf1CfgAndUse.AdcDiagcStrtPtrOutp.Val /end SUB_GROUP
 /begin FUNCTION_LIST /end FUNCTION_LIST
 /begin REF_CHARACTERISTIC /end REF_CHARACTERISTIC
 /begin REF_MEASUREMENT /end REF_MEASUREMENT
/end GROUP
/begin GROUP Assi "MICROSAR RTE"
 /begin SUB_GROUP Assi.CalibrationPorts Assi.PerInstanceMemories Assi.ReceiverPorts Assi.SenderPorts /end SUB_GROUP
 /begin FUNCTION_LIST /end FUNCTION_LIST
 /begin REF_CHARACTERISTIC /end REF_CHARACTERISTIC
 /begin REF_MEASUREMENT /end REF_MEASUREMENT
/end GROUP
/begin GROUP Assi.AssiCmdBas.Val "MICROSAR RTE" /begin SUB_GROUP /end SUB_GROUP /begin FUNCTION_LIST /end FUNCTION_LIST /begin REF_CHARACTERISTIC /end REF_CHARACTERISTIC /begin REF_MEASUREMENT Assi.AssiCmdBas.Val /end REF_MEASUREMENT /end GROUP
/begin GROUP Assi.AssiCmdBasSca.Val "MICROSAR RTE" /begin SUB_GROUP /end SUB_GROUP /begin FUNCTION_LIST /end FUNCTION_LIST /begin REF_CHARACTERISTIC /end REF_CHARACTERISTIC /begin REF_MEASUREMENT Assi.AssiCmdBasSca.Val /end REF_MEASUREMENT /end GROUP
/begin GROUP Assi.AssiLnrGain.Val "MICROSAR RTE" /begin SUB_GROUP /end SUB_GROUP /begin FUNCTION_LIST /end FUNCTION_LIST /begin REF_CHARACTERISTIC /end REF_CHARACTERISTIC /begin REF_MEASUREMENT Assi.AssiLnrGain.Val /end REF_MEASUREMENT /end GROUP
/begin GROUP Assi.AssiLnrGainEna.Logl "MICROSAR RTE" /begin SUB_GROUP /end SUB_GROUP /begin FUNCTION_LIST /end FUNCTION_LIST /begin REF_CHARACTERISTIC /end REF_CHARACTERISTIC /begin REF_MEASUREMENT Assi.AssiLnrGainEna.Logl /end REF_MEASUREMENT /end GROUP
/begin GROUP Assi.AssiMotTqWhlImbRejctnMaxX.Ary2D "MICROSAR RTE" /begin SUB_GROUP /end SUB_GROUP /begin FUNCTION_LIST /end FUNCTION_LIST /begin REF_CHARACTERISTIC Assi.AssiMotTqWhlImbRejctnMaxX.Ary2D /end REF_CHARACTERISTIC /begin REF_MEASUREMENT /end REF_MEASUREMENT /end GROUP
/begin GROUP Assi.AssiMotTqWhlImbRejctnMaxY.Ary2D "MICROSAR RTE" /begin SUB_GROUP /end SUB_GROUP /begin FUNCTION_LIST /end FUNCTION_LIST /begin REF_CHARACTERISTIC Assi.AssiMotTqWhlImbRejctnMaxY.Ary2D /end REF_CHARACTERISTIC /begin REF_MEASUREMENT /end REF_MEASUREMENT /end GROUP
/begin GROUP Assi.AssiMotTqWhlImbRejctnMinX.Ary2D "MICROSAR RTE" /begin SUB_GROUP /end SUB_GROUP /begin FUNCTION_LIST /end FUNCTION_LIST /begin REF_CHARACTERISTIC Assi.AssiMotTqWhlImbRejctnMinX.Ary2D /end REF_CHARACTERISTIC /begin REF_MEASUREMENT /end REF_MEASUREMENT /end GROUP
/begin GROUP Assi.AssiMotTqWhlImbRejctnMinY.Ary2D "MICROSAR RTE" /begin SUB_GROUP /end SUB_GROUP /begin FUNCTION_LIST /end FUNCTION_LIST /begin REF_CHARACTERISTIC Assi.AssiMotTqWhlImbRejctnMinY.Ary2D /end REF_CHARACTERISTIC /begin REF_MEASUREMENT /end REF_MEASUREMENT /end GROUP
/begin GROUP Assi.AssiThermScaX.Ary1D "MICROSAR RTE" /begin SUB_GROUP /end SUB_GROUP /begin FUNCTION_LIST /end FUNCTION_LIST /begin REF_CHARACTERISTIC Assi.AssiThermScaX.Ary1D /end REF_CHARACTERISTIC /begin REF_MEASUREMENT /end REF_MEASUREMENT /end GROUP
/begin GROUP Assi.AssiThermScaY.Ary1D "MICROSAR RTE" /begin SUB_GROUP /end SUB_GROUP /begin FUNCTION_LIST /end FUNCTION_LIST /begin REF_CHARACTERISTIC Assi.AssiThermScaY.Ary1D /end REF_CHARACTERISTIC /begin REF_MEASUREMENT /end REF_MEASUREMENT /end GROUP
/begin GROUP Assi.AssiWhlImbRejctnBlndScaX.Ary2D "MICROSAR RTE" /begin SUB_GROUP /end SUB_GROUP /begin FUNCTION_LIST /end FUNCTION_LIST /begin REF_CHARACTERISTIC Assi.AssiWhlImbRejctnBlndScaX.Ary2D /end REF_CHARACTERISTIC /begin REF_MEASUREMENT /end REF_MEASUREMENT /end GROUP
/begin GROUP Assi.AssiWhlImbRejctnBlndScaY.Ary2D "MICROSAR RTE" /begin SUB_GROUP /end SUB_GROUP /begin FUNCTION_LIST /end FUNCTION_LIST /begin REF_CHARACTERISTIC Assi.AssiWhlImbRejctnBlndScaY.Ary2D /end REF_CHARACTERISTIC /begin REF_MEASUREMENT /end REF_MEASUREMENT /end GROUP
/begin GROUP Assi.CalibrationPorts "MICROSAR RTE"
 /begin SUB_GROUP Assi.AssiMotTqWhlImbRejctnMaxX.Ary2D Assi.AssiMotTqWhlImbRejctnMaxY.Ary2D Assi.AssiMotTqWhlImbRejctnMinX.Ary2D Assi.AssiMotTqWhlImbRejctnMinY.Ary2D Assi.AssiThermScaX.Ary1D Assi.AssiThermScaY.Ary1D Assi.AssiWhlImbRejctnBlndScaX.Ary2D Assi.AssiWhlImbRejctnBlndScaY.Ary2D Assi.SysGlbPrmVehSpdBilnrSeln.Ary1D /end SUB_GROUP
 /begin FUNCTION_LIST /end FUNCTION_LIST
 /begin REF_CHARACTERISTIC /end REF_CHARACTERISTIC
 /begin REF_MEASUREMENT /end REF_MEASUREMENT
/end GROUP
/begin GROUP Assi.HwTq.Val "MICROSAR RTE" /begin SUB_GROUP /end SUB_GROUP /begin FUNCTION_LIST /end FUNCTION_LIST /begin REF_CHARACTERISTIC /end REF_CHARACTERISTIC /begin REF_MEASUREMENT Assi.HwTq.Val /end REF_MEASUREMENT /end GROUP
/begin GROUP Assi.HwTqHysOvrl.Val "MICROSAR RTE" /begin SUB_GROUP /end SUB_GROUP /begin FUNCTION_LIST /end FUNCTION_LIST /begin REF_CHARACTERISTIC /end REF_CHARACTERISTIC /begin REF_MEASUREMENT Assi.HwTqHysOvrl.Val /end REF_MEASUREMENT /end GROUP
/begin GROUP Assi.HwTqOvrl.Val "MICROSAR RTE" /begin SUB_GROUP /end SUB_GROUP /begin FUNCTION_LIST /end FUNCTION_LIST /begin REF_CHARACTERISTIC /end REF_CHARACTERISTIC /begin REF_MEASUREMENT Assi.HwTqOvrl.Val /end REF_MEASUREMENT /end GROUP
/begin GROUP Assi.PerInstanceMemories "MICROSAR RTE" /begin SUB_GROUP Assi.dAssiThermAssiSca Assi.dAssiWhlImbRejctnBlnd /end SUB_GROUP /begin FUNCTION_LIST /end FUNCTION_LIST /begin REF_CHARACTERISTIC /end REF_CHARACTERISTIC /begin REF_MEASUREMENT /end REF_MEASUREMENT /end GROUP
/begin GROUP Assi.ReceiverPorts "MICROSAR RTE"
 /begin SUB_GROUP Assi.AssiCmdBasSca.Val Assi.AssiLnrGain.Val Assi.AssiLnrGainEna.Logl Assi.HwTq.Val Assi.HwTqHysOvrl.Val Assi.HwTqOvrl.Val Assi.ThermLimSlowFilMax.Val Assi.VehSpd.Val Assi.WhlImbRejctnAmp.Val /end SUB_GROUP
 /begin FUNCTION_LIST /end FUNCTION_LIST
 /begin REF_CHARACTERISTIC /end REF_CHARACTERISTIC
 /begin REF_MEASUREMENT /end REF_MEASUREMENT
/end GROUP
/begin GROUP Assi.SenderPorts "MICROSAR RTE" /begin SUB_GROUP Assi.AssiCmdBas.Val /end SUB_GROUP /begin FUNCTION_LIST /end FUNCTION_LIST /begin REF_CHARACTERISTIC /end REF_CHARACTERISTIC /begin REF_MEASUREMENT /end REF_MEASUREMENT /end GROUP
/begin GROUP Assi.SysGlbPrmVehSpdBilnrSeln.Ary1D "MICROSAR RTE" /begin SUB_GROUP /end SUB_GROUP /begin FUNCTION_LIST /end FUNCTION_LIST /begin REF_CHARACTERISTIC Assi.SysGlbPrmVehSpdBilnrSeln.Ary1D /end REF_CHARACTERISTIC /begin REF_MEASUREMENT /end REF_MEASUREMENT /end GROUP
/begin GROUP Assi.ThermLimSlowFilMax.Val "MICROSAR RTE" /begin SUB_GROUP /end SUB_GROUP /begin FUNCTION_LIST /end FUNCTION_LIST /begin REF_CHARACTERISTIC /end REF_CHARACTERISTIC /begin REF_MEASUREMENT Assi.ThermLimSlowFilMax.Val /end REF_MEASUREMENT /end GROUP
/begin GROUP Assi.VehSpd.Val "MICROSAR RTE" /begin SUB_GROUP /end SUB_GROUP /begin FUNCTION_LIST /end FUNCTION_LIST /begin REF_CHARACTERISTIC /end REF_CHARACTERISTIC /begin REF_MEASUREMENT Assi.VehSpd.Val /end REF_MEASUREMENT /end GROUP
/begin GROUP Assi.WhlImbRejctnAmp.Val "MICROSAR RTE" /begin SUB_GROUP /end SUB_GROUP /begin FUNCTION_LIST /end FUNCTION_LIST /begin REF_CHARACTERISTIC /end REF_CHARACTERISTIC /begin REF_MEASUREMENT Assi.WhlImbRejctnAmp.Val /end REF_MEASUREMENT /end GROUP
/begin GROUP Assi.dAssiThermAssiSca "MICROSAR RTE" /begin SUB_GROUP /end SUB_GROUP /begin FUNCTION_LIST /end FUNCTION_LIST /begin REF_CHARACTERISTIC /end REF_CHARACTERISTIC /begin REF_MEASUREMENT Assi.dAssiThermAssiSca /end REF_MEASUREMENT /end GROUP
/begin GROUP Assi.dAssiWhlImbRejctnBlnd "MICROSAR RTE" /begin SUB_GROUP /end SUB_GROUP /begin FUNCTION_LIST /end FUNCTION_LIST /begin REF_CHARACTERISTIC /end REF_CHARACTERISTIC /begin REF_MEASUREMENT Assi.dAssiWhlImbRejctnBlnd /end REF_MEASUREMENT /end GROUP
/begin GROUP AssiHiFrq "MICROSAR RTE"
 /begin SUB_GROUP AssiHiFrq.CalibrationPorts AssiHiFrq.PerInstanceMemories AssiHiFrq.ReceiverPorts AssiHiFrq.SenderPorts /end SUB_GROUP
 /begin FUNCTION_LIST /end FUNCTION_LIST
 /begin REF_CHARACTERISTIC /end REF_CHARACTERISTIC
 /begin REF_MEASUREMENT /end REF_MEASUREMENT
/end GROUP
/begin GROUP AssiHiFrq.AssiHiFrqCmd.Val "MICROSAR RTE" /begin SUB_GROUP /end SUB_GROUP /begin FUNCTION_LIST /end FUNCTION_LIST /begin REF_CHARACTERISTIC /end REF_CHARACTERISTIC /begin REF_MEASUREMENT AssiHiFrq.AssiHiFrqCmd.Val /end REF_MEASUREMENT /end GROUP
/begin GROUP AssiHiFrq.AssiHiFrqGainY.Ary2D "MICROSAR RTE" /begin SUB_GROUP /end SUB_GROUP /begin FUNCTION_LIST /end FUNCTION_LIST /begin REF_CHARACTERISTIC AssiHiFrq.AssiHiFrqGainY.Ary2D /end REF_CHARACTERISTIC /begin REF_MEASUREMENT /end REF_MEASUREMENT /end GROUP
/begin GROUP AssiHiFrq.AssiHiFrqHpFilFrq.Val "MICROSAR RTE" /begin SUB_GROUP /end SUB_GROUP /begin FUNCTION_LIST /end FUNCTION_LIST /begin REF_CHARACTERISTIC AssiHiFrq.AssiHiFrqHpFilFrq.Val /end REF_CHARACTERISTIC /begin REF_MEASUREMENT /end REF_MEASUREMENT /end GROUP
/begin GROUP AssiHiFrq.AssiHiFrqHpFilFrqY.Ary1D "MICROSAR RTE" /begin SUB_GROUP /end SUB_GROUP /begin FUNCTION_LIST /end FUNCTION_LIST /begin REF_CHARACTERISTIC AssiHiFrq.AssiHiFrqHpFilFrqY.Ary1D /end REF_CHARACTERISTIC /begin REF_MEASUREMENT /end REF_MEASUREMENT /end GROUP
/begin GROUP AssiHiFrq.AssiHiFrqTqWhlImbRejctnTqX.Ary2D "MICROSAR RTE" /begin SUB_GROUP /end SUB_GROUP /begin FUNCTION_LIST /end FUNCTION_LIST /begin REF_CHARACTERISTIC AssiHiFrq.AssiHiFrqTqWhlImbRejctnTqX.Ary2D /end REF_CHARACTERISTIC /begin REF_MEASUREMENT /end REF_MEASUREMENT /end GROUP
/begin GROUP AssiHiFrq.AssiHiFrqTqX.Ary2D "MICROSAR RTE" /begin SUB_GROUP /end SUB_GROUP /begin FUNCTION_LIST /end FUNCTION_LIST /begin REF_CHARACTERISTIC AssiHiFrq.AssiHiFrqTqX.Ary2D /end REF_CHARACTERISTIC /begin REF_MEASUREMENT /end REF_MEASUREMENT /end GROUP
/begin GROUP AssiHiFrq.AssiHiFrqWhlImbRejctnBlndX.Ary2D "MICROSAR RTE" /begin SUB_GROUP /end SUB_GROUP /begin FUNCTION_LIST /end FUNCTION_LIST /begin REF_CHARACTERISTIC AssiHiFrq.AssiHiFrqWhlImbRejctnBlndX.Ary2D /end REF_CHARACTERISTIC /begin REF_MEASUREMENT /end REF_MEASUREMENT /end GROUP
/begin GROUP AssiHiFrq.AssiHiFrqWhlImbRejctnBlndY.Ary2D "MICROSAR RTE" /begin SUB_GROUP /end SUB_GROUP /begin FUNCTION_LIST /end FUNCTION_LIST /begin REF_CHARACTERISTIC AssiHiFrq.AssiHiFrqWhlImbRejctnBlndY.Ary2D /end REF_CHARACTERISTIC /begin REF_MEASUREMENT /end REF_MEASUREMENT /end GROUP
/begin GROUP AssiHiFrq.AssiHiFrqWhlImbRejctnGainY.Ary2D "MICROSAR RTE" /begin SUB_GROUP /end SUB_GROUP /begin FUNCTION_LIST /end FUNCTION_LIST /begin REF_CHARACTERISTIC AssiHiFrq.AssiHiFrqWhlImbRejctnGainY.Ary2D /end REF_CHARACTERISTIC /begin REF_MEASUREMENT /end REF_MEASUREMENT /end GROUP
/begin GROUP AssiHiFrq.CalibrationPorts "MICROSAR RTE"
 /begin SUB_GROUP AssiHiFrq.AssiHiFrqGainY.Ary2D AssiHiFrq.AssiHiFrqHpFilFrq.Val AssiHiFrq.AssiHiFrqHpFilFrqY.Ary1D AssiHiFrq.AssiHiFrqTqWhlImbRejctnTqX.Ary2D AssiHiFrq.AssiHiFrqTqX.Ary2D AssiHiFrq.AssiHiFrqWhlImbRejctnBlndX.Ary2D AssiHiFrq.AssiHiFrqWhlImbRejctnBlndY.Ary2D AssiHiFrq.AssiHiFrqWhlImbRejctnGainY.Ary2D AssiHiFrq.SysGlbPrmVehSpdBilnrSeln.Ary1D /end SUB_GROUP
 /begin FUNCTION_LIST /end FUNCTION_LIST
 /begin REF_CHARACTERISTIC /end REF_CHARACTERISTIC
 /begin REF_MEASUREMENT /end REF_MEASUREMENT
/end GROUP
/begin GROUP AssiHiFrq.HwTq.Val "MICROSAR RTE" /begin SUB_GROUP /end SUB_GROUP /begin FUNCTION_LIST /end FUNCTION_LIST /begin REF_CHARACTERISTIC /end REF_CHARACTERISTIC /begin REF_MEASUREMENT AssiHiFrq.HwTq.Val /end REF_MEASUREMENT /end GROUP
/begin GROUP AssiHiFrq.HwTqHpFil "MICROSAR RTE" /begin SUB_GROUP /end SUB_GROUP /begin FUNCTION_LIST /end FUNCTION_LIST /begin REF_CHARACTERISTIC /end REF_CHARACTERISTIC
 /begin REF_MEASUREMENT AssiHiFrq.HwTqHpFil.CorrnFac AssiHiFrq.HwTqHpFil.FilLpRec.FilGain AssiHiFrq.HwTqHpFil.FilLpRec.FilSt /end REF_MEASUREMENT
/end GROUP
/begin GROUP AssiHiFrq.PerInstanceMemories "MICROSAR RTE"
 /begin SUB_GROUP AssiHiFrq.HwTqHpFil AssiHiFrq.dAssiHiFrqGain AssiHiFrq.dAssiHiFrqGainBlnd AssiHiFrq.dAssiHiFrqGainWhlImbRejtcnZero /end SUB_GROUP
 /begin FUNCTION_LIST /end FUNCTION_LIST
 /begin REF_CHARACTERISTIC /end REF_CHARACTERISTIC
 /begin REF_MEASUREMENT /end REF_MEASUREMENT
/end GROUP
/begin GROUP AssiHiFrq.ReceiverPorts "MICROSAR RTE"
 /begin SUB_GROUP AssiHiFrq.HwTq.Val AssiHiFrq.VehSpd.Val AssiHiFrq.WhlImbRejctnAmp.Val /end SUB_GROUP
 /begin FUNCTION_LIST /end FUNCTION_LIST
 /begin REF_CHARACTERISTIC /end REF_CHARACTERISTIC
 /begin REF_MEASUREMENT /end REF_MEASUREMENT
/end GROUP
/begin GROUP AssiHiFrq.SenderPorts "MICROSAR RTE" /begin SUB_GROUP AssiHiFrq.AssiHiFrqCmd.Val /end SUB_GROUP /begin FUNCTION_LIST /end FUNCTION_LIST /begin REF_CHARACTERISTIC /end REF_CHARACTERISTIC /begin REF_MEASUREMENT /end REF_MEASUREMENT /end GROUP
/begin GROUP AssiHiFrq.SysGlbPrmVehSpdBilnrSeln.Ary1D "MICROSAR RTE" /begin SUB_GROUP /end SUB_GROUP /begin FUNCTION_LIST /end FUNCTION_LIST /begin REF_CHARACTERISTIC AssiHiFrq.SysGlbPrmVehSpdBilnrSeln.Ary1D /end REF_CHARACTERISTIC /begin REF_MEASUREMENT /end REF_MEASUREMENT /end GROUP
/begin GROUP AssiHiFrq.VehSpd.Val "MICROSAR RTE" /begin SUB_GROUP /end SUB_GROUP /begin FUNCTION_LIST /end FUNCTION_LIST /begin REF_CHARACTERISTIC /end REF_CHARACTERISTIC /begin REF_MEASUREMENT AssiHiFrq.VehSpd.Val /end REF_MEASUREMENT /end GROUP
/begin GROUP AssiHiFrq.WhlImbRejctnAmp.Val "MICROSAR RTE" /begin SUB_GROUP /end SUB_GROUP /begin FUNCTION_LIST /end FUNCTION_LIST /begin REF_CHARACTERISTIC /end REF_CHARACTERISTIC /begin REF_MEASUREMENT AssiHiFrq.WhlImbRejctnAmp.Val /end REF_MEASUREMENT /end GROUP
/begin GROUP AssiHiFrq.dAssiHiFrqGain "MICROSAR RTE" /begin SUB_GROUP /end SUB_GROUP /begin FUNCTION_LIST /end FUNCTION_LIST /begin REF_CHARACTERISTIC /end REF_CHARACTERISTIC /begin REF_MEASUREMENT AssiHiFrq.dAssiHiFrqGain /end REF_MEASUREMENT /end GROUP
/begin GROUP AssiHiFrq.dAssiHiFrqGainBlnd "MICROSAR RTE" /begin SUB_GROUP /end SUB_GROUP /begin FUNCTION_LIST /end FUNCTION_LIST /begin REF_CHARACTERISTIC /end REF_CHARACTERISTIC /begin REF_MEASUREMENT AssiHiFrq.dAssiHiFrqGainBlnd /end REF_MEASUREMENT /end GROUP
/begin GROUP AssiHiFrq.dAssiHiFrqGainWhlImbRejtcnZero "MICROSAR RTE" /begin SUB_GROUP /end SUB_GROUP /begin FUNCTION_LIST /end FUNCTION_LIST /begin REF_CHARACTERISTIC /end REF_CHARACTERISTIC /begin REF_MEASUREMENT AssiHiFrq.dAssiHiFrqGainWhlImbRejtcnZero /end REF_MEASUREMENT /end GROUP
/begin GROUP AssiPahSum "MICROSAR RTE"
 /begin SUB_GROUP AssiPahSum.CalibrationPorts AssiPahSum.ReceiverPorts AssiPahSum.SenderPorts /end SUB_GROUP
 /begin FUNCTION_LIST /end FUNCTION_LIST
 /begin REF_CHARACTERISTIC /end REF_CHARACTERISTIC
 /begin REF_MEASUREMENT /end REF_MEASUREMENT
/end GROUP
/begin GROUP AssiPahSum.AssiCmdBas.Val "MICROSAR RTE" /begin SUB_GROUP /end SUB_GROUP /begin FUNCTION_LIST /end FUNCTION_LIST /begin REF_CHARACTERISTIC /end REF_CHARACTERISTIC /begin REF_MEASUREMENT AssiPahSum.AssiCmdBas.Val /end REF_MEASUREMENT /end GROUP
/begin GROUP AssiPahSum.AssiCmdSum.Val "MICROSAR RTE" /begin SUB_GROUP /end SUB_GROUP /begin FUNCTION_LIST /end FUNCTION_LIST /begin REF_CHARACTERISTIC /end REF_CHARACTERISTIC /begin REF_MEASUREMENT AssiPahSum.AssiCmdSum.Val /end REF_MEASUREMENT /end GROUP
/begin GROUP AssiPahSum.AssiHiFrqCmd.Val "MICROSAR RTE" /begin SUB_GROUP /end SUB_GROUP /begin FUNCTION_LIST /end FUNCTION_LIST /begin REF_CHARACTERISTIC /end REF_CHARACTERISTIC /begin REF_MEASUREMENT AssiPahSum.AssiHiFrqCmd.Val /end REF_MEASUREMENT /end GROUP
/begin GROUP AssiPahSum.AssiPahSumHysCmpLim.Val "MICROSAR RTE" /begin SUB_GROUP /end SUB_GROUP /begin FUNCTION_LIST /end FUNCTION_LIST /begin REF_CHARACTERISTIC AssiPahSum.AssiPahSumHysCmpLim.Val /end REF_CHARACTERISTIC /begin REF_MEASUREMENT /end REF_MEASUREMENT /end GROUP
/begin GROUP AssiPahSum.CalibrationPorts "MICROSAR RTE" /begin SUB_GROUP AssiPahSum.AssiPahSumHysCmpLim.Val /end SUB_GROUP /begin FUNCTION_LIST /end FUNCTION_LIST /begin REF_CHARACTERISTIC /end REF_CHARACTERISTIC /begin REF_MEASUREMENT /end REF_MEASUREMENT /end GROUP
/begin GROUP AssiPahSum.HysCmpCmd.Val "MICROSAR RTE" /begin SUB_GROUP /end SUB_GROUP /begin FUNCTION_LIST /end FUNCTION_LIST /begin REF_CHARACTERISTIC /end REF_CHARACTERISTIC /begin REF_MEASUREMENT AssiPahSum.HysCmpCmd.Val /end REF_MEASUREMENT /end GROUP
/begin GROUP AssiPahSum.ReceiverPorts "MICROSAR RTE"
 /begin SUB_GROUP AssiPahSum.AssiCmdBas.Val AssiPahSum.AssiHiFrqCmd.Val AssiPahSum.HysCmpCmd.Val /end SUB_GROUP
 /begin FUNCTION_LIST /end FUNCTION_LIST
 /begin REF_CHARACTERISTIC /end REF_CHARACTERISTIC
 /begin REF_MEASUREMENT /end REF_MEASUREMENT
/end GROUP
/begin GROUP AssiPahSum.SenderPorts "MICROSAR RTE" /begin SUB_GROUP AssiPahSum.AssiCmdSum.Val /end SUB_GROUP /begin FUNCTION_LIST /end FUNCTION_LIST /begin REF_CHARACTERISTIC /end REF_CHARACTERISTIC /begin REF_MEASUREMENT /end REF_MEASUREMENT /end GROUP
/begin GROUP AssiSumLim "MICROSAR RTE"
 /begin SUB_GROUP AssiSumLim.CalibrationPorts AssiSumLim.PerInstanceMemories AssiSumLim.ReceiverPorts AssiSumLim.SenderPorts /end SUB_GROUP
 /begin FUNCTION_LIST /end FUNCTION_LIST
 /begin REF_CHARACTERISTIC /end REF_CHARACTERISTIC
 /begin REF_MEASUREMENT /end REF_MEASUREMENT
/end GROUP
/begin GROUP AssiSumLim.AssiCmd.Val "MICROSAR RTE" /begin SUB_GROUP /end SUB_GROUP /begin FUNCTION_LIST /end FUNCTION_LIST /begin REF_CHARACTERISTIC /end REF_CHARACTERISTIC /begin REF_MEASUREMENT AssiSumLim.AssiCmd.Val /end REF_MEASUREMENT /end GROUP
/begin GROUP AssiSumLim.AssiSumLimBlndCmdSumFrqLimX.Ary1D "MICROSAR RTE" /begin SUB_GROUP /end SUB_GROUP /begin FUNCTION_LIST /end FUNCTION_LIST /begin REF_CHARACTERISTIC AssiSumLim.AssiSumLimBlndCmdSumFrqLimX.Ary1D /end REF_CHARACTERISTIC /begin REF_MEASUREMENT /end REF_MEASUREMENT /end GROUP
/begin GROUP AssiSumLim.AssiSumLimBlndCmdSumFrqLimY.Ary1D "MICROSAR RTE" /begin SUB_GROUP /end SUB_GROUP /begin FUNCTION_LIST /end FUNCTION_LIST /begin REF_CHARACTERISTIC AssiSumLim.AssiSumLimBlndCmdSumFrqLimY.Ary1D /end REF_CHARACTERISTIC /begin REF_MEASUREMENT /end REF_MEASUREMENT /end GROUP
/begin GROUP AssiSumLim.AssiSumLimCmdSumFilActv.Logl "MICROSAR RTE" /begin SUB_GROUP /end SUB_GROUP /begin FUNCTION_LIST /end FUNCTION_LIST /begin REF_CHARACTERISTIC AssiSumLim.AssiSumLimCmdSumFilActv.Logl /end REF_CHARACTERISTIC /begin REF_MEASUREMENT /end REF_MEASUREMENT /end GROUP
/begin GROUP AssiSumLim.AssiSumLimHiSpdCmdSumFrqLimX.Ary1D "MICROSAR RTE" /begin SUB_GROUP /end SUB_GROUP /begin FUNCTION_LIST /end FUNCTION_LIST /begin REF_CHARACTERISTIC AssiSumLim.AssiSumLimHiSpdCmdSumFrqLimX.Ary1D /end REF_CHARACTERISTIC /begin REF_MEASUREMENT /end REF_MEASUREMENT /end GROUP
/begin GROUP AssiSumLim.AssiSumLimHiSpdCmdSumFrqLimY.Ary1D "MICROSAR RTE" /begin SUB_GROUP /end SUB_GROUP /begin FUNCTION_LIST /end FUNCTION_LIST /begin REF_CHARACTERISTIC AssiSumLim.AssiSumLimHiSpdCmdSumFrqLimY.Ary1D /end REF_CHARACTERISTIC /begin REF_MEASUREMENT /end REF_MEASUREMENT /end GROUP
/begin GROUP AssiSumLim.AssiSumLimLoSpdCmdSumFrqLimX.Ary1D "MICROSAR RTE" /begin SUB_GROUP /end SUB_GROUP /begin FUNCTION_LIST /end FUNCTION_LIST /begin REF_CHARACTERISTIC AssiSumLim.AssiSumLimLoSpdCmdSumFrqLimX.Ary1D /end REF_CHARACTERISTIC /begin REF_MEASUREMENT /end REF_MEASUREMENT /end GROUP
/begin GROUP AssiSumLim.AssiSumLimLoSpdCmdSumFrqLimY.Ary1D "MICROSAR RTE" /begin SUB_GROUP /end SUB_GROUP /begin FUNCTION_LIST /end FUNCTION_LIST /begin REF_CHARACTERISTIC AssiSumLim.AssiSumLimLoSpdCmdSumFrqLimY.Ary1D /end REF_CHARACTERISTIC /begin REF_MEASUREMENT /end REF_MEASUREMENT /end GROUP
/begin GROUP AssiSumLim.AssiSumLimMotVelLpFilFrq.Val "MICROSAR RTE" /begin SUB_GROUP /end SUB_GROUP /begin FUNCTION_LIST /end FUNCTION_LIST /begin REF_CHARACTERISTIC AssiSumLim.AssiSumLimMotVelLpFilFrq.Val /end REF_CHARACTERISTIC /begin REF_MEASUREMENT /end REF_MEASUREMENT /end GROUP
/begin GROUP AssiSumLim.AssiSumLimNtc0x0C4FailStep.Val "MICROSAR RTE" /begin SUB_GROUP /end SUB_GROUP /begin FUNCTION_LIST /end FUNCTION_LIST /begin REF_CHARACTERISTIC AssiSumLim.AssiSumLimNtc0x0C4FailStep.Val /end REF_CHARACTERISTIC /begin REF_MEASUREMENT /end REF_MEASUREMENT /end GROUP
/begin GROUP AssiSumLim.AssiSumLimNtc0x0C4PassStep.Val "MICROSAR RTE" /begin SUB_GROUP /end SUB_GROUP /begin FUNCTION_LIST /end FUNCTION_LIST /begin REF_CHARACTERISTIC AssiSumLim.AssiSumLimNtc0x0C4PassStep.Val /end REF_CHARACTERISTIC /begin REF_MEASUREMENT /end REF_MEASUREMENT /end GROUP
/begin GROUP AssiSumLim.AssiSumLimPullCmpLim.Val "MICROSAR RTE" /begin SUB_GROUP /end SUB_GROUP /begin FUNCTION_LIST /end FUNCTION_LIST /begin REF_CHARACTERISTIC AssiSumLim.AssiSumLimPullCmpLim.Val /end REF_CHARACTERISTIC /begin REF_MEASUREMENT /end REF_MEASUREMENT /end GROUP
/begin GROUP AssiSumLim.CalibrationPorts "MICROSAR RTE"
 /begin SUB_GROUP AssiSumLim.AssiSumLimBlndCmdSumFrqLimX.Ary1D AssiSumLim.AssiSumLimBlndCmdSumFrqLimY.Ary1D AssiSumLim.AssiSumLimCmdSumFilActv.Logl AssiSumLim.AssiSumLimHiSpdCmdSumFrqLimX.Ary1D AssiSumLim.AssiSumLimHiSpdCmdSumFrqLimY.Ary1D AssiSumLim.AssiSumLimLoSpdCmdSumFrqLimX.Ary1D AssiSumLim.AssiSumLimLoSpdCmdSumFrqLimY.Ary1D AssiSumLim.AssiSumLimMotVelLpFilFrq.Val AssiSumLim.AssiSumLimNtc0x0C4FailStep.Val AssiSumLim.AssiSumLimNtc0x0C4PassStep.Val AssiSumLim.AssiSumLimPullCmpLim.Val /end SUB_GROUP
 /begin FUNCTION_LIST /end FUNCTION_LIST
 /begin REF_CHARACTERISTIC /end REF_CHARACTERISTIC
 /begin REF_MEASUREMENT /end REF_MEASUREMENT
/end GROUP
/begin GROUP AssiSumLim.CmdSumInpPrev "MICROSAR RTE" /begin SUB_GROUP /end SUB_GROUP /begin FUNCTION_LIST /end FUNCTION_LIST /begin REF_CHARACTERISTIC /end REF_CHARACTERISTIC /begin REF_MEASUREMENT AssiSumLim.CmdSumInpPrev /end REF_MEASUREMENT /end GROUP
/begin GROUP AssiSumLim.CmdSumOutpPrev "MICROSAR RTE" /begin SUB_GROUP /end SUB_GROUP /begin FUNCTION_LIST /end FUNCTION_LIST /begin REF_CHARACTERISTIC /end REF_CHARACTERISTIC /begin REF_MEASUREMENT AssiSumLim.CmdSumOutpPrev /end REF_MEASUREMENT /end GROUP
/begin GROUP AssiSumLim.DampgCmd.Val "MICROSAR RTE" /begin SUB_GROUP /end SUB_GROUP /begin FUNCTION_LIST /end FUNCTION_LIST /begin REF_CHARACTERISTIC /end REF_CHARACTERISTIC /begin REF_MEASUREMENT AssiSumLim.DampgCmd.Val /end REF_MEASUREMENT /end GROUP
/begin GROUP AssiSumLim.EotActvCmd.Val "MICROSAR RTE" /begin SUB_GROUP /end SUB_GROUP /begin FUNCTION_LIST /end FUNCTION_LIST /begin REF_CHARACTERISTIC /end REF_CHARACTERISTIC /begin REF_MEASUREMENT AssiSumLim.EotActvCmd.Val /end REF_MEASUREMENT /end GROUP
/begin GROUP AssiSumLim.EotAssiSca.Val "MICROSAR RTE" /begin SUB_GROUP /end SUB_GROUP /begin FUNCTION_LIST /end FUNCTION_LIST /begin REF_CHARACTERISTIC /end REF_CHARACTERISTIC /begin REF_MEASUREMENT AssiSumLim.EotAssiSca.Val /end REF_MEASUREMENT /end GROUP
/begin GROUP AssiSumLim.EotDampgCmd.Val "MICROSAR RTE" /begin SUB_GROUP /end SUB_GROUP /begin FUNCTION_LIST /end FUNCTION_LIST /begin REF_CHARACTERISTIC /end REF_CHARACTERISTIC /begin REF_MEASUREMENT AssiSumLim.EotDampgCmd.Val /end REF_MEASUREMENT /end GROUP
/begin GROUP AssiSumLim.EotMotTqLim.Val "MICROSAR RTE" /begin SUB_GROUP /end SUB_GROUP /begin FUNCTION_LIST /end FUNCTION_LIST /begin REF_CHARACTERISTIC /end REF_CHARACTERISTIC /begin REF_MEASUREMENT AssiSumLim.EotMotTqLim.Val /end REF_MEASUREMENT /end GROUP
/begin GROUP AssiSumLim.HwTqLoaMtgtnEna.Logl "MICROSAR RTE" /begin SUB_GROUP /end SUB_GROUP /begin FUNCTION_LIST /end FUNCTION_LIST /begin REF_CHARACTERISTIC /end REF_CHARACTERISTIC /begin REF_MEASUREMENT AssiSumLim.HwTqLoaMtgtnEna.Logl /end REF_MEASUREMENT /end GROUP
/begin GROUP AssiSumLim.MotTqCmd.Val "MICROSAR RTE" /begin SUB_GROUP /end SUB_GROUP /begin FUNCTION_LIST /end FUNCTION_LIST /begin REF_CHARACTERISTIC /end REF_CHARACTERISTIC /begin REF_MEASUREMENT AssiSumLim.MotTqCmd.Val /end REF_MEASUREMENT /end GROUP
/begin GROUP AssiSumLim.MotTqCmdLimDi.Logl "MICROSAR RTE" /begin SUB_GROUP /end SUB_GROUP /begin FUNCTION_LIST /end FUNCTION_LIST /begin REF_CHARACTERISTIC /end REF_CHARACTERISTIC /begin REF_MEASUREMENT AssiSumLim.MotTqCmdLimDi.Logl /end REF_MEASUREMENT /end GROUP
/begin GROUP AssiSumLim.MotTqCmdLimdPreStall.Val "MICROSAR RTE" /begin SUB_GROUP /end SUB_GROUP /begin FUNCTION_LIST /end FUNCTION_LIST /begin REF_CHARACTERISTIC /end REF_CHARACTERISTIC /begin REF_MEASUREMENT AssiSumLim.MotTqCmdLimdPreStall.Val /end REF_MEASUREMENT /end GROUP
/begin GROUP AssiSumLim.MotTqCmdLimrMin.Val "MICROSAR RTE" /begin SUB_GROUP /end SUB_GROUP /begin FUNCTION_LIST /end FUNCTION_LIST /begin REF_CHARACTERISTIC /end REF_CHARACTERISTIC /begin REF_MEASUREMENT AssiSumLim.MotTqCmdLimrMin.Val /end REF_MEASUREMENT /end GROUP
/begin GROUP AssiSumLim.MotTqCmdOvrl.Val "MICROSAR RTE" /begin SUB_GROUP /end SUB_GROUP /begin FUNCTION_LIST /end FUNCTION_LIST /begin REF_CHARACTERISTIC /end REF_CHARACTERISTIC /begin REF_MEASUREMENT AssiSumLim.MotTqCmdOvrl.Val /end REF_MEASUREMENT /end GROUP
/begin GROUP AssiSumLim.MotTqCmdPreLim.Val "MICROSAR RTE" /begin SUB_GROUP /end SUB_GROUP /begin FUNCTION_LIST /end FUNCTION_LIST /begin REF_CHARACTERISTIC /end REF_CHARACTERISTIC /begin REF_MEASUREMENT AssiSumLim.MotTqCmdPreLim.Val /end REF_MEASUREMENT /end GROUP
/begin GROUP AssiSumLim.MotVelFilLp "MICROSAR RTE" /begin SUB_GROUP /end SUB_GROUP /begin FUNCTION_LIST /end FUNCTION_LIST /begin REF_CHARACTERISTIC /end REF_CHARACTERISTIC
 /begin REF_MEASUREMENT AssiSumLim.MotVelFilLp.FilGain AssiSumLim.MotVelFilLp.FilSt /end REF_MEASUREMENT
/end GROUP
/begin GROUP AssiSumLim.MotVelMrf.Val "MICROSAR RTE" /begin SUB_GROUP /end SUB_GROUP /begin FUNCTION_LIST /end FUNCTION_LIST /begin REF_CHARACTERISTIC /end REF_CHARACTERISTIC /begin REF_MEASUREMENT AssiSumLim.MotVelMrf.Val /end REF_MEASUREMENT /end GROUP
/begin GROUP AssiSumLim.PerInstanceMemories "MICROSAR RTE"
 /begin SUB_GROUP AssiSumLim.CmdSumInpPrev AssiSumLim.CmdSumOutpPrev AssiSumLim.MotVelFilLp /end SUB_GROUP
 /begin FUNCTION_LIST /end FUNCTION_LIST
 /begin REF_CHARACTERISTIC /end REF_CHARACTERISTIC
 /begin REF_MEASUREMENT /end REF_MEASUREMENT
/end GROUP
/begin GROUP AssiSumLim.PinionCentrLrnCmd.Val "MICROSAR RTE" /begin SUB_GROUP /end SUB_GROUP /begin FUNCTION_LIST /end FUNCTION_LIST /begin REF_CHARACTERISTIC /end REF_CHARACTERISTIC /begin REF_MEASUREMENT AssiSumLim.PinionCentrLrnCmd.Val /end REF_MEASUREMENT /end GROUP
/begin GROUP AssiSumLim.PinionCentrLrnEna.Logl "MICROSAR RTE" /begin SUB_GROUP /end SUB_GROUP /begin FUNCTION_LIST /end FUNCTION_LIST /begin REF_CHARACTERISTIC /end REF_CHARACTERISTIC /begin REF_MEASUREMENT AssiSumLim.PinionCentrLrnEna.Logl /end REF_MEASUREMENT /end GROUP
/begin GROUP AssiSumLim.PullCmpCmd.Val "MICROSAR RTE" /begin SUB_GROUP /end SUB_GROUP /begin FUNCTION_LIST /end FUNCTION_LIST /begin REF_CHARACTERISTIC /end REF_CHARACTERISTIC /begin REF_MEASUREMENT AssiSumLim.PullCmpCmd.Val /end REF_MEASUREMENT /end GROUP
/begin GROUP AssiSumLim.PwrLimrRednFac.Val "MICROSAR RTE" /begin SUB_GROUP /end SUB_GROUP /begin FUNCTION_LIST /end FUNCTION_LIST /begin REF_CHARACTERISTIC /end REF_CHARACTERISTIC /begin REF_MEASUREMENT AssiSumLim.PwrLimrRednFac.Val /end REF_MEASUREMENT /end GROUP
/begin GROUP AssiSumLim.ReceiverPorts "MICROSAR RTE"
 /begin SUB_GROUP AssiSumLim.AssiCmd.Val AssiSumLim.DampgCmd.Val AssiSumLim.EotActvCmd.Val AssiSumLim.EotAssiSca.Val AssiSumLim.EotDampgCmd.Val AssiSumLim.EotMotTqLim.Val AssiSumLim.HwTqLoaMtgtnEna.Logl AssiSumLim.MotTqCmdLimDi.Logl AssiSumLim.MotTqCmdOvrl.Val AssiSumLim.MotVelMrf.Val AssiSumLim.PinionCentrLrnCmd.Val AssiSumLim.PinionCentrLrnEna.Logl AssiSumLim.PullCmpCmd.Val AssiSumLim.PwrLimrRednFac.Val AssiSumLim.RtnCmd.Val AssiSumLim.StallMotTqLim.Val AssiSumLim.SysMotTqCmdSca.Val AssiSumLim.ThermMotTqLim.Val AssiSumLim.ThermRednFac.Val AssiSumLim.TqLoaCmd.Val AssiSumLim.TqSteerMtgtnCmd.Val AssiSumLim.VehSpd.Val AssiSumLim.VehSpdMotTqLim.Val AssiSumLim.WhlImbRejctnCmd.Val /end SUB_GROUP
 /begin FUNCTION_LIST /end FUNCTION_LIST
 /begin REF_CHARACTERISTIC /end REF_CHARACTERISTIC
 /begin REF_MEASUREMENT /end REF_MEASUREMENT
/end GROUP
/begin GROUP AssiSumLim.RtnCmd.Val "MICROSAR RTE" /begin SUB_GROUP /end SUB_GROUP /begin FUNCTION_LIST /end FUNCTION_LIST /begin REF_CHARACTERISTIC /end REF_CHARACTERISTIC /begin REF_MEASUREMENT AssiSumLim.RtnCmd.Val /end REF_MEASUREMENT /end GROUP
/begin GROUP AssiSumLim.SenderPorts "MICROSAR RTE"
 /begin SUB_GROUP AssiSumLim.MotTqCmd.Val AssiSumLim.MotTqCmdLimdPreStall.Val AssiSumLim.MotTqCmdLimrMin.Val AssiSumLim.MotTqCmdPreLim.Val AssiSumLim.SysProtnRednFac.Val /end SUB_GROUP
 /begin FUNCTION_LIST /end FUNCTION_LIST
 /begin REF_CHARACTERISTIC /end REF_CHARACTERISTIC
 /begin REF_MEASUREMENT /end REF_MEASUREMENT
/end GROUP
/begin GROUP AssiSumLim.StallMotTqLim.Val "MICROSAR RTE" /begin SUB_GROUP /end SUB_GROUP /begin FUNCTION_LIST /end FUNCTION_LIST /begin REF_CHARACTERISTIC /end REF_CHARACTERISTIC /begin REF_MEASUREMENT AssiSumLim.StallMotTqLim.Val /end REF_MEASUREMENT /end GROUP
/begin GROUP AssiSumLim.SysMotTqCmdSca.Val "MICROSAR RTE" /begin SUB_GROUP /end SUB_GROUP /begin FUNCTION_LIST /end FUNCTION_LIST /begin REF_CHARACTERISTIC /end REF_CHARACTERISTIC /begin REF_MEASUREMENT AssiSumLim.SysMotTqCmdSca.Val /end REF_MEASUREMENT /end GROUP
/begin GROUP AssiSumLim.SysProtnRednFac.Val "MICROSAR RTE" /begin SUB_GROUP /end SUB_GROUP /begin FUNCTION_LIST /end FUNCTION_LIST /begin REF_CHARACTERISTIC /end REF_CHARACTERISTIC /begin REF_MEASUREMENT AssiSumLim.SysProtnRednFac.Val /end REF_MEASUREMENT /end GROUP
/begin GROUP AssiSumLim.ThermMotTqLim.Val "MICROSAR RTE" /begin SUB_GROUP /end SUB_GROUP /begin FUNCTION_LIST /end FUNCTION_LIST /begin REF_CHARACTERISTIC /end REF_CHARACTERISTIC /begin REF_MEASUREMENT AssiSumLim.ThermMotTqLim.Val /end REF_MEASUREMENT /end GROUP
/begin GROUP AssiSumLim.ThermRednFac.Val "MICROSAR RTE" /begin SUB_GROUP /end SUB_GROUP /begin FUNCTION_LIST /end FUNCTION_LIST /begin REF_CHARACTERISTIC /end REF_CHARACTERISTIC /begin REF_MEASUREMENT AssiSumLim.ThermRednFac.Val /end REF_MEASUREMENT /end GROUP
/begin GROUP AssiSumLim.TqLoaCmd.Val "MICROSAR RTE" /begin SUB_GROUP /end SUB_GROUP /begin FUNCTION_LIST /end FUNCTION_LIST /begin REF_CHARACTERISTIC /end REF_CHARACTERISTIC /begin REF_MEASUREMENT AssiSumLim.TqLoaCmd.Val /end REF_MEASUREMENT /end GROUP
/begin GROUP AssiSumLim.TqSteerMtgtnCmd.Val "MICROSAR RTE" /begin SUB_GROUP /end SUB_GROUP /begin FUNCTION_LIST /end FUNCTION_LIST /begin REF_CHARACTERISTIC /end REF_CHARACTERISTIC /begin REF_MEASUREMENT AssiSumLim.TqSteerMtgtnCmd.Val /end REF_MEASUREMENT /end GROUP
/begin GROUP AssiSumLim.VehSpd.Val "MICROSAR RTE" /begin SUB_GROUP /end SUB_GROUP /begin FUNCTION_LIST /end FUNCTION_LIST /begin REF_CHARACTERISTIC /end REF_CHARACTERISTIC /begin REF_MEASUREMENT AssiSumLim.VehSpd.Val /end REF_MEASUREMENT /end GROUP
/begin GROUP AssiSumLim.VehSpdMotTqLim.Val "MICROSAR RTE" /begin SUB_GROUP /end SUB_GROUP /begin FUNCTION_LIST /end FUNCTION_LIST /begin REF_CHARACTERISTIC /end REF_CHARACTERISTIC /begin REF_MEASUREMENT AssiSumLim.VehSpdMotTqLim.Val /end REF_MEASUREMENT /end GROUP
/begin GROUP AssiSumLim.WhlImbRejctnCmd.Val "MICROSAR RTE" /begin SUB_GROUP /end SUB_GROUP /begin FUNCTION_LIST /end FUNCTION_LIST /begin REF_CHARACTERISTIC /end REF_CHARACTERISTIC /begin REF_MEASUREMENT AssiSumLim.WhlImbRejctnCmd.Val /end REF_MEASUREMENT /end GROUP
/begin GROUP BattVltg "MICROSAR RTE"
 /begin SUB_GROUP BattVltg.CalibrationPorts BattVltg.PerInstanceMemories BattVltg.ReceiverPorts BattVltg.SenderPorts /end SUB_GROUP
 /begin FUNCTION_LIST /end FUNCTION_LIST
 /begin REF_CHARACTERISTIC /end REF_CHARACTERISTIC
 /begin REF_MEASUREMENT /end REF_MEASUREMENT
/end GROUP
/begin GROUP BattVltg.BattSwdVltgCorrlnSts.Val "MICROSAR RTE" /begin SUB_GROUP /end SUB_GROUP /begin FUNCTION_LIST /end FUNCTION_LIST /begin REF_CHARACTERISTIC /end REF_CHARACTERISTIC /begin REF_MEASUREMENT BattVltg.BattSwdVltgCorrlnSts.Val /end REF_MEASUREMENT /end GROUP
/begin GROUP BattVltg.BattVltg.Val "MICROSAR RTE" /begin SUB_GROUP /end SUB_GROUP /begin FUNCTION_LIST /end FUNCTION_LIST /begin REF_CHARACTERISTIC /end REF_CHARACTERISTIC /begin REF_MEASUREMENT BattVltg.BattVltg.Val /end REF_MEASUREMENT /end GROUP
/begin GROUP BattVltg.BattVltgPrevBattVltg "MICROSAR RTE" /begin SUB_GROUP /end SUB_GROUP /begin FUNCTION_LIST /end FUNCTION_LIST /begin REF_CHARACTERISTIC /end REF_CHARACTERISTIC /begin REF_MEASUREMENT BattVltg.BattVltgPrevBattVltg /end REF_MEASUREMENT /end GROUP
/begin GROUP BattVltg.BattVltgSwd1.Val "MICROSAR RTE" /begin SUB_GROUP /end SUB_GROUP /begin FUNCTION_LIST /end FUNCTION_LIST /begin REF_CHARACTERISTIC /end REF_CHARACTERISTIC /begin REF_MEASUREMENT BattVltg.BattVltgSwd1.Val /end REF_MEASUREMENT /end GROUP
/begin GROUP BattVltg.BattVltgSwdMax.Val "MICROSAR RTE" /begin SUB_GROUP /end SUB_GROUP /begin FUNCTION_LIST /end FUNCTION_LIST /begin REF_CHARACTERISTIC BattVltg.BattVltgSwdMax.Val /end REF_CHARACTERISTIC /begin REF_MEASUREMENT /end REF_MEASUREMENT /end GROUP
/begin GROUP BattVltg.BrdgVltg.Val "MICROSAR RTE" /begin SUB_GROUP /end SUB_GROUP /begin FUNCTION_LIST /end FUNCTION_LIST /begin REF_CHARACTERISTIC /end REF_CHARACTERISTIC /begin REF_MEASUREMENT BattVltg.BrdgVltg.Val /end REF_MEASUREMENT /end GROUP
/begin GROUP BattVltg.CalibrationPorts "MICROSAR RTE" /begin SUB_GROUP BattVltg.BattVltgSwdMax.Val /end SUB_GROUP /begin FUNCTION_LIST /end FUNCTION_LIST /begin REF_CHARACTERISTIC /end REF_CHARACTERISTIC /begin REF_MEASUREMENT /end REF_MEASUREMENT /end GROUP
/begin GROUP BattVltg.PerInstanceMemories "MICROSAR RTE" /begin SUB_GROUP BattVltg.BattVltgPrevBattVltg /end SUB_GROUP /begin FUNCTION_LIST /end FUNCTION_LIST /begin REF_CHARACTERISTIC /end REF_CHARACTERISTIC /begin REF_MEASUREMENT /end REF_MEASUREMENT /end GROUP
/begin GROUP BattVltg.ReceiverPorts "MICROSAR RTE"
 /begin SUB_GROUP BattVltg.BattSwdVltgCorrlnSts.Val BattVltg.BattVltg.Val BattVltg.BattVltgSwd1.Val /end SUB_GROUP
 /begin FUNCTION_LIST /end FUNCTION_LIST
 /begin REF_CHARACTERISTIC /end REF_CHARACTERISTIC
 /begin REF_MEASUREMENT /end REF_MEASUREMENT
/end GROUP
/begin GROUP BattVltg.SenderPorts "MICROSAR RTE" /begin SUB_GROUP BattVltg.BrdgVltg.Val /end SUB_GROUP /begin FUNCTION_LIST /end FUNCTION_LIST /begin REF_CHARACTERISTIC /end REF_CHARACTERISTIC /begin REF_MEASUREMENT /end REF_MEASUREMENT /end GROUP
/begin GROUP BattVltgCorrln "MICROSAR RTE"
 /begin SUB_GROUP BattVltgCorrln.CalibrationPorts BattVltgCorrln.PerInstanceMemories BattVltgCorrln.ReceiverPorts BattVltgCorrln.SenderPorts /end SUB_GROUP
 /begin FUNCTION_LIST /end FUNCTION_LIST
 /begin REF_CHARACTERISTIC /end REF_CHARACTERISTIC
 /begin REF_MEASUREMENT /end REF_MEASUREMENT
/end GROUP
/begin GROUP BattVltgCorrln.BattSwdVltgCorrlnSts.Val "MICROSAR RTE" /begin SUB_GROUP /end SUB_GROUP /begin FUNCTION_LIST /end FUNCTION_LIST /begin REF_CHARACTERISTIC /end REF_CHARACTERISTIC /begin REF_MEASUREMENT BattVltgCorrln.BattSwdVltgCorrlnSts.Val /end REF_MEASUREMENT /end GROUP
/begin GROUP BattVltgCorrln.BattVltg.Val "MICROSAR RTE" /begin SUB_GROUP /end SUB_GROUP /begin FUNCTION_LIST /end FUNCTION_LIST /begin REF_CHARACTERISTIC /end REF_CHARACTERISTIC /begin REF_MEASUREMENT BattVltgCorrln.BattVltg.Val /end REF_MEASUREMENT /end GROUP
/begin GROUP BattVltgCorrln.BattVltgAdcFaild.Logl "MICROSAR RTE" /begin SUB_GROUP /end SUB_GROUP /begin FUNCTION_LIST /end FUNCTION_LIST /begin REF_CHARACTERISTIC /end REF_CHARACTERISTIC /begin REF_MEASUREMENT BattVltgCorrln.BattVltgAdcFaild.Logl /end REF_MEASUREMENT /end GROUP
/begin GROUP BattVltgCorrln.BattVltgCorrlnAllwdVltgDif.Val "MICROSAR RTE" /begin SUB_GROUP /end SUB_GROUP /begin FUNCTION_LIST /end FUNCTION_LIST /begin REF_CHARACTERISTIC BattVltgCorrln.BattVltgCorrlnAllwdVltgDif.Val /end REF_CHARACTERISTIC /begin REF_MEASUREMENT /end REF_MEASUREMENT /end GROUP
/begin GROUP BattVltgCorrln.BattVltgCorrlnBattLoVltg.Val "MICROSAR RTE" /begin SUB_GROUP /end SUB_GROUP /begin FUNCTION_LIST /end FUNCTION_LIST /begin REF_CHARACTERISTIC BattVltgCorrln.BattVltgCorrlnBattLoVltg.Val /end REF_CHARACTERISTIC /begin REF_MEASUREMENT /end REF_MEASUREMENT /end GROUP
/begin GROUP BattVltgCorrln.BattVltgCorrlnBattOverVltg.Val "MICROSAR RTE" /begin SUB_GROUP /end SUB_GROUP /begin FUNCTION_LIST /end FUNCTION_LIST /begin REF_CHARACTERISTIC BattVltgCorrln.BattVltgCorrlnBattOverVltg.Val /end REF_CHARACTERISTIC /begin REF_MEASUREMENT /end REF_MEASUREMENT /end GROUP
/begin GROUP BattVltgCorrln.BattVltgCorrlnBattUnderVltg.Val "MICROSAR RTE" /begin SUB_GROUP /end SUB_GROUP /begin FUNCTION_LIST /end FUNCTION_LIST /begin REF_CHARACTERISTIC BattVltgCorrln.BattVltgCorrlnBattUnderVltg.Val /end REF_CHARACTERISTIC /begin REF_MEASUREMENT /end REF_MEASUREMENT /end GROUP
/begin GROUP BattVltgCorrln.BattVltgCorrlnIdptSig.Val "MICROSAR RTE" /begin SUB_GROUP /end SUB_GROUP /begin FUNCTION_LIST /end FUNCTION_LIST /begin REF_CHARACTERISTIC /end REF_CHARACTERISTIC /begin REF_MEASUREMENT BattVltgCorrln.BattVltgCorrlnIdptSig.Val /end REF_MEASUREMENT /end GROUP
/begin GROUP BattVltgCorrln.BattVltgCorrlnNtc0x03C0x044FailStep.Val "MICROSAR RTE" /begin SUB_GROUP /end SUB_GROUP /begin FUNCTION_LIST /end FUNCTION_LIST /begin REF_CHARACTERISTIC BattVltgCorrln.BattVltgCorrlnNtc0x03C0x044FailStep.Val /end REF_CHARACTERISTIC /begin REF_MEASUREMENT /end REF_MEASUREMENT /end GROUP
/begin GROUP BattVltgCorrln.BattVltgCorrlnNtc0x03C0x044PassStep.Val "MICROSAR RTE" /begin SUB_GROUP /end SUB_GROUP /begin FUNCTION_LIST /end FUNCTION_LIST /begin REF_CHARACTERISTIC BattVltgCorrln.BattVltgCorrlnNtc0x03C0x044PassStep.Val /end REF_CHARACTERISTIC /begin REF_MEASUREMENT /end REF_MEASUREMENT /end GROUP
/begin GROUP BattVltgCorrln.BattVltgCorrlnNtc0x0B0FailStep.Val "MICROSAR RTE" /begin SUB_GROUP /end SUB_GROUP /begin FUNCTION_LIST /end FUNCTION_LIST /begin REF_CHARACTERISTIC BattVltgCorrln.BattVltgCorrlnNtc0x0B0FailStep.Val /end REF_CHARACTERISTIC /begin REF_MEASUREMENT /end REF_MEASUREMENT /end GROUP
/begin GROUP BattVltgCorrln.BattVltgCorrlnNtc0x0B0PassStep.Val "MICROSAR RTE" /begin SUB_GROUP /end SUB_GROUP /begin FUNCTION_LIST /end FUNCTION_LIST /begin REF_CHARACTERISTIC BattVltgCorrln.BattVltgCorrlnNtc0x0B0PassStep.Val /end REF_CHARACTERISTIC /begin REF_MEASUREMENT /end REF_MEASUREMENT /end GROUP
/begin GROUP BattVltgCorrln.BattVltgCorrlnNtc0x0B1FailStep.Val "MICROSAR RTE" /begin SUB_GROUP /end SUB_GROUP /begin FUNCTION_LIST /end FUNCTION_LIST /begin REF_CHARACTERISTIC BattVltgCorrln.BattVltgCorrlnNtc0x0B1FailStep.Val /end REF_CHARACTERISTIC /begin REF_MEASUREMENT /end REF_MEASUREMENT /end GROUP
/begin GROUP BattVltgCorrln.BattVltgCorrlnNtc0x0B1PassStep.Val "MICROSAR RTE" /begin SUB_GROUP /end SUB_GROUP /begin FUNCTION_LIST /end FUNCTION_LIST /begin REF_CHARACTERISTIC BattVltgCorrln.BattVltgCorrlnNtc0x0B1PassStep.Val /end REF_CHARACTERISTIC /begin REF_MEASUREMENT /end REF_MEASUREMENT /end GROUP
/begin GROUP BattVltgCorrln.BattVltgCorrlnNtc0x0B5FailStep.Val "MICROSAR RTE" /begin SUB_GROUP /end SUB_GROUP /begin FUNCTION_LIST /end FUNCTION_LIST /begin REF_CHARACTERISTIC BattVltgCorrln.BattVltgCorrlnNtc0x0B5FailStep.Val /end REF_CHARACTERISTIC /begin REF_MEASUREMENT /end REF_MEASUREMENT /end GROUP
/begin GROUP BattVltgCorrln.BattVltgCorrlnNtc0x0B5PassStep.Val "MICROSAR RTE" /begin SUB_GROUP /end SUB_GROUP /begin FUNCTION_LIST /end FUNCTION_LIST /begin REF_CHARACTERISTIC BattVltgCorrln.BattVltgCorrlnNtc0x0B5PassStep.Val /end REF_CHARACTERISTIC /begin REF_MEASUREMENT /end REF_MEASUREMENT /end GROUP
/begin GROUP BattVltgCorrln.BattVltgCorrlnRcvrlBattLoVltg.Val "MICROSAR RTE" /begin SUB_GROUP /end SUB_GROUP /begin FUNCTION_LIST /end FUNCTION_LIST /begin REF_CHARACTERISTIC BattVltgCorrln.BattVltgCorrlnRcvrlBattLoVltg.Val /end REF_CHARACTERISTIC /begin REF_MEASUREMENT /end REF_MEASUREMENT /end GROUP
/begin GROUP BattVltgCorrln.BattVltgCorrlnRcvrlBattOverVltg.Val "MICROSAR RTE" /begin SUB_GROUP /end SUB_GROUP /begin FUNCTION_LIST /end FUNCTION_LIST /begin REF_CHARACTERISTIC BattVltgCorrln.BattVltgCorrlnRcvrlBattOverVltg.Val /end REF_CHARACTERISTIC /begin REF_MEASUREMENT /end REF_MEASUREMENT /end GROUP
/begin GROUP BattVltgCorrln.BattVltgCorrlnRcvrlBattUnderVltg.Val "MICROSAR RTE" /begin SUB_GROUP /end SUB_GROUP /begin FUNCTION_LIST /end FUNCTION_LIST /begin REF_CHARACTERISTIC BattVltgCorrln.BattVltgCorrlnRcvrlBattUnderVltg.Val /end REF_CHARACTERISTIC /begin REF_MEASUREMENT /end REF_MEASUREMENT /end GROUP
/begin GROUP BattVltgCorrln.BattVltgCorrlnSwdMax.Val "MICROSAR RTE" /begin SUB_GROUP /end SUB_GROUP /begin FUNCTION_LIST /end FUNCTION_LIST /begin REF_CHARACTERISTIC BattVltgCorrln.BattVltgCorrlnSwdMax.Val /end REF_CHARACTERISTIC /begin REF_MEASUREMENT /end REF_MEASUREMENT /end GROUP
/begin GROUP BattVltgCorrln.BattVltgCorrlnSysMinVltg.Val "MICROSAR RTE" /begin SUB_GROUP /end SUB_GROUP /begin FUNCTION_LIST /end FUNCTION_LIST /begin REF_CHARACTERISTIC BattVltgCorrln.BattVltgCorrlnSysMinVltg.Val /end REF_CHARACTERISTIC /begin REF_MEASUREMENT /end REF_MEASUREMENT /end GROUP
/begin GROUP BattVltgCorrln.BattVltgSwd1.Val "MICROSAR RTE" /begin SUB_GROUP /end SUB_GROUP /begin FUNCTION_LIST /end FUNCTION_LIST /begin REF_CHARACTERISTIC /end REF_CHARACTERISTIC /begin REF_MEASUREMENT BattVltgCorrln.BattVltgSwd1.Val /end REF_MEASUREMENT /end GROUP
/begin GROUP BattVltgCorrln.BattVltgSwd1AdcFaild.Logl "MICROSAR RTE" /begin SUB_GROUP /end SUB_GROUP /begin FUNCTION_LIST /end FUNCTION_LIST /begin REF_CHARACTERISTIC /end REF_CHARACTERISTIC /begin REF_MEASUREMENT BattVltgCorrln.BattVltgSwd1AdcFaild.Logl /end REF_MEASUREMENT /end GROUP
/begin GROUP BattVltgCorrln.CalibrationPorts "MICROSAR RTE"
 /begin SUB_GROUP BattVltgCorrln.BattVltgCorrlnAllwdVltgDif.Val BattVltgCorrln.BattVltgCorrlnBattLoVltg.Val BattVltgCorrln.BattVltgCorrlnBattOverVltg.Val BattVltgCorrln.BattVltgCorrlnBattUnderVltg.Val BattVltgCorrln.BattVltgCorrlnNtc0x03C0x044FailStep.Val BattVltgCorrln.BattVltgCorrlnNtc0x03C0x044PassStep.Val BattVltgCorrln.BattVltgCorrlnNtc0x0B0FailStep.Val BattVltgCorrln.BattVltgCorrlnNtc0x0B0PassStep.Val BattVltgCorrln.BattVltgCorrlnNtc0x0B1FailStep.Val BattVltgCorrln.BattVltgCorrlnNtc0x0B1PassStep.Val BattVltgCorrln.BattVltgCorrlnNtc0x0B5FailStep.Val BattVltgCorrln.BattVltgCorrlnNtc0x0B5PassStep.Val BattVltgCorrln.BattVltgCorrlnRcvrlBattLoVltg.Val BattVltgCorrln.BattVltgCorrlnRcvrlBattOverVltg.Val BattVltgCorrln.BattVltgCorrlnRcvrlBattUnderVltg.Val BattVltgCorrln.BattVltgCorrlnSwdMax.Val BattVltgCorrln.BattVltgCorrlnSysMinVltg.Val /end SUB_GROUP
 /begin FUNCTION_LIST /end FUNCTION_LIST
 /begin REF_CHARACTERISTIC /end REF_CHARACTERISTIC
 /begin REF_MEASUREMENT /end REF_MEASUREMENT
/end GROUP
/begin GROUP BattVltgCorrln.DftBrdgVltgActv.Logl "MICROSAR RTE" /begin SUB_GROUP /end SUB_GROUP /begin FUNCTION_LIST /end FUNCTION_LIST /begin REF_CHARACTERISTIC /end REF_CHARACTERISTIC /begin REF_MEASUREMENT BattVltgCorrln.DftBrdgVltgActv.Logl /end REF_MEASUREMENT /end GROUP
/begin GROUP BattVltgCorrln.DiagcStsIvtr1Inactv.Logl "MICROSAR RTE" /begin SUB_GROUP /end SUB_GROUP /begin FUNCTION_LIST /end FUNCTION_LIST /begin REF_CHARACTERISTIC /end REF_CHARACTERISTIC /begin REF_MEASUREMENT BattVltgCorrln.DiagcStsIvtr1Inactv.Logl /end REF_MEASUREMENT /end GROUP
/begin GROUP BattVltgCorrln.InhbBattVltgDiagc.Logl "MICROSAR RTE" /begin SUB_GROUP /end SUB_GROUP /begin FUNCTION_LIST /end FUNCTION_LIST /begin REF_CHARACTERISTIC /end REF_CHARACTERISTIC /begin REF_MEASUREMENT BattVltgCorrln.InhbBattVltgDiagc.Logl /end REF_MEASUREMENT /end GROUP
/begin GROUP BattVltgCorrln.PerInstanceMemories "MICROSAR RTE"
 /begin SUB_GROUP BattVltgCorrln.dBattVltgCorrlnBattVltgAndSwd1Ok BattVltgCorrln.dBattVltgCorrlnBattVltgRngOk BattVltgCorrln.dBattVltgCorrlnBattVltgSwd1RngOk BattVltgCorrln.dBattVltgCorrlnNtc0x03CQlfrSts BattVltgCorrln.dBattVltgCorrlnNtc0x044QlfrSts /end SUB_GROUP
 /begin FUNCTION_LIST /end FUNCTION_LIST
 /begin REF_CHARACTERISTIC /end REF_CHARACTERISTIC
 /begin REF_MEASUREMENT /end REF_MEASUREMENT
/end GROUP
/begin GROUP BattVltgCorrln.ReceiverPorts "MICROSAR RTE"
 /begin SUB_GROUP BattVltgCorrln.BattVltg.Val BattVltgCorrln.BattVltgAdcFaild.Logl BattVltgCorrln.BattVltgSwd1.Val BattVltgCorrln.BattVltgSwd1AdcFaild.Logl BattVltgCorrln.DiagcStsIvtr1Inactv.Logl BattVltgCorrln.InhbBattVltgDiagc.Logl BattVltgCorrln.StrtUpSt.Val BattVltgCorrln.SysSt.Val /end SUB_GROUP
 /begin FUNCTION_LIST /end FUNCTION_LIST
 /begin REF_CHARACTERISTIC /end REF_CHARACTERISTIC
 /begin REF_MEASUREMENT /end REF_MEASUREMENT
/end GROUP
/begin GROUP BattVltgCorrln.SenderPorts "MICROSAR RTE"
 /begin SUB_GROUP BattVltgCorrln.BattSwdVltgCorrlnSts.Val BattVltgCorrln.BattVltgCorrlnIdptSig.Val BattVltgCorrln.DftBrdgVltgActv.Logl BattVltgCorrln.SwdVltgLimd.Logl /end SUB_GROUP
 /begin FUNCTION_LIST /end FUNCTION_LIST
 /begin REF_CHARACTERISTIC /end REF_CHARACTERISTIC
 /begin REF_MEASUREMENT /end REF_MEASUREMENT
/end GROUP
/begin GROUP BattVltgCorrln.StrtUpSt.Val "MICROSAR RTE" /begin SUB_GROUP /end SUB_GROUP /begin FUNCTION_LIST /end FUNCTION_LIST /begin REF_CHARACTERISTIC /end REF_CHARACTERISTIC /begin REF_MEASUREMENT BattVltgCorrln.StrtUpSt.Val /end REF_MEASUREMENT /end GROUP
/begin GROUP BattVltgCorrln.SwdVltgLimd.Logl "MICROSAR RTE" /begin SUB_GROUP /end SUB_GROUP /begin FUNCTION_LIST /end FUNCTION_LIST /begin REF_CHARACTERISTIC /end REF_CHARACTERISTIC /begin REF_MEASUREMENT BattVltgCorrln.SwdVltgLimd.Logl /end REF_MEASUREMENT /end GROUP
/begin GROUP BattVltgCorrln.SysSt.Val "MICROSAR RTE" /begin SUB_GROUP /end SUB_GROUP /begin FUNCTION_LIST /end FUNCTION_LIST /begin REF_CHARACTERISTIC /end REF_CHARACTERISTIC /begin REF_MEASUREMENT BattVltgCorrln.SysSt.Val /end REF_MEASUREMENT /end GROUP
/begin GROUP BattVltgCorrln.dBattVltgCorrlnBattVltgAndSwd1Ok "MICROSAR RTE" /begin SUB_GROUP /end SUB_GROUP /begin FUNCTION_LIST /end FUNCTION_LIST /begin REF_CHARACTERISTIC /end REF_CHARACTERISTIC /begin REF_MEASUREMENT BattVltgCorrln.dBattVltgCorrlnBattVltgAndSwd1Ok /end REF_MEASUREMENT /end GROUP
/begin GROUP BattVltgCorrln.dBattVltgCorrlnBattVltgRngOk "MICROSAR RTE" /begin SUB_GROUP /end SUB_GROUP /begin FUNCTION_LIST /end FUNCTION_LIST /begin REF_CHARACTERISTIC /end REF_CHARACTERISTIC /begin REF_MEASUREMENT BattVltgCorrln.dBattVltgCorrlnBattVltgRngOk /end REF_MEASUREMENT /end GROUP
/begin GROUP BattVltgCorrln.dBattVltgCorrlnBattVltgSwd1RngOk "MICROSAR RTE" /begin SUB_GROUP /end SUB_GROUP /begin FUNCTION_LIST /end FUNCTION_LIST /begin REF_CHARACTERISTIC /end REF_CHARACTERISTIC /begin REF_MEASUREMENT BattVltgCorrln.dBattVltgCorrlnBattVltgSwd1RngOk /end REF_MEASUREMENT /end GROUP
/begin RECORD_LAYOUT RTE_RL_UWORD FNC_VALUES 1 UWORD ROW_DIR DIRECT /end RECORD_LAYOUT
/begin RECORD_LAYOUT RTE_RL_SWORD FNC_VALUES 1 SWORD ROW_DIR DIRECT /end RECORD_LAYOUT
/begin RECORD_LAYOUT RTE_RL_FLOAT32_IEEE FNC_VALUES 1 FLOAT32_IEEE ROW_DIR DIRECT /end RECORD_LAYOUT
/begin RECORD_LAYOUT RTE_RL_BOOLEAN FNC_VALUES 1 UBYTE ROW_DIR DIRECT /end RECORD_LAYOUT
/**********************************************************************************************************************
* COMPU_METHOD / COMPU_VTAB_RANGE
*********************************************************************************************************************/
/begin COMPU_METHOD RTE_CM_BOOLEAN "" TAB_VERB "%3.1" "" COMPU_TAB_REF RTE_CM_BOOLEAN /end COMPU_METHOD
/begin COMPU_VTAB_RANGE RTE_CM_BOOLEAN "" 2 0 0 "false" 1 255 "true" /end COMPU_VTAB_RANGE
/begin COMPU_METHOD RTE_CM_ENUM_SysSt1 "" TAB_VERB "%.1" "" COMPU_TAB_REF RTE_CM_ENUM_SysSt1 /end COMPU_METHOD
/begin COMPU_VTAB_RANGE RTE_CM_ENUM_SysSt1 "" 4 0 0 "SYSST_DI" 1 1 "SYSST_OFF" 2 2 "SYSST_ENA" 3 3 "SYSST_WRMININ" /end COMPU_VTAB_RANGE
