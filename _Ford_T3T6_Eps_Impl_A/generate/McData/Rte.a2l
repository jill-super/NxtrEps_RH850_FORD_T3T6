/begin CHARACTERISTIC FordMsg415BusHiSpd.FordMsg415BusHiSpdBrkModlLoQlyVldFaildThd.Val "MICROSAR RTE" VALUE 0x0 RTE_RL_UWORD 0 NO_COMPU_METHOD 0 65535 SYMBOL_LINK "Rte_CalprmRom_CalRegn01Cmn_DEFAULT_RTE_CALPRM_GROUP.FordMsg415BusHiSpdBrkModlLoQlyVldFaildThd_Val" 0 DISPLAY_IDENTIFIER FordMsg415BusHiSpd.CalibrationPorts.FordMsg415BusHiSpdBrkModlLoQlyVldFaildThd.Val /end CHARACTERISTIC
/begin CHARACTERISTIC FordMsg415BusHiSpd.FordMsg415BusHiSpdBrkModlLoQlyVldMissThd.Val "MICROSAR RTE" VALUE 0x0 RTE_RL_UWORD 0 NO_COMPU_METHOD 0 65535 SYMBOL_LINK "Rte_CalprmRom_CalRegn01Cmn_DEFAULT_RTE_CALPRM_GROUP.FordMsg415BusHiSpdBrkModlLoQlyVldMissThd_Val" 0 DISPLAY_IDENTIFIER FordMsg415BusHiSpd.CalibrationPorts.FordMsg415BusHiSpdBrkModlLoQlyVldMissThd.Val /end CHARACTERISTIC
/begin CHARACTERISTIC FordMsg415BusHiSpd.FordMsg415BusHiSpdBrkModlLoQlyVldPassdThd.Val "MICROSAR RTE" VALUE 0x0 RTE_RL_UWORD 0 NO_COMPU_METHOD 0 65535 SYMBOL_LINK "Rte_CalprmRom_CalRegn01Cmn_DEFAULT_RTE_CALPRM_GROUP.FordMsg415BusHiSpdBrkModlLoQlyVldPassdThd_Val" 0 DISPLAY_IDENTIFIER FordMsg415BusHiSpd.CalibrationPorts.FordMsg415BusHiSpdBrkModlLoQlyVldPassdThd.Val /end CHARACTERISTIC
/begin CHARACTERISTIC FordMsg415BusHiSpd.FordMsg415BusHiSpdBrkModlVldFaildThd.Val "MICROSAR RTE" VALUE 0x0 RTE_RL_UWORD 0 NO_COMPU_METHOD 0 65535 SYMBOL_LINK "Rte_CalprmRom_CalRegn01Cmn_DEFAULT_RTE_CALPRM_GROUP.FordMsg415BusHiSpdBrkModlVldFaildThd_Val" 0 DISPLAY_IDENTIFIER FordMsg415BusHiSpd.CalibrationPorts.FordMsg415BusHiSpdBrkModlVldFaildThd.Val /end CHARACTERISTIC
/begin CHARACTERISTIC FordMsg415BusHiSpd.FordMsg415BusHiSpdBrkModlVldMissThd.Val "MICROSAR RTE" VALUE 0x0 RTE_RL_UWORD 0 NO_COMPU_METHOD 0 65535 SYMBOL_LINK "Rte_CalprmRom_CalRegn01Cmn_DEFAULT_RTE_CALPRM_GROUP.FordMsg415BusHiSpdBrkModlVldMissThd_Val" 0 DISPLAY_IDENTIFIER FordMsg415BusHiSpd.CalibrationPorts.FordMsg415BusHiSpdBrkModlVldMissThd.Val /end CHARACTERISTIC
/begin CHARACTERISTIC FordMsg415BusHiSpd.FordMsg415BusHiSpdBrkModlVldPassdThd.Val "MICROSAR RTE" VALUE 0x0 RTE_RL_UWORD 0 NO_COMPU_METHOD 0 65535 SYMBOL_LINK "Rte_CalprmRom_CalRegn01Cmn_DEFAULT_RTE_CALPRM_GROUP.FordMsg415BusHiSpdBrkModlVldPassdThd_Val" 0 DISPLAY_IDENTIFIER FordMsg415BusHiSpd.CalibrationPorts.FordMsg415BusHiSpdBrkModlVldPassdThd.Val /end CHARACTERISTIC
/begin CHARACTERISTIC FordMsg415BusHiSpd.FordMsg415BusHiSpdBrkSprtVldMissThd.Val "MICROSAR RTE" VALUE 0x0 RTE_RL_UWORD 0 NO_COMPU_METHOD 0 65535 SYMBOL_LINK "Rte_CalprmRom_CalRegn01Cmn_DEFAULT_RTE_CALPRM_GROUP.FordMsg415BusHiSpdBrkSprtVldMissThd_Val" 0 DISPLAY_IDENTIFIER FordMsg415BusHiSpd.CalibrationPorts.FordMsg415BusHiSpdBrkSprtVldMissThd.Val /end CHARACTERISTIC
/begin CHARACTERISTIC FordMsg415BusHiSpd.FordMsg415BusHiSpdBrkSprtVldPassdThd.Val "MICROSAR RTE" VALUE 0x0 RTE_RL_UWORD 0 NO_COMPU_METHOD 0 65535 SYMBOL_LINK "Rte_CalprmRom_CalRegn01Cmn_DEFAULT_RTE_CALPRM_GROUP.FordMsg415BusHiSpdBrkSprtVldPassdThd_Val" 0 DISPLAY_IDENTIFIER FordMsg415BusHiSpd.CalibrationPorts.FordMsg415BusHiSpdBrkSprtVldPassdThd.Val /end CHARACTERISTIC
/begin CHARACTERISTIC FordMsg415BusHiSpd.FordMsg415BusHiSpdChksBrkModlInvldFaildThd.Val "MICROSAR RTE" VALUE 0x0 RTE_RL_UWORD 0 NO_COMPU_METHOD 0 65535 SYMBOL_LINK "Rte_CalprmRom_CalRegn01Cmn_DEFAULT_RTE_CALPRM_GROUP.FordMsg415BusHiSpdChksBrkModlInvldFaildThd_Val" 0 DISPLAY_IDENTIFIER FordMsg415BusHiSpd.CalibrationPorts.FordMsg415BusHiSpdChksBrkModlInvldFaildThd.Val /end CHARACTERISTIC
/begin CHARACTERISTIC FordMsg415BusHiSpd.FordMsg415BusHiSpdChksBrkModlInvldPassdThd.Val "MICROSAR RTE" VALUE 0x0 RTE_RL_UWORD 0 NO_COMPU_METHOD 0 65535 SYMBOL_LINK "Rte_CalprmRom_CalRegn01Cmn_DEFAULT_RTE_CALPRM_GROUP.FordMsg415BusHiSpdChksBrkModlInvldPassdThd_Val" 0 DISPLAY_IDENTIFIER FordMsg415BusHiSpd.CalibrationPorts.FordMsg415BusHiSpdChksBrkModlInvldPassdThd.Val /end CHARACTERISTIC
/begin CHARACTERISTIC FordMsg415BusHiSpd.FordMsg415BusHiSpdCntrBrkModlInvldFaildThd.Val "MICROSAR RTE" VALUE 0x0 RTE_RL_UWORD 0 NO_COMPU_METHOD 0 65535 SYMBOL_LINK "Rte_CalprmRom_CalRegn01Cmn_DEFAULT_RTE_CALPRM_GROUP.FordMsg415BusHiSpdCntrBrkModlInvldFaildThd_Val" 0 DISPLAY_IDENTIFIER FordMsg415BusHiSpd.CalibrationPorts.FordMsg415BusHiSpdCntrBrkModlInvldFaildThd.Val /end CHARACTERISTIC
/begin CHARACTERISTIC FordMsg415BusHiSpd.FordMsg415BusHiSpdCntrBrkModlInvldPassdThd.Val "MICROSAR RTE" VALUE 0x0 RTE_RL_UWORD 0 NO_COMPU_METHOD 0 65535 SYMBOL_LINK "Rte_CalprmRom_CalRegn01Cmn_DEFAULT_RTE_CALPRM_GROUP.FordMsg415BusHiSpdCntrBrkModlInvldPassdThd_Val" 0 DISPLAY_IDENTIFIER FordMsg415BusHiSpd.CalibrationPorts.FordMsg415BusHiSpdCntrBrkModlInvldPassdThd.Val /end CHARACTERISTIC
/begin CHARACTERISTIC FordMsg415BusHiSpd.FordMsg415BusHiSpdMissMsgFaildThd.Val "MICROSAR RTE" VALUE 0x0 RTE_RL_UWORD 0 NO_COMPU_METHOD 0 65535 SYMBOL_LINK "Rte_CalprmRom_CalRegn01Cmn_DEFAULT_RTE_CALPRM_GROUP.FordMsg415BusHiSpdMissMsgFaildThd_Val" 0 DISPLAY_IDENTIFIER FordMsg415BusHiSpd.CalibrationPorts.FordMsg415BusHiSpdMissMsgFaildThd.Val /end CHARACTERISTIC
/begin CHARACTERISTIC FordMsg415BusHiSpd.FordMsg415BusHiSpdMissMsgPassdThd.Val "MICROSAR RTE" VALUE 0x0 RTE_RL_UWORD 0 NO_COMPU_METHOD 0 65535 SYMBOL_LINK "Rte_CalprmRom_CalRegn01Cmn_DEFAULT_RTE_CALPRM_GROUP.FordMsg415BusHiSpdMissMsgPassdThd_Val" 0 DISPLAY_IDENTIFIER FordMsg415BusHiSpd.CalibrationPorts.FordMsg415BusHiSpdMissMsgPassdThd.Val /end CHARACTERISTIC
/begin CHARACTERISTIC FordMsg415BusHiSpd.FordMsg415BusHiSpdQlyFacBrkModlInvldFaildThd.Val "MICROSAR RTE" VALUE 0x0 RTE_RL_UWORD 0 NO_COMPU_METHOD 0 65535 SYMBOL_LINK "Rte_CalprmRom_CalRegn01Cmn_DEFAULT_RTE_CALPRM_GROUP.FordMsg415BusHiSpdQlyFacBrkModlInvldFaildThd_Val" 0 DISPLAY_IDENTIFIER FordMsg415BusHiSpd.CalibrationPorts.FordMsg415BusHiSpdQlyFacBrkModlInvldFaildThd.Val /end CHARACTERISTIC
/begin CHARACTERISTIC FordMsg415BusHiSpd.FordMsg415BusHiSpdQlyFacBrkModlInvldSigPassdThd.Val "MICROSAR RTE" VALUE 0x0 RTE_RL_UWORD 0 NO_COMPU_METHOD 0 65535 SYMBOL_LINK "Rte_CalprmRom_CalRegn01Cmn_DEFAULT_RTE_CALPRM_GROUP.FordMsg415BusHiSpdQlyFacBrkModlInvldSigPassdThd_Val" 0 DISPLAY_IDENTIFIER FordMsg415BusHiSpd.CalibrationPorts.FordMsg415BusHiSpdQlyFacBrkModlInvldSigPassdThd.Val /end CHARACTERISTIC
/begin CHARACTERISTIC FordMsg41ABusHiSpd.FordMsg41ABusHiSpdMissMsgFaildThd.Val "MICROSAR RTE" VALUE 0x0 RTE_RL_UWORD 0 NO_COMPU_METHOD 0 65535 SYMBOL_LINK "Rte_CalprmRom_CalRegn01Cmn_DEFAULT_RTE_CALPRM_GROUP.FordMsg41ABusHiSpdMissMsgFaildThd_Val" 0 DISPLAY_IDENTIFIER FordMsg41ABusHiSpd.CalibrationPorts.FordMsg41ABusHiSpdMissMsgFaildThd.Val /end CHARACTERISTIC
/begin CHARACTERISTIC FordMsg41ABusHiSpd.FordMsg41ABusHiSpdMissMsgPassdThd.Val "MICROSAR RTE" VALUE 0x0 RTE_RL_UWORD 0 NO_COMPU_METHOD 0 65535 SYMBOL_LINK "Rte_CalprmRom_CalRegn01Cmn_DEFAULT_RTE_CALPRM_GROUP.FordMsg41ABusHiSpdMissMsgPassdThd_Val" 0 DISPLAY_IDENTIFIER FordMsg41ABusHiSpd.CalibrationPorts.FordMsg41ABusHiSpdMissMsgPassdThd.Val /end CHARACTERISTIC
/begin CHARACTERISTIC FordMsg41EBusHiSpd.FordMsg41EBusHiSpdChassisVldMissFaildThd.Val "MICROSAR RTE" VALUE 0x0 RTE_RL_UWORD 0 NO_COMPU_METHOD 0 65535 SYMBOL_LINK "Rte_CalprmRom_CalRegn01Cmn_DEFAULT_RTE_CALPRM_GROUP.FordMsg41EBusHiSpdChassisVldMissFaildThd_Val" 0 DISPLAY_IDENTIFIER FordMsg41EBusHiSpd.CalibrationPorts.FordMsg41EBusHiSpdChassisVldMissFaildThd.Val /end CHARACTERISTIC
/begin CHARACTERISTIC FordMsg41EBusHiSpd.FordMsg41EBusHiSpdChassisVldSigFaildThd.Val "MICROSAR RTE" VALUE 0x0 RTE_RL_UWORD 0 NO_COMPU_METHOD 0 65535 SYMBOL_LINK "Rte_CalprmRom_CalRegn01Cmn_DEFAULT_RTE_CALPRM_GROUP.FordMsg41EBusHiSpdChassisVldSigFaildThd_Val" 0 DISPLAY_IDENTIFIER FordMsg41EBusHiSpd.CalibrationPorts.FordMsg41EBusHiSpdChassisVldSigFaildThd.Val /end CHARACTERISTIC
/begin CHARACTERISTIC FordMsg41EBusHiSpd.FordMsg41EBusHiSpdChassisVldSigPassdThd.Val "MICROSAR RTE" VALUE 0x0 RTE_RL_UWORD 0 NO_COMPU_METHOD 0 65535 SYMBOL_LINK "Rte_CalprmRom_CalRegn01Cmn_DEFAULT_RTE_CALPRM_GROUP.FordMsg41EBusHiSpdChassisVldSigPassdThd_Val" 0 DISPLAY_IDENTIFIER FordMsg41EBusHiSpd.CalibrationPorts.FordMsg41EBusHiSpdChassisVldSigPassdThd.Val /end CHARACTERISTIC
/begin CHARACTERISTIC FordMsg41EBusHiSpd.FordMsg41EBusHiSpdInvldMsgFaildThd.Val "MICROSAR RTE" VALUE 0x0 RTE_RL_UWORD 0 NO_COMPU_METHOD 0 65535 SYMBOL_LINK "Rte_CalprmRom_CalRegn01Cmn_DEFAULT_RTE_CALPRM_GROUP.FordMsg41EBusHiSpdInvldMsgFaildThd_Val" 0 DISPLAY_IDENTIFIER FordMsg41EBusHiSpd.CalibrationPorts.FordMsg41EBusHiSpdInvldMsgFaildThd.Val /end CHARACTERISTIC
/begin CHARACTERISTIC FordMsg41EBusHiSpd.FordMsg41EBusHiSpdInvldMsgPassdThd.Val "MICROSAR RTE" VALUE 0x0 RTE_RL_UWORD 0 NO_COMPU_METHOD 0 65535 SYMBOL_LINK "Rte_CalprmRom_CalRegn01Cmn_DEFAULT_RTE_CALPRM_GROUP.FordMsg41EBusHiSpdInvldMsgPassdThd_Val" 0 DISPLAY_IDENTIFIER FordMsg41EBusHiSpd.CalibrationPorts.FordMsg41EBusHiSpdInvldMsgPassdThd.Val /end CHARACTERISTIC
/begin CHARACTERISTIC FordMsg41EBusHiSpd.FordMsg41EBusHiSpdMissMsgFaildThd.Val "MICROSAR RTE" VALUE 0x0 RTE_RL_UWORD 0 NO_COMPU_METHOD 0 65535 SYMBOL_LINK "Rte_CalprmRom_CalRegn01Cmn_DEFAULT_RTE_CALPRM_GROUP.FordMsg41EBusHiSpdMissMsgFaildThd_Val" 0 DISPLAY_IDENTIFIER FordMsg41EBusHiSpd.CalibrationPorts.FordMsg41EBusHiSpdMissMsgFaildThd.Val /end CHARACTERISTIC
/begin CHARACTERISTIC FordMsg41EBusHiSpd.FordMsg41EBusHiSpdMissMsgPassdThd.Val "MICROSAR RTE" VALUE 0x0 RTE_RL_UWORD 0 NO_COMPU_METHOD 0 65535 SYMBOL_LINK "Rte_CalprmRom_CalRegn01Cmn_DEFAULT_RTE_CALPRM_GROUP.FordMsg41EBusHiSpdMissMsgPassdThd_Val" 0 DISPLAY_IDENTIFIER FordMsg41EBusHiSpd.CalibrationPorts.FordMsg41EBusHiSpdMissMsgPassdThd.Val /end CHARACTERISTIC
/begin CHARACTERISTIC FordMsg430BusHiSpd.FordMsg430BusHiSpdMissMsgFaildThd.Val "MICROSAR RTE" VALUE 0x0 RTE_RL_UWORD 0 NO_COMPU_METHOD 0 65535 SYMBOL_LINK "Rte_CalprmRom_CalRegn01Cmn_DEFAULT_RTE_CALPRM_GROUP.FordMsg430BusHiSpdMissMsgFaildThd_Val" 0 DISPLAY_IDENTIFIER FordMsg430BusHiSpd.CalibrationPorts.FordMsg430BusHiSpdMissMsgFaildThd.Val /end CHARACTERISTIC
/begin CHARACTERISTIC FordMsg430BusHiSpd.FordMsg430BusHiSpdMissMsgPassdThd.Val "MICROSAR RTE" VALUE 0x0 RTE_RL_UWORD 0 NO_COMPU_METHOD 0 65535 SYMBOL_LINK "Rte_CalprmRom_CalRegn01Cmn_DEFAULT_RTE_CALPRM_GROUP.FordMsg430BusHiSpdMissMsgPassdThd_Val" 0 DISPLAY_IDENTIFIER FordMsg430BusHiSpd.CalibrationPorts.FordMsg430BusHiSpdMissMsgPassdThd.Val /end CHARACTERISTIC
/begin CHARACTERISTIC FordMsg443BusHiSpd.FordMsg443BusHiSpdMissMsgFaildThd.Val "MICROSAR RTE" VALUE 0x0 RTE_RL_UWORD 0 NO_COMPU_METHOD 0 65535 SYMBOL_LINK "Rte_CalprmRom_CalRegn01Cmn_DEFAULT_RTE_CALPRM_GROUP.FordMsg443BusHiSpdMissMsgFaildThd_Val" 0 DISPLAY_IDENTIFIER FordMsg443BusHiSpd.CalibrationPorts.FordMsg443BusHiSpdMissMsgFaildThd.Val /end CHARACTERISTIC
/begin CHARACTERISTIC FordMsg443BusHiSpd.FordMsg443BusHiSpdMissMsgPassdThd.Val "MICROSAR RTE" VALUE 0x0 RTE_RL_UWORD 0 NO_COMPU_METHOD 0 65535 SYMBOL_LINK "Rte_CalprmRom_CalRegn01Cmn_DEFAULT_RTE_CALPRM_GROUP.FordMsg443BusHiSpdMissMsgPassdThd_Val" 0 DISPLAY_IDENTIFIER FordMsg443BusHiSpd.CalibrationPorts.FordMsg443BusHiSpdMissMsgPassdThd.Val /end CHARACTERISTIC
/begin CHARACTERISTIC FordMsg459BusHiSpd.FordMsg459BusHiSpdDiagMsgMissTmrThd.Val "MICROSAR RTE" VALUE 0x0 RTE_RL_UWORD 0 NO_COMPU_METHOD 0 65535 SYMBOL_LINK "Rte_CalprmRom_CalRegn01Cmn_DEFAULT_RTE_CALPRM_GROUP.FordMsg459BusHiSpdDiagMsgMissTmrThd_Val" 0 DISPLAY_IDENTIFIER FordMsg459BusHiSpd.CalibrationPorts.FordMsg459BusHiSpdDiagMsgMissTmrThd.Val /end CHARACTERISTIC
/begin CHARACTERISTIC FordMsg459BusHiSpd.FordMsg459BusHiSpdHitchAgInvldFaildThd.Val "MICROSAR RTE" VALUE 0x0 RTE_RL_UWORD 0 NO_COMPU_METHOD 0 65535 SYMBOL_LINK "Rte_CalprmRom_CalRegn01Cmn_DEFAULT_RTE_CALPRM_GROUP.FordMsg459BusHiSpdHitchAgInvldFaildThd_Val" 0 DISPLAY_IDENTIFIER FordMsg459BusHiSpd.CalibrationPorts.FordMsg459BusHiSpdHitchAgInvldFaildThd.Val /end CHARACTERISTIC
/begin CHARACTERISTIC FordMsg459BusHiSpd.FordMsg459BusHiSpdHitchAgInvldPassdThd.Val "MICROSAR RTE" VALUE 0x0 RTE_RL_UWORD 0 NO_COMPU_METHOD 0 65535 SYMBOL_LINK "Rte_CalprmRom_CalRegn01Cmn_DEFAULT_RTE_CALPRM_GROUP.FordMsg459BusHiSpdHitchAgInvldPassdThd_Val" 0 DISPLAY_IDENTIFIER FordMsg459BusHiSpd.CalibrationPorts.FordMsg459BusHiSpdHitchAgInvldPassdThd.Val /end CHARACTERISTIC
/begin CHARACTERISTIC FordMsg459BusHiSpd.FordMsg459BusHiSpdHitchAgRateInvldFaildThd.Val "MICROSAR RTE" VALUE 0x0 RTE_RL_UWORD 0 NO_COMPU_METHOD 0 65535 SYMBOL_LINK "Rte_CalprmRom_CalRegn01Cmn_DEFAULT_RTE_CALPRM_GROUP.FordMsg459BusHiSpdHitchAgRateInvldFaildThd_Val" 0 DISPLAY_IDENTIFIER FordMsg459BusHiSpd.CalibrationPorts.FordMsg459BusHiSpdHitchAgRateInvldFaildThd.Val /end CHARACTERISTIC
/begin CHARACTERISTIC FordMsg459BusHiSpd.FordMsg459BusHiSpdHitchAgRateInvldPassdThd.Val "MICROSAR RTE" VALUE 0x0 RTE_RL_UWORD 0 NO_COMPU_METHOD 0 65535 SYMBOL_LINK "Rte_CalprmRom_CalRegn01Cmn_DEFAULT_RTE_CALPRM_GROUP.FordMsg459BusHiSpdHitchAgRateInvldPassdThd_Val" 0 DISPLAY_IDENTIFIER FordMsg459BusHiSpd.CalibrationPorts.FordMsg459BusHiSpdHitchAgRateInvldPassdThd.Val /end CHARACTERISTIC
/begin CHARACTERISTIC FordMsg459BusHiSpd.FordMsg459BusHiSpdPrsntFlgMsgMissTmrThd.Val "MICROSAR RTE" VALUE 0x0 RTE_RL_UWORD 0 NO_COMPU_METHOD 0 65535 SYMBOL_LINK "Rte_CalprmRom_CalRegn01Cmn_DEFAULT_RTE_CALPRM_GROUP.FordMsg459BusHiSpdPrsntFlgMsgMissTmrThd_Val" 0 DISPLAY_IDENTIFIER FordMsg459BusHiSpd.CalibrationPorts.FordMsg459BusHiSpdPrsntFlgMsgMissTmrThd.Val /end CHARACTERISTIC
/begin CHARACTERISTIC FordMsg459BusHiSpd.FordMsg459BusHiSpdRcvrDiagMsgMissTmrThd.Val "MICROSAR RTE" VALUE 0x0 RTE_RL_UWORD 0 NO_COMPU_METHOD 0 65535 SYMBOL_LINK "Rte_CalprmRom_CalRegn01Cmn_DEFAULT_RTE_CALPRM_GROUP.FordMsg459BusHiSpdRcvrDiagMsgMissTmrThd_Val" 0 DISPLAY_IDENTIFIER FordMsg459BusHiSpd.CalibrationPorts.FordMsg459BusHiSpdRcvrDiagMsgMissTmrThd.Val /end CHARACTERISTIC
/begin CHARACTERISTIC FordMsg459BusHiSpd.FordMsg459BusHiSpdRcvrPrsntFlgTmrThd.Val "MICROSAR RTE" VALUE 0x0 RTE_RL_UWORD 0 NO_COMPU_METHOD 0 65535 SYMBOL_LINK "Rte_CalprmRom_CalRegn01Cmn_DEFAULT_RTE_CALPRM_GROUP.FordMsg459BusHiSpdRcvrPrsntFlgTmrThd_Val" 0 DISPLAY_IDENTIFIER FordMsg459BusHiSpd.CalibrationPorts.FordMsg459BusHiSpdRcvrPrsntFlgTmrThd.Val /end CHARACTERISTIC
/begin CHARACTERISTIC FordMsg459BusHiSpd.FordMsg459BusHiSpdTrackStInvldFaildThd.Val "MICROSAR RTE" VALUE 0x0 RTE_RL_UWORD 0 NO_COMPU_METHOD 0 65535 SYMBOL_LINK "Rte_CalprmRom_CalRegn01Cmn_DEFAULT_RTE_CALPRM_GROUP.FordMsg459BusHiSpdTrackStInvldFaildThd_Val" 0 DISPLAY_IDENTIFIER FordMsg459BusHiSpd.CalibrationPorts.FordMsg459BusHiSpdTrackStInvldFaildThd.Val /end CHARACTERISTIC
/begin CHARACTERISTIC FordMsg459BusHiSpd.FordMsg459BusHiSpdTrackStInvldPassdThd.Val "MICROSAR RTE" VALUE 0x0 RTE_RL_UWORD 0 NO_COMPU_METHOD 0 65535 SYMBOL_LINK "Rte_CalprmRom_CalRegn01Cmn_DEFAULT_RTE_CALPRM_GROUP.FordMsg459BusHiSpdTrackStInvldPassdThd_Val" 0 DISPLAY_IDENTIFIER FordMsg459BusHiSpd.CalibrationPorts.FordMsg459BusHiSpdTrackStInvldPassdThd.Val /end CHARACTERISTIC
/begin CHARACTERISTIC FordMsg459BusHiSpd.FordMsg459BusHiSpdTrlrHitchAgVldInvldMsgThd.Val "MICROSAR RTE" VALUE 0x0 RTE_RL_UWORD 0 NO_COMPU_METHOD 0 65535 SYMBOL_LINK "Rte_CalprmRom_CalRegn01Cmn_DEFAULT_RTE_CALPRM_GROUP.FordMsg459BusHiSpdTrlrHitchAgVldInvldMsgThd_Val" 0 DISPLAY_IDENTIFIER FordMsg459BusHiSpd.CalibrationPorts.FordMsg459BusHiSpdTrlrHitchAgVldInvldMsgThd.Val /end CHARACTERISTIC
/begin CHARACTERISTIC FordMsg459BusHiSpd.FordMsg459BusHiSpdTrlrHitchAgVldMissMsgThd.Val "MICROSAR RTE" VALUE 0x0 RTE_RL_UWORD 0 NO_COMPU_METHOD 0 65535 SYMBOL_LINK "Rte_CalprmRom_CalRegn01Cmn_DEFAULT_RTE_CALPRM_GROUP.FordMsg459BusHiSpdTrlrHitchAgVldMissMsgThd_Val" 0 DISPLAY_IDENTIFIER FordMsg459BusHiSpd.CalibrationPorts.FordMsg459BusHiSpdTrlrHitchAgVldMissMsgThd.Val /end CHARACTERISTIC
/begin CHARACTERISTIC FordMsg459BusHiSpd.FordMsg459BusHiSpdTrlrHitchRateVldInvldMsgThd.Val "MICROSAR RTE" VALUE 0x0 RTE_RL_UWORD 0 NO_COMPU_METHOD 0 65535 SYMBOL_LINK "Rte_CalprmRom_CalRegn01Cmn_DEFAULT_RTE_CALPRM_GROUP.FordMsg459BusHiSpdTrlrHitchRateVldInvldMsgThd_Val" 0 DISPLAY_IDENTIFIER FordMsg459BusHiSpd.CalibrationPorts.FordMsg459BusHiSpdTrlrHitchRateVldInvldMsgThd.Val /end CHARACTERISTIC
/begin CHARACTERISTIC FordMsg459BusHiSpd.FordMsg459BusHiSpdTrlrHitchRateVldMissMsgThd.Val "MICROSAR RTE" VALUE 0x0 RTE_RL_UWORD 0 NO_COMPU_METHOD 0 65535 SYMBOL_LINK "Rte_CalprmRom_CalRegn01Cmn_DEFAULT_RTE_CALPRM_GROUP.FordMsg459BusHiSpdTrlrHitchRateVldMissMsgThd_Val" 0 DISPLAY_IDENTIFIER FordMsg459BusHiSpd.CalibrationPorts.FordMsg459BusHiSpdTrlrHitchRateVldMissMsgThd.Val /end CHARACTERISTIC
/begin CHARACTERISTIC FordMsg459BusHiSpd.FordMsg459BusHiSpdTrlrRcvrHitchAgVldThd.Val "MICROSAR RTE" VALUE 0x0 RTE_RL_UWORD 0 NO_COMPU_METHOD 0 65535 SYMBOL_LINK "Rte_CalprmRom_CalRegn01Cmn_DEFAULT_RTE_CALPRM_GROUP.FordMsg459BusHiSpdTrlrRcvrHitchAgVldThd_Val" 0 DISPLAY_IDENTIFIER FordMsg459BusHiSpd.CalibrationPorts.FordMsg459BusHiSpdTrlrRcvrHitchAgVldThd.Val /end CHARACTERISTIC
/begin CHARACTERISTIC FordMsg459BusHiSpd.FordMsg459BusHiSpdTrlrRcvrHitchRateVldThd.Val "MICROSAR RTE" VALUE 0x0 RTE_RL_UWORD 0 NO_COMPU_METHOD 0 65535 SYMBOL_LINK "Rte_CalprmRom_CalRegn01Cmn_DEFAULT_RTE_CALPRM_GROUP.FordMsg459BusHiSpdTrlrRcvrHitchRateVldThd_Val" 0 DISPLAY_IDENTIFIER FordMsg459BusHiSpd.CalibrationPorts.FordMsg459BusHiSpdTrlrRcvrHitchRateVldThd.Val /end CHARACTERISTIC
/begin CHARACTERISTIC FordMsg459BusHiSpd.FordMsg459BusHiSpdTrlrRcvrTarVldThd.Val "MICROSAR RTE" VALUE 0x0 RTE_RL_UWORD 0 NO_COMPU_METHOD 0 65535 SYMBOL_LINK "Rte_CalprmRom_CalRegn01Cmn_DEFAULT_RTE_CALPRM_GROUP.FordMsg459BusHiSpdTrlrRcvrTarVldThd_Val" 0 DISPLAY_IDENTIFIER FordMsg459BusHiSpd.CalibrationPorts.FordMsg459BusHiSpdTrlrRcvrTarVldThd.Val /end CHARACTERISTIC
/begin CHARACTERISTIC FordMsg459BusHiSpd.FordMsg459BusHiSpdTrlrRcvrTrackStVldThd.Val "MICROSAR RTE" VALUE 0x0 RTE_RL_UWORD 0 NO_COMPU_METHOD 0 65535 SYMBOL_LINK "Rte_CalprmRom_CalRegn01Cmn_DEFAULT_RTE_CALPRM_GROUP.FordMsg459BusHiSpdTrlrRcvrTrackStVldThd_Val" 0 DISPLAY_IDENTIFIER FordMsg459BusHiSpd.CalibrationPorts.FordMsg459BusHiSpdTrlrRcvrTrackStVldThd.Val /end CHARACTERISTIC
/begin CHARACTERISTIC FordMsg459BusHiSpd.FordMsg459BusHiSpdTrlrTarVldMissMsgThd.Val "MICROSAR RTE" VALUE 0x0 RTE_RL_UWORD 0 NO_COMPU_METHOD 0 65535 SYMBOL_LINK "Rte_CalprmRom_CalRegn01Cmn_DEFAULT_RTE_CALPRM_GROUP.FordMsg459BusHiSpdTrlrTarVldMissMsgThd_Val" 0 DISPLAY_IDENTIFIER FordMsg459BusHiSpd.CalibrationPorts.FordMsg459BusHiSpdTrlrTarVldMissMsgThd.Val /end CHARACTERISTIC
/begin CHARACTERISTIC FordMsg459BusHiSpd.FordMsg459BusHiSpdTrlrTrackStVldInvldMsgThd.Val "MICROSAR RTE" VALUE 0x0 RTE_RL_UWORD 0 NO_COMPU_METHOD 0 65535 SYMBOL_LINK "Rte_CalprmRom_CalRegn01Cmn_DEFAULT_RTE_CALPRM_GROUP.FordMsg459BusHiSpdTrlrTrackStVldInvldMsgThd_Val" 0 DISPLAY_IDENTIFIER FordMsg459BusHiSpd.CalibrationPorts.FordMsg459BusHiSpdTrlrTrackStVldInvldMsgThd.Val /end CHARACTERISTIC
/begin CHARACTERISTIC FordMsg459BusHiSpd.FordMsg459BusHiSpdTrlrTrackStVldMissMsgThd.Val "MICROSAR RTE" VALUE 0x0 RTE_RL_UWORD 0 NO_COMPU_METHOD 0 65535 SYMBOL_LINK "Rte_CalprmRom_CalRegn01Cmn_DEFAULT_RTE_CALPRM_GROUP.FordMsg459BusHiSpdTrlrTrackStVldMissMsgThd_Val" 0 DISPLAY_IDENTIFIER FordMsg459BusHiSpd.CalibrationPorts.FordMsg459BusHiSpdTrlrTrackStVldMissMsgThd.Val /end CHARACTERISTIC
/begin CHARACTERISTIC FordMsg47ABusHiSpd.FordMsg47ABusHiSpdMissMsgFaildTiThd.Val "MICROSAR RTE" VALUE 0x0 RTE_RL_UWORD 0 NO_COMPU_METHOD 0 65535 SYMBOL_LINK "Rte_CalprmRom_CalRegn01Cmn_DEFAULT_RTE_CALPRM_GROUP.FordMsg47ABusHiSpdMissMsgFaildTiThd_Val" 0 DISPLAY_IDENTIFIER FordMsg47ABusHiSpd.CalibrationPorts.FordMsg47ABusHiSpdMissMsgFaildTiThd.Val /end CHARACTERISTIC
/begin CHARACTERISTIC FordMsg47ABusHiSpd.FordMsg47ABusHiSpdMissMsgPassdTiThd.Val "MICROSAR RTE" VALUE 0x0 RTE_RL_UWORD 0 NO_COMPU_METHOD 0 65535 SYMBOL_LINK "Rte_CalprmRom_CalRegn01Cmn_DEFAULT_RTE_CALPRM_GROUP.FordMsg47ABusHiSpdMissMsgPassdTiThd_Val" 0 DISPLAY_IDENTIFIER FordMsg47ABusHiSpd.CalibrationPorts.FordMsg47ABusHiSpdMissMsgPassdTiThd.Val /end CHARACTERISTIC
/begin CHARACTERISTIC FordMsg47ABusHiSpd.FordMsg47ABusHiSpdTrlrAidKnobBtnFaildTiThd.Val "MICROSAR RTE" VALUE 0x0 RTE_RL_UWORD 0 NO_COMPU_METHOD 0 65535 SYMBOL_LINK "Rte_CalprmRom_CalRegn01Cmn_DEFAULT_RTE_CALPRM_GROUP.FordMsg47ABusHiSpdTrlrAidKnobBtnFaildTiThd_Val" 0 DISPLAY_IDENTIFIER FordMsg47ABusHiSpd.CalibrationPorts.FordMsg47ABusHiSpdTrlrAidKnobBtnFaildTiThd.Val /end CHARACTERISTIC
/begin CHARACTERISTIC FordMsg47ABusHiSpd.FordMsg47ABusHiSpdTrlrAidKnobBtnInvldPassdTiThd.Val "MICROSAR RTE" VALUE 0x0 RTE_RL_UWORD 0 NO_COMPU_METHOD 0 65535 SYMBOL_LINK "Rte_CalprmRom_CalRegn01Cmn_DEFAULT_RTE_CALPRM_GROUP.FordMsg47ABusHiSpdTrlrAidKnobBtnInvldPassdTiThd_Val" 0 DISPLAY_IDENTIFIER FordMsg47ABusHiSpd.CalibrationPorts.FordMsg47ABusHiSpdTrlrAidKnobBtnInvldPassdTiThd.Val /end CHARACTERISTIC
/begin CHARACTERISTIC FordMsg47ABusHiSpd.FordMsg47ABusHiSpdTrlrAidKnobBtnMissTiThd.Val "MICROSAR RTE" VALUE 0x0 RTE_RL_UWORD 0 NO_COMPU_METHOD 0 65535 SYMBOL_LINK "Rte_CalprmRom_CalRegn01Cmn_DEFAULT_RTE_CALPRM_GROUP.FordMsg47ABusHiSpdTrlrAidKnobBtnMissTiThd_Val" 0 DISPLAY_IDENTIFIER FordMsg47ABusHiSpd.CalibrationPorts.FordMsg47ABusHiSpdTrlrAidKnobBtnMissTiThd.Val /end CHARACTERISTIC
/begin CHARACTERISTIC FordMsg47ABusHiSpd.FordMsg47ABusHiSpdTrlrAidKnobBtnPassdTiThd.Val "MICROSAR RTE" VALUE 0x0 RTE_RL_UWORD 0 NO_COMPU_METHOD 0 65535 SYMBOL_LINK "Rte_CalprmRom_CalRegn01Cmn_DEFAULT_RTE_CALPRM_GROUP.FordMsg47ABusHiSpdTrlrAidKnobBtnPassdTiThd_Val" 0 DISPLAY_IDENTIFIER FordMsg47ABusHiSpd.CalibrationPorts.FordMsg47ABusHiSpdTrlrAidKnobBtnPassdTiThd.Val /end CHARACTERISTIC
/begin CHARACTERISTIC FordMsg47ABusHiSpd.FordMsg47ABusHiSpdTrlrAidKnobPosFaildTiThd.Val "MICROSAR RTE" VALUE 0x0 RTE_RL_UWORD 0 NO_COMPU_METHOD 0 65535 SYMBOL_LINK "Rte_CalprmRom_CalRegn01Cmn_DEFAULT_RTE_CALPRM_GROUP.FordMsg47ABusHiSpdTrlrAidKnobPosFaildTiThd_Val" 0 DISPLAY_IDENTIFIER FordMsg47ABusHiSpd.CalibrationPorts.FordMsg47ABusHiSpdTrlrAidKnobPosFaildTiThd.Val /end CHARACTERISTIC
/begin CHARACTERISTIC FordMsg47ABusHiSpd.FordMsg47ABusHiSpdTrlrAidKnobPosInvldPassdTiThd.Val "MICROSAR RTE" VALUE 0x0 RTE_RL_UWORD 0 NO_COMPU_METHOD 0 65535 SYMBOL_LINK "Rte_CalprmRom_CalRegn01Cmn_DEFAULT_RTE_CALPRM_GROUP.FordMsg47ABusHiSpdTrlrAidKnobPosInvldPassdTiThd_Val" 0 DISPLAY_IDENTIFIER FordMsg47ABusHiSpd.CalibrationPorts.FordMsg47ABusHiSpdTrlrAidKnobPosInvldPassdTiThd.Val /end CHARACTERISTIC
/begin CHARACTERISTIC FordMsg47ABusHiSpd.FordMsg47ABusHiSpdTrlrAidKnobPosMissTiThd.Val "MICROSAR RTE" VALUE 0x0 RTE_RL_UWORD 0 NO_COMPU_METHOD 0 65535 SYMBOL_LINK "Rte_CalprmRom_CalRegn01Cmn_DEFAULT_RTE_CALPRM_GROUP.FordMsg47ABusHiSpdTrlrAidKnobPosMissTiThd_Val" 0 DISPLAY_IDENTIFIER FordMsg47ABusHiSpd.CalibrationPorts.FordMsg47ABusHiSpdTrlrAidKnobPosMissTiThd.Val /end CHARACTERISTIC
/begin CHARACTERISTIC FordMsg47ABusHiSpd.FordMsg47ABusHiSpdTrlrAidKnobPosPassdTiThd.Val "MICROSAR RTE" VALUE 0x0 RTE_RL_UWORD 0 NO_COMPU_METHOD 0 65535 SYMBOL_LINK "Rte_CalprmRom_CalRegn01Cmn_DEFAULT_RTE_CALPRM_GROUP.FordMsg47ABusHiSpdTrlrAidKnobPosPassdTiThd_Val" 0 DISPLAY_IDENTIFIER FordMsg47ABusHiSpd.CalibrationPorts.FordMsg47ABusHiSpdTrlrAidKnobPosPassdTiThd.Val /end CHARACTERISTIC
/begin CHARACTERISTIC FordMsg4B0BusHiSpd.FordMsg4B0BusHiSpdCanDtcInhbTiThd.Val "MICROSAR RTE" VALUE 0x0 RTE_RL_UWORD 0 NO_COMPU_METHOD 0 65535 SYMBOL_LINK "Rte_CalRegn01Cmn_FordMsg4B0BusHiSpdCanDtcInhbTiThd_Val" 0 DISPLAY_IDENTIFIER FordMsg4B0BusHiSpd.CalibrationPorts.FordMsg4B0BusHiSpdCanDtcInhbTiThd.Val /end CHARACTERISTIC
/begin CHARACTERISTIC FordMsg4B0BusHiSpd.FordMsg4B0BusHiSpdMsgFltNtcDiagcTiThd.Val "MICROSAR RTE" VALUE 0x0 RTE_RL_UWORD 0 NO_COMPU_METHOD 0 65535 SYMBOL_LINK "Rte_CalRegn01Cmn_FordMsg4B0BusHiSpdMsgFltNtcDiagcTiThd_Val" 0 DISPLAY_IDENTIFIER FordMsg4B0BusHiSpd.CalibrationPorts.FordMsg4B0BusHiSpdMsgFltNtcDiagcTiThd.Val /end CHARACTERISTIC
/begin CHARACTERISTIC FordMsg4B0BusHiSpd.FordMsg4B0BusHiSpdMsgFltTiThd.Val "MICROSAR RTE" VALUE 0x0 RTE_RL_UWORD 0 NO_COMPU_METHOD 0 65535 SYMBOL_LINK "Rte_CalRegn01Cmn_FordMsg4B0BusHiSpdMsgFltTiThd_Val" 0 DISPLAY_IDENTIFIER FordMsg4B0BusHiSpd.CalibrationPorts.FordMsg4B0BusHiSpdMsgFltTiThd.Val /end CHARACTERISTIC
/begin CHARACTERISTIC FordMsg4B0BusHiSpd.FordMsg4B0BusHiSpdMsgMissNtcDiagcTiThd.Val "MICROSAR RTE" VALUE 0x0 RTE_RL_UWORD 0 NO_COMPU_METHOD 0 65535 SYMBOL_LINK "Rte_CalRegn01Cmn_FordMsg4B0BusHiSpdMsgMissNtcDiagcTiThd_Val" 0 DISPLAY_IDENTIFIER FordMsg4B0BusHiSpd.CalibrationPorts.FordMsg4B0BusHiSpdMsgMissNtcDiagcTiThd.Val /end CHARACTERISTIC
/begin CHARACTERISTIC FordMsg4B0BusHiSpd.FordMsg4B0BusHiSpdMsgMissTiThd.Val "MICROSAR RTE" VALUE 0x0 RTE_RL_UWORD 0 NO_COMPU_METHOD 0 65535 SYMBOL_LINK "Rte_CalRegn01Cmn_FordMsg4B0BusHiSpdMsgMissTiThd_Val" 0 DISPLAY_IDENTIFIER FordMsg4B0BusHiSpd.CalibrationPorts.FordMsg4B0BusHiSpdMsgMissTiThd.Val /end CHARACTERISTIC
/begin CHARACTERISTIC FordMsg4B0BusHiSpd.FordMsg4B0BusHiSpdMsgRxdNtcDiagcTiThd.Val "MICROSAR RTE" VALUE 0x0 RTE_RL_UWORD 0 NO_COMPU_METHOD 0 65535 SYMBOL_LINK "Rte_CalRegn01Cmn_FordMsg4B0BusHiSpdMsgRxdNtcDiagcTiThd_Val" 0 DISPLAY_IDENTIFIER FordMsg4B0BusHiSpd.CalibrationPorts.FordMsg4B0BusHiSpdMsgRxdNtcDiagcTiThd.Val /end CHARACTERISTIC
/begin CHARACTERISTIC FordMsg4B0BusHiSpd.FordMsg4B0BusHiSpdMsgVldNtcDiagcTiThd.Val "MICROSAR RTE" VALUE 0x0 RTE_RL_UWORD 0 NO_COMPU_METHOD 0 65535 SYMBOL_LINK "Rte_CalRegn01Cmn_FordMsg4B0BusHiSpdMsgVldNtcDiagcTiThd_Val" 0 DISPLAY_IDENTIFIER FordMsg4B0BusHiSpd.CalibrationPorts.FordMsg4B0BusHiSpdMsgVldNtcDiagcTiThd.Val /end CHARACTERISTIC
/begin CHARACTERISTIC FordMsg4B0BusHiSpd.FordMsg4B0BusHiSpdMsgVldTiThd.Val "MICROSAR RTE" VALUE 0x0 RTE_RL_UWORD 0 NO_COMPU_METHOD 0 65535 SYMBOL_LINK "Rte_CalRegn01Cmn_FordMsg4B0BusHiSpdMsgVldTiThd_Val" 0 DISPLAY_IDENTIFIER FordMsg4B0BusHiSpd.CalibrationPorts.FordMsg4B0BusHiSpdMsgVldTiThd.Val /end CHARACTERISTIC
/begin MEASUREMENT FordMsg415BusHiSpd.ChksBrkModlInvldFaildRefTi "MICROSAR RTE" ULONG NO_COMPU_METHOD 0 0 0 4294967295 ECU_ADDRESS 0 SYMBOL_LINK "Rte_FordMsg415BusHiSpd_ChksBrkModlInvldFaildRefTi" 0 DISPLAY_IDENTIFIER FordMsg415BusHiSpd.PerInstanceMemories.ChksBrkModlInvldFaildRefTi /end MEASUREMENT
/begin MEASUREMENT FordMsg415BusHiSpd.ChksBrkModlInvldPassdRefTi "MICROSAR RTE" ULONG NO_COMPU_METHOD 0 0 0 4294967295 ECU_ADDRESS 0 SYMBOL_LINK "Rte_FordMsg415BusHiSpd_ChksBrkModlInvldPassdRefTi" 0 DISPLAY_IDENTIFIER FordMsg415BusHiSpd.PerInstanceMemories.ChksBrkModlInvldPassdRefTi /end MEASUREMENT
/begin MEASUREMENT FordMsg415BusHiSpd.ClrDiagcFlgProxy.Val "MICROSAR RTE" UBYTE NO_COMPU_METHOD 0 0 0 255 ECU_ADDRESS 0 SYMBOL_LINK "Rte_DiagcMgr_ClrDiagcFlgProxy_Val" 0 DISPLAY_IDENTIFIER FordMsg415BusHiSpd.ReceiverPorts.ClrDiagcFlgProxy.Val /end MEASUREMENT
/begin MEASUREMENT FordMsg415BusHiSpd.ClrDiagcFlgProxyPrev "MICROSAR RTE" UBYTE NO_COMPU_METHOD 0 0 0 255 ECU_ADDRESS 0 SYMBOL_LINK "Rte_FordMsg415BusHiSpd_ClrDiagcFlgProxyPrev" 0 DISPLAY_IDENTIFIER FordMsg415BusHiSpd.PerInstanceMemories.ClrDiagcFlgProxyPrev /end MEASUREMENT
/begin MEASUREMENT FordMsg415BusHiSpd.CntrBrkModlInvldFaildRefTi "MICROSAR RTE" ULONG NO_COMPU_METHOD 0 0 0 4294967295 ECU_ADDRESS 0 SYMBOL_LINK "Rte_FordMsg415BusHiSpd_CntrBrkModlInvldFaildRefTi" 0 DISPLAY_IDENTIFIER FordMsg415BusHiSpd.PerInstanceMemories.CntrBrkModlInvldFaildRefTi /end MEASUREMENT
/begin MEASUREMENT FordMsg415BusHiSpd.CntrBrkModlInvldPassdRefTi "MICROSAR RTE" ULONG NO_COMPU_METHOD 0 0 0 4294967295 ECU_ADDRESS 0 SYMBOL_LINK "Rte_FordMsg415BusHiSpd_CntrBrkModlInvldPassdRefTi" 0 DISPLAY_IDENTIFIER FordMsg415BusHiSpd.PerInstanceMemories.CntrBrkModlInvldPassdRefTi /end MEASUREMENT
/begin MEASUREMENT FordMsg415BusHiSpd.FirstTranVldFlg "MICROSAR RTE" UBYTE RTE_CM_BOOLEAN 0 0 0 255 ECU_ADDRESS 0 SYMBOL_LINK "Rte_FordMsg415BusHiSpd_FirstTranVldFlg" 0 DISPLAY_IDENTIFIER FordMsg415BusHiSpd.PerInstanceMemories.FirstTranVldFlg /end MEASUREMENT
/begin MEASUREMENT FordMsg415BusHiSpd.FordAbsPrsnt.Logl "MICROSAR RTE" UBYTE RTE_CM_BOOLEAN 0 0 0 255 ECU_ADDRESS 0 SYMBOL_LINK "Rte_CustDiag_FordAbsPrsnt_Logl" 0 DISPLAY_IDENTIFIER FordMsg415BusHiSpd.ReceiverPorts.FordAbsPrsnt.Logl /end MEASUREMENT
/begin MEASUREMENT FordMsg415BusHiSpd.FordCanDtcInhb.Val "MICROSAR RTE" UBYTE NO_COMPU_METHOD 0 0 0 255 ECU_ADDRESS 0 SYMBOL_LINK "Rte_FordCanDtcInhb_FordCanDtcInhb8_Val" 0 DISPLAY_IDENTIFIER FordMsg415BusHiSpd.ReceiverPorts.FordCanDtcInhb.Val /end MEASUREMENT
/begin MEASUREMENT FordMsg415BusHiSpd.FordEpsLifeCycMod.Val "MICROSAR RTE" UBYTE NO_COMPU_METHOD 0 0 0 255 ECU_ADDRESS 0 SYMBOL_LINK "Rte_FordCanDtcInhb_FordEpsLifeCycMod_Val" 0 DISPLAY_IDENTIFIER FordMsg415BusHiSpd.ReceiverPorts.FordEpsLifeCycMod.Val /end MEASUREMENT
/begin MEASUREMENT FordMsg415BusHiSpd.FordInvldMsgDiagcInhb.Val "MICROSAR RTE" UBYTE NO_COMPU_METHOD 0 0 0 255 ECU_ADDRESS 0 SYMBOL_LINK "Rte_FordMsg415BusHiSpd_FordInvldMsgDiagcInhb_Val" 0 DISPLAY_IDENTIFIER FordMsg415BusHiSpd.ReceiverPorts.FordInvldMsgDiagcInhb.Val /end MEASUREMENT
/begin MEASUREMENT FordMsg415BusHiSpd.FordMfgDiagcInhb.Val "MICROSAR RTE" UBYTE NO_COMPU_METHOD 0 0 0 255 ECU_ADDRESS 0 SYMBOL_LINK "Rte_FordMsg415BusHiSpd_FordMfgDiagcInhb_Val" 0 DISPLAY_IDENTIFIER FordMsg415BusHiSpd.ReceiverPorts.FordMfgDiagcInhb.Val /end MEASUREMENT
/begin MEASUREMENT FordMsg415BusHiSpd.FordMissMsgDiagcInhb.Val "MICROSAR RTE" UBYTE NO_COMPU_METHOD 0 0 0 255 ECU_ADDRESS 0 SYMBOL_LINK "Rte_FordMsg415BusHiSpd_FordMissMsgDiagcInhb_Val" 0 DISPLAY_IDENTIFIER FordMsg415BusHiSpd.ReceiverPorts.FordMissMsgDiagcInhb.Val /end MEASUREMENT
/begin MEASUREMENT FordMsg415BusHiSpd.FordTrlrBackupAssiEnad.Logl "MICROSAR RTE" UBYTE RTE_CM_BOOLEAN 0 0 0 255 ECU_ADDRESS 0 SYMBOL_LINK "Rte_FordMsg415BusHiSpd_FordTrlrBackupAssiEnad_Logl" 0 DISPLAY_IDENTIFIER FordMsg415BusHiSpd.ReceiverPorts.FordTrlrBackupAssiEnad.Logl /end MEASUREMENT
/begin MEASUREMENT FordMsg415BusHiSpd.FordVehLoSpdMtnCtrlBrkSprtSts.Ford_LsmcBrkDecel_D_Stat "MICROSAR RTE" UBYTE RTE_CM_ENUM_Ford_LsmcBrkDecel_D_Stat 0 0 0 7 ECU_ADDRESS 0 SYMBOL_LINK "Rte_FordMsg415BusHiSpd_FordVehLoSpdMtnCtrlBrkSprtSts_Ford_LsmcBrkDecel_D_Stat" 0 DISPLAY_IDENTIFIER FordMsg415BusHiSpd.SenderPorts.FordVehLoSpdMtnCtrlBrkSprtSts.Ford_LsmcBrkDecel_D_Stat /end MEASUREMENT
/begin MEASUREMENT FordMsg415BusHiSpd.FordVehLoSpdMtnCtrlBrkSprtStsPrev "MICROSAR RTE" UBYTE RTE_CM_ENUM_Ford_LsmcBrkDecel_D_Stat 0 0 0 7 ECU_ADDRESS 0 SYMBOL_LINK "Rte_FordMsg415BusHiSpd_FordVehLoSpdMtnCtrlBrkSprtStsPrev" 0 DISPLAY_IDENTIFIER FordMsg415BusHiSpd.PerInstanceMemories.FordVehLoSpdMtnCtrlBrkSprtStsPrev /end MEASUREMENT
/begin MEASUREMENT FordMsg415BusHiSpd.FordVehLoSpdMtnCtrlBrkSprtStsRaw.Val "MICROSAR RTE" UBYTE NO_COMPU_METHOD 0 0 0 255 ECU_ADDRESS 0 SYMBOL_LINK "Rte_FordMsg415BusHiSpd_FordVehLoSpdMtnCtrlBrkSprtStsRaw_Val" 0 DISPLAY_IDENTIFIER FordMsg415BusHiSpd.SenderPorts.FordVehLoSpdMtnCtrlBrkSprtStsRaw.Val /end MEASUREMENT
/begin MEASUREMENT FordMsg415BusHiSpd.FordVehLoSpdMtnCtrlBrkSprtStsRawPrev "MICROSAR RTE" UBYTE NO_COMPU_METHOD 0 0 0 255 ECU_ADDRESS 0 SYMBOL_LINK "Rte_FordMsg415BusHiSpd_FordVehLoSpdMtnCtrlBrkSprtStsRawPrev" 0 DISPLAY_IDENTIFIER FordMsg415BusHiSpd.PerInstanceMemories.FordVehLoSpdMtnCtrlBrkSprtStsRawPrev /end MEASUREMENT
/begin MEASUREMENT FordMsg415BusHiSpd.FordVehLoSpdMtnCtrlBrkSprtVld.Logl "MICROSAR RTE" UBYTE RTE_CM_BOOLEAN 0 0 0 255 ECU_ADDRESS 0 SYMBOL_LINK "Rte_FordMsg415BusHiSpd_FordVehLoSpdMtnCtrlBrkSprtVld_Logl" 0 DISPLAY_IDENTIFIER FordMsg415BusHiSpd.SenderPorts.FordVehLoSpdMtnCtrlBrkSprtVld.Logl /end MEASUREMENT
/begin MEASUREMENT FordMsg415BusHiSpd.FordVehLoSpdMtnCtrlBrkSprtVldFlg "MICROSAR RTE" UBYTE RTE_CM_BOOLEAN 0 0 0 255 ECU_ADDRESS 0 SYMBOL_LINK "Rte_FordMsg415BusHiSpd_FordVehLoSpdMtnCtrlBrkSprtVldFlg" 0 DISPLAY_IDENTIFIER FordMsg415BusHiSpd.PerInstanceMemories.FordVehLoSpdMtnCtrlBrkSprtVldFlg /end MEASUREMENT
/begin MEASUREMENT FordMsg415BusHiSpd.FordVehLoSpdMtnCtrlBrkSprtVldPrev "MICROSAR RTE" UBYTE RTE_CM_BOOLEAN 0 0 0 255 ECU_ADDRESS 0 SYMBOL_LINK "Rte_FordMsg415BusHiSpd_FordVehLoSpdMtnCtrlBrkSprtVldPrev" 0 DISPLAY_IDENTIFIER FordMsg415BusHiSpd.PerInstanceMemories.FordVehLoSpdMtnCtrlBrkSprtVldPrev /end MEASUREMENT
/begin MEASUREMENT FordMsg415BusHiSpd.FordVehMsg415Miss "MICROSAR RTE" UBYTE RTE_CM_BOOLEAN 0 0 0 255 ECU_ADDRESS 0 SYMBOL_LINK "Rte_FordMsg415BusHiSpd_FordVehMsg415Miss" 0 DISPLAY_IDENTIFIER FordMsg415BusHiSpd.PerInstanceMemories.FordVehMsg415Miss /end MEASUREMENT
/begin MEASUREMENT FordMsg415BusHiSpd.FordVehMsg415Rxd "MICROSAR RTE" UBYTE RTE_CM_BOOLEAN 0 0 0 255 ECU_ADDRESS 0 SYMBOL_LINK "Rte_FordMsg415BusHiSpd_FordVehMsg415Rxd" 0 DISPLAY_IDENTIFIER FordMsg415BusHiSpd.PerInstanceMemories.FordVehMsg415Rxd /end MEASUREMENT
/begin MEASUREMENT FordMsg415BusHiSpd.FordVehSpdBrkModl.Val "MICROSAR RTE" FLOAT32_IEEE NO_COMPU_METHOD 0 0 -3.402823466e+38 3.402823466e+38 ECU_ADDRESS 0 SYMBOL_LINK "Rte_FordMsg415BusHiSpd_FordVehSpdBrkModl_Val" 0 DISPLAY_IDENTIFIER FordMsg415BusHiSpd.SenderPorts.FordVehSpdBrkModl.Val /end MEASUREMENT
/begin MEASUREMENT FordMsg415BusHiSpd.FordVehSpdBrkModlLoQlyVld.Logl "MICROSAR RTE" UBYTE RTE_CM_BOOLEAN 0 0 0 255 ECU_ADDRESS 0 SYMBOL_LINK "Rte_FordMsg415BusHiSpd_FordVehSpdBrkModlLoQlyVld_Logl" 0 DISPLAY_IDENTIFIER FordMsg415BusHiSpd.SenderPorts.FordVehSpdBrkModlLoQlyVld.Logl /end MEASUREMENT
/begin MEASUREMENT FordMsg415BusHiSpd.FordVehSpdBrkModlLoQlyVldPrev "MICROSAR RTE" UBYTE RTE_CM_BOOLEAN 0 0 0 255 ECU_ADDRESS 0 SYMBOL_LINK "Rte_FordMsg415BusHiSpd_FordVehSpdBrkModlLoQlyVldPrev" 0 DISPLAY_IDENTIFIER FordMsg415BusHiSpd.PerInstanceMemories.FordVehSpdBrkModlLoQlyVldPrev /end MEASUREMENT
/begin MEASUREMENT FordMsg415BusHiSpd.FordVehSpdBrkModlPrev "MICROSAR RTE" FLOAT32_IEEE NO_COMPU_METHOD 0 0 -3.402823466e+38 3.402823466e+38 ECU_ADDRESS 0 SYMBOL_LINK "Rte_FordMsg415BusHiSpd_FordVehSpdBrkModlPrev" 0 DISPLAY_IDENTIFIER FordMsg415BusHiSpd.PerInstanceMemories.FordVehSpdBrkModlPrev /end MEASUREMENT
/begin MEASUREMENT FordMsg415BusHiSpd.FordVehSpdBrkModlRaw.Val "MICROSAR RTE" UWORD NO_COMPU_METHOD 0 0 0 65535 ECU_ADDRESS 0 SYMBOL_LINK "Rte_FordMsg415BusHiSpd_FordVehSpdBrkModlRaw_Val" 0 DISPLAY_IDENTIFIER FordMsg415BusHiSpd.SenderPorts.FordVehSpdBrkModlRaw.Val /end MEASUREMENT
/begin MEASUREMENT FordMsg415BusHiSpd.FordVehSpdBrkModlRawPrev "MICROSAR RTE" UWORD NO_COMPU_METHOD 0 0 0 65535 ECU_ADDRESS 0 SYMBOL_LINK "Rte_FordMsg415BusHiSpd_FordVehSpdBrkModlRawPrev" 0 DISPLAY_IDENTIFIER FordMsg415BusHiSpd.PerInstanceMemories.FordVehSpdBrkModlRawPrev /end MEASUREMENT
/begin MEASUREMENT FordMsg415BusHiSpd.FordVehSpdBrkModlVld.Logl "MICROSAR RTE" UBYTE RTE_CM_BOOLEAN 0 0 0 255 ECU_ADDRESS 0 SYMBOL_LINK "Rte_FordMsg415BusHiSpd_FordVehSpdBrkModlVld_Logl" 0 DISPLAY_IDENTIFIER FordMsg415BusHiSpd.SenderPorts.FordVehSpdBrkModlVld.Logl /end MEASUREMENT
/begin MEASUREMENT FordMsg415BusHiSpd.FordVehSpdBrkModlVldPrev "MICROSAR RTE" UBYTE RTE_CM_BOOLEAN 0 0 0 255 ECU_ADDRESS 0 SYMBOL_LINK "Rte_FordMsg415BusHiSpd_FordVehSpdBrkModlVldPrev" 0 DISPLAY_IDENTIFIER FordMsg415BusHiSpd.PerInstanceMemories.FordVehSpdBrkModlVldPrev /end MEASUREMENT
/begin MEASUREMENT FordMsg415BusHiSpd.FordVehSpdChksBrkModl.Val "MICROSAR RTE" UBYTE NO_COMPU_METHOD 0 0 0 255 ECU_ADDRESS 0 SYMBOL_LINK "Rte_FordMsg415BusHiSpd_FordVehSpdChksBrkModl_Val" 0 DISPLAY_IDENTIFIER FordMsg415BusHiSpd.SenderPorts.FordVehSpdChksBrkModl.Val /end MEASUREMENT
/begin MEASUREMENT FordMsg415BusHiSpd.FordVehSpdChksBrkModlPrev "MICROSAR RTE" UBYTE NO_COMPU_METHOD 0 0 0 255 ECU_ADDRESS 0 SYMBOL_LINK "Rte_FordMsg415BusHiSpd_FordVehSpdChksBrkModlPrev" 0 DISPLAY_IDENTIFIER FordMsg415BusHiSpd.PerInstanceMemories.FordVehSpdChksBrkModlPrev /end MEASUREMENT
/begin MEASUREMENT FordMsg415BusHiSpd.FordVehSpdCntrBrkModl.Val "MICROSAR RTE" UBYTE NO_COMPU_METHOD 0 0 0 255 ECU_ADDRESS 0 SYMBOL_LINK "Rte_FordMsg415BusHiSpd_FordVehSpdCntrBrkModl_Val" 0 DISPLAY_IDENTIFIER FordMsg415BusHiSpd.SenderPorts.FordVehSpdCntrBrkModl.Val /end MEASUREMENT
/begin MEASUREMENT FordMsg415BusHiSpd.FordVehSpdCntrBrkModlPrev "MICROSAR RTE" UBYTE NO_COMPU_METHOD 0 0 0 255 ECU_ADDRESS 0 SYMBOL_LINK "Rte_FordMsg415BusHiSpd_FordVehSpdCntrBrkModlPrev" 0 DISPLAY_IDENTIFIER FordMsg415BusHiSpd.PerInstanceMemories.FordVehSpdCntrBrkModlPrev /end MEASUREMENT
/begin MEASUREMENT FordMsg415BusHiSpd.FordVehSpdQlyFacBrkModl.Ford_VehVActlBrk_D_Qf "MICROSAR RTE" UBYTE RTE_CM_ENUM_Ford_VehVActlBrk_D_Qf 0 0 0 3 ECU_ADDRESS 0 SYMBOL_LINK "Rte_FordMsg415BusHiSpd_FordVehSpdQlyFacBrkModl_Ford_VehVActlBrk_D_Qf" 0 DISPLAY_IDENTIFIER FordMsg415BusHiSpd.SenderPorts.FordVehSpdQlyFacBrkModl.Ford_VehVActlBrk_D_Qf /end MEASUREMENT
/begin MEASUREMENT FordMsg415BusHiSpd.FordVehSpdQlyFacBrkModlPrev "MICROSAR RTE" UBYTE RTE_CM_ENUM_Ford_VehVActlBrk_D_Qf 0 0 0 3 ECU_ADDRESS 0 SYMBOL_LINK "Rte_FordMsg415BusHiSpd_FordVehSpdQlyFacBrkModlPrev" 0 DISPLAY_IDENTIFIER FordMsg415BusHiSpd.PerInstanceMemories.FordVehSpdQlyFacBrkModlPrev /end MEASUREMENT
/begin MEASUREMENT FordMsg415BusHiSpd.MissMsgFaildRefTi "MICROSAR RTE" ULONG NO_COMPU_METHOD 0 0 0 4294967295 ECU_ADDRESS 0 SYMBOL_LINK "Rte_FordMsg415BusHiSpd_MissMsgFaildRefTi" 0 DISPLAY_IDENTIFIER FordMsg415BusHiSpd.PerInstanceMemories.MissMsgFaildRefTi /end MEASUREMENT
/begin MEASUREMENT FordMsg415BusHiSpd.MissMsgPassdRefTi "MICROSAR RTE" ULONG NO_COMPU_METHOD 0 0 0 4294967295 ECU_ADDRESS 0 SYMBOL_LINK "Rte_FordMsg415BusHiSpd_MissMsgPassdRefTi" 0 DISPLAY_IDENTIFIER FordMsg415BusHiSpd.PerInstanceMemories.MissMsgPassdRefTi /end MEASUREMENT
/begin MEASUREMENT FordMsg415BusHiSpd.QlyFacBrkModlInvldFaildRefTi "MICROSAR RTE" ULONG NO_COMPU_METHOD 0 0 0 4294967295 ECU_ADDRESS 0 SYMBOL_LINK "Rte_FordMsg415BusHiSpd_QlyFacBrkModlInvldFaildRefTi" 0 DISPLAY_IDENTIFIER FordMsg415BusHiSpd.PerInstanceMemories.QlyFacBrkModlInvldFaildRefTi /end MEASUREMENT
/begin MEASUREMENT FordMsg415BusHiSpd.QlyFacBrkModlInvldPassdRefTi "MICROSAR RTE" ULONG NO_COMPU_METHOD 0 0 0 4294967295 ECU_ADDRESS 0 SYMBOL_LINK "Rte_FordMsg415BusHiSpd_QlyFacBrkModlInvldPassdRefTi" 0 DISPLAY_IDENTIFIER FordMsg415BusHiSpd.PerInstanceMemories.QlyFacBrkModlInvldPassdRefTi /end MEASUREMENT
/begin MEASUREMENT FordMsg417BusHiSpd.FordVehEvasSteerAssiSts.Ford_EsaOn_B_Stat "MICROSAR RTE" UBYTE RTE_CM_BOOLEAN 0 0 0 255 ECU_ADDRESS 0 SYMBOL_LINK "Rte_CDD_FordBlaBoxIfCmp2_FordVehEvasSteerAssiSts_Ford_EsaOn_B_Stat" 0 DISPLAY_IDENTIFIER FordMsg417BusHiSpd.ReceiverPorts.FordVehEvasSteerAssiSts.Ford_EsaOn_B_Stat /end MEASUREMENT
/begin MEASUREMENT FordMsg417BusHiSpd.FordVehLatCtrlLimSts.Ford_LatCtlLim_D_Stat "MICROSAR RTE" UBYTE RTE_CM_ENUM_Ford_LatCtlLim_D_Stat 0 0 0 3 ECU_ADDRESS 0 SYMBOL_LINK "Rte_CDD_FordBlaBoxIfCmp1_FordVehLatCtrlLimSts_Ford_LatCtlLim_D_Stat" 0 DISPLAY_IDENTIFIER FordMsg417BusHiSpd.ReceiverPorts.FordVehLatCtrlLimSts.Ford_LatCtlLim_D_Stat /end MEASUREMENT
/begin MEASUREMENT FordMsg417BusHiSpd.FordVehLatCtrlSteerSts.Ford_LatCtlSte_D_Stat "MICROSAR RTE" UBYTE RTE_CM_ENUM_Ford_LatCtlSte_D_Stat 0 0 0 7 ECU_ADDRESS 0 SYMBOL_LINK "Rte_CDD_FordBlaBoxIfCmp1_FordVehLatCtrlSteerSts_Ford_LatCtlSte_D_Stat" 0 DISPLAY_IDENTIFIER FordMsg417BusHiSpd.ReceiverPorts.FordVehLatCtrlSteerSts.Ford_LatCtlSte_D_Stat /end MEASUREMENT
/begin MEASUREMENT FordMsg417BusHiSpd.FordVehSelDrvModSteerSts.Ford_SelDrvMdeSte_D_Stat "MICROSAR RTE" UBYTE RTE_CM_ENUM_Ford_SelDrvMdeSte_D_Stat 0 0 0 3 ECU_ADDRESS 0 SYMBOL_LINK "Rte_FordMsg417BusHiSpd_FordVehSelDrvModSteerSts_Ford_SelDrvMdeSte_D_Stat" 0 DISPLAY_IDENTIFIER FordMsg417BusHiSpd.ReceiverPorts.FordVehSelDrvModSteerSts.Ford_SelDrvMdeSte_D_Stat /end MEASUREMENT
/begin MEASUREMENT FordMsg417BusHiSpd.FordVehTrlrAidEnaSts.Ford_TrlrAidEnbl_D2_Stat "MICROSAR RTE" UBYTE RTE_CM_ENUM_Ford_TrlrAidEnbl_D2_Stat 0 0 0 7 ECU_ADDRESS 0 SYMBOL_LINK "Rte_FordMsg417BusHiSpd_FordVehTrlrAidEnaSts_Ford_TrlrAidEnbl_D2_Stat" 0 DISPLAY_IDENTIFIER FordMsg417BusHiSpd.ReceiverPorts.FordVehTrlrAidEnaSts.Ford_TrlrAidEnbl_D2_Stat /end MEASUREMENT
/begin MEASUREMENT FordMsg417BusHiSpd.FordVehTrlrAidMsgTxtReq.Ford_TrlrAidMsgTxt_D2_Rq "MICROSAR RTE" UBYTE RTE_CM_ENUM_Ford_TrlrAidMsgTxt_D2_Rq 0 0 0 63 ECU_ADDRESS 0 SYMBOL_LINK "Rte_FordMsg417BusHiSpd_FordVehTrlrAidMsgTxtReq_Ford_TrlrAidMsgTxt_D2_Rq" 0 DISPLAY_IDENTIFIER FordMsg417BusHiSpd.ReceiverPorts.FordVehTrlrAidMsgTxtReq.Ford_TrlrAidMsgTxt_D2_Rq /end MEASUREMENT
/begin MEASUREMENT FordMsg41ABusHiSpd.ClrDiagcFlgProxy.Val "MICROSAR RTE" UBYTE NO_COMPU_METHOD 0 0 0 255 ECU_ADDRESS 0 SYMBOL_LINK "Rte_DiagcMgr_ClrDiagcFlgProxy_Val" 0 DISPLAY_IDENTIFIER FordMsg41ABusHiSpd.ReceiverPorts.ClrDiagcFlgProxy.Val /end MEASUREMENT
/begin MEASUREMENT FordMsg41ABusHiSpd.ClrDiagcFlgProxyPrev "MICROSAR RTE" UBYTE NO_COMPU_METHOD 0 0 0 255 ECU_ADDRESS 0 SYMBOL_LINK "Rte_FordMsg41ABusHiSpd_ClrDiagcFlgProxyPrev" 0 DISPLAY_IDENTIFIER FordMsg41ABusHiSpd.PerInstanceMemories.ClrDiagcFlgProxyPrev /end MEASUREMENT
/begin MEASUREMENT FordMsg41ABusHiSpd.FordCanDtcInhb.Logl "MICROSAR RTE" UBYTE RTE_CM_BOOLEAN 0 0 0 255 ECU_ADDRESS 0 SYMBOL_LINK "Rte_FordCanDtcInhb_FordCanDtcInhb_Logl" 0 DISPLAY_IDENTIFIER FordMsg41ABusHiSpd.ReceiverPorts.FordCanDtcInhb.Logl /end MEASUREMENT
/begin MEASUREMENT FordMsg41ABusHiSpd.FordEpsLifeCycMod.Val "MICROSAR RTE" UBYTE NO_COMPU_METHOD 0 0 0 255 ECU_ADDRESS 0 SYMBOL_LINK "Rte_FordCanDtcInhb_FordEpsLifeCycMod_Val" 0 DISPLAY_IDENTIFIER FordMsg41ABusHiSpd.ReceiverPorts.FordEpsLifeCycMod.Val /end MEASUREMENT
/begin MEASUREMENT FordMsg41ABusHiSpd.FordVehMsg41AMiss "MICROSAR RTE" UBYTE RTE_CM_BOOLEAN 0 0 0 255 ECU_ADDRESS 0 SYMBOL_LINK "Rte_FordMsg41ABusHiSpd_FordVehMsg41AMiss" 0 DISPLAY_IDENTIFIER FordMsg41ABusHiSpd.PerInstanceMemories.FordVehMsg41AMiss /end MEASUREMENT
/begin MEASUREMENT FordMsg41ABusHiSpd.FordVehOutdAirT.Val "MICROSAR RTE" FLOAT32_IEEE NO_COMPU_METHOD 0 0 -3.402823466e+38 3.402823466e+38 ECU_ADDRESS 0 SYMBOL_LINK "Rte_FordMsg41ABusHiSpd_FordVehOutdAirT_Val" 0 DISPLAY_IDENTIFIER FordMsg41ABusHiSpd.SenderPorts.FordVehOutdAirT.Val /end MEASUREMENT
/begin MEASUREMENT FordMsg41ABusHiSpd.FordVehOutdAirTPrev "MICROSAR RTE" FLOAT32_IEEE NO_COMPU_METHOD 0 0 -3.402823466e+38 3.402823466e+38 ECU_ADDRESS 0 SYMBOL_LINK "Rte_FordMsg41ABusHiSpd_FordVehOutdAirTPrev" 0 DISPLAY_IDENTIFIER FordMsg41ABusHiSpd.PerInstanceMemories.FordVehOutdAirTPrev /end MEASUREMENT
/begin MEASUREMENT FordMsg41ABusHiSpd.FordVehOutdAirTRaw.Val "MICROSAR RTE" UWORD NO_COMPU_METHOD 0 0 0 65535 ECU_ADDRESS 0 SYMBOL_LINK "Rte_FordMsg41ABusHiSpd_FordVehOutdAirTRaw_Val" 0 DISPLAY_IDENTIFIER FordMsg41ABusHiSpd.SenderPorts.FordVehOutdAirTRaw.Val /end MEASUREMENT
/begin MEASUREMENT FordMsg41ABusHiSpd.FordVehOutdAirTRawPrev "MICROSAR RTE" UWORD NO_COMPU_METHOD 0 0 0 65535 ECU_ADDRESS 0 SYMBOL_LINK "Rte_FordMsg41ABusHiSpd_FordVehOutdAirTRawPrev" 0 DISPLAY_IDENTIFIER FordMsg41ABusHiSpd.PerInstanceMemories.FordVehOutdAirTRawPrev /end MEASUREMENT
/begin MEASUREMENT FordMsg41ABusHiSpd.MissMsgFaildRefTi "MICROSAR RTE" ULONG NO_COMPU_METHOD 0 0 0 4294967295 ECU_ADDRESS 0 SYMBOL_LINK "Rte_FordMsg41ABusHiSpd_MissMsgFaildRefTi" 0 DISPLAY_IDENTIFIER FordMsg41ABusHiSpd.PerInstanceMemories.MissMsgFaildRefTi /end MEASUREMENT
/begin MEASUREMENT FordMsg41ABusHiSpd.MissMsgPassdRefTi "MICROSAR RTE" ULONG NO_COMPU_METHOD 0 0 0 4294967295 ECU_ADDRESS 0 SYMBOL_LINK "Rte_FordMsg41ABusHiSpd_MissMsgPassdRefTi" 0 DISPLAY_IDENTIFIER FordMsg41ABusHiSpd.PerInstanceMemories.MissMsgPassdRefTi /end MEASUREMENT
/begin MEASUREMENT FordMsg41EBusHiSpd.ClrDiagcFlgProxy.Val "MICROSAR RTE" UBYTE NO_COMPU_METHOD 0 0 0 255 ECU_ADDRESS 0 SYMBOL_LINK "Rte_DiagcMgr_ClrDiagcFlgProxy_Val" 0 DISPLAY_IDENTIFIER FordMsg41EBusHiSpd.ReceiverPorts.ClrDiagcFlgProxy.Val /end MEASUREMENT
/begin MEASUREMENT FordMsg41EBusHiSpd.ClrDiagcFlgProxyPrev "Clear Diagc Flag Proxy" UBYTE NO_COMPU_METHOD 0 0 0 255 ECU_ADDRESS 0 SYMBOL_LINK "Rte_FordMsg41EBusHiSpd_ClrDiagcFlgProxyPrev" 0 DISPLAY_IDENTIFIER FordMsg41EBusHiSpd.PerInstanceMemories.ClrDiagcFlgProxyPrev /end MEASUREMENT
/begin MEASUREMENT FordMsg41EBusHiSpd.FirstTranVldFlg "This flag is used to indicate the reception of first message" UBYTE RTE_CM_BOOLEAN 0 0 0 255 ECU_ADDRESS 0 SYMBOL_LINK "Rte_FordMsg41EBusHiSpd_FirstTranVldFlg" 0 DISPLAY_IDENTIFIER FordMsg41EBusHiSpd.PerInstanceMemories.FirstTranVldFlg /end MEASUREMENT
/begin MEASUREMENT FordMsg41EBusHiSpd.FordCanDtcInhb.Logl "MICROSAR RTE" UBYTE RTE_CM_BOOLEAN 0 0 0 255 ECU_ADDRESS 0 SYMBOL_LINK "Rte_FordCanDtcInhb_FordCanDtcInhb_Logl" 0 DISPLAY_IDENTIFIER FordMsg41EBusHiSpd.ReceiverPorts.FordCanDtcInhb.Logl /end MEASUREMENT
/begin MEASUREMENT FordMsg41EBusHiSpd.FordEpsLifeCycMod.Val "MICROSAR RTE" UBYTE NO_COMPU_METHOD 0 0 0 255 ECU_ADDRESS 0 SYMBOL_LINK "Rte_FordCanDtcInhb_FordEpsLifeCycMod_Val" 0 DISPLAY_IDENTIFIER FordMsg41EBusHiSpd.ReceiverPorts.FordEpsLifeCycMod.Val /end MEASUREMENT
/begin MEASUREMENT FordMsg41EBusHiSpd.FordSelDrvModEnad.Logl "MICROSAR RTE" UBYTE RTE_CM_BOOLEAN 0 0 0 255 ECU_ADDRESS 0 SYMBOL_LINK "Rte_CustDiag_FordSelDrvModEnad_Logl" 0 DISPLAY_IDENTIFIER FordMsg41EBusHiSpd.ReceiverPorts.FordSelDrvModEnad.Logl /end MEASUREMENT
/begin MEASUREMENT FordMsg41EBusHiSpd.FordVehMsg41EMiss "Previous value of Ford Vehicle Propulsion Wheel Torque Valid" UBYTE RTE_CM_BOOLEAN 0 0 0 255 ECU_ADDRESS 0 SYMBOL_LINK "Rte_FordMsg41EBusHiSpd_FordVehMsg41EMiss" 0 DISPLAY_IDENTIFIER FordMsg41EBusHiSpd.PerInstanceMemories.FordVehMsg41EMiss /end MEASUREMENT
/begin MEASUREMENT FordMsg41EBusHiSpd.FordVehPenSelDrvMod.Ford_SelDrvMdeChassis2_D_Rq "MICROSAR RTE" UBYTE RTE_CM_ENUM_Ford_SelDrvMdeChassis2_D_Rq 0 0 0 31 ECU_ADDRESS 0 SYMBOL_LINK "Rte_FordMsg41EBusHiSpd_FordVehPenSelDrvMod_Ford_SelDrvMdeChassis2_D_Rq" 0 DISPLAY_IDENTIFIER FordMsg41EBusHiSpd.SenderPorts.FordVehPenSelDrvMod.Ford_SelDrvMdeChassis2_D_Rq /end MEASUREMENT
/begin MEASUREMENT FordMsg41EBusHiSpd.FordVehPenSelDrvModPrev "Hold the Previous value of Ford Vehicle Personalization Select Drive Mode" UBYTE RTE_CM_ENUM_Ford_SelDrvMdeChassis2_D_Rq 0 0 0 31 ECU_ADDRESS 0 SYMBOL_LINK "Rte_FordMsg41EBusHiSpd_FordVehPenSelDrvModPrev" 0 DISPLAY_IDENTIFIER FordMsg41EBusHiSpd.PerInstanceMemories.FordVehPenSelDrvModPrev /end MEASUREMENT
/begin MEASUREMENT FordMsg41EBusHiSpd.FordVehSelDrvModChassisVld.Logl "MICROSAR RTE" UBYTE RTE_CM_BOOLEAN 0 0 0 255 ECU_ADDRESS 0 SYMBOL_LINK "Rte_FordMsg41EBusHiSpd_FordVehSelDrvModChassisVld_Logl" 0 DISPLAY_IDENTIFIER FordMsg41EBusHiSpd.SenderPorts.FordVehSelDrvModChassisVld.Logl /end MEASUREMENT
/begin MEASUREMENT FordMsg41EBusHiSpd.FordVehSelDrvModChassisVldFaildRefTi "Timer for Select Drive Mode Chassis Valid Failed Reference Time will increment or reset based on the conditions" ULONG NO_COMPU_METHOD 0 0 0 4294967295 ECU_ADDRESS 0 SYMBOL_LINK "Rte_FordMsg41EBusHiSpd_FordVehSelDrvModChassisVldFaildRefTi" 0 DISPLAY_IDENTIFIER FordMsg41EBusHiSpd.PerInstanceMemories.FordVehSelDrvModChassisVldFaildRefTi /end MEASUREMENT
/begin MEASUREMENT FordMsg41EBusHiSpd.FordVehSelDrvModChassisVldMissRefTi "Timer for Ford Vehicle Select Drive Mode Chassis Valid Missing Reference Time will incrementor reset based on the conditions" ULONG NO_COMPU_METHOD 0 0 0 4294967295 ECU_ADDRESS 0 SYMBOL_LINK "Rte_FordMsg41EBusHiSpd_FordVehSelDrvModChassisVldMissRefTi" 0 DISPLAY_IDENTIFIER FordMsg41EBusHiSpd.PerInstanceMemories.FordVehSelDrvModChassisVldMissRefTi /end MEASUREMENT
/begin MEASUREMENT FordMsg41EBusHiSpd.FordVehSelDrvModChassisVldPassdRefTi "Timer for Ford Vehicle Select Drive Mode Chassis Valid Passed Reference Time will increment or reset based on the conditions" ULONG NO_COMPU_METHOD 0 0 0 4294967295 ECU_ADDRESS 0 SYMBOL_LINK "Rte_FordMsg41EBusHiSpd_FordVehSelDrvModChassisVldPassdRefTi" 0 DISPLAY_IDENTIFIER FordMsg41EBusHiSpd.PerInstanceMemories.FordVehSelDrvModChassisVldPassdRefTi /end MEASUREMENT
/begin MEASUREMENT FordMsg41EBusHiSpd.FordVehSelDrvModChassisVldPrev "Previous Value of Ford Vehicle Select Drive Mode Chassis Valid" UBYTE RTE_CM_BOOLEAN 0 0 0 255 ECU_ADDRESS 0 SYMBOL_LINK "Rte_FordMsg41EBusHiSpd_FordVehSelDrvModChassisVldPrev" 0 DISPLAY_IDENTIFIER FordMsg41EBusHiSpd.PerInstanceMemories.FordVehSelDrvModChassisVldPrev /end MEASUREMENT
/begin MEASUREMENT FordMsg41EBusHiSpd.InvldMsgFaildRefTi "Timer for invalid message will increment or reset based on the conditions" ULONG NO_COMPU_METHOD 0 0 0 4294967295 ECU_ADDRESS 0 SYMBOL_LINK "Rte_FordMsg41EBusHiSpd_InvldMsgFaildRefTi" 0 DISPLAY_IDENTIFIER FordMsg41EBusHiSpd.PerInstanceMemories.InvldMsgFaildRefTi /end MEASUREMENT
/begin MEASUREMENT FordMsg41EBusHiSpd.InvldMsgPassdRefTi "Timer for invalid message will increment or reset based on the conditions" ULONG NO_COMPU_METHOD 0 0 0 4294967295 ECU_ADDRESS 0 SYMBOL_LINK "Rte_FordMsg41EBusHiSpd_InvldMsgPassdRefTi" 0 DISPLAY_IDENTIFIER FordMsg41EBusHiSpd.PerInstanceMemories.InvldMsgPassdRefTi /end MEASUREMENT
/begin MEASUREMENT FordMsg41EBusHiSpd.MissMsgFaildRefTi "Timer for missing message will increment or reset based on the conditions" ULONG NO_COMPU_METHOD 0 0 0 4294967295 ECU_ADDRESS 0 SYMBOL_LINK "Rte_FordMsg41EBusHiSpd_MissMsgFaildRefTi" 0 DISPLAY_IDENTIFIER FordMsg41EBusHiSpd.PerInstanceMemories.MissMsgFaildRefTi /end MEASUREMENT
/begin MEASUREMENT FordMsg41EBusHiSpd.MissMsgPassdRefTi "Timer for missing message will increment or reset based on the conditions" ULONG NO_COMPU_METHOD 0 0 0 4294967295 ECU_ADDRESS 0 SYMBOL_LINK "Rte_FordMsg41EBusHiSpd_MissMsgPassdRefTi" 0 DISPLAY_IDENTIFIER FordMsg41EBusHiSpd.PerInstanceMemories.MissMsgPassdRefTi /end MEASUREMENT
/begin MEASUREMENT FordMsg430BusHiSpd.ClrDiagcFlgProxy.Val "MICROSAR RTE" UBYTE NO_COMPU_METHOD 0 0 0 255 ECU_ADDRESS 0 SYMBOL_LINK "Rte_DiagcMgr_ClrDiagcFlgProxy_Val" 0 DISPLAY_IDENTIFIER FordMsg430BusHiSpd.ReceiverPorts.ClrDiagcFlgProxy.Val /end MEASUREMENT
/begin MEASUREMENT FordMsg430BusHiSpd.ClrDiagcFlgProxyPrev "Clear Diagnostics Flag Proxy Previous" UBYTE NO_COMPU_METHOD 0 0 0 255 ECU_ADDRESS 0 SYMBOL_LINK "Rte_FordMsg430BusHiSpd_ClrDiagcFlgProxyPrev" 0 DISPLAY_IDENTIFIER FordMsg430BusHiSpd.PerInstanceMemories.ClrDiagcFlgProxyPrev /end MEASUREMENT
/begin MEASUREMENT FordMsg430BusHiSpd.FordCanDtcInhb.Val "MICROSAR RTE" UBYTE NO_COMPU_METHOD 0 0 0 255 ECU_ADDRESS 0 SYMBOL_LINK "Rte_FordCanDtcInhb_FordCanDtcInhb8_Val" 0 DISPLAY_IDENTIFIER FordMsg430BusHiSpd.ReceiverPorts.FordCanDtcInhb.Val /end MEASUREMENT
/begin MEASUREMENT FordMsg430BusHiSpd.FordEpsLifeCycMod.Val "MICROSAR RTE" UBYTE NO_COMPU_METHOD 0 0 0 255 ECU_ADDRESS 0 SYMBOL_LINK "Rte_FordCanDtcInhb_FordEpsLifeCycMod_Val" 0 DISPLAY_IDENTIFIER FordMsg430BusHiSpd.ReceiverPorts.FordEpsLifeCycMod.Val /end MEASUREMENT
/begin MEASUREMENT FordMsg430BusHiSpd.FordMfgDiagcInhb.Val "MICROSAR RTE" UBYTE NO_COMPU_METHOD 0 0 0 255 ECU_ADDRESS 0 SYMBOL_LINK "Rte_FordMsg430BusHiSpd_FordMfgDiagcInhb_Val" 0 DISPLAY_IDENTIFIER FordMsg430BusHiSpd.ReceiverPorts.FordMfgDiagcInhb.Val /end MEASUREMENT
/begin MEASUREMENT FordMsg430BusHiSpd.FordMissMsgDiagcInhb.Val "MICROSAR RTE" UBYTE NO_COMPU_METHOD 0 0 0 255 ECU_ADDRESS 0 SYMBOL_LINK "Rte_FordMsg430BusHiSpd_FordMissMsgDiagcInhb_Val" 0 DISPLAY_IDENTIFIER FordMsg430BusHiSpd.ReceiverPorts.FordMissMsgDiagcInhb.Val /end MEASUREMENT
/begin MEASUREMENT FordMsg430BusHiSpd.FordVehMsg430Miss "Flag for missing message diagnostics, it is true when message is missing" UBYTE RTE_CM_BOOLEAN 0 0 0 255 ECU_ADDRESS 0 SYMBOL_LINK "Rte_FordMsg430BusHiSpd_FordVehMsg430Miss" 0 DISPLAY_IDENTIFIER FordMsg430BusHiSpd.PerInstanceMemories.FordVehMsg430Miss /end MEASUREMENT
/begin MEASUREMENT FordMsg430BusHiSpd.FordVehMsg430Rxd "Flag for missing message diagnostics, it is true when message is received" UBYTE RTE_CM_BOOLEAN 0 0 0 255 ECU_ADDRESS 0 SYMBOL_LINK "Rte_FordMsg430BusHiSpd_FordVehMsg430Rxd" 0 DISPLAY_IDENTIFIER FordMsg430BusHiSpd.PerInstanceMemories.FordVehMsg430Rxd /end MEASUREMENT
/begin MEASUREMENT FordMsg430BusHiSpd.FordVehOdom.Val "MICROSAR RTE" FLOAT32_IEEE NO_COMPU_METHOD 0 0 -3.402823466e+38 3.402823466e+38 ECU_ADDRESS 0 SYMBOL_LINK "Rte_FordMsg430BusHiSpd_FordVehOdom_Val" 0 DISPLAY_IDENTIFIER FordMsg430BusHiSpd.SenderPorts.FordVehOdom.Val /end MEASUREMENT
/begin MEASUREMENT FordMsg430BusHiSpd.FordVehOdomPrev "Previous Value for Ford Vehicle Odometer" FLOAT32_IEEE NO_COMPU_METHOD 0 0 -3.402823466e+38 3.402823466e+38 ECU_ADDRESS 0 SYMBOL_LINK "Rte_FordMsg430BusHiSpd_FordVehOdomPrev" 0 DISPLAY_IDENTIFIER FordMsg430BusHiSpd.PerInstanceMemories.FordVehOdomPrev /end MEASUREMENT
/begin MEASUREMENT FordMsg430BusHiSpd.MissMsgFaildRefTi "Timer for missing message will increment or reset based on the conditions" ULONG NO_COMPU_METHOD 0 0 0 4294967295 ECU_ADDRESS 0 SYMBOL_LINK "Rte_FordMsg430BusHiSpd_MissMsgFaildRefTi" 0 DISPLAY_IDENTIFIER FordMsg430BusHiSpd.PerInstanceMemories.MissMsgFaildRefTi /end MEASUREMENT
/begin MEASUREMENT FordMsg430BusHiSpd.MissMsgPassdRefTi "Timer for missing message will increment or reset based on the conditions" ULONG NO_COMPU_METHOD 0 0 0 4294967295 ECU_ADDRESS 0 SYMBOL_LINK "Rte_FordMsg430BusHiSpd_MissMsgPassdRefTi" 0 DISPLAY_IDENTIFIER FordMsg430BusHiSpd.PerInstanceMemories.MissMsgPassdRefTi /end MEASUREMENT
/begin MEASUREMENT FordMsg443BusHiSpd.ClrDiagcFlgProxy.Val "MICROSAR RTE" UBYTE NO_COMPU_METHOD 0 0 0 255 ECU_ADDRESS 0 SYMBOL_LINK "Rte_DiagcMgr_ClrDiagcFlgProxy_Val" 0 DISPLAY_IDENTIFIER FordMsg443BusHiSpd.ReceiverPorts.ClrDiagcFlgProxy.Val /end MEASUREMENT
/begin MEASUREMENT FordMsg443BusHiSpd.ClrDiagcFlgProxyPrev "MICROSAR RTE" UBYTE NO_COMPU_METHOD 0 0 0 255 ECU_ADDRESS 0 SYMBOL_LINK "Rte_FordMsg443BusHiSpd_ClrDiagcFlgProxyPrev" 0 DISPLAY_IDENTIFIER FordMsg443BusHiSpd.PerInstanceMemories.ClrDiagcFlgProxyPrev /end MEASUREMENT
/begin MEASUREMENT FordMsg443BusHiSpd.FordCanDtcInhb.Logl "MICROSAR RTE" UBYTE RTE_CM_BOOLEAN 0 0 0 255 ECU_ADDRESS 0 SYMBOL_LINK "Rte_FordCanDtcInhb_FordCanDtcInhb_Logl" 0 DISPLAY_IDENTIFIER FordMsg443BusHiSpd.ReceiverPorts.FordCanDtcInhb.Logl /end MEASUREMENT
/begin MEASUREMENT FordMsg443BusHiSpd.FordEpsLifeCycMod.Val "MICROSAR RTE" UBYTE NO_COMPU_METHOD 0 0 0 255 ECU_ADDRESS 0 SYMBOL_LINK "Rte_FordCanDtcInhb_FordEpsLifeCycMod_Val" 0 DISPLAY_IDENTIFIER FordMsg443BusHiSpd.ReceiverPorts.FordEpsLifeCycMod.Val /end MEASUREMENT
/begin MEASUREMENT FordMsg443BusHiSpd.FordTrlrBackUpAssiEnad.Logl "MICROSAR RTE" UBYTE RTE_CM_BOOLEAN 0 0 0 255 ECU_ADDRESS 0 SYMBOL_LINK "Rte_FordMsg443BusHiSpd_FordTrlrBackUpAssiEnad_Logl" 0 DISPLAY_IDENTIFIER FordMsg443BusHiSpd.ReceiverPorts.FordTrlrBackUpAssiEnad.Logl /end MEASUREMENT
/begin MEASUREMENT FordMsg443BusHiSpd.FordVehMsg443Miss "MICROSAR RTE" UBYTE RTE_CM_BOOLEAN 0 0 0 255 ECU_ADDRESS 0 SYMBOL_LINK "Rte_FordMsg443BusHiSpd_FordVehMsg443Miss" 0 DISPLAY_IDENTIFIER FordMsg443BusHiSpd.PerInstanceMemories.FordVehMsg443Miss /end MEASUREMENT
/begin MEASUREMENT FordMsg443BusHiSpd.FordVehTrlrLampCnctnStsRaw.Ford_TrlrLampCnnct_B_Actl "MICROSAR RTE" UBYTE RTE_CM_BOOLEAN 0 0 0 255 ECU_ADDRESS 0 SYMBOL_LINK "Rte_FordMsg443BusHiSpd_FordVehTrlrLampCnctnStsRaw_Ford_TrlrLampCnnct_B_Actl" 0 DISPLAY_IDENTIFIER FordMsg443BusHiSpd.SenderPorts.FordVehTrlrLampCnctnStsRaw.Ford_TrlrLampCnnct_B_Actl /end MEASUREMENT
/begin MEASUREMENT FordMsg443BusHiSpd.FordVehTrlrLampCnctnStsRawPrev "MICROSAR RTE" UBYTE RTE_CM_BOOLEAN 0 0 0 255 ECU_ADDRESS 0 SYMBOL_LINK "Rte_FordMsg443BusHiSpd_FordVehTrlrLampCnctnStsRawPrev" 0 DISPLAY_IDENTIFIER FordMsg443BusHiSpd.PerInstanceMemories.FordVehTrlrLampCnctnStsRawPrev /end MEASUREMENT
/begin MEASUREMENT FordMsg443BusHiSpd.MissMsgFaildRefTi "MICROSAR RTE" ULONG NO_COMPU_METHOD 0 0 0 4294967295 ECU_ADDRESS 0 SYMBOL_LINK "Rte_FordMsg443BusHiSpd_MissMsgFaildRefTi" 0 DISPLAY_IDENTIFIER FordMsg443BusHiSpd.PerInstanceMemories.MissMsgFaildRefTi /end MEASUREMENT
/begin MEASUREMENT FordMsg443BusHiSpd.MissMsgPassdRefTi "MICROSAR RTE" ULONG NO_COMPU_METHOD 0 0 0 4294967295 ECU_ADDRESS 0 SYMBOL_LINK "Rte_FordMsg443BusHiSpd_MissMsgPassdRefTi" 0 DISPLAY_IDENTIFIER FordMsg443BusHiSpd.PerInstanceMemories.MissMsgPassdRefTi /end MEASUREMENT
/begin MEASUREMENT FordMsg459BusHiSpd.ClrDiagcFlgProxy.Val "MICROSAR RTE" UBYTE NO_COMPU_METHOD 0 0 0 255 ECU_ADDRESS 0 SYMBOL_LINK "Rte_DiagcMgr_ClrDiagcFlgProxy_Val" 0 DISPLAY_IDENTIFIER FordMsg459BusHiSpd.ReceiverPorts.ClrDiagcFlgProxy.Val /end MEASUREMENT
/begin MEASUREMENT FordMsg459BusHiSpd.ClrDiagcFlgProxyPrev "MICROSAR RTE" UBYTE NO_COMPU_METHOD 0 0 0 255 ECU_ADDRESS 0 SYMBOL_LINK "Rte_FordMsg459BusHiSpd_ClrDiagcFlgProxyPrev" 0 DISPLAY_IDENTIFIER FordMsg459BusHiSpd.PerInstanceMemories.ClrDiagcFlgProxyPrev /end MEASUREMENT
/begin MEASUREMENT FordMsg459BusHiSpd.FirstTranVldFlg "MICROSAR RTE" UBYTE RTE_CM_BOOLEAN 0 0 0 255 ECU_ADDRESS 0 SYMBOL_LINK "Rte_FordMsg459BusHiSpd_FirstTranVldFlg" 0 DISPLAY_IDENTIFIER FordMsg459BusHiSpd.PerInstanceMemories.FirstTranVldFlg /end MEASUREMENT
/begin MEASUREMENT FordMsg459BusHiSpd.FordCanDtcInhb.Logl "MICROSAR RTE" UBYTE RTE_CM_BOOLEAN 0 0 0 255 ECU_ADDRESS 0 SYMBOL_LINK "Rte_FordCanDtcInhb_FordCanDtcInhb_Logl" 0 DISPLAY_IDENTIFIER FordMsg459BusHiSpd.ReceiverPorts.FordCanDtcInhb.Logl /end MEASUREMENT
/begin MEASUREMENT FordMsg459BusHiSpd.FordEpsLifeCycMod.Val "MICROSAR RTE" UBYTE NO_COMPU_METHOD 0 0 0 255 ECU_ADDRESS 0 SYMBOL_LINK "Rte_FordCanDtcInhb_FordEpsLifeCycMod_Val" 0 DISPLAY_IDENTIFIER FordMsg459BusHiSpd.ReceiverPorts.FordEpsLifeCycMod.Val /end MEASUREMENT
/begin MEASUREMENT FordMsg459BusHiSpd.FordTrlrBackupAssiEnad.Logl "MICROSAR RTE" UBYTE RTE_CM_BOOLEAN 0 0 0 255 ECU_ADDRESS 0 SYMBOL_LINK "Rte_FordMsg459BusHiSpd_FordTrlrBackupAssiEnad_Logl" 0 DISPLAY_IDENTIFIER FordMsg459BusHiSpd.ReceiverPorts.FordTrlrBackupAssiEnad.Logl /end MEASUREMENT
/begin MEASUREMENT FordMsg459BusHiSpd.FordVehMsg459Miss "MICROSAR RTE" UBYTE RTE_CM_BOOLEAN 0 0 0 255 ECU_ADDRESS 0 SYMBOL_LINK "Rte_FordMsg459BusHiSpd_FordVehMsg459Miss" 0 DISPLAY_IDENTIFIER FordMsg459BusHiSpd.PerInstanceMemories.FordVehMsg459Miss /end MEASUREMENT
/begin MEASUREMENT FordMsg459BusHiSpd.FordVehMsg459MissTmr "MICROSAR RTE" ULONG NO_COMPU_METHOD 0 0 0 4294967295 ECU_ADDRESS 0 SYMBOL_LINK "Rte_FordMsg459BusHiSpd_FordVehMsg459MissTmr" 0 DISPLAY_IDENTIFIER FordMsg459BusHiSpd.PerInstanceMemories.FordVehMsg459MissTmr /end MEASUREMENT
/begin MEASUREMENT FordMsg459BusHiSpd.FordVehMsg459RxdTmr "MICROSAR RTE" ULONG NO_COMPU_METHOD 0 0 0 4294967295 ECU_ADDRESS 0 SYMBOL_LINK "Rte_FordMsg459BusHiSpd_FordVehMsg459RxdTmr" 0 DISPLAY_IDENTIFIER FordMsg459BusHiSpd.PerInstanceMemories.FordVehMsg459RxdTmr /end MEASUREMENT
/begin MEASUREMENT FordMsg459BusHiSpd.FordVehTrlrAidAcqSts.Val "MICROSAR RTE" UBYTE NO_COMPU_METHOD 0 0 0 255 ECU_ADDRESS 0 SYMBOL_LINK "Rte_FordMsg459BusHiSpd_FordVehTrlrAidAcqSts_Val" 0 DISPLAY_IDENTIFIER FordMsg459BusHiSpd.SenderPorts.FordVehTrlrAidAcqSts.Val /end MEASUREMENT
/begin MEASUREMENT FordMsg459BusHiSpd.FordVehTrlrAidAcqStsPrev "MICROSAR RTE" UBYTE NO_COMPU_METHOD 0 0 0 255 ECU_ADDRESS 0 SYMBOL_LINK "Rte_FordMsg459BusHiSpd_FordVehTrlrAidAcqStsPrev" 0 DISPLAY_IDENTIFIER FordMsg459BusHiSpd.PerInstanceMemories.FordVehTrlrAidAcqStsPrev /end MEASUREMENT
/begin MEASUREMENT FordMsg459BusHiSpd.FordVehTrlrAidGuidcRevsStsPrev "MICROSAR RTE" UBYTE NO_COMPU_METHOD 0 0 0 255 ECU_ADDRESS 0 SYMBOL_LINK "Rte_FordMsg459BusHiSpd_FordVehTrlrAidGuidcRevsStsPrev" 0 DISPLAY_IDENTIFIER FordMsg459BusHiSpd.PerInstanceMemories.FordVehTrlrAidGuidcRevsStsPrev /end MEASUREMENT
/begin MEASUREMENT FordMsg459BusHiSpd.FordVehTrlrAidHitchAg.Val "MICROSAR RTE" UWORD NO_COMPU_METHOD 0 0 0 65535 ECU_ADDRESS 0 SYMBOL_LINK "Rte_FordMsg459BusHiSpd_FordVehTrlrAidHitchAg_Val" 0 DISPLAY_IDENTIFIER FordMsg459BusHiSpd.SenderPorts.FordVehTrlrAidHitchAg.Val /end MEASUREMENT
/begin MEASUREMENT FordMsg459BusHiSpd.FordVehTrlrAidHitchAgPrev "MICROSAR RTE" UWORD NO_COMPU_METHOD 0 0 0 65535 ECU_ADDRESS 0 SYMBOL_LINK "Rte_FordMsg459BusHiSpd_FordVehTrlrAidHitchAgPrev" 0 DISPLAY_IDENTIFIER FordMsg459BusHiSpd.PerInstanceMemories.FordVehTrlrAidHitchAgPrev /end MEASUREMENT
/begin MEASUREMENT FordMsg459BusHiSpd.FordVehTrlrAidHitchAgRate.Val "MICROSAR RTE" UWORD NO_COMPU_METHOD 0 0 0 65535 ECU_ADDRESS 0 SYMBOL_LINK "Rte_FordMsg459BusHiSpd_FordVehTrlrAidHitchAgRate_Val" 0 DISPLAY_IDENTIFIER FordMsg459BusHiSpd.SenderPorts.FordVehTrlrAidHitchAgRate.Val /end MEASUREMENT
/begin MEASUREMENT FordMsg459BusHiSpd.FordVehTrlrAidHitchAgRatePrev "MICROSAR RTE" UWORD NO_COMPU_METHOD 0 0 0 65535 ECU_ADDRESS 0 SYMBOL_LINK "Rte_FordMsg459BusHiSpd_FordVehTrlrAidHitchAgRatePrev" 0 DISPLAY_IDENTIFIER FordMsg459BusHiSpd.PerInstanceMemories.FordVehTrlrAidHitchAgRatePrev /end MEASUREMENT
/begin MEASUREMENT FordMsg459BusHiSpd.FordVehTrlrAidIdnVal.Val "MICROSAR RTE" UBYTE NO_COMPU_METHOD 0 0 0 255 ECU_ADDRESS 0 SYMBOL_LINK "Rte_FordMsg459BusHiSpd_FordVehTrlrAidIdnVal_Val" 0 DISPLAY_IDENTIFIER FordMsg459BusHiSpd.SenderPorts.FordVehTrlrAidIdnVal.Val /end MEASUREMENT
/begin MEASUREMENT FordMsg459BusHiSpd.FordVehTrlrAidIdnValPrev "MICROSAR RTE" UBYTE NO_COMPU_METHOD 0 0 0 255 ECU_ADDRESS 0 SYMBOL_LINK "Rte_FordMsg459BusHiSpd_FordVehTrlrAidIdnValPrev" 0 DISPLAY_IDENTIFIER FordMsg459BusHiSpd.PerInstanceMemories.FordVehTrlrAidIdnValPrev /end MEASUREMENT
/begin MEASUREMENT FordMsg459BusHiSpd.FordVehTrlrAidTrackStFaildTmr "MICROSAR RTE" ULONG NO_COMPU_METHOD 0 0 0 4294967295 ECU_ADDRESS 0 SYMBOL_LINK "Rte_FordMsg459BusHiSpd_FordVehTrlrAidTrackStFaildTmr" 0 DISPLAY_IDENTIFIER FordMsg459BusHiSpd.PerInstanceMemories.FordVehTrlrAidTrackStFaildTmr /end MEASUREMENT
/begin MEASUREMENT FordMsg459BusHiSpd.FordVehTrlrAidTrackStPassdTmr "MICROSAR RTE" ULONG NO_COMPU_METHOD 0 0 0 4294967295 ECU_ADDRESS 0 SYMBOL_LINK "Rte_FordMsg459BusHiSpd_FordVehTrlrAidTrackStPassdTmr" 0 DISPLAY_IDENTIFIER FordMsg459BusHiSpd.PerInstanceMemories.FordVehTrlrAidTrackStPassdTmr /end MEASUREMENT
/begin MEASUREMENT FordMsg459BusHiSpd.FordVehTrlrAidTrackStPrev "MICROSAR RTE" UBYTE NO_COMPU_METHOD 0 0 0 255 ECU_ADDRESS 0 SYMBOL_LINK "Rte_FordMsg459BusHiSpd_FordVehTrlrAidTrackStPrev" 0 DISPLAY_IDENTIFIER FordMsg459BusHiSpd.PerInstanceMemories.FordVehTrlrAidTrackStPrev /end MEASUREMENT
/begin MEASUREMENT FordMsg459BusHiSpd.FordVehTrlrAidTrakgSt.Val "MICROSAR RTE" UBYTE NO_COMPU_METHOD 0 0 0 255 ECU_ADDRESS 0 SYMBOL_LINK "Rte_FordMsg459BusHiSpd_FordVehTrlrAidTrakgSt_Val" 0 DISPLAY_IDENTIFIER FordMsg459BusHiSpd.SenderPorts.FordVehTrlrAidTrakgSt.Val /end MEASUREMENT
/begin MEASUREMENT FordMsg459BusHiSpd.FordVehTrlrAidTrakgStVld.Logl "MICROSAR RTE" UBYTE RTE_CM_BOOLEAN 0 0 0 255 ECU_ADDRESS 0 SYMBOL_LINK "Rte_FordMsg459BusHiSpd_FordVehTrlrAidTrakgStVld_Logl" 0 DISPLAY_IDENTIFIER FordMsg459BusHiSpd.SenderPorts.FordVehTrlrAidTrakgStVld.Logl /end MEASUREMENT
/begin MEASUREMENT FordMsg459BusHiSpd.FordVehTrlrAidTrlrRvsGuidcSts.Val "MICROSAR RTE" UBYTE NO_COMPU_METHOD 0 0 0 255 ECU_ADDRESS 0 SYMBOL_LINK "Rte_FordMsg459BusHiSpd_FordVehTrlrAidTrlrRvsGuidcSts_Val" 0 DISPLAY_IDENTIFIER FordMsg459BusHiSpd.SenderPorts.FordVehTrlrAidTrlrRvsGuidcSts.Val /end MEASUREMENT
/begin MEASUREMENT FordMsg459BusHiSpd.FordVehTrlrBallToAxle.Val "MICROSAR RTE" UBYTE NO_COMPU_METHOD 0 0 0 255 ECU_ADDRESS 0 SYMBOL_LINK "Rte_FordMsg459BusHiSpd_FordVehTrlrBallToAxle_Val" 0 DISPLAY_IDENTIFIER FordMsg459BusHiSpd.SenderPorts.FordVehTrlrBallToAxle.Val /end MEASUREMENT
/begin MEASUREMENT FordMsg459BusHiSpd.FordVehTrlrBallToAxlePrev "MICROSAR RTE" UBYTE NO_COMPU_METHOD 0 0 0 255 ECU_ADDRESS 0 SYMBOL_LINK "Rte_FordMsg459BusHiSpd_FordVehTrlrBallToAxlePrev" 0 DISPLAY_IDENTIFIER FordMsg459BusHiSpd.PerInstanceMemories.FordVehTrlrBallToAxlePrev /end MEASUREMENT
/begin MEASUREMENT FordMsg459BusHiSpd.FordVehTrlrHitchAgFaildTmr "MICROSAR RTE" ULONG NO_COMPU_METHOD 0 0 0 4294967295 ECU_ADDRESS 0 SYMBOL_LINK "Rte_FordMsg459BusHiSpd_FordVehTrlrHitchAgFaildTmr" 0 DISPLAY_IDENTIFIER FordMsg459BusHiSpd.PerInstanceMemories.FordVehTrlrHitchAgFaildTmr /end MEASUREMENT
/begin MEASUREMENT FordMsg459BusHiSpd.FordVehTrlrHitchAgPassdTmr "MICROSAR RTE" ULONG NO_COMPU_METHOD 0 0 0 4294967295 ECU_ADDRESS 0 SYMBOL_LINK "Rte_FordMsg459BusHiSpd_FordVehTrlrHitchAgPassdTmr" 0 DISPLAY_IDENTIFIER FordMsg459BusHiSpd.PerInstanceMemories.FordVehTrlrHitchAgPassdTmr /end MEASUREMENT
/begin MEASUREMENT FordMsg459BusHiSpd.FordVehTrlrHitchAgRateFaildTmr "MICROSAR RTE" ULONG NO_COMPU_METHOD 0 0 0 4294967295 ECU_ADDRESS 0 SYMBOL_LINK "Rte_FordMsg459BusHiSpd_FordVehTrlrHitchAgRateFaildTmr" 0 DISPLAY_IDENTIFIER FordMsg459BusHiSpd.PerInstanceMemories.FordVehTrlrHitchAgRateFaildTmr /end MEASUREMENT
/begin MEASUREMENT FordMsg459BusHiSpd.FordVehTrlrHitchAgRatePassdTmr "MICROSAR RTE" ULONG NO_COMPU_METHOD 0 0 0 4294967295 ECU_ADDRESS 0 SYMBOL_LINK "Rte_FordMsg459BusHiSpd_FordVehTrlrHitchAgRatePassdTmr" 0 DISPLAY_IDENTIFIER FordMsg459BusHiSpd.PerInstanceMemories.FordVehTrlrHitchAgRatePassdTmr /end MEASUREMENT
/begin MEASUREMENT FordMsg459BusHiSpd.FordVehTrlrHitchAgVld.Logl "MICROSAR RTE" UBYTE RTE_CM_BOOLEAN 0 0 0 255 ECU_ADDRESS 0 SYMBOL_LINK "Rte_FordMsg459BusHiSpd_FordVehTrlrHitchAgVld_Logl" 0 DISPLAY_IDENTIFIER FordMsg459BusHiSpd.SenderPorts.FordVehTrlrHitchAgVld.Logl /end MEASUREMENT
/begin MEASUREMENT FordMsg459BusHiSpd.FordVehTrlrHitchAgVldPrev "MICROSAR RTE" UBYTE RTE_CM_BOOLEAN 0 0 0 255 ECU_ADDRESS 0 SYMBOL_LINK "Rte_FordMsg459BusHiSpd_FordVehTrlrHitchAgVldPrev" 0 DISPLAY_IDENTIFIER FordMsg459BusHiSpd.PerInstanceMemories.FordVehTrlrHitchAgVldPrev /end MEASUREMENT
/begin MEASUREMENT FordMsg459BusHiSpd.FordVehTrlrHitchRateVld.Logl "MICROSAR RTE" UBYTE RTE_CM_BOOLEAN 0 0 0 255 ECU_ADDRESS 0 SYMBOL_LINK "Rte_FordMsg459BusHiSpd_FordVehTrlrHitchRateVld_Logl" 0 DISPLAY_IDENTIFIER FordMsg459BusHiSpd.SenderPorts.FordVehTrlrHitchRateVld.Logl /end MEASUREMENT
/begin MEASUREMENT FordMsg459BusHiSpd.FordVehTrlrHitchRateVldPrev "MICROSAR RTE" UBYTE RTE_CM_BOOLEAN 0 0 0 255 ECU_ADDRESS 0 SYMBOL_LINK "Rte_FordMsg459BusHiSpd_FordVehTrlrHitchRateVldPrev" 0 DISPLAY_IDENTIFIER FordMsg459BusHiSpd.PerInstanceMemories.FordVehTrlrHitchRateVldPrev /end MEASUREMENT
/begin MEASUREMENT FordMsg459BusHiSpd.FordVehTrlrTarVld.Logl "MICROSAR RTE" UBYTE RTE_CM_BOOLEAN 0 0 0 255 ECU_ADDRESS 0 SYMBOL_LINK "Rte_FordMsg459BusHiSpd_FordVehTrlrTarVld_Logl" 0 DISPLAY_IDENTIFIER FordMsg459BusHiSpd.SenderPorts.FordVehTrlrTarVld.Logl /end MEASUREMENT
/begin MEASUREMENT FordMsg459BusHiSpd.FordVehTrlrTarVldPrev "MICROSAR RTE" UBYTE RTE_CM_BOOLEAN 0 0 0 255 ECU_ADDRESS 0 SYMBOL_LINK "Rte_FordMsg459BusHiSpd_FordVehTrlrTarVldPrev" 0 DISPLAY_IDENTIFIER FordMsg459BusHiSpd.PerInstanceMemories.FordVehTrlrTarVldPrev /end MEASUREMENT
/begin MEASUREMENT FordMsg459BusHiSpd.FordVehTrlrTrackStVldPrev "MICROSAR RTE" UBYTE RTE_CM_BOOLEAN 0 0 0 255 ECU_ADDRESS 0 SYMBOL_LINK "Rte_FordMsg459BusHiSpd_FordVehTrlrTrackStVldPrev" 0 DISPLAY_IDENTIFIER FordMsg459BusHiSpd.PerInstanceMemories.FordVehTrlrTrackStVldPrev /end MEASUREMENT
/begin MEASUREMENT FordMsg459BusHiSpd.TrlrAidStsThreePrsntInt.Logl "MICROSAR RTE" UBYTE RTE_CM_BOOLEAN 0 0 0 255 ECU_ADDRESS 0 SYMBOL_LINK "Rte_FordMsg459BusHiSpd_TrlrAidStsThreePrsntInt_Logl" 0 DISPLAY_IDENTIFIER FordMsg459BusHiSpd.SenderPorts.TrlrAidStsThreePrsntInt.Logl /end MEASUREMENT
/begin MEASUREMENT FordMsg459BusHiSpd.TrlrAidStsThreePrsntIntPrev "MICROSAR RTE" UBYTE RTE_CM_BOOLEAN 0 0 0 255 ECU_ADDRESS 0 SYMBOL_LINK "Rte_FordMsg459BusHiSpd_TrlrAidStsThreePrsntIntPrev" 0 DISPLAY_IDENTIFIER FordMsg459BusHiSpd.PerInstanceMemories.TrlrAidStsThreePrsntIntPrev /end MEASUREMENT
/begin MEASUREMENT FordMsg47ABusHiSpd.ClrDiagcFlgProxy.Val "MICROSAR RTE" UBYTE NO_COMPU_METHOD 0 0 0 255 ECU_ADDRESS 0 SYMBOL_LINK "Rte_DiagcMgr_ClrDiagcFlgProxy_Val" 0 DISPLAY_IDENTIFIER FordMsg47ABusHiSpd.ReceiverPorts.ClrDiagcFlgProxy.Val /end MEASUREMENT
/begin MEASUREMENT FordMsg47ABusHiSpd.ClrDiagcFlgProxyPrev "MICROSAR RTE" UBYTE NO_COMPU_METHOD 0 0 0 255 ECU_ADDRESS 0 SYMBOL_LINK "Rte_FordMsg47ABusHiSpd_ClrDiagcFlgProxyPrev" 0 DISPLAY_IDENTIFIER FordMsg47ABusHiSpd.PerInstanceMemories.ClrDiagcFlgProxyPrev /end MEASUREMENT
/begin MEASUREMENT FordMsg47ABusHiSpd.FirstTranTrlrAidKnobBtnVldFlg "MICROSAR RTE" UBYTE RTE_CM_BOOLEAN 0 0 0 255 ECU_ADDRESS 0 SYMBOL_LINK "Rte_FordMsg47ABusHiSpd_FirstTranTrlrAidKnobBtnVldFlg" 0 DISPLAY_IDENTIFIER FordMsg47ABusHiSpd.PerInstanceMemories.FirstTranTrlrAidKnobBtnVldFlg /end MEASUREMENT
/begin MEASUREMENT FordMsg47ABusHiSpd.FirstTranTrlrAidKnobPosVldFlg "MICROSAR RTE" UBYTE RTE_CM_BOOLEAN 0 0 0 255 ECU_ADDRESS 0 SYMBOL_LINK "Rte_FordMsg47ABusHiSpd_FirstTranTrlrAidKnobPosVldFlg" 0 DISPLAY_IDENTIFIER FordMsg47ABusHiSpd.PerInstanceMemories.FirstTranTrlrAidKnobPosVldFlg /end MEASUREMENT
/begin MEASUREMENT FordMsg47ABusHiSpd.FordCanDtcInhb.Logl "MICROSAR RTE" UBYTE RTE_CM_BOOLEAN 0 0 0 255 ECU_ADDRESS 0 SYMBOL_LINK "Rte_FordCanDtcInhb_FordCanDtcInhb_Logl" 0 DISPLAY_IDENTIFIER FordMsg47ABusHiSpd.ReceiverPorts.FordCanDtcInhb.Logl /end MEASUREMENT
/begin MEASUREMENT FordMsg47ABusHiSpd.FordEpsLifeCycMod.Val "MICROSAR RTE" UBYTE NO_COMPU_METHOD 0 0 0 255 ECU_ADDRESS 0 SYMBOL_LINK "Rte_FordCanDtcInhb_FordEpsLifeCycMod_Val" 0 DISPLAY_IDENTIFIER FordMsg47ABusHiSpd.ReceiverPorts.FordEpsLifeCycMod.Val /end MEASUREMENT
/begin MEASUREMENT FordMsg47ABusHiSpd.FordTrlrBackupAssiEnad.Logl "MICROSAR RTE" UBYTE RTE_CM_BOOLEAN 0 0 0 255 ECU_ADDRESS 0 SYMBOL_LINK "Rte_CustDiag_FordTrlrBackupAssiEnad_Logl" 0 DISPLAY_IDENTIFIER FordMsg47ABusHiSpd.ReceiverPorts.FordTrlrBackupAssiEnad.Logl /end MEASUREMENT
/begin MEASUREMENT FordMsg47ABusHiSpd.FordVehMsg47Miss "MICROSAR RTE" UBYTE RTE_CM_BOOLEAN 0 0 0 255 ECU_ADDRESS 0 SYMBOL_LINK "Rte_FordMsg47ABusHiSpd_FordVehMsg47Miss" 0 DISPLAY_IDENTIFIER FordMsg47ABusHiSpd.PerInstanceMemories.FordVehMsg47Miss /end MEASUREMENT
/begin MEASUREMENT FordMsg47ABusHiSpd.FordVehMsg47Rxd "MICROSAR RTE" UBYTE RTE_CM_BOOLEAN 0 0 0 255 ECU_ADDRESS 0 SYMBOL_LINK "Rte_FordMsg47ABusHiSpd_FordVehMsg47Rxd" 0 DISPLAY_IDENTIFIER FordMsg47ABusHiSpd.PerInstanceMemories.FordVehMsg47Rxd /end MEASUREMENT
/begin MEASUREMENT FordMsg47ABusHiSpd.FordVehTrlrAidKnobBtn.Val "MICROSAR RTE" UBYTE NO_COMPU_METHOD 0 0 0 255 ECU_ADDRESS 0 SYMBOL_LINK "Rte_FordMsg47ABusHiSpd_FordVehTrlrAidKnobBtn_Val" 0 DISPLAY_IDENTIFIER FordMsg47ABusHiSpd.SenderPorts.FordVehTrlrAidKnobBtn.Val /end MEASUREMENT
/begin MEASUREMENT FordMsg47ABusHiSpd.FordVehTrlrAidKnobBtnInvldFaildRefTi "MICROSAR RTE" ULONG NO_COMPU_METHOD 0 0 0 4294967295 ECU_ADDRESS 0 SYMBOL_LINK "Rte_FordMsg47ABusHiSpd_FordVehTrlrAidKnobBtnInvldFaildRefTi" 0 DISPLAY_IDENTIFIER FordMsg47ABusHiSpd.PerInstanceMemories.FordVehTrlrAidKnobBtnInvldFaildRefTi /end MEASUREMENT
/begin MEASUREMENT FordMsg47ABusHiSpd.FordVehTrlrAidKnobBtnInvldPassdRefTi "MICROSAR RTE" ULONG NO_COMPU_METHOD 0 0 0 4294967295 ECU_ADDRESS 0 SYMBOL_LINK "Rte_FordMsg47ABusHiSpd_FordVehTrlrAidKnobBtnInvldPassdRefTi" 0 DISPLAY_IDENTIFIER FordMsg47ABusHiSpd.PerInstanceMemories.FordVehTrlrAidKnobBtnInvldPassdRefTi /end MEASUREMENT
/begin MEASUREMENT FordMsg47ABusHiSpd.FordVehTrlrAidKnobBtnPrev "MICROSAR RTE" UBYTE RTE_CM_ENUM_Ford_TrlrAidSwtch_D_RqDrv 0 0 0 3 ECU_ADDRESS 0 SYMBOL_LINK "Rte_FordMsg47ABusHiSpd_FordVehTrlrAidKnobBtnPrev" 0 DISPLAY_IDENTIFIER FordMsg47ABusHiSpd.PerInstanceMemories.FordVehTrlrAidKnobBtnPrev /end MEASUREMENT
/begin MEASUREMENT FordMsg47ABusHiSpd.FordVehTrlrAidKnobPosn.Val "MICROSAR RTE" UWORD NO_COMPU_METHOD 0 0 0 65535 ECU_ADDRESS 0 SYMBOL_LINK "Rte_FordMsg47ABusHiSpd_FordVehTrlrAidKnobPosn_Val" 0 DISPLAY_IDENTIFIER FordMsg47ABusHiSpd.SenderPorts.FordVehTrlrAidKnobPosn.Val /end MEASUREMENT
/begin MEASUREMENT FordMsg47ABusHiSpd.FordVehTrlrAidKnobPosnInvldFaildRefTi "MICROSAR RTE" ULONG NO_COMPU_METHOD 0 0 0 4294967295 ECU_ADDRESS 0 SYMBOL_LINK "Rte_FordMsg47ABusHiSpd_FordVehTrlrAidKnobPosnInvldFaildRefTi" 0 DISPLAY_IDENTIFIER FordMsg47ABusHiSpd.PerInstanceMemories.FordVehTrlrAidKnobPosnInvldFaildRefTi /end MEASUREMENT
/begin MEASUREMENT FordMsg47ABusHiSpd.FordVehTrlrAidKnobPosnInvldPassdRefTi "MICROSAR RTE" ULONG NO_COMPU_METHOD 0 0 0 4294967295 ECU_ADDRESS 0 SYMBOL_LINK "Rte_FordMsg47ABusHiSpd_FordVehTrlrAidKnobPosnInvldPassdRefTi" 0 DISPLAY_IDENTIFIER FordMsg47ABusHiSpd.PerInstanceMemories.FordVehTrlrAidKnobPosnInvldPassdRefTi /end MEASUREMENT
/begin MEASUREMENT FordMsg47ABusHiSpd.FordVehTrlrAidKnobPosnPrev "MICROSAR RTE" UWORD NO_COMPU_METHOD 0 0 0 65535 ECU_ADDRESS 0 SYMBOL_LINK "Rte_FordMsg47ABusHiSpd_FordVehTrlrAidKnobPosnPrev" 0 DISPLAY_IDENTIFIER FordMsg47ABusHiSpd.PerInstanceMemories.FordVehTrlrAidKnobPosnPrev /end MEASUREMENT
/begin MEASUREMENT FordMsg47ABusHiSpd.FordVehTrlrBackupAssiKnobPosVld.Logl "MICROSAR RTE" UBYTE RTE_CM_BOOLEAN 0 0 0 255 ECU_ADDRESS 0 SYMBOL_LINK "Rte_FordMsg47ABusHiSpd_FordVehTrlrBackupAssiKnobPosVld_Logl" 0 DISPLAY_IDENTIFIER FordMsg47ABusHiSpd.SenderPorts.FordVehTrlrBackupAssiKnobPosVld.Logl /end MEASUREMENT
/begin MEASUREMENT FordMsg47ABusHiSpd.FordVehTrlrBackupAssiKnobVld.Logl "MICROSAR RTE" UBYTE RTE_CM_BOOLEAN 0 0 0 255 ECU_ADDRESS 0 SYMBOL_LINK "Rte_FordMsg47ABusHiSpd_FordVehTrlrBackupAssiKnobVld_Logl" 0 DISPLAY_IDENTIFIER FordMsg47ABusHiSpd.SenderPorts.FordVehTrlrBackupAssiKnobVld.Logl /end MEASUREMENT
/begin MEASUREMENT FordMsg47ABusHiSpd.MissMsgFaildRefTi "MICROSAR RTE" ULONG NO_COMPU_METHOD 0 0 0 4294967295 ECU_ADDRESS 0 SYMBOL_LINK "Rte_FordMsg47ABusHiSpd_MissMsgFaildRefTi" 0 DISPLAY_IDENTIFIER FordMsg47ABusHiSpd.PerInstanceMemories.MissMsgFaildRefTi /end MEASUREMENT
/begin MEASUREMENT FordMsg47ABusHiSpd.MissMsgPassdRefTi "MICROSAR RTE" ULONG NO_COMPU_METHOD 0 0 0 4294967295 ECU_ADDRESS 0 SYMBOL_LINK "Rte_FordMsg47ABusHiSpd_MissMsgPassdRefTi" 0 DISPLAY_IDENTIFIER FordMsg47ABusHiSpd.PerInstanceMemories.MissMsgPassdRefTi /end MEASUREMENT
/begin MEASUREMENT FordMsg47ABusHiSpd.TrlrAidKnobBtnVldFaildRefTi "MICROSAR RTE" ULONG NO_COMPU_METHOD 0 0 0 4294967295 ECU_ADDRESS 0 SYMBOL_LINK "Rte_FordMsg47ABusHiSpd_TrlrAidKnobBtnVldFaildRefTi" 0 DISPLAY_IDENTIFIER FordMsg47ABusHiSpd.PerInstanceMemories.TrlrAidKnobBtnVldFaildRefTi /end MEASUREMENT
/begin MEASUREMENT FordMsg47ABusHiSpd.TrlrAidKnobBtnVldMissRefTi "MICROSAR RTE" ULONG NO_COMPU_METHOD 0 0 0 4294967295 ECU_ADDRESS 0 SYMBOL_LINK "Rte_FordMsg47ABusHiSpd_TrlrAidKnobBtnVldMissRefTi" 0 DISPLAY_IDENTIFIER FordMsg47ABusHiSpd.PerInstanceMemories.TrlrAidKnobBtnVldMissRefTi /end MEASUREMENT
/begin MEASUREMENT FordMsg47ABusHiSpd.TrlrAidKnobBtnVldPassdRefTi "MICROSAR RTE" ULONG NO_COMPU_METHOD 0 0 0 4294967295 ECU_ADDRESS 0 SYMBOL_LINK "Rte_FordMsg47ABusHiSpd_TrlrAidKnobBtnVldPassdRefTi" 0 DISPLAY_IDENTIFIER FordMsg47ABusHiSpd.PerInstanceMemories.TrlrAidKnobBtnVldPassdRefTi /end MEASUREMENT
/begin MEASUREMENT FordMsg47ABusHiSpd.TrlrAidKnobBtnVldPrev "MICROSAR RTE" UBYTE RTE_CM_BOOLEAN 0 0 0 255 ECU_ADDRESS 0 SYMBOL_LINK "Rte_FordMsg47ABusHiSpd_TrlrAidKnobBtnVldPrev" 0 DISPLAY_IDENTIFIER FordMsg47ABusHiSpd.PerInstanceMemories.TrlrAidKnobBtnVldPrev /end MEASUREMENT
/begin MEASUREMENT FordMsg47ABusHiSpd.TrlrAidKnobPosVldFaildRefTi "MICROSAR RTE" ULONG NO_COMPU_METHOD 0 0 0 4294967295 ECU_ADDRESS 0 SYMBOL_LINK "Rte_FordMsg47ABusHiSpd_TrlrAidKnobPosVldFaildRefTi" 0 DISPLAY_IDENTIFIER FordMsg47ABusHiSpd.PerInstanceMemories.TrlrAidKnobPosVldFaildRefTi /end MEASUREMENT
/begin MEASUREMENT FordMsg47ABusHiSpd.TrlrAidKnobPosVldMissRefTi "MICROSAR RTE" ULONG NO_COMPU_METHOD 0 0 0 4294967295 ECU_ADDRESS 0 SYMBOL_LINK "Rte_FordMsg47ABusHiSpd_TrlrAidKnobPosVldMissRefTi" 0 DISPLAY_IDENTIFIER FordMsg47ABusHiSpd.PerInstanceMemories.TrlrAidKnobPosVldMissRefTi /end MEASUREMENT
/begin MEASUREMENT FordMsg47ABusHiSpd.TrlrAidKnobPosVldPassdRefTi "MICROSAR RTE" ULONG NO_COMPU_METHOD 0 0 0 4294967295 ECU_ADDRESS 0 SYMBOL_LINK "Rte_FordMsg47ABusHiSpd_TrlrAidKnobPosVldPassdRefTi" 0 DISPLAY_IDENTIFIER FordMsg47ABusHiSpd.PerInstanceMemories.TrlrAidKnobPosVldPassdRefTi /end MEASUREMENT
/begin MEASUREMENT FordMsg47ABusHiSpd.TrlrAidKnobPosVldPrev "MICROSAR RTE" UBYTE RTE_CM_BOOLEAN 0 0 0 255 ECU_ADDRESS 0 SYMBOL_LINK "Rte_FordMsg47ABusHiSpd_TrlrAidKnobPosVldPrev" 0 DISPLAY_IDENTIFIER FordMsg47ABusHiSpd.PerInstanceMemories.TrlrAidKnobPosVldPrev /end MEASUREMENT
/begin MEASUREMENT FordMsg4B0BusHiSpd.CanDtcInhbRefTi "Timer for invalid message will increment or reset based on the conditions" ULONG NO_COMPU_METHOD 0 0 0 4294967295 ECU_ADDRESS 0 SYMBOL_LINK "Rte_FordMsg4B0BusHiSpd_CanDtcInhbRefTi" 0 DISPLAY_IDENTIFIER FordMsg4B0BusHiSpd.PerInstanceMemories.CanDtcInhbRefTi /end MEASUREMENT
/begin MEASUREMENT FordMsg4B0BusHiSpd.ClrDiagcFlgProxy.Val "MICROSAR RTE" UBYTE NO_COMPU_METHOD 0 0 0 255 ECU_ADDRESS 0 SYMBOL_LINK "Rte_DiagcMgr_ClrDiagcFlgProxy_Val" 0 DISPLAY_IDENTIFIER FordMsg4B0BusHiSpd.ReceiverPorts.ClrDiagcFlgProxy.Val /end MEASUREMENT
/begin MEASUREMENT FordMsg4B0BusHiSpd.ClrDiagcFlgProxyPrev "It stores the previous value of ClrDiagcFlgProxy" UBYTE NO_COMPU_METHOD 0 0 0 255 ECU_ADDRESS 0 SYMBOL_LINK "Rte_FordMsg4B0BusHiSpd_ClrDiagcFlgProxyPrev" 0 DISPLAY_IDENTIFIER FordMsg4B0BusHiSpd.PerInstanceMemories.ClrDiagcFlgProxyPrev /end MEASUREMENT
/begin MEASUREMENT FordMsg4B0BusHiSpd.FordBrkOscnRednEnad.Logl "MICROSAR RTE" UBYTE RTE_CM_BOOLEAN 0 0 0 255 ECU_ADDRESS 0 SYMBOL_LINK "Rte_CustDiag_FordBrkPlsRejctnEnad_Logl" 0 DISPLAY_IDENTIFIER FordMsg4B0BusHiSpd.ReceiverPorts.FordBrkOscnRednEnad.Logl /end MEASUREMENT
/begin MEASUREMENT FordMsg4B0BusHiSpd.FordCanDtcInhb.Logl "MICROSAR RTE" UBYTE RTE_CM_BOOLEAN 0 0 0 255 ECU_ADDRESS 0 SYMBOL_LINK "Rte_FordCanDtcInhb_FordCanDtcInhb_Logl" 0 DISPLAY_IDENTIFIER FordMsg4B0BusHiSpd.ReceiverPorts.FordCanDtcInhb.Logl /end MEASUREMENT
/begin MEASUREMENT FordMsg4B0BusHiSpd.FordEpsLifeCycMod.Val "MICROSAR RTE" UBYTE NO_COMPU_METHOD 0 0 0 255 ECU_ADDRESS 0 SYMBOL_LINK "Rte_FordCanDtcInhb_FordEpsLifeCycMod_Val" 0 DISPLAY_IDENTIFIER FordMsg4B0BusHiSpd.ReceiverPorts.FordEpsLifeCycMod.Val /end MEASUREMENT
/begin MEASUREMENT FordMsg4B0BusHiSpd.FordEvasSteerAssiEnad.Logl "MICROSAR RTE" UBYTE RTE_CM_BOOLEAN 0 0 0 255 ECU_ADDRESS 0 SYMBOL_LINK "Rte_CustDiag_FordEvasSteerAssiEnad_Logl" 0 DISPLAY_IDENTIFIER FordMsg4B0BusHiSpd.ReceiverPorts.FordEvasSteerAssiEnad.Logl /end MEASUREMENT
/begin MEASUREMENT FordMsg4B0BusHiSpd.FordLaneCentrAssiEnad.Logl "MICROSAR RTE" UBYTE RTE_CM_BOOLEAN 0 0 0 255 ECU_ADDRESS 0 SYMBOL_LINK "Rte_CustDiag_FordLaneCentrAssiEnad_Logl" 0 DISPLAY_IDENTIFIER FordMsg4B0BusHiSpd.ReceiverPorts.FordLaneCentrAssiEnad.Logl /end MEASUREMENT
/begin MEASUREMENT FordMsg4B0BusHiSpd.FordMsg4B0Miss "It is used to indicate that the service ComTimeoutNotification_YawStabilityIndex is called and the message is missing" UBYTE RTE_CM_BOOLEAN 0 0 0 255 ECU_ADDRESS 0 SYMBOL_LINK "Rte_FordMsg4B0BusHiSpd_FordMsg4B0Miss" 0 DISPLAY_IDENTIFIER FordMsg4B0BusHiSpd.PerInstanceMemories.FordMsg4B0Miss /end MEASUREMENT
/begin MEASUREMENT FordMsg4B0BusHiSpd.FordTqSteerCmpEnad.Logl "MICROSAR RTE" UBYTE RTE_CM_BOOLEAN 0 0 0 255 ECU_ADDRESS 0 SYMBOL_LINK "Rte_CustDiag_FordTqSteerCmpEnad_Logl" 0 DISPLAY_IDENTIFIER FordMsg4B0BusHiSpd.ReceiverPorts.FordTqSteerCmpEnad.Logl /end MEASUREMENT
/begin MEASUREMENT FordMsg4B0BusHiSpd.FordVehYawStabyRaw.Val "MICROSAR RTE" UWORD NO_COMPU_METHOD 0 0 0 65535 ECU_ADDRESS 0 SYMBOL_LINK "Rte_FordMsg4B0BusHiSpd_FordVehYawStabyRaw_Val" 0 DISPLAY_IDENTIFIER FordMsg4B0BusHiSpd.SenderPorts.FordVehYawStabyRaw.Val /end MEASUREMENT
/begin MEASUREMENT FordMsg4B0BusHiSpd.FordVehYawStabyRawPrev "Hold the Previous value of Ford Vehicle Yaw Stability Raw Previous" UWORD NO_COMPU_METHOD 0 0 0 65535 ECU_ADDRESS 0 SYMBOL_LINK "Rte_FordMsg4B0BusHiSpd_FordVehYawStabyRawPrev" 0 DISPLAY_IDENTIFIER FordMsg4B0BusHiSpd.PerInstanceMemories.FordVehYawStabyRawPrev /end MEASUREMENT
/begin MEASUREMENT FordMsg4B0BusHiSpd.FordVehYawStabyVld.Logl "MICROSAR RTE" UBYTE RTE_CM_BOOLEAN 0 0 0 255 ECU_ADDRESS 0 SYMBOL_LINK "Rte_FordMsg4B0BusHiSpd_FordVehYawStabyVld_Logl" 0 DISPLAY_IDENTIFIER FordMsg4B0BusHiSpd.SenderPorts.FordVehYawStabyVld.Logl /end MEASUREMENT
/begin MEASUREMENT FordMsg4B0BusHiSpd.FordVehYawStabyVldPrev "Hold the Previous value of Ford Vehicle Yaw Stability Valid" UBYTE RTE_CM_BOOLEAN 0 0 0 255 ECU_ADDRESS 0 SYMBOL_LINK "Rte_FordMsg4B0BusHiSpd_FordVehYawStabyVldPrev" 0 DISPLAY_IDENTIFIER FordMsg4B0BusHiSpd.PerInstanceMemories.FordVehYawStabyVldPrev /end MEASUREMENT
/begin MEASUREMENT FordMsg4B0BusHiSpd.IniVehYawStabyInvld "It is used to set FordVehYawStabyVld to True for the first time without time delay. It is set to False after FordVehYawStabyVld is set to False for the first time. Therefore, setting FordVehYawStabyVld to True has a time delay after the first time" UBYTE RTE_CM_BOOLEAN 0 0 0 255 ECU_ADDRESS 0 SYMBOL_LINK "Rte_FordMsg4B0BusHiSpd_IniVehYawStabyInvld" 0 DISPLAY_IDENTIFIER FordMsg4B0BusHiSpd.PerInstanceMemories.IniVehYawStabyInvld /end MEASUREMENT
/begin MEASUREMENT FordMsg4B0BusHiSpd.LaneDetnWarnEnad.Logl "MICROSAR RTE" UBYTE RTE_CM_BOOLEAN 0 0 0 255 ECU_ADDRESS 0 SYMBOL_LINK "Rte_CustDiag_FordLaneDprtrWarnEnad_Logl" 0 DISPLAY_IDENTIFIER FordMsg4B0BusHiSpd.ReceiverPorts.LaneDetnWarnEnad.Logl /end MEASUREMENT
/begin GROUP FordMsg415BusHiSpd.CalibrationPorts "MICROSAR RTE"
 /begin SUB_GROUP FordMsg415BusHiSpd.FordMsg415BusHiSpdBrkModlLoQlyVldFaildThd.Val FordMsg415BusHiSpd.FordMsg415BusHiSpdBrkModlLoQlyVldMissThd.Val FordMsg415BusHiSpd.FordMsg415BusHiSpdBrkModlLoQlyVldPassdThd.Val FordMsg415BusHiSpd.FordMsg415BusHiSpdBrkModlVldFaildThd.Val FordMsg415BusHiSpd.FordMsg415BusHiSpdBrkModlVldMissThd.Val FordMsg415BusHiSpd.FordMsg415BusHiSpdBrkModlVldPassdThd.Val FordMsg415BusHiSpd.FordMsg415BusHiSpdBrkSprtVldMissThd.Val FordMsg415BusHiSpd.FordMsg415BusHiSpdBrkSprtVldPassdThd.Val FordMsg415BusHiSpd.FordMsg415BusHiSpdChksBrkModlInvldFaildThd.Val FordMsg415BusHiSpd.FordMsg415BusHiSpdChksBrkModlInvldPassdThd.Val FordMsg415BusHiSpd.FordMsg415BusHiSpdCntrBrkModlInvldFaildThd.Val FordMsg415BusHiSpd.FordMsg415BusHiSpdCntrBrkModlInvldPassdThd.Val FordMsg415BusHiSpd.FordMsg415BusHiSpdMissMsgFaildThd.Val FordMsg415BusHiSpd.FordMsg415BusHiSpdMissMsgPassdThd.Val FordMsg415BusHiSpd.FordMsg415BusHiSpdQlyFacBrkModlInvldFaildThd.Val FordMsg415BusHiSpd.FordMsg415BusHiSpdQlyFacBrkModlInvldSigPassdThd.Val /end SUB_GROUP
 /begin FUNCTION_LIST /end FUNCTION_LIST
 /begin REF_CHARACTERISTIC /end REF_CHARACTERISTIC
 /begin REF_MEASUREMENT /end REF_MEASUREMENT
/end GROUP
/begin GROUP FordMsg415BusHiSpd.ChksBrkModlInvldFaildRefTi "MICROSAR RTE" /begin SUB_GROUP /end SUB_GROUP /begin FUNCTION_LIST /end FUNCTION_LIST /begin REF_CHARACTERISTIC /end REF_CHARACTERISTIC /begin REF_MEASUREMENT FordMsg415BusHiSpd.ChksBrkModlInvldFaildRefTi /end REF_MEASUREMENT /end GROUP
/begin GROUP FordMsg415BusHiSpd.ChksBrkModlInvldPassdRefTi "MICROSAR RTE" /begin SUB_GROUP /end SUB_GROUP /begin FUNCTION_LIST /end FUNCTION_LIST /begin REF_CHARACTERISTIC /end REF_CHARACTERISTIC /begin REF_MEASUREMENT FordMsg415BusHiSpd.ChksBrkModlInvldPassdRefTi /end REF_MEASUREMENT /end GROUP
/begin GROUP FordMsg415BusHiSpd.ClrDiagcFlgProxy.Val "MICROSAR RTE" /begin SUB_GROUP /end SUB_GROUP /begin FUNCTION_LIST /end FUNCTION_LIST /begin REF_CHARACTERISTIC /end REF_CHARACTERISTIC /begin REF_MEASUREMENT FordMsg415BusHiSpd.ClrDiagcFlgProxy.Val /end REF_MEASUREMENT /end GROUP
/begin GROUP FordMsg415BusHiSpd.ClrDiagcFlgProxyPrev "MICROSAR RTE" /begin SUB_GROUP /end SUB_GROUP /begin FUNCTION_LIST /end FUNCTION_LIST /begin REF_CHARACTERISTIC /end REF_CHARACTERISTIC /begin REF_MEASUREMENT FordMsg415BusHiSpd.ClrDiagcFlgProxyPrev /end REF_MEASUREMENT /end GROUP
/begin GROUP FordMsg415BusHiSpd.CntrBrkModlInvldFaildRefTi "MICROSAR RTE" /begin SUB_GROUP /end SUB_GROUP /begin FUNCTION_LIST /end FUNCTION_LIST /begin REF_CHARACTERISTIC /end REF_CHARACTERISTIC /begin REF_MEASUREMENT FordMsg415BusHiSpd.CntrBrkModlInvldFaildRefTi /end REF_MEASUREMENT /end GROUP
/begin GROUP FordMsg415BusHiSpd.CntrBrkModlInvldPassdRefTi "MICROSAR RTE" /begin SUB_GROUP /end SUB_GROUP /begin FUNCTION_LIST /end FUNCTION_LIST /begin REF_CHARACTERISTIC /end REF_CHARACTERISTIC /begin REF_MEASUREMENT FordMsg415BusHiSpd.CntrBrkModlInvldPassdRefTi /end REF_MEASUREMENT /end GROUP
/begin GROUP FordMsg415BusHiSpd.FirstTranVldFlg "MICROSAR RTE" /begin SUB_GROUP /end SUB_GROUP /begin FUNCTION_LIST /end FUNCTION_LIST /begin REF_CHARACTERISTIC /end REF_CHARACTERISTIC /begin REF_MEASUREMENT FordMsg415BusHiSpd.FirstTranVldFlg /end REF_MEASUREMENT /end GROUP
/begin GROUP FordMsg415BusHiSpd.FordAbsPrsnt.Logl "MICROSAR RTE" /begin SUB_GROUP /end SUB_GROUP /begin FUNCTION_LIST /end FUNCTION_LIST /begin REF_CHARACTERISTIC /end REF_CHARACTERISTIC /begin REF_MEASUREMENT FordMsg415BusHiSpd.FordAbsPrsnt.Logl /end REF_MEASUREMENT /end GROUP
/begin GROUP FordMsg415BusHiSpd.FordCanDtcInhb.Val "MICROSAR RTE" /begin SUB_GROUP /end SUB_GROUP /begin FUNCTION_LIST /end FUNCTION_LIST /begin REF_CHARACTERISTIC /end REF_CHARACTERISTIC /begin REF_MEASUREMENT FordMsg415BusHiSpd.FordCanDtcInhb.Val /end REF_MEASUREMENT /end GROUP
/begin GROUP FordMsg415BusHiSpd.FordEpsLifeCycMod.Val "MICROSAR RTE" /begin SUB_GROUP /end SUB_GROUP /begin FUNCTION_LIST /end FUNCTION_LIST /begin REF_CHARACTERISTIC /end REF_CHARACTERISTIC /begin REF_MEASUREMENT FordMsg415BusHiSpd.FordEpsLifeCycMod.Val /end REF_MEASUREMENT /end GROUP
/begin GROUP FordMsg415BusHiSpd.FordInvldMsgDiagcInhb.Val "MICROSAR RTE" /begin SUB_GROUP /end SUB_GROUP /begin FUNCTION_LIST /end FUNCTION_LIST /begin REF_CHARACTERISTIC /end REF_CHARACTERISTIC /begin REF_MEASUREMENT FordMsg415BusHiSpd.FordInvldMsgDiagcInhb.Val /end REF_MEASUREMENT /end GROUP
/begin GROUP FordMsg415BusHiSpd.FordMfgDiagcInhb.Val "MICROSAR RTE" /begin SUB_GROUP /end SUB_GROUP /begin FUNCTION_LIST /end FUNCTION_LIST /begin REF_CHARACTERISTIC /end REF_CHARACTERISTIC /begin REF_MEASUREMENT FordMsg415BusHiSpd.FordMfgDiagcInhb.Val /end REF_MEASUREMENT /end GROUP
/begin GROUP FordMsg415BusHiSpd.FordMissMsgDiagcInhb.Val "MICROSAR RTE" /begin SUB_GROUP /end SUB_GROUP /begin FUNCTION_LIST /end FUNCTION_LIST /begin REF_CHARACTERISTIC /end REF_CHARACTERISTIC /begin REF_MEASUREMENT FordMsg415BusHiSpd.FordMissMsgDiagcInhb.Val /end REF_MEASUREMENT /end GROUP
/begin GROUP FordMsg415BusHiSpd.FordMsg415BusHiSpdBrkModlLoQlyVldFaildThd.Val "MICROSAR RTE" /begin SUB_GROUP /end SUB_GROUP /begin FUNCTION_LIST /end FUNCTION_LIST
 /begin REF_CHARACTERISTIC FordMsg415BusHiSpd.FordMsg415BusHiSpdBrkModlLoQlyVldFaildThd.Val /end REF_CHARACTERISTIC
 /begin REF_MEASUREMENT /end REF_MEASUREMENT
/end GROUP
/begin GROUP FordMsg415BusHiSpd.FordMsg415BusHiSpdBrkModlLoQlyVldMissThd.Val "MICROSAR RTE" /begin SUB_GROUP /end SUB_GROUP /begin FUNCTION_LIST /end FUNCTION_LIST
 /begin REF_CHARACTERISTIC FordMsg415BusHiSpd.FordMsg415BusHiSpdBrkModlLoQlyVldMissThd.Val /end REF_CHARACTERISTIC
 /begin REF_MEASUREMENT /end REF_MEASUREMENT
/end GROUP
/begin GROUP FordMsg415BusHiSpd.FordMsg415BusHiSpdBrkModlLoQlyVldPassdThd.Val "MICROSAR RTE" /begin SUB_GROUP /end SUB_GROUP /begin FUNCTION_LIST /end FUNCTION_LIST
 /begin REF_CHARACTERISTIC FordMsg415BusHiSpd.FordMsg415BusHiSpdBrkModlLoQlyVldPassdThd.Val /end REF_CHARACTERISTIC
 /begin REF_MEASUREMENT /end REF_MEASUREMENT
/end GROUP
/begin GROUP FordMsg415BusHiSpd.FordMsg415BusHiSpdBrkModlVldFaildThd.Val "MICROSAR RTE" /begin SUB_GROUP /end SUB_GROUP /begin FUNCTION_LIST /end FUNCTION_LIST
 /begin REF_CHARACTERISTIC FordMsg415BusHiSpd.FordMsg415BusHiSpdBrkModlVldFaildThd.Val /end REF_CHARACTERISTIC
 /begin REF_MEASUREMENT /end REF_MEASUREMENT
/end GROUP
/begin GROUP FordMsg415BusHiSpd.FordMsg415BusHiSpdBrkModlVldMissThd.Val "MICROSAR RTE" /begin SUB_GROUP /end SUB_GROUP /begin FUNCTION_LIST /end FUNCTION_LIST /begin REF_CHARACTERISTIC FordMsg415BusHiSpd.FordMsg415BusHiSpdBrkModlVldMissThd.Val /end REF_CHARACTERISTIC /begin REF_MEASUREMENT /end REF_MEASUREMENT /end GROUP
/begin GROUP FordMsg415BusHiSpd.FordMsg415BusHiSpdBrkModlVldPassdThd.Val "MICROSAR RTE" /begin SUB_GROUP /end SUB_GROUP /begin FUNCTION_LIST /end FUNCTION_LIST
 /begin REF_CHARACTERISTIC FordMsg415BusHiSpd.FordMsg415BusHiSpdBrkModlVldPassdThd.Val /end REF_CHARACTERISTIC
 /begin REF_MEASUREMENT /end REF_MEASUREMENT
/end GROUP
/begin GROUP FordMsg415BusHiSpd.FordMsg415BusHiSpdBrkSprtVldMissThd.Val "MICROSAR RTE" /begin SUB_GROUP /end SUB_GROUP /begin FUNCTION_LIST /end FUNCTION_LIST /begin REF_CHARACTERISTIC FordMsg415BusHiSpd.FordMsg415BusHiSpdBrkSprtVldMissThd.Val /end REF_CHARACTERISTIC /begin REF_MEASUREMENT /end REF_MEASUREMENT /end GROUP
/begin GROUP FordMsg415BusHiSpd.FordMsg415BusHiSpdBrkSprtVldPassdThd.Val "MICROSAR RTE" /begin SUB_GROUP /end SUB_GROUP /begin FUNCTION_LIST /end FUNCTION_LIST
 /begin REF_CHARACTERISTIC FordMsg415BusHiSpd.FordMsg415BusHiSpdBrkSprtVldPassdThd.Val /end REF_CHARACTERISTIC
 /begin REF_MEASUREMENT /end REF_MEASUREMENT
/end GROUP
/begin GROUP FordMsg415BusHiSpd.FordMsg415BusHiSpdChksBrkModlInvldFaildThd.Val "MICROSAR RTE" /begin SUB_GROUP /end SUB_GROUP /begin FUNCTION_LIST /end FUNCTION_LIST
 /begin REF_CHARACTERISTIC FordMsg415BusHiSpd.FordMsg415BusHiSpdChksBrkModlInvldFaildThd.Val /end REF_CHARACTERISTIC
 /begin REF_MEASUREMENT /end REF_MEASUREMENT
/end GROUP
/begin GROUP FordMsg415BusHiSpd.FordMsg415BusHiSpdChksBrkModlInvldPassdThd.Val "MICROSAR RTE" /begin SUB_GROUP /end SUB_GROUP /begin FUNCTION_LIST /end FUNCTION_LIST
 /begin REF_CHARACTERISTIC FordMsg415BusHiSpd.FordMsg415BusHiSpdChksBrkModlInvldPassdThd.Val /end REF_CHARACTERISTIC
 /begin REF_MEASUREMENT /end REF_MEASUREMENT
/end GROUP
/begin GROUP FordMsg415BusHiSpd.FordMsg415BusHiSpdCntrBrkModlInvldFaildThd.Val "MICROSAR RTE" /begin SUB_GROUP /end SUB_GROUP /begin FUNCTION_LIST /end FUNCTION_LIST
 /begin REF_CHARACTERISTIC FordMsg415BusHiSpd.FordMsg415BusHiSpdCntrBrkModlInvldFaildThd.Val /end REF_CHARACTERISTIC
 /begin REF_MEASUREMENT /end REF_MEASUREMENT
/end GROUP
/begin GROUP FordMsg415BusHiSpd.FordMsg415BusHiSpdCntrBrkModlInvldPassdThd.Val "MICROSAR RTE" /begin SUB_GROUP /end SUB_GROUP /begin FUNCTION_LIST /end FUNCTION_LIST
 /begin REF_CHARACTERISTIC FordMsg415BusHiSpd.FordMsg415BusHiSpdCntrBrkModlInvldPassdThd.Val /end REF_CHARACTERISTIC
 /begin REF_MEASUREMENT /end REF_MEASUREMENT
/end GROUP
/begin GROUP FordMsg415BusHiSpd.FordMsg415BusHiSpdMissMsgFaildThd.Val "MICROSAR RTE" /begin SUB_GROUP /end SUB_GROUP /begin FUNCTION_LIST /end FUNCTION_LIST /begin REF_CHARACTERISTIC FordMsg415BusHiSpd.FordMsg415BusHiSpdMissMsgFaildThd.Val /end REF_CHARACTERISTIC /begin REF_MEASUREMENT /end REF_MEASUREMENT /end GROUP
/begin GROUP FordMsg415BusHiSpd.FordMsg415BusHiSpdMissMsgPassdThd.Val "MICROSAR RTE" /begin SUB_GROUP /end SUB_GROUP /begin FUNCTION_LIST /end FUNCTION_LIST /begin REF_CHARACTERISTIC FordMsg415BusHiSpd.FordMsg415BusHiSpdMissMsgPassdThd.Val /end REF_CHARACTERISTIC /begin REF_MEASUREMENT /end REF_MEASUREMENT /end GROUP
/begin GROUP FordMsg415BusHiSpd.FordMsg415BusHiSpdQlyFacBrkModlInvldFaildThd.Val "MICROSAR RTE" /begin SUB_GROUP /end SUB_GROUP /begin FUNCTION_LIST /end FUNCTION_LIST
 /begin REF_CHARACTERISTIC FordMsg415BusHiSpd.FordMsg415BusHiSpdQlyFacBrkModlInvldFaildThd.Val /end REF_CHARACTERISTIC
 /begin REF_MEASUREMENT /end REF_MEASUREMENT
/end GROUP
/begin GROUP FordMsg415BusHiSpd.FordMsg415BusHiSpdQlyFacBrkModlInvldSigPassdThd.Val "MICROSAR RTE" /begin SUB_GROUP /end SUB_GROUP /begin FUNCTION_LIST /end FUNCTION_LIST
 /begin REF_CHARACTERISTIC FordMsg415BusHiSpd.FordMsg415BusHiSpdQlyFacBrkModlInvldSigPassdThd.Val /end REF_CHARACTERISTIC
 /begin REF_MEASUREMENT /end REF_MEASUREMENT
/end GROUP
/begin GROUP FordMsg415BusHiSpd.FordTrlrBackupAssiEnad.Logl "MICROSAR RTE" /begin SUB_GROUP /end SUB_GROUP /begin FUNCTION_LIST /end FUNCTION_LIST /begin REF_CHARACTERISTIC /end REF_CHARACTERISTIC /begin REF_MEASUREMENT FordMsg415BusHiSpd.FordTrlrBackupAssiEnad.Logl /end REF_MEASUREMENT /end GROUP
/begin GROUP FordMsg415BusHiSpd.FordVehLoSpdMtnCtrlBrkSprtSts.Ford_LsmcBrkDecel_D_Stat "MICROSAR RTE" /begin SUB_GROUP /end SUB_GROUP /begin FUNCTION_LIST /end FUNCTION_LIST /begin REF_CHARACTERISTIC /end REF_CHARACTERISTIC
 /begin REF_MEASUREMENT FordMsg415BusHiSpd.FordVehLoSpdMtnCtrlBrkSprtSts.Ford_LsmcBrkDecel_D_Stat /end REF_MEASUREMENT
/end GROUP
/begin GROUP FordMsg415BusHiSpd.FordVehLoSpdMtnCtrlBrkSprtStsPrev "MICROSAR RTE" /begin SUB_GROUP /end SUB_GROUP /begin FUNCTION_LIST /end FUNCTION_LIST /begin REF_CHARACTERISTIC /end REF_CHARACTERISTIC /begin REF_MEASUREMENT FordMsg415BusHiSpd.FordVehLoSpdMtnCtrlBrkSprtStsPrev /end REF_MEASUREMENT /end GROUP
/begin GROUP FordMsg415BusHiSpd.FordVehLoSpdMtnCtrlBrkSprtStsRaw.Val "MICROSAR RTE" /begin SUB_GROUP /end SUB_GROUP /begin FUNCTION_LIST /end FUNCTION_LIST /begin REF_CHARACTERISTIC /end REF_CHARACTERISTIC /begin REF_MEASUREMENT FordMsg415BusHiSpd.FordVehLoSpdMtnCtrlBrkSprtStsRaw.Val /end REF_MEASUREMENT /end GROUP
/begin GROUP FordMsg415BusHiSpd.FordVehLoSpdMtnCtrlBrkSprtStsRawPrev "MICROSAR RTE" /begin SUB_GROUP /end SUB_GROUP /begin FUNCTION_LIST /end FUNCTION_LIST /begin REF_CHARACTERISTIC /end REF_CHARACTERISTIC /begin REF_MEASUREMENT FordMsg415BusHiSpd.FordVehLoSpdMtnCtrlBrkSprtStsRawPrev /end REF_MEASUREMENT /end GROUP
/begin GROUP FordMsg415BusHiSpd.FordVehLoSpdMtnCtrlBrkSprtVld.Logl "MICROSAR RTE" /begin SUB_GROUP /end SUB_GROUP /begin FUNCTION_LIST /end FUNCTION_LIST /begin REF_CHARACTERISTIC /end REF_CHARACTERISTIC /begin REF_MEASUREMENT FordMsg415BusHiSpd.FordVehLoSpdMtnCtrlBrkSprtVld.Logl /end REF_MEASUREMENT /end GROUP
/begin GROUP FordMsg415BusHiSpd.FordVehLoSpdMtnCtrlBrkSprtVldFlg "MICROSAR RTE" /begin SUB_GROUP /end SUB_GROUP /begin FUNCTION_LIST /end FUNCTION_LIST /begin REF_CHARACTERISTIC /end REF_CHARACTERISTIC /begin REF_MEASUREMENT FordMsg415BusHiSpd.FordVehLoSpdMtnCtrlBrkSprtVldFlg /end REF_MEASUREMENT /end GROUP
/begin GROUP FordMsg415BusHiSpd.FordVehLoSpdMtnCtrlBrkSprtVldPrev "MICROSAR RTE" /begin SUB_GROUP /end SUB_GROUP /begin FUNCTION_LIST /end FUNCTION_LIST /begin REF_CHARACTERISTIC /end REF_CHARACTERISTIC /begin REF_MEASUREMENT FordMsg415BusHiSpd.FordVehLoSpdMtnCtrlBrkSprtVldPrev /end REF_MEASUREMENT /end GROUP
/begin GROUP FordMsg415BusHiSpd.FordVehMsg415Miss "MICROSAR RTE" /begin SUB_GROUP /end SUB_GROUP /begin FUNCTION_LIST /end FUNCTION_LIST /begin REF_CHARACTERISTIC /end REF_CHARACTERISTIC /begin REF_MEASUREMENT FordMsg415BusHiSpd.FordVehMsg415Miss /end REF_MEASUREMENT /end GROUP
/begin GROUP FordMsg415BusHiSpd.FordVehMsg415Rxd "MICROSAR RTE" /begin SUB_GROUP /end SUB_GROUP /begin FUNCTION_LIST /end FUNCTION_LIST /begin REF_CHARACTERISTIC /end REF_CHARACTERISTIC /begin REF_MEASUREMENT FordMsg415BusHiSpd.FordVehMsg415Rxd /end REF_MEASUREMENT /end GROUP
/begin GROUP FordMsg415BusHiSpd.FordVehSpdBrkModl.Val "MICROSAR RTE" /begin SUB_GROUP /end SUB_GROUP /begin FUNCTION_LIST /end FUNCTION_LIST /begin REF_CHARACTERISTIC /end REF_CHARACTERISTIC /begin REF_MEASUREMENT FordMsg415BusHiSpd.FordVehSpdBrkModl.Val /end REF_MEASUREMENT /end GROUP
/begin GROUP FordMsg415BusHiSpd.FordVehSpdBrkModlLoQlyVld.Logl "MICROSAR RTE" /begin SUB_GROUP /end SUB_GROUP /begin FUNCTION_LIST /end FUNCTION_LIST /begin REF_CHARACTERISTIC /end REF_CHARACTERISTIC /begin REF_MEASUREMENT FordMsg415BusHiSpd.FordVehSpdBrkModlLoQlyVld.Logl /end REF_MEASUREMENT /end GROUP
/begin GROUP FordMsg415BusHiSpd.FordVehSpdBrkModlLoQlyVldPrev "MICROSAR RTE" /begin SUB_GROUP /end SUB_GROUP /begin FUNCTION_LIST /end FUNCTION_LIST /begin REF_CHARACTERISTIC /end REF_CHARACTERISTIC /begin REF_MEASUREMENT FordMsg415BusHiSpd.FordVehSpdBrkModlLoQlyVldPrev /end REF_MEASUREMENT /end GROUP
/begin GROUP FordMsg415BusHiSpd.FordVehSpdBrkModlPrev "MICROSAR RTE" /begin SUB_GROUP /end SUB_GROUP /begin FUNCTION_LIST /end FUNCTION_LIST /begin REF_CHARACTERISTIC /end REF_CHARACTERISTIC /begin REF_MEASUREMENT FordMsg415BusHiSpd.FordVehSpdBrkModlPrev /end REF_MEASUREMENT /end GROUP
/begin GROUP FordMsg415BusHiSpd.FordVehSpdBrkModlRaw.Val "MICROSAR RTE" /begin SUB_GROUP /end SUB_GROUP /begin FUNCTION_LIST /end FUNCTION_LIST /begin REF_CHARACTERISTIC /end REF_CHARACTERISTIC /begin REF_MEASUREMENT FordMsg415BusHiSpd.FordVehSpdBrkModlRaw.Val /end REF_MEASUREMENT /end GROUP
/begin GROUP FordMsg415BusHiSpd.FordVehSpdBrkModlRawPrev "MICROSAR RTE" /begin SUB_GROUP /end SUB_GROUP /begin FUNCTION_LIST /end FUNCTION_LIST /begin REF_CHARACTERISTIC /end REF_CHARACTERISTIC /begin REF_MEASUREMENT FordMsg415BusHiSpd.FordVehSpdBrkModlRawPrev /end REF_MEASUREMENT /end GROUP
/begin GROUP FordMsg415BusHiSpd.FordVehSpdBrkModlVld.Logl "MICROSAR RTE" /begin SUB_GROUP /end SUB_GROUP /begin FUNCTION_LIST /end FUNCTION_LIST /begin REF_CHARACTERISTIC /end REF_CHARACTERISTIC /begin REF_MEASUREMENT FordMsg415BusHiSpd.FordVehSpdBrkModlVld.Logl /end REF_MEASUREMENT /end GROUP
/begin GROUP FordMsg415BusHiSpd.FordVehSpdBrkModlVldPrev "MICROSAR RTE" /begin SUB_GROUP /end SUB_GROUP /begin FUNCTION_LIST /end FUNCTION_LIST /begin REF_CHARACTERISTIC /end REF_CHARACTERISTIC /begin REF_MEASUREMENT FordMsg415BusHiSpd.FordVehSpdBrkModlVldPrev /end REF_MEASUREMENT /end GROUP
/begin GROUP FordMsg415BusHiSpd.FordVehSpdChksBrkModl.Val "MICROSAR RTE" /begin SUB_GROUP /end SUB_GROUP /begin FUNCTION_LIST /end FUNCTION_LIST /begin REF_CHARACTERISTIC /end REF_CHARACTERISTIC /begin REF_MEASUREMENT FordMsg415BusHiSpd.FordVehSpdChksBrkModl.Val /end REF_MEASUREMENT /end GROUP
/begin GROUP FordMsg415BusHiSpd.FordVehSpdChksBrkModlPrev "MICROSAR RTE" /begin SUB_GROUP /end SUB_GROUP /begin FUNCTION_LIST /end FUNCTION_LIST /begin REF_CHARACTERISTIC /end REF_CHARACTERISTIC /begin REF_MEASUREMENT FordMsg415BusHiSpd.FordVehSpdChksBrkModlPrev /end REF_MEASUREMENT /end GROUP
/begin GROUP FordMsg415BusHiSpd.FordVehSpdCntrBrkModl.Val "MICROSAR RTE" /begin SUB_GROUP /end SUB_GROUP /begin FUNCTION_LIST /end FUNCTION_LIST /begin REF_CHARACTERISTIC /end REF_CHARACTERISTIC /begin REF_MEASUREMENT FordMsg415BusHiSpd.FordVehSpdCntrBrkModl.Val /end REF_MEASUREMENT /end GROUP
/begin GROUP FordMsg415BusHiSpd.FordVehSpdCntrBrkModlPrev "MICROSAR RTE" /begin SUB_GROUP /end SUB_GROUP /begin FUNCTION_LIST /end FUNCTION_LIST /begin REF_CHARACTERISTIC /end REF_CHARACTERISTIC /begin REF_MEASUREMENT FordMsg415BusHiSpd.FordVehSpdCntrBrkModlPrev /end REF_MEASUREMENT /end GROUP
/begin GROUP FordMsg415BusHiSpd.FordVehSpdQlyFacBrkModl.Ford_VehVActlBrk_D_Qf "MICROSAR RTE" /begin SUB_GROUP /end SUB_GROUP /begin FUNCTION_LIST /end FUNCTION_LIST /begin REF_CHARACTERISTIC /end REF_CHARACTERISTIC
 /begin REF_MEASUREMENT FordMsg415BusHiSpd.FordVehSpdQlyFacBrkModl.Ford_VehVActlBrk_D_Qf /end REF_MEASUREMENT
/end GROUP
/begin GROUP FordMsg415BusHiSpd.FordVehSpdQlyFacBrkModlPrev "MICROSAR RTE" /begin SUB_GROUP /end SUB_GROUP /begin FUNCTION_LIST /end FUNCTION_LIST /begin REF_CHARACTERISTIC /end REF_CHARACTERISTIC /begin REF_MEASUREMENT FordMsg415BusHiSpd.FordVehSpdQlyFacBrkModlPrev /end REF_MEASUREMENT /end GROUP
/begin GROUP FordMsg415BusHiSpd.MissMsgFaildRefTi "MICROSAR RTE" /begin SUB_GROUP /end SUB_GROUP /begin FUNCTION_LIST /end FUNCTION_LIST /begin REF_CHARACTERISTIC /end REF_CHARACTERISTIC /begin REF_MEASUREMENT FordMsg415BusHiSpd.MissMsgFaildRefTi /end REF_MEASUREMENT /end GROUP
/begin GROUP FordMsg415BusHiSpd.MissMsgPassdRefTi "MICROSAR RTE" /begin SUB_GROUP /end SUB_GROUP /begin FUNCTION_LIST /end FUNCTION_LIST /begin REF_CHARACTERISTIC /end REF_CHARACTERISTIC /begin REF_MEASUREMENT FordMsg415BusHiSpd.MissMsgPassdRefTi /end REF_MEASUREMENT /end GROUP
/begin GROUP FordMsg415BusHiSpd.PerInstanceMemories "MICROSAR RTE"
 /begin SUB_GROUP FordMsg415BusHiSpd.BrkModlLoQlyVldFaildRefTi FordMsg415BusHiSpd.BrkModlLoQlyVldMissRefTi FordMsg415BusHiSpd.BrkModlLoQlyVldPassdRefTi FordMsg415BusHiSpd.BrkModlVldFaildRefTi FordMsg415BusHiSpd.BrkModlVldMissRefTi FordMsg415BusHiSpd.BrkModlVldPassdRefTi FordMsg415BusHiSpd.BrkSprtVldMissRefTi FordMsg415BusHiSpd.BrkSprtVldPassdRefTi FordMsg415BusHiSpd.ChksBrkModlInvldFaildRefTi FordMsg415BusHiSpd.ChksBrkModlInvldPassdRefTi FordMsg415BusHiSpd.ClrDiagcFlgProxyPrev FordMsg415BusHiSpd.CntrBrkModlInvldFaildRefTi FordMsg415BusHiSpd.CntrBrkModlInvldPassdRefTi FordMsg415BusHiSpd.FirstTranVldFlg FordMsg415BusHiSpd.FordVehLoSpdMtnCtrlBrkSprtStsPrev FordMsg415BusHiSpd.FordVehLoSpdMtnCtrlBrkSprtStsRawPrev FordMsg415BusHiSpd.FordVehLoSpdMtnCtrlBrkSprtVldFlg FordMsg415BusHiSpd.FordVehLoSpdMtnCtrlBrkSprtVldPrev FordMsg415BusHiSpd.FordVehMsg415Miss FordMsg415BusHiSpd.FordVehMsg415Rxd FordMsg415BusHiSpd.FordVehSpdBrkModlLoQlyVldPrev FordMsg415BusHiSpd.FordVehSpdBrkModlPrev FordMsg415BusHiSpd.FordVehSpdBrkModlRawPrev FordMsg415BusHiSpd.FordVehSpdBrkModlVldPrev FordMsg415BusHiSpd.FordVehSpdChksBrkModlPrev FordMsg415BusHiSpd.FordVehSpdCntrBrkModlPrev FordMsg415BusHiSpd.FordVehSpdQlyFacBrkModlPrev FordMsg415BusHiSpd.MissMsgFaildRefTi FordMsg415BusHiSpd.MissMsgPassdRefTi FordMsg415BusHiSpd.QlyFacBrkModlInvldFaildRefTi FordMsg415BusHiSpd.QlyFacBrkModlInvldPassdRefTi /end SUB_GROUP
 /begin FUNCTION_LIST /end FUNCTION_LIST
 /begin REF_CHARACTERISTIC /end REF_CHARACTERISTIC
 /begin REF_MEASUREMENT /end REF_MEASUREMENT
/end GROUP
/begin GROUP FordMsg415BusHiSpd.QlyFacBrkModlInvldFaildRefTi "MICROSAR RTE" /begin SUB_GROUP /end SUB_GROUP /begin FUNCTION_LIST /end FUNCTION_LIST /begin REF_CHARACTERISTIC /end REF_CHARACTERISTIC /begin REF_MEASUREMENT FordMsg415BusHiSpd.QlyFacBrkModlInvldFaildRefTi /end REF_MEASUREMENT /end GROUP
/begin GROUP FordMsg415BusHiSpd.QlyFacBrkModlInvldPassdRefTi "MICROSAR RTE" /begin SUB_GROUP /end SUB_GROUP /begin FUNCTION_LIST /end FUNCTION_LIST /begin REF_CHARACTERISTIC /end REF_CHARACTERISTIC /begin REF_MEASUREMENT FordMsg415BusHiSpd.QlyFacBrkModlInvldPassdRefTi /end REF_MEASUREMENT /end GROUP
/begin GROUP FordMsg415BusHiSpd.ReceiverPorts "MICROSAR RTE"
 /begin SUB_GROUP FordMsg415BusHiSpd.ClrDiagcFlgProxy.Val FordMsg415BusHiSpd.FordAbsPrsnt.Logl FordMsg415BusHiSpd.FordCanDtcInhb.Val FordMsg415BusHiSpd.FordEpsLifeCycMod.Val FordMsg415BusHiSpd.FordInvldMsgDiagcInhb.Val FordMsg415BusHiSpd.FordMfgDiagcInhb.Val FordMsg415BusHiSpd.FordMissMsgDiagcInhb.Val FordMsg415BusHiSpd.FordTrlrBackupAssiEnad.Logl /end SUB_GROUP
 /begin FUNCTION_LIST /end FUNCTION_LIST
 /begin REF_CHARACTERISTIC /end REF_CHARACTERISTIC
 /begin REF_MEASUREMENT /end REF_MEASUREMENT
/end GROUP
/begin GROUP FordMsg415BusHiSpd.SenderPorts "MICROSAR RTE"
 /begin SUB_GROUP FordMsg415BusHiSpd.FordVehLoSpdMtnCtrlBrkSprtSts.Ford_LsmcBrkDecel_D_Stat FordMsg415BusHiSpd.FordVehLoSpdMtnCtrlBrkSprtStsRaw.Val FordMsg415BusHiSpd.FordVehLoSpdMtnCtrlBrkSprtVld.Logl FordMsg415BusHiSpd.FordVehSpdBrkModl.Val FordMsg415BusHiSpd.FordVehSpdBrkModlLoQlyVld.Logl FordMsg415BusHiSpd.FordVehSpdBrkModlRaw.Val FordMsg415BusHiSpd.FordVehSpdBrkModlVld.Logl FordMsg415BusHiSpd.FordVehSpdChksBrkModl.Val FordMsg415BusHiSpd.FordVehSpdCntrBrkModl.Val FordMsg415BusHiSpd.FordVehSpdQlyFacBrkModl.Ford_VehVActlBrk_D_Qf /end SUB_GROUP
 /begin FUNCTION_LIST /end FUNCTION_LIST
 /begin REF_CHARACTERISTIC /end REF_CHARACTERISTIC
 /begin REF_MEASUREMENT /end REF_MEASUREMENT
/end GROUP
/begin GROUP FordMsg417BusHiSpd "MICROSAR RTE" /begin SUB_GROUP FordMsg417BusHiSpd.ReceiverPorts /end SUB_GROUP /begin FUNCTION_LIST /end FUNCTION_LIST /begin REF_CHARACTERISTIC /end REF_CHARACTERISTIC /begin REF_MEASUREMENT /end REF_MEASUREMENT /end GROUP
/begin GROUP FordMsg417BusHiSpd.FordVehEvasSteerAssiSts.Ford_EsaOn_B_Stat "MICROSAR RTE" /begin SUB_GROUP /end SUB_GROUP /begin FUNCTION_LIST /end FUNCTION_LIST /begin REF_CHARACTERISTIC /end REF_CHARACTERISTIC
 /begin REF_MEASUREMENT FordMsg417BusHiSpd.FordVehEvasSteerAssiSts.Ford_EsaOn_B_Stat /end REF_MEASUREMENT
/end GROUP
/begin GROUP FordMsg417BusHiSpd.FordVehLatCtrlLimSts.Ford_LatCtlLim_D_Stat "MICROSAR RTE" /begin SUB_GROUP /end SUB_GROUP /begin FUNCTION_LIST /end FUNCTION_LIST /begin REF_CHARACTERISTIC /end REF_CHARACTERISTIC
 /begin REF_MEASUREMENT FordMsg417BusHiSpd.FordVehLatCtrlLimSts.Ford_LatCtlLim_D_Stat /end REF_MEASUREMENT
/end GROUP
/begin GROUP FordMsg417BusHiSpd.FordVehLatCtrlSteerSts.Ford_LatCtlSte_D_Stat "MICROSAR RTE" /begin SUB_GROUP /end SUB_GROUP /begin FUNCTION_LIST /end FUNCTION_LIST /begin REF_CHARACTERISTIC /end REF_CHARACTERISTIC
 /begin REF_MEASUREMENT FordMsg417BusHiSpd.FordVehLatCtrlSteerSts.Ford_LatCtlSte_D_Stat /end REF_MEASUREMENT
/end GROUP
/begin GROUP FordMsg417BusHiSpd.FordVehSelDrvModSteerSts.Ford_SelDrvMdeSte_D_Stat "MICROSAR RTE" /begin SUB_GROUP /end SUB_GROUP /begin FUNCTION_LIST /end FUNCTION_LIST /begin REF_CHARACTERISTIC /end REF_CHARACTERISTIC
 /begin REF_MEASUREMENT FordMsg417BusHiSpd.FordVehSelDrvModSteerSts.Ford_SelDrvMdeSte_D_Stat /end REF_MEASUREMENT
/end GROUP
/begin GROUP FordMsg417BusHiSpd.FordVehTrlrAidEnaSts.Ford_TrlrAidEnbl_D2_Stat "MICROSAR RTE" /begin SUB_GROUP /end SUB_GROUP /begin FUNCTION_LIST /end FUNCTION_LIST /begin REF_CHARACTERISTIC /end REF_CHARACTERISTIC
 /begin REF_MEASUREMENT FordMsg417BusHiSpd.FordVehTrlrAidEnaSts.Ford_TrlrAidEnbl_D2_Stat /end REF_MEASUREMENT
/end GROUP
/begin GROUP FordMsg417BusHiSpd.FordVehTrlrAidMsgTxtReq.Ford_TrlrAidMsgTxt_D2_Rq "MICROSAR RTE" /begin SUB_GROUP /end SUB_GROUP /begin FUNCTION_LIST /end FUNCTION_LIST /begin REF_CHARACTERISTIC /end REF_CHARACTERISTIC
 /begin REF_MEASUREMENT FordMsg417BusHiSpd.FordVehTrlrAidMsgTxtReq.Ford_TrlrAidMsgTxt_D2_Rq /end REF_MEASUREMENT
/end GROUP
/begin GROUP FordMsg417BusHiSpd.ReceiverPorts "MICROSAR RTE"
 /begin SUB_GROUP FordMsg417BusHiSpd.FordVehEvasSteerAssiSts.Ford_EsaOn_B_Stat FordMsg417BusHiSpd.FordVehLatCtrlLimSts.Ford_LatCtlLim_D_Stat FordMsg417BusHiSpd.FordVehLatCtrlSteerSts.Ford_LatCtlSte_D_Stat FordMsg417BusHiSpd.FordVehSelDrvModSteerSts.Ford_SelDrvMdeSte_D_Stat FordMsg417BusHiSpd.FordVehTrlrAidEnaSts.Ford_TrlrAidEnbl_D2_Stat FordMsg417BusHiSpd.FordVehTrlrAidMsgTxtReq.Ford_TrlrAidMsgTxt_D2_Rq /end SUB_GROUP
 /begin FUNCTION_LIST /end FUNCTION_LIST
 /begin REF_CHARACTERISTIC /end REF_CHARACTERISTIC
 /begin REF_MEASUREMENT /end REF_MEASUREMENT
/end GROUP
/begin GROUP FordMsg41ABusHiSpd "MICROSAR RTE"
 /begin SUB_GROUP FordMsg41ABusHiSpd.CalibrationPorts FordMsg41ABusHiSpd.PerInstanceMemories FordMsg41ABusHiSpd.ReceiverPorts FordMsg41ABusHiSpd.SenderPorts /end SUB_GROUP
 /begin FUNCTION_LIST /end FUNCTION_LIST
 /begin REF_CHARACTERISTIC /end REF_CHARACTERISTIC
 /begin REF_MEASUREMENT /end REF_MEASUREMENT
/end GROUP
/begin GROUP FordMsg41ABusHiSpd.CalibrationPorts "MICROSAR RTE"
 /begin SUB_GROUP FordMsg41ABusHiSpd.FordMsg41ABusHiSpdMissMsgFaildThd.Val FordMsg41ABusHiSpd.FordMsg41ABusHiSpdMissMsgPassdThd.Val /end SUB_GROUP
 /begin FUNCTION_LIST /end FUNCTION_LIST
 /begin REF_CHARACTERISTIC /end REF_CHARACTERISTIC
 /begin REF_MEASUREMENT /end REF_MEASUREMENT
/end GROUP
/begin GROUP FordMsg41ABusHiSpd.ClrDiagcFlgProxy.Val "MICROSAR RTE" /begin SUB_GROUP /end SUB_GROUP /begin FUNCTION_LIST /end FUNCTION_LIST /begin REF_CHARACTERISTIC /end REF_CHARACTERISTIC /begin REF_MEASUREMENT FordMsg41ABusHiSpd.ClrDiagcFlgProxy.Val /end REF_MEASUREMENT /end GROUP
/begin GROUP FordMsg41ABusHiSpd.ClrDiagcFlgProxyPrev "MICROSAR RTE" /begin SUB_GROUP /end SUB_GROUP /begin FUNCTION_LIST /end FUNCTION_LIST /begin REF_CHARACTERISTIC /end REF_CHARACTERISTIC /begin REF_MEASUREMENT FordMsg41ABusHiSpd.ClrDiagcFlgProxyPrev /end REF_MEASUREMENT /end GROUP
/begin GROUP FordMsg41ABusHiSpd.FordCanDtcInhb.Logl "MICROSAR RTE" /begin SUB_GROUP /end SUB_GROUP /begin FUNCTION_LIST /end FUNCTION_LIST /begin REF_CHARACTERISTIC /end REF_CHARACTERISTIC /begin REF_MEASUREMENT FordMsg41ABusHiSpd.FordCanDtcInhb.Logl /end REF_MEASUREMENT /end GROUP
/begin GROUP FordMsg41ABusHiSpd.FordEpsLifeCycMod.Val "MICROSAR RTE" /begin SUB_GROUP /end SUB_GROUP /begin FUNCTION_LIST /end FUNCTION_LIST /begin REF_CHARACTERISTIC /end REF_CHARACTERISTIC /begin REF_MEASUREMENT FordMsg41ABusHiSpd.FordEpsLifeCycMod.Val /end REF_MEASUREMENT /end GROUP
/begin GROUP FordMsg41ABusHiSpd.FordMsg41ABusHiSpdMissMsgFaildThd.Val "MICROSAR RTE" /begin SUB_GROUP /end SUB_GROUP /begin FUNCTION_LIST /end FUNCTION_LIST /begin REF_CHARACTERISTIC FordMsg41ABusHiSpd.FordMsg41ABusHiSpdMissMsgFaildThd.Val /end REF_CHARACTERISTIC /begin REF_MEASUREMENT /end REF_MEASUREMENT /end GROUP
/begin GROUP FordMsg41ABusHiSpd.FordMsg41ABusHiSpdMissMsgPassdThd.Val "MICROSAR RTE" /begin SUB_GROUP /end SUB_GROUP /begin FUNCTION_LIST /end FUNCTION_LIST /begin REF_CHARACTERISTIC FordMsg41ABusHiSpd.FordMsg41ABusHiSpdMissMsgPassdThd.Val /end REF_CHARACTERISTIC /begin REF_MEASUREMENT /end REF_MEASUREMENT /end GROUP
/begin GROUP FordMsg41ABusHiSpd.FordVehMsg41AMiss "MICROSAR RTE" /begin SUB_GROUP /end SUB_GROUP /begin FUNCTION_LIST /end FUNCTION_LIST /begin REF_CHARACTERISTIC /end REF_CHARACTERISTIC /begin REF_MEASUREMENT FordMsg41ABusHiSpd.FordVehMsg41AMiss /end REF_MEASUREMENT /end GROUP
/begin GROUP FordMsg41ABusHiSpd.FordVehOutdAirT.Val "MICROSAR RTE" /begin SUB_GROUP /end SUB_GROUP /begin FUNCTION_LIST /end FUNCTION_LIST /begin REF_CHARACTERISTIC /end REF_CHARACTERISTIC /begin REF_MEASUREMENT FordMsg41ABusHiSpd.FordVehOutdAirT.Val /end REF_MEASUREMENT /end GROUP
/begin GROUP FordMsg41ABusHiSpd.FordVehOutdAirTPrev "MICROSAR RTE" /begin SUB_GROUP /end SUB_GROUP /begin FUNCTION_LIST /end FUNCTION_LIST /begin REF_CHARACTERISTIC /end REF_CHARACTERISTIC /begin REF_MEASUREMENT FordMsg41ABusHiSpd.FordVehOutdAirTPrev /end REF_MEASUREMENT /end GROUP
/begin GROUP FordMsg41ABusHiSpd.FordVehOutdAirTRaw.Val "MICROSAR RTE" /begin SUB_GROUP /end SUB_GROUP /begin FUNCTION_LIST /end FUNCTION_LIST /begin REF_CHARACTERISTIC /end REF_CHARACTERISTIC /begin REF_MEASUREMENT FordMsg41ABusHiSpd.FordVehOutdAirTRaw.Val /end REF_MEASUREMENT /end GROUP
/begin GROUP FordMsg41ABusHiSpd.FordVehOutdAirTRawPrev "MICROSAR RTE" /begin SUB_GROUP /end SUB_GROUP /begin FUNCTION_LIST /end FUNCTION_LIST /begin REF_CHARACTERISTIC /end REF_CHARACTERISTIC /begin REF_MEASUREMENT FordMsg41ABusHiSpd.FordVehOutdAirTRawPrev /end REF_MEASUREMENT /end GROUP
/begin GROUP FordMsg41ABusHiSpd.MissMsgFaildRefTi "MICROSAR RTE" /begin SUB_GROUP /end SUB_GROUP /begin FUNCTION_LIST /end FUNCTION_LIST /begin REF_CHARACTERISTIC /end REF_CHARACTERISTIC /begin REF_MEASUREMENT FordMsg41ABusHiSpd.MissMsgFaildRefTi /end REF_MEASUREMENT /end GROUP
/begin GROUP FordMsg41ABusHiSpd.MissMsgPassdRefTi "MICROSAR RTE" /begin SUB_GROUP /end SUB_GROUP /begin FUNCTION_LIST /end FUNCTION_LIST /begin REF_CHARACTERISTIC /end REF_CHARACTERISTIC /begin REF_MEASUREMENT FordMsg41ABusHiSpd.MissMsgPassdRefTi /end REF_MEASUREMENT /end GROUP
/begin GROUP FordMsg41ABusHiSpd.PerInstanceMemories "MICROSAR RTE"
 /begin SUB_GROUP FordMsg41ABusHiSpd.ClrDiagcFlgProxyPrev FordMsg41ABusHiSpd.FordVehMsg41AMiss FordMsg41ABusHiSpd.FordVehOutdAirTPrev FordMsg41ABusHiSpd.FordVehOutdAirTRawPrev FordMsg41ABusHiSpd.MissMsgFaildRefTi FordMsg41ABusHiSpd.MissMsgPassdRefTi /end SUB_GROUP
 /begin FUNCTION_LIST /end FUNCTION_LIST
 /begin REF_CHARACTERISTIC /end REF_CHARACTERISTIC
 /begin REF_MEASUREMENT /end REF_MEASUREMENT
/end GROUP
/begin GROUP FordMsg41ABusHiSpd.ReceiverPorts "MICROSAR RTE"
 /begin SUB_GROUP FordMsg41ABusHiSpd.ClrDiagcFlgProxy.Val FordMsg41ABusHiSpd.FordCanDtcInhb.Logl FordMsg41ABusHiSpd.FordEpsLifeCycMod.Val /end SUB_GROUP
 /begin FUNCTION_LIST /end FUNCTION_LIST
 /begin REF_CHARACTERISTIC /end REF_CHARACTERISTIC
 /begin REF_MEASUREMENT /end REF_MEASUREMENT
/end GROUP
/begin GROUP FordMsg41ABusHiSpd.SenderPorts "MICROSAR RTE"
 /begin SUB_GROUP FordMsg41ABusHiSpd.FordVehOutdAirT.Val FordMsg41ABusHiSpd.FordVehOutdAirTRaw.Val /end SUB_GROUP
 /begin FUNCTION_LIST /end FUNCTION_LIST
 /begin REF_CHARACTERISTIC /end REF_CHARACTERISTIC
 /begin REF_MEASUREMENT /end REF_MEASUREMENT
/end GROUP
/begin GROUP FordMsg41EBusHiSpd "MICROSAR RTE"
 /begin SUB_GROUP FordMsg41EBusHiSpd.CalibrationPorts FordMsg41EBusHiSpd.PerInstanceMemories FordMsg41EBusHiSpd.ReceiverPorts FordMsg41EBusHiSpd.SenderPorts /end SUB_GROUP
 /begin FUNCTION_LIST /end FUNCTION_LIST
 /begin REF_CHARACTERISTIC /end REF_CHARACTERISTIC
 /begin REF_MEASUREMENT /end REF_MEASUREMENT
/end GROUP
/begin GROUP FordMsg41EBusHiSpd.CalibrationPorts "MICROSAR RTE"
 /begin SUB_GROUP FordMsg41EBusHiSpd.FordMsg41EBusHiSpdChassisVldMissFaildThd.Val FordMsg41EBusHiSpd.FordMsg41EBusHiSpdChassisVldSigFaildThd.Val FordMsg41EBusHiSpd.FordMsg41EBusHiSpdChassisVldSigPassdThd.Val FordMsg41EBusHiSpd.FordMsg41EBusHiSpdInvldMsgFaildThd.Val FordMsg41EBusHiSpd.FordMsg41EBusHiSpdInvldMsgPassdThd.Val FordMsg41EBusHiSpd.FordMsg41EBusHiSpdMissMsgFaildThd.Val FordMsg41EBusHiSpd.FordMsg41EBusHiSpdMissMsgPassdThd.Val /end SUB_GROUP
 /begin FUNCTION_LIST /end FUNCTION_LIST
 /begin REF_CHARACTERISTIC /end REF_CHARACTERISTIC
 /begin REF_MEASUREMENT /end REF_MEASUREMENT
/end GROUP
/begin GROUP FordMsg41EBusHiSpd.ClrDiagcFlgProxy.Val "MICROSAR RTE" /begin SUB_GROUP /end SUB_GROUP /begin FUNCTION_LIST /end FUNCTION_LIST /begin REF_CHARACTERISTIC /end REF_CHARACTERISTIC /begin REF_MEASUREMENT FordMsg41EBusHiSpd.ClrDiagcFlgProxy.Val /end REF_MEASUREMENT /end GROUP
/begin GROUP FordMsg41EBusHiSpd.ClrDiagcFlgProxyPrev "MICROSAR RTE" /begin SUB_GROUP /end SUB_GROUP /begin FUNCTION_LIST /end FUNCTION_LIST /begin REF_CHARACTERISTIC /end REF_CHARACTERISTIC /begin REF_MEASUREMENT FordMsg41EBusHiSpd.ClrDiagcFlgProxyPrev /end REF_MEASUREMENT /end GROUP
/begin GROUP FordMsg41EBusHiSpd.FirstTranVldFlg "MICROSAR RTE" /begin SUB_GROUP /end SUB_GROUP /begin FUNCTION_LIST /end FUNCTION_LIST /begin REF_CHARACTERISTIC /end REF_CHARACTERISTIC /begin REF_MEASUREMENT FordMsg41EBusHiSpd.FirstTranVldFlg /end REF_MEASUREMENT /end GROUP
/begin GROUP FordMsg41EBusHiSpd.FordCanDtcInhb.Logl "MICROSAR RTE" /begin SUB_GROUP /end SUB_GROUP /begin FUNCTION_LIST /end FUNCTION_LIST /begin REF_CHARACTERISTIC /end REF_CHARACTERISTIC /begin REF_MEASUREMENT FordMsg41EBusHiSpd.FordCanDtcInhb.Logl /end REF_MEASUREMENT /end GROUP
/begin GROUP FordMsg41EBusHiSpd.FordEpsLifeCycMod.Val "MICROSAR RTE" /begin SUB_GROUP /end SUB_GROUP /begin FUNCTION_LIST /end FUNCTION_LIST /begin REF_CHARACTERISTIC /end REF_CHARACTERISTIC /begin REF_MEASUREMENT FordMsg41EBusHiSpd.FordEpsLifeCycMod.Val /end REF_MEASUREMENT /end GROUP
/begin GROUP FordMsg41EBusHiSpd.FordMsg41EBusHiSpdChassisVldMissFaildThd.Val "MICROSAR RTE" /begin SUB_GROUP /end SUB_GROUP /begin FUNCTION_LIST /end FUNCTION_LIST
 /begin REF_CHARACTERISTIC FordMsg41EBusHiSpd.FordMsg41EBusHiSpdChassisVldMissFaildThd.Val /end REF_CHARACTERISTIC
 /begin REF_MEASUREMENT /end REF_MEASUREMENT
/end GROUP
/begin GROUP FordMsg41EBusHiSpd.FordMsg41EBusHiSpdChassisVldSigFaildThd.Val "MICROSAR RTE" /begin SUB_GROUP /end SUB_GROUP /begin FUNCTION_LIST /end FUNCTION_LIST
 /begin REF_CHARACTERISTIC FordMsg41EBusHiSpd.FordMsg41EBusHiSpdChassisVldSigFaildThd.Val /end REF_CHARACTERISTIC
 /begin REF_MEASUREMENT /end REF_MEASUREMENT
/end GROUP
/begin GROUP FordMsg41EBusHiSpd.FordMsg41EBusHiSpdChassisVldSigPassdThd.Val "MICROSAR RTE" /begin SUB_GROUP /end SUB_GROUP /begin FUNCTION_LIST /end FUNCTION_LIST
 /begin REF_CHARACTERISTIC FordMsg41EBusHiSpd.FordMsg41EBusHiSpdChassisVldSigPassdThd.Val /end REF_CHARACTERISTIC
 /begin REF_MEASUREMENT /end REF_MEASUREMENT
/end GROUP
/begin GROUP FordMsg41EBusHiSpd.FordMsg41EBusHiSpdInvldMsgFaildThd.Val "MICROSAR RTE" /begin SUB_GROUP /end SUB_GROUP /begin FUNCTION_LIST /end FUNCTION_LIST /begin REF_CHARACTERISTIC FordMsg41EBusHiSpd.FordMsg41EBusHiSpdInvldMsgFaildThd.Val /end REF_CHARACTERISTIC /begin REF_MEASUREMENT /end REF_MEASUREMENT /end GROUP
/begin GROUP FordMsg41EBusHiSpd.FordMsg41EBusHiSpdInvldMsgPassdThd.Val "MICROSAR RTE" /begin SUB_GROUP /end SUB_GROUP /begin FUNCTION_LIST /end FUNCTION_LIST /begin REF_CHARACTERISTIC FordMsg41EBusHiSpd.FordMsg41EBusHiSpdInvldMsgPassdThd.Val /end REF_CHARACTERISTIC /begin REF_MEASUREMENT /end REF_MEASUREMENT /end GROUP
/begin GROUP FordMsg41EBusHiSpd.FordMsg41EBusHiSpdMissMsgFaildThd.Val "MICROSAR RTE" /begin SUB_GROUP /end SUB_GROUP /begin FUNCTION_LIST /end FUNCTION_LIST /begin REF_CHARACTERISTIC FordMsg41EBusHiSpd.FordMsg41EBusHiSpdMissMsgFaildThd.Val /end REF_CHARACTERISTIC /begin REF_MEASUREMENT /end REF_MEASUREMENT /end GROUP
/begin GROUP FordMsg41EBusHiSpd.FordMsg41EBusHiSpdMissMsgPassdThd.Val "MICROSAR RTE" /begin SUB_GROUP /end SUB_GROUP /begin FUNCTION_LIST /end FUNCTION_LIST /begin REF_CHARACTERISTIC FordMsg41EBusHiSpd.FordMsg41EBusHiSpdMissMsgPassdThd.Val /end REF_CHARACTERISTIC /begin REF_MEASUREMENT /end REF_MEASUREMENT /end GROUP
/begin GROUP FordMsg41EBusHiSpd.FordSelDrvModEnad.Logl "MICROSAR RTE" /begin SUB_GROUP /end SUB_GROUP /begin FUNCTION_LIST /end FUNCTION_LIST /begin REF_CHARACTERISTIC /end REF_CHARACTERISTIC /begin REF_MEASUREMENT FordMsg41EBusHiSpd.FordSelDrvModEnad.Logl /end REF_MEASUREMENT /end GROUP
/begin GROUP FordMsg41EBusHiSpd.FordVehMsg41EMiss "MICROSAR RTE" /begin SUB_GROUP /end SUB_GROUP /begin FUNCTION_LIST /end FUNCTION_LIST /begin REF_CHARACTERISTIC /end REF_CHARACTERISTIC /begin REF_MEASUREMENT FordMsg41EBusHiSpd.FordVehMsg41EMiss /end REF_MEASUREMENT /end GROUP
/begin GROUP FordMsg41EBusHiSpd.FordVehPenSelDrvMod.Ford_SelDrvMdeChassis2_D_Rq "MICROSAR RTE" /begin SUB_GROUP /end SUB_GROUP /begin FUNCTION_LIST /end FUNCTION_LIST /begin REF_CHARACTERISTIC /end REF_CHARACTERISTIC
 /begin REF_MEASUREMENT FordMsg41EBusHiSpd.FordVehPenSelDrvMod.Ford_SelDrvMdeChassis2_D_Rq /end REF_MEASUREMENT
/end GROUP
/begin GROUP FordMsg41EBusHiSpd.FordVehPenSelDrvModPrev "MICROSAR RTE" /begin SUB_GROUP /end SUB_GROUP /begin FUNCTION_LIST /end FUNCTION_LIST /begin REF_CHARACTERISTIC /end REF_CHARACTERISTIC /begin REF_MEASUREMENT FordMsg41EBusHiSpd.FordVehPenSelDrvModPrev /end REF_MEASUREMENT /end GROUP
/begin GROUP FordMsg41EBusHiSpd.FordVehSelDrvModChassisVld.Logl "MICROSAR RTE" /begin SUB_GROUP /end SUB_GROUP /begin FUNCTION_LIST /end FUNCTION_LIST /begin REF_CHARACTERISTIC /end REF_CHARACTERISTIC /begin REF_MEASUREMENT FordMsg41EBusHiSpd.FordVehSelDrvModChassisVld.Logl /end REF_MEASUREMENT /end GROUP
/begin GROUP FordMsg41EBusHiSpd.FordVehSelDrvModChassisVldFaildRefTi "MICROSAR RTE" /begin SUB_GROUP /end SUB_GROUP /begin FUNCTION_LIST /end FUNCTION_LIST /begin REF_CHARACTERISTIC /end REF_CHARACTERISTIC /begin REF_MEASUREMENT FordMsg41EBusHiSpd.FordVehSelDrvModChassisVldFaildRefTi /end REF_MEASUREMENT /end GROUP
/begin GROUP FordMsg41EBusHiSpd.FordVehSelDrvModChassisVldMissRefTi "MICROSAR RTE" /begin SUB_GROUP /end SUB_GROUP /begin FUNCTION_LIST /end FUNCTION_LIST /begin REF_CHARACTERISTIC /end REF_CHARACTERISTIC /begin REF_MEASUREMENT FordMsg41EBusHiSpd.FordVehSelDrvModChassisVldMissRefTi /end REF_MEASUREMENT /end GROUP
/begin GROUP FordMsg41EBusHiSpd.FordVehSelDrvModChassisVldPassdRefTi "MICROSAR RTE" /begin SUB_GROUP /end SUB_GROUP /begin FUNCTION_LIST /end FUNCTION_LIST /begin REF_CHARACTERISTIC /end REF_CHARACTERISTIC /begin REF_MEASUREMENT FordMsg41EBusHiSpd.FordVehSelDrvModChassisVldPassdRefTi /end REF_MEASUREMENT /end GROUP
/begin GROUP FordMsg41EBusHiSpd.FordVehSelDrvModChassisVldPrev "MICROSAR RTE" /begin SUB_GROUP /end SUB_GROUP /begin FUNCTION_LIST /end FUNCTION_LIST /begin REF_CHARACTERISTIC /end REF_CHARACTERISTIC /begin REF_MEASUREMENT FordMsg41EBusHiSpd.FordVehSelDrvModChassisVldPrev /end REF_MEASUREMENT /end GROUP
/begin GROUP FordMsg41EBusHiSpd.InvldMsgFaildRefTi "MICROSAR RTE" /begin SUB_GROUP /end SUB_GROUP /begin FUNCTION_LIST /end FUNCTION_LIST /begin REF_CHARACTERISTIC /end REF_CHARACTERISTIC /begin REF_MEASUREMENT FordMsg41EBusHiSpd.InvldMsgFaildRefTi /end REF_MEASUREMENT /end GROUP
/begin GROUP FordMsg41EBusHiSpd.InvldMsgPassdRefTi "MICROSAR RTE" /begin SUB_GROUP /end SUB_GROUP /begin FUNCTION_LIST /end FUNCTION_LIST /begin REF_CHARACTERISTIC /end REF_CHARACTERISTIC /begin REF_MEASUREMENT FordMsg41EBusHiSpd.InvldMsgPassdRefTi /end REF_MEASUREMENT /end GROUP
/begin GROUP FordMsg41EBusHiSpd.MissMsgFaildRefTi "MICROSAR RTE" /begin SUB_GROUP /end SUB_GROUP /begin FUNCTION_LIST /end FUNCTION_LIST /begin REF_CHARACTERISTIC /end REF_CHARACTERISTIC /begin REF_MEASUREMENT FordMsg41EBusHiSpd.MissMsgFaildRefTi /end REF_MEASUREMENT /end GROUP
/begin GROUP FordMsg41EBusHiSpd.MissMsgPassdRefTi "MICROSAR RTE" /begin SUB_GROUP /end SUB_GROUP /begin FUNCTION_LIST /end FUNCTION_LIST /begin REF_CHARACTERISTIC /end REF_CHARACTERISTIC /begin REF_MEASUREMENT FordMsg41EBusHiSpd.MissMsgPassdRefTi /end REF_MEASUREMENT /end GROUP
/begin GROUP FordMsg41EBusHiSpd.PerInstanceMemories "MICROSAR RTE"
 /begin SUB_GROUP FordMsg41EBusHiSpd.ClrDiagcFlgProxyPrev FordMsg41EBusHiSpd.FirstTranVldFlg FordMsg41EBusHiSpd.FordVehMsg41EMiss FordMsg41EBusHiSpd.FordVehPenSelDrvModPrev FordMsg41EBusHiSpd.FordVehSelDrvModChassisVldFaildRefTi FordMsg41EBusHiSpd.FordVehSelDrvModChassisVldMissRefTi FordMsg41EBusHiSpd.FordVehSelDrvModChassisVldPassdRefTi FordMsg41EBusHiSpd.FordVehSelDrvModChassisVldPrev FordMsg41EBusHiSpd.InvldMsgFaildRefTi FordMsg41EBusHiSpd.InvldMsgPassdRefTi FordMsg41EBusHiSpd.MissMsgFaildRefTi FordMsg41EBusHiSpd.MissMsgPassdRefTi /end SUB_GROUP
 /begin FUNCTION_LIST /end FUNCTION_LIST
 /begin REF_CHARACTERISTIC /end REF_CHARACTERISTIC
 /begin REF_MEASUREMENT /end REF_MEASUREMENT
/end GROUP
/begin GROUP FordMsg41EBusHiSpd.ReceiverPorts "MICROSAR RTE"
 /begin SUB_GROUP FordMsg41EBusHiSpd.ClrDiagcFlgProxy.Val FordMsg41EBusHiSpd.FordCanDtcInhb.Logl FordMsg41EBusHiSpd.FordEpsLifeCycMod.Val FordMsg41EBusHiSpd.FordSelDrvModEnad.Logl /end SUB_GROUP
 /begin FUNCTION_LIST /end FUNCTION_LIST
 /begin REF_CHARACTERISTIC /end REF_CHARACTERISTIC
 /begin REF_MEASUREMENT /end REF_MEASUREMENT
/end GROUP
/begin GROUP FordMsg41EBusHiSpd.SenderPorts "MICROSAR RTE"
 /begin SUB_GROUP FordMsg41EBusHiSpd.FordVehPenSelDrvMod.Ford_SelDrvMdeChassis2_D_Rq FordMsg41EBusHiSpd.FordVehSelDrvModChassisVld.Logl /end SUB_GROUP
 /begin FUNCTION_LIST /end FUNCTION_LIST
 /begin REF_CHARACTERISTIC /end REF_CHARACTERISTIC
 /begin REF_MEASUREMENT /end REF_MEASUREMENT
/end GROUP
/begin GROUP FordMsg430BusHiSpd "MICROSAR RTE"
 /begin SUB_GROUP FordMsg430BusHiSpd.CalibrationPorts FordMsg430BusHiSpd.PerInstanceMemories FordMsg430BusHiSpd.ReceiverPorts FordMsg430BusHiSpd.SenderPorts /end SUB_GROUP
 /begin FUNCTION_LIST /end FUNCTION_LIST
 /begin REF_CHARACTERISTIC /end REF_CHARACTERISTIC
 /begin REF_MEASUREMENT /end REF_MEASUREMENT
/end GROUP
/begin GROUP FordMsg430BusHiSpd.CalibrationPorts "MICROSAR RTE"
 /begin SUB_GROUP FordMsg430BusHiSpd.FordMsg430BusHiSpdMissMsgFaildThd.Val FordMsg430BusHiSpd.FordMsg430BusHiSpdMissMsgPassdThd.Val /end SUB_GROUP
 /begin FUNCTION_LIST /end FUNCTION_LIST
 /begin REF_CHARACTERISTIC /end REF_CHARACTERISTIC
 /begin REF_MEASUREMENT /end REF_MEASUREMENT
/end GROUP
/begin GROUP FordMsg430BusHiSpd.ClrDiagcFlgProxy.Val "MICROSAR RTE" /begin SUB_GROUP /end SUB_GROUP /begin FUNCTION_LIST /end FUNCTION_LIST /begin REF_CHARACTERISTIC /end REF_CHARACTERISTIC /begin REF_MEASUREMENT FordMsg430BusHiSpd.ClrDiagcFlgProxy.Val /end REF_MEASUREMENT /end GROUP
/begin GROUP FordMsg430BusHiSpd.ClrDiagcFlgProxyPrev "MICROSAR RTE" /begin SUB_GROUP /end SUB_GROUP /begin FUNCTION_LIST /end FUNCTION_LIST /begin REF_CHARACTERISTIC /end REF_CHARACTERISTIC /begin REF_MEASUREMENT FordMsg430BusHiSpd.ClrDiagcFlgProxyPrev /end REF_MEASUREMENT /end GROUP
/begin GROUP FordMsg430BusHiSpd.FordCanDtcInhb.Val "MICROSAR RTE" /begin SUB_GROUP /end SUB_GROUP /begin FUNCTION_LIST /end FUNCTION_LIST /begin REF_CHARACTERISTIC /end REF_CHARACTERISTIC /begin REF_MEASUREMENT FordMsg430BusHiSpd.FordCanDtcInhb.Val /end REF_MEASUREMENT /end GROUP
/begin GROUP FordMsg430BusHiSpd.FordEpsLifeCycMod.Val "MICROSAR RTE" /begin SUB_GROUP /end SUB_GROUP /begin FUNCTION_LIST /end FUNCTION_LIST /begin REF_CHARACTERISTIC /end REF_CHARACTERISTIC /begin REF_MEASUREMENT FordMsg430BusHiSpd.FordEpsLifeCycMod.Val /end REF_MEASUREMENT /end GROUP
/begin GROUP FordMsg430BusHiSpd.FordMfgDiagcInhb.Val "MICROSAR RTE" /begin SUB_GROUP /end SUB_GROUP /begin FUNCTION_LIST /end FUNCTION_LIST /begin REF_CHARACTERISTIC /end REF_CHARACTERISTIC /begin REF_MEASUREMENT FordMsg430BusHiSpd.FordMfgDiagcInhb.Val /end REF_MEASUREMENT /end GROUP
/begin GROUP FordMsg430BusHiSpd.FordMissMsgDiagcInhb.Val "MICROSAR RTE" /begin SUB_GROUP /end SUB_GROUP /begin FUNCTION_LIST /end FUNCTION_LIST /begin REF_CHARACTERISTIC /end REF_CHARACTERISTIC /begin REF_MEASUREMENT FordMsg430BusHiSpd.FordMissMsgDiagcInhb.Val /end REF_MEASUREMENT /end GROUP
/begin GROUP FordMsg430BusHiSpd.FordMsg430BusHiSpdMissMsgFaildThd.Val "MICROSAR RTE" /begin SUB_GROUP /end SUB_GROUP /begin FUNCTION_LIST /end FUNCTION_LIST /begin REF_CHARACTERISTIC FordMsg430BusHiSpd.FordMsg430BusHiSpdMissMsgFaildThd.Val /end REF_CHARACTERISTIC /begin REF_MEASUREMENT /end REF_MEASUREMENT /end GROUP
/begin GROUP FordMsg430BusHiSpd.FordMsg430BusHiSpdMissMsgPassdThd.Val "MICROSAR RTE" /begin SUB_GROUP /end SUB_GROUP /begin FUNCTION_LIST /end FUNCTION_LIST /begin REF_CHARACTERISTIC FordMsg430BusHiSpd.FordMsg430BusHiSpdMissMsgPassdThd.Val /end REF_CHARACTERISTIC /begin REF_MEASUREMENT /end REF_MEASUREMENT /end GROUP
/begin GROUP FordMsg430BusHiSpd.FordVehMsg430Miss "MICROSAR RTE" /begin SUB_GROUP /end SUB_GROUP /begin FUNCTION_LIST /end FUNCTION_LIST /begin REF_CHARACTERISTIC /end REF_CHARACTERISTIC /begin REF_MEASUREMENT FordMsg430BusHiSpd.FordVehMsg430Miss /end REF_MEASUREMENT /end GROUP
/begin GROUP FordMsg430BusHiSpd.FordVehMsg430Rxd "MICROSAR RTE" /begin SUB_GROUP /end SUB_GROUP /begin FUNCTION_LIST /end FUNCTION_LIST /begin REF_CHARACTERISTIC /end REF_CHARACTERISTIC /begin REF_MEASUREMENT FordMsg430BusHiSpd.FordVehMsg430Rxd /end REF_MEASUREMENT /end GROUP
/begin GROUP FordMsg430BusHiSpd.FordVehOdom.Val "MICROSAR RTE" /begin SUB_GROUP /end SUB_GROUP /begin FUNCTION_LIST /end FUNCTION_LIST /begin REF_CHARACTERISTIC /end REF_CHARACTERISTIC /begin REF_MEASUREMENT FordMsg430BusHiSpd.FordVehOdom.Val /end REF_MEASUREMENT /end GROUP
/begin GROUP FordMsg430BusHiSpd.FordVehOdomPrev "MICROSAR RTE" /begin SUB_GROUP /end SUB_GROUP /begin FUNCTION_LIST /end FUNCTION_LIST /begin REF_CHARACTERISTIC /end REF_CHARACTERISTIC /begin REF_MEASUREMENT FordMsg430BusHiSpd.FordVehOdomPrev /end REF_MEASUREMENT /end GROUP
/begin GROUP FordMsg430BusHiSpd.MissMsgFaildRefTi "MICROSAR RTE" /begin SUB_GROUP /end SUB_GROUP /begin FUNCTION_LIST /end FUNCTION_LIST /begin REF_CHARACTERISTIC /end REF_CHARACTERISTIC /begin REF_MEASUREMENT FordMsg430BusHiSpd.MissMsgFaildRefTi /end REF_MEASUREMENT /end GROUP
/begin GROUP FordMsg430BusHiSpd.MissMsgPassdRefTi "MICROSAR RTE" /begin SUB_GROUP /end SUB_GROUP /begin FUNCTION_LIST /end FUNCTION_LIST /begin REF_CHARACTERISTIC /end REF_CHARACTERISTIC /begin REF_MEASUREMENT FordMsg430BusHiSpd.MissMsgPassdRefTi /end REF_MEASUREMENT /end GROUP
/begin GROUP FordMsg430BusHiSpd.PerInstanceMemories "MICROSAR RTE"
 /begin SUB_GROUP FordMsg430BusHiSpd.ClrDiagcFlgProxyPrev FordMsg430BusHiSpd.FordVehMsg430Miss FordMsg430BusHiSpd.FordVehMsg430Rxd FordMsg430BusHiSpd.FordVehOdomPrev FordMsg430BusHiSpd.MissMsgFaildRefTi FordMsg430BusHiSpd.MissMsgPassdRefTi /end SUB_GROUP
 /begin FUNCTION_LIST /end FUNCTION_LIST
 /begin REF_CHARACTERISTIC /end REF_CHARACTERISTIC
 /begin REF_MEASUREMENT /end REF_MEASUREMENT
/end GROUP
/begin GROUP FordMsg430BusHiSpd.ReceiverPorts "MICROSAR RTE"
 /begin SUB_GROUP FordMsg430BusHiSpd.ClrDiagcFlgProxy.Val FordMsg430BusHiSpd.FordCanDtcInhb.Val FordMsg430BusHiSpd.FordEpsLifeCycMod.Val FordMsg430BusHiSpd.FordMfgDiagcInhb.Val FordMsg430BusHiSpd.FordMissMsgDiagcInhb.Val /end SUB_GROUP
 /begin FUNCTION_LIST /end FUNCTION_LIST
 /begin REF_CHARACTERISTIC /end REF_CHARACTERISTIC
 /begin REF_MEASUREMENT /end REF_MEASUREMENT
/end GROUP
/begin GROUP FordMsg430BusHiSpd.SenderPorts "MICROSAR RTE" /begin SUB_GROUP FordMsg430BusHiSpd.FordVehOdom.Val /end SUB_GROUP /begin FUNCTION_LIST /end FUNCTION_LIST /begin REF_CHARACTERISTIC /end REF_CHARACTERISTIC /begin REF_MEASUREMENT /end REF_MEASUREMENT /end GROUP
/begin GROUP FordMsg443BusHiSpd "MICROSAR RTE"
 /begin SUB_GROUP FordMsg443BusHiSpd.CalibrationPorts FordMsg443BusHiSpd.PerInstanceMemories FordMsg443BusHiSpd.ReceiverPorts FordMsg443BusHiSpd.SenderPorts /end SUB_GROUP
 /begin FUNCTION_LIST /end FUNCTION_LIST
 /begin REF_CHARACTERISTIC /end REF_CHARACTERISTIC
 /begin REF_MEASUREMENT /end REF_MEASUREMENT
/end GROUP
/begin GROUP FordMsg443BusHiSpd.CalibrationPorts "MICROSAR RTE"
 /begin SUB_GROUP FordMsg443BusHiSpd.FordMsg443BusHiSpdMissMsgFaildThd.Val FordMsg443BusHiSpd.FordMsg443BusHiSpdMissMsgPassdThd.Val /end SUB_GROUP
 /begin FUNCTION_LIST /end FUNCTION_LIST
 /begin REF_CHARACTERISTIC /end REF_CHARACTERISTIC
 /begin REF_MEASUREMENT /end REF_MEASUREMENT
/end GROUP
/begin GROUP FordMsg443BusHiSpd.ClrDiagcFlgProxy.Val "MICROSAR RTE" /begin SUB_GROUP /end SUB_GROUP /begin FUNCTION_LIST /end FUNCTION_LIST /begin REF_CHARACTERISTIC /end REF_CHARACTERISTIC /begin REF_MEASUREMENT FordMsg443BusHiSpd.ClrDiagcFlgProxy.Val /end REF_MEASUREMENT /end GROUP
/begin GROUP FordMsg443BusHiSpd.ClrDiagcFlgProxyPrev "MICROSAR RTE" /begin SUB_GROUP /end SUB_GROUP /begin FUNCTION_LIST /end FUNCTION_LIST /begin REF_CHARACTERISTIC /end REF_CHARACTERISTIC /begin REF_MEASUREMENT FordMsg443BusHiSpd.ClrDiagcFlgProxyPrev /end REF_MEASUREMENT /end GROUP
/begin GROUP FordMsg443BusHiSpd.FordCanDtcInhb.Logl "MICROSAR RTE" /begin SUB_GROUP /end SUB_GROUP /begin FUNCTION_LIST /end FUNCTION_LIST /begin REF_CHARACTERISTIC /end REF_CHARACTERISTIC /begin REF_MEASUREMENT FordMsg443BusHiSpd.FordCanDtcInhb.Logl /end REF_MEASUREMENT /end GROUP
/begin GROUP FordMsg443BusHiSpd.FordEpsLifeCycMod.Val "MICROSAR RTE" /begin SUB_GROUP /end SUB_GROUP /begin FUNCTION_LIST /end FUNCTION_LIST /begin REF_CHARACTERISTIC /end REF_CHARACTERISTIC /begin REF_MEASUREMENT FordMsg443BusHiSpd.FordEpsLifeCycMod.Val /end REF_MEASUREMENT /end GROUP
/begin GROUP FordMsg443BusHiSpd.FordMsg443BusHiSpdMissMsgFaildThd.Val "MICROSAR RTE" /begin SUB_GROUP /end SUB_GROUP /begin FUNCTION_LIST /end FUNCTION_LIST /begin REF_CHARACTERISTIC FordMsg443BusHiSpd.FordMsg443BusHiSpdMissMsgFaildThd.Val /end REF_CHARACTERISTIC /begin REF_MEASUREMENT /end REF_MEASUREMENT /end GROUP
/begin GROUP FordMsg443BusHiSpd.FordMsg443BusHiSpdMissMsgPassdThd.Val "MICROSAR RTE" /begin SUB_GROUP /end SUB_GROUP /begin FUNCTION_LIST /end FUNCTION_LIST /begin REF_CHARACTERISTIC FordMsg443BusHiSpd.FordMsg443BusHiSpdMissMsgPassdThd.Val /end REF_CHARACTERISTIC /begin REF_MEASUREMENT /end REF_MEASUREMENT /end GROUP
/begin GROUP FordMsg443BusHiSpd.FordTrlrBackUpAssiEnad.Logl "MICROSAR RTE" /begin SUB_GROUP /end SUB_GROUP /begin FUNCTION_LIST /end FUNCTION_LIST /begin REF_CHARACTERISTIC /end REF_CHARACTERISTIC /begin REF_MEASUREMENT FordMsg443BusHiSpd.FordTrlrBackUpAssiEnad.Logl /end REF_MEASUREMENT /end GROUP
/begin GROUP FordMsg443BusHiSpd.FordVehMsg443Miss "MICROSAR RTE" /begin SUB_GROUP /end SUB_GROUP /begin FUNCTION_LIST /end FUNCTION_LIST /begin REF_CHARACTERISTIC /end REF_CHARACTERISTIC /begin REF_MEASUREMENT FordMsg443BusHiSpd.FordVehMsg443Miss /end REF_MEASUREMENT /end GROUP
/begin GROUP FordMsg443BusHiSpd.FordVehTrlrLampCnctnStsRaw.Ford_TrlrLampCnnct_B_Actl "MICROSAR RTE" /begin SUB_GROUP /end SUB_GROUP /begin FUNCTION_LIST /end FUNCTION_LIST /begin REF_CHARACTERISTIC /end REF_CHARACTERISTIC
 /begin REF_MEASUREMENT FordMsg443BusHiSpd.FordVehTrlrLampCnctnStsRaw.Ford_TrlrLampCnnct_B_Actl /end REF_MEASUREMENT
/end GROUP
/begin GROUP FordMsg443BusHiSpd.FordVehTrlrLampCnctnStsRawPrev "MICROSAR RTE" /begin SUB_GROUP /end SUB_GROUP /begin FUNCTION_LIST /end FUNCTION_LIST /begin REF_CHARACTERISTIC /end REF_CHARACTERISTIC /begin REF_MEASUREMENT FordMsg443BusHiSpd.FordVehTrlrLampCnctnStsRawPrev /end REF_MEASUREMENT /end GROUP
/begin GROUP FordMsg443BusHiSpd.MissMsgFaildRefTi "MICROSAR RTE" /begin SUB_GROUP /end SUB_GROUP /begin FUNCTION_LIST /end FUNCTION_LIST /begin REF_CHARACTERISTIC /end REF_CHARACTERISTIC /begin REF_MEASUREMENT FordMsg443BusHiSpd.MissMsgFaildRefTi /end REF_MEASUREMENT /end GROUP
/begin GROUP FordMsg443BusHiSpd.MissMsgPassdRefTi "MICROSAR RTE" /begin SUB_GROUP /end SUB_GROUP /begin FUNCTION_LIST /end FUNCTION_LIST /begin REF_CHARACTERISTIC /end REF_CHARACTERISTIC /begin REF_MEASUREMENT FordMsg443BusHiSpd.MissMsgPassdRefTi /end REF_MEASUREMENT /end GROUP
/begin GROUP FordMsg443BusHiSpd.PerInstanceMemories "MICROSAR RTE"
 /begin SUB_GROUP FordMsg443BusHiSpd.ClrDiagcFlgProxyPrev FordMsg443BusHiSpd.FordVehMsg443Miss FordMsg443BusHiSpd.FordVehTrlrLampCnctnStsRawPrev FordMsg443BusHiSpd.MissMsgFaildRefTi FordMsg443BusHiSpd.MissMsgPassdRefTi /end SUB_GROUP
 /begin FUNCTION_LIST /end FUNCTION_LIST
 /begin REF_CHARACTERISTIC /end REF_CHARACTERISTIC
 /begin REF_MEASUREMENT /end REF_MEASUREMENT
/end GROUP
/begin GROUP FordMsg443BusHiSpd.ReceiverPorts "MICROSAR RTE"
 /begin SUB_GROUP FordMsg443BusHiSpd.ClrDiagcFlgProxy.Val FordMsg443BusHiSpd.FordCanDtcInhb.Logl FordMsg443BusHiSpd.FordEpsLifeCycMod.Val FordMsg443BusHiSpd.FordTrlrBackUpAssiEnad.Logl /end SUB_GROUP
 /begin FUNCTION_LIST /end FUNCTION_LIST
 /begin REF_CHARACTERISTIC /end REF_CHARACTERISTIC
 /begin REF_MEASUREMENT /end REF_MEASUREMENT
/end GROUP
/begin GROUP FordMsg443BusHiSpd.SenderPorts "MICROSAR RTE"
 /begin SUB_GROUP FordMsg443BusHiSpd.FordVehTrlrLampCnctnStsRaw.Ford_TrlrLampCnnct_B_Actl /end SUB_GROUP
 /begin FUNCTION_LIST /end FUNCTION_LIST
 /begin REF_CHARACTERISTIC /end REF_CHARACTERISTIC
 /begin REF_MEASUREMENT /end REF_MEASUREMENT
/end GROUP
/begin GROUP FordMsg459BusHiSpd "MICROSAR RTE"
 /begin SUB_GROUP FordMsg459BusHiSpd.CalibrationPorts FordMsg459BusHiSpd.PerInstanceMemories FordMsg459BusHiSpd.ReceiverPorts FordMsg459BusHiSpd.SenderPorts /end SUB_GROUP
 /begin FUNCTION_LIST /end FUNCTION_LIST
 /begin REF_CHARACTERISTIC /end REF_CHARACTERISTIC
 /begin REF_MEASUREMENT /end REF_MEASUREMENT
/end GROUP
/begin GROUP FordMsg459BusHiSpd.CalibrationPorts "MICROSAR RTE"
 /begin SUB_GROUP FordMsg459BusHiSpd.FordMsg459BusHiSpdDiagMsgMissTmrThd.Val FordMsg459BusHiSpd.FordMsg459BusHiSpdHitchAgInvldFaildThd.Val FordMsg459BusHiSpd.FordMsg459BusHiSpdHitchAgInvldPassdThd.Val FordMsg459BusHiSpd.FordMsg459BusHiSpdHitchAgRateInvldFaildThd.Val FordMsg459BusHiSpd.FordMsg459BusHiSpdHitchAgRateInvldPassdThd.Val FordMsg459BusHiSpd.FordMsg459BusHiSpdPrsntFlgMsgMissTmrThd.Val FordMsg459BusHiSpd.FordMsg459BusHiSpdRcvrDiagMsgMissTmrThd.Val FordMsg459BusHiSpd.FordMsg459BusHiSpdRcvrPrsntFlgTmrThd.Val FordMsg459BusHiSpd.FordMsg459BusHiSpdTrackStInvldFaildThd.Val FordMsg459BusHiSpd.FordMsg459BusHiSpdTrackStInvldPassdThd.Val FordMsg459BusHiSpd.FordMsg459BusHiSpdTrlrHitchAgVldInvldMsgThd.Val FordMsg459BusHiSpd.FordMsg459BusHiSpdTrlrHitchAgVldMissMsgThd.Val FordMsg459BusHiSpd.FordMsg459BusHiSpdTrlrHitchRateVldInvldMsgThd.Val FordMsg459BusHiSpd.FordMsg459BusHiSpdTrlrHitchRateVldMissMsgThd.Val FordMsg459BusHiSpd.FordMsg459BusHiSpdTrlrRcvrHitchAgVldThd.Val FordMsg459BusHiSpd.FordMsg459BusHiSpdTrlrRcvrHitchRateVldThd.Val FordMsg459BusHiSpd.FordMsg459BusHiSpdTrlrRcvrTarVldThd.Val FordMsg459BusHiSpd.FordMsg459BusHiSpdTrlrRcvrTrackStVldThd.Val FordMsg459BusHiSpd.FordMsg459BusHiSpdTrlrTarVldMissMsgThd.Val FordMsg459BusHiSpd.FordMsg459BusHiSpdTrlrTrackStVldInvldMsgThd.Val FordMsg459BusHiSpd.FordMsg459BusHiSpdTrlrTrackStVldMissMsgThd.Val /end SUB_GROUP
 /begin FUNCTION_LIST /end FUNCTION_LIST
 /begin REF_CHARACTERISTIC /end REF_CHARACTERISTIC
 /begin REF_MEASUREMENT /end REF_MEASUREMENT
/end GROUP
/begin GROUP FordMsg459BusHiSpd.ClrDiagcFlgProxy.Val "MICROSAR RTE" /begin SUB_GROUP /end SUB_GROUP /begin FUNCTION_LIST /end FUNCTION_LIST /begin REF_CHARACTERISTIC /end REF_CHARACTERISTIC /begin REF_MEASUREMENT FordMsg459BusHiSpd.ClrDiagcFlgProxy.Val /end REF_MEASUREMENT /end GROUP
/begin GROUP FordMsg459BusHiSpd.ClrDiagcFlgProxyPrev "MICROSAR RTE" /begin SUB_GROUP /end SUB_GROUP /begin FUNCTION_LIST /end FUNCTION_LIST /begin REF_CHARACTERISTIC /end REF_CHARACTERISTIC /begin REF_MEASUREMENT FordMsg459BusHiSpd.ClrDiagcFlgProxyPrev /end REF_MEASUREMENT /end GROUP
/begin GROUP FordMsg459BusHiSpd.FirstTranVldFlg "MICROSAR RTE" /begin SUB_GROUP /end SUB_GROUP /begin FUNCTION_LIST /end FUNCTION_LIST /begin REF_CHARACTERISTIC /end REF_CHARACTERISTIC /begin REF_MEASUREMENT FordMsg459BusHiSpd.FirstTranVldFlg /end REF_MEASUREMENT /end GROUP
/begin GROUP FordMsg459BusHiSpd.FordCanDtcInhb.Logl "MICROSAR RTE" /begin SUB_GROUP /end SUB_GROUP /begin FUNCTION_LIST /end FUNCTION_LIST /begin REF_CHARACTERISTIC /end REF_CHARACTERISTIC /begin REF_MEASUREMENT FordMsg459BusHiSpd.FordCanDtcInhb.Logl /end REF_MEASUREMENT /end GROUP
/begin GROUP FordMsg459BusHiSpd.FordEpsLifeCycMod.Val "MICROSAR RTE" /begin SUB_GROUP /end SUB_GROUP /begin FUNCTION_LIST /end FUNCTION_LIST /begin REF_CHARACTERISTIC /end REF_CHARACTERISTIC /begin REF_MEASUREMENT FordMsg459BusHiSpd.FordEpsLifeCycMod.Val /end REF_MEASUREMENT /end GROUP
/begin GROUP FordMsg459BusHiSpd.FordMsg459BusHiSpdDiagMsgMissTmrThd.Val "MICROSAR RTE" /begin SUB_GROUP /end SUB_GROUP /begin FUNCTION_LIST /end FUNCTION_LIST /begin REF_CHARACTERISTIC FordMsg459BusHiSpd.FordMsg459BusHiSpdDiagMsgMissTmrThd.Val /end REF_CHARACTERISTIC /begin REF_MEASUREMENT /end REF_MEASUREMENT /end GROUP
/begin GROUP FordMsg459BusHiSpd.FordMsg459BusHiSpdHitchAgInvldFaildThd.Val "MICROSAR RTE" /begin SUB_GROUP /end SUB_GROUP /begin FUNCTION_LIST /end FUNCTION_LIST
 /begin REF_CHARACTERISTIC FordMsg459BusHiSpd.FordMsg459BusHiSpdHitchAgInvldFaildThd.Val /end REF_CHARACTERISTIC
 /begin REF_MEASUREMENT /end REF_MEASUREMENT
/end GROUP
/begin GROUP FordMsg459BusHiSpd.FordMsg459BusHiSpdHitchAgInvldPassdThd.Val "MICROSAR RTE" /begin SUB_GROUP /end SUB_GROUP /begin FUNCTION_LIST /end FUNCTION_LIST
 /begin REF_CHARACTERISTIC FordMsg459BusHiSpd.FordMsg459BusHiSpdHitchAgInvldPassdThd.Val /end REF_CHARACTERISTIC
 /begin REF_MEASUREMENT /end REF_MEASUREMENT
/end GROUP
/begin GROUP FordMsg459BusHiSpd.FordMsg459BusHiSpdHitchAgRateInvldFaildThd.Val "MICROSAR RTE" /begin SUB_GROUP /end SUB_GROUP /begin FUNCTION_LIST /end FUNCTION_LIST
 /begin REF_CHARACTERISTIC FordMsg459BusHiSpd.FordMsg459BusHiSpdHitchAgRateInvldFaildThd.Val /end REF_CHARACTERISTIC
 /begin REF_MEASUREMENT /end REF_MEASUREMENT
/end GROUP
/begin GROUP FordMsg459BusHiSpd.FordMsg459BusHiSpdHitchAgRateInvldPassdThd.Val "MICROSAR RTE" /begin SUB_GROUP /end SUB_GROUP /begin FUNCTION_LIST /end FUNCTION_LIST
 /begin REF_CHARACTERISTIC FordMsg459BusHiSpd.FordMsg459BusHiSpdHitchAgRateInvldPassdThd.Val /end REF_CHARACTERISTIC
 /begin REF_MEASUREMENT /end REF_MEASUREMENT
/end GROUP
/begin GROUP FordMsg459BusHiSpd.FordMsg459BusHiSpdPrsntFlgMsgMissTmrThd.Val "MICROSAR RTE" /begin SUB_GROUP /end SUB_GROUP /begin FUNCTION_LIST /end FUNCTION_LIST
 /begin REF_CHARACTERISTIC FordMsg459BusHiSpd.FordMsg459BusHiSpdPrsntFlgMsgMissTmrThd.Val /end REF_CHARACTERISTIC
 /begin REF_MEASUREMENT /end REF_MEASUREMENT
/end GROUP
/begin GROUP FordMsg459BusHiSpd.FordMsg459BusHiSpdRcvrDiagMsgMissTmrThd.Val "MICROSAR RTE" /begin SUB_GROUP /end SUB_GROUP /begin FUNCTION_LIST /end FUNCTION_LIST
 /begin REF_CHARACTERISTIC FordMsg459BusHiSpd.FordMsg459BusHiSpdRcvrDiagMsgMissTmrThd.Val /end REF_CHARACTERISTIC
 /begin REF_MEASUREMENT /end REF_MEASUREMENT
/end GROUP
/begin GROUP FordMsg459BusHiSpd.FordMsg459BusHiSpdRcvrPrsntFlgTmrThd.Val "MICROSAR RTE" /begin SUB_GROUP /end SUB_GROUP /begin FUNCTION_LIST /end FUNCTION_LIST
 /begin REF_CHARACTERISTIC FordMsg459BusHiSpd.FordMsg459BusHiSpdRcvrPrsntFlgTmrThd.Val /end REF_CHARACTERISTIC
 /begin REF_MEASUREMENT /end REF_MEASUREMENT
/end GROUP
/begin GROUP FordMsg459BusHiSpd.FordMsg459BusHiSpdTrackStInvldFaildThd.Val "MICROSAR RTE" /begin SUB_GROUP /end SUB_GROUP /begin FUNCTION_LIST /end FUNCTION_LIST
 /begin REF_CHARACTERISTIC FordMsg459BusHiSpd.FordMsg459BusHiSpdTrackStInvldFaildThd.Val /end REF_CHARACTERISTIC
 /begin REF_MEASUREMENT /end REF_MEASUREMENT
/end GROUP
/begin GROUP FordMsg459BusHiSpd.FordMsg459BusHiSpdTrackStInvldPassdThd.Val "MICROSAR RTE" /begin SUB_GROUP /end SUB_GROUP /begin FUNCTION_LIST /end FUNCTION_LIST
 /begin REF_CHARACTERISTIC FordMsg459BusHiSpd.FordMsg459BusHiSpdTrackStInvldPassdThd.Val /end REF_CHARACTERISTIC
 /begin REF_MEASUREMENT /end REF_MEASUREMENT
/end GROUP
/begin GROUP FordMsg459BusHiSpd.FordMsg459BusHiSpdTrlrHitchAgVldInvldMsgThd.Val "MICROSAR RTE" /begin SUB_GROUP /end SUB_GROUP /begin FUNCTION_LIST /end FUNCTION_LIST
 /begin REF_CHARACTERISTIC FordMsg459BusHiSpd.FordMsg459BusHiSpdTrlrHitchAgVldInvldMsgThd.Val /end REF_CHARACTERISTIC
 /begin REF_MEASUREMENT /end REF_MEASUREMENT
/end GROUP
/begin GROUP FordMsg459BusHiSpd.FordMsg459BusHiSpdTrlrHitchAgVldMissMsgThd.Val "MICROSAR RTE" /begin SUB_GROUP /end SUB_GROUP /begin FUNCTION_LIST /end FUNCTION_LIST
 /begin REF_CHARACTERISTIC FordMsg459BusHiSpd.FordMsg459BusHiSpdTrlrHitchAgVldMissMsgThd.Val /end REF_CHARACTERISTIC
 /begin REF_MEASUREMENT /end REF_MEASUREMENT
/end GROUP
/begin GROUP FordMsg459BusHiSpd.FordMsg459BusHiSpdTrlrHitchRateVldInvldMsgThd.Val "MICROSAR RTE" /begin SUB_GROUP /end SUB_GROUP /begin FUNCTION_LIST /end FUNCTION_LIST
 /begin REF_CHARACTERISTIC FordMsg459BusHiSpd.FordMsg459BusHiSpdTrlrHitchRateVldInvldMsgThd.Val /end REF_CHARACTERISTIC
 /begin REF_MEASUREMENT /end REF_MEASUREMENT
/end GROUP
/begin GROUP FordMsg459BusHiSpd.FordMsg459BusHiSpdTrlrHitchRateVldMissMsgThd.Val "MICROSAR RTE" /begin SUB_GROUP /end SUB_GROUP /begin FUNCTION_LIST /end FUNCTION_LIST
 /begin REF_CHARACTERISTIC FordMsg459BusHiSpd.FordMsg459BusHiSpdTrlrHitchRateVldMissMsgThd.Val /end REF_CHARACTERISTIC
 /begin REF_MEASUREMENT /end REF_MEASUREMENT
/end GROUP
/begin GROUP FordMsg459BusHiSpd.FordMsg459BusHiSpdTrlrRcvrHitchAgVldThd.Val "MICROSAR RTE" /begin SUB_GROUP /end SUB_GROUP /begin FUNCTION_LIST /end FUNCTION_LIST
 /begin REF_CHARACTERISTIC FordMsg459BusHiSpd.FordMsg459BusHiSpdTrlrRcvrHitchAgVldThd.Val /end REF_CHARACTERISTIC
 /begin REF_MEASUREMENT /end REF_MEASUREMENT
/end GROUP
/begin GROUP FordMsg459BusHiSpd.FordMsg459BusHiSpdTrlrRcvrHitchRateVldThd.Val "MICROSAR RTE" /begin SUB_GROUP /end SUB_GROUP /begin FUNCTION_LIST /end FUNCTION_LIST
 /begin REF_CHARACTERISTIC FordMsg459BusHiSpd.FordMsg459BusHiSpdTrlrRcvrHitchRateVldThd.Val /end REF_CHARACTERISTIC
 /begin REF_MEASUREMENT /end REF_MEASUREMENT
/end GROUP
/begin GROUP FordMsg459BusHiSpd.FordMsg459BusHiSpdTrlrRcvrTarVldThd.Val "MICROSAR RTE" /begin SUB_GROUP /end SUB_GROUP /begin FUNCTION_LIST /end FUNCTION_LIST /begin REF_CHARACTERISTIC FordMsg459BusHiSpd.FordMsg459BusHiSpdTrlrRcvrTarVldThd.Val /end REF_CHARACTERISTIC /begin REF_MEASUREMENT /end REF_MEASUREMENT /end GROUP
/begin GROUP FordMsg459BusHiSpd.FordMsg459BusHiSpdTrlrRcvrTrackStVldThd.Val "MICROSAR RTE" /begin SUB_GROUP /end SUB_GROUP /begin FUNCTION_LIST /end FUNCTION_LIST
 /begin REF_CHARACTERISTIC FordMsg459BusHiSpd.FordMsg459BusHiSpdTrlrRcvrTrackStVldThd.Val /end REF_CHARACTERISTIC
 /begin REF_MEASUREMENT /end REF_MEASUREMENT
/end GROUP
/begin GROUP FordMsg459BusHiSpd.FordMsg459BusHiSpdTrlrTarVldMissMsgThd.Val "MICROSAR RTE" /begin SUB_GROUP /end SUB_GROUP /begin FUNCTION_LIST /end FUNCTION_LIST
 /begin REF_CHARACTERISTIC FordMsg459BusHiSpd.FordMsg459BusHiSpdTrlrTarVldMissMsgThd.Val /end REF_CHARACTERISTIC
 /begin REF_MEASUREMENT /end REF_MEASUREMENT
/end GROUP
/begin GROUP FordMsg459BusHiSpd.FordMsg459BusHiSpdTrlrTrackStVldInvldMsgThd.Val "MICROSAR RTE" /begin SUB_GROUP /end SUB_GROUP /begin FUNCTION_LIST /end FUNCTION_LIST
 /begin REF_CHARACTERISTIC FordMsg459BusHiSpd.FordMsg459BusHiSpdTrlrTrackStVldInvldMsgThd.Val /end REF_CHARACTERISTIC
 /begin REF_MEASUREMENT /end REF_MEASUREMENT
/end GROUP
/begin GROUP FordMsg459BusHiSpd.FordMsg459BusHiSpdTrlrTrackStVldMissMsgThd.Val "MICROSAR RTE" /begin SUB_GROUP /end SUB_GROUP /begin FUNCTION_LIST /end FUNCTION_LIST
 /begin REF_CHARACTERISTIC FordMsg459BusHiSpd.FordMsg459BusHiSpdTrlrTrackStVldMissMsgThd.Val /end REF_CHARACTERISTIC
 /begin REF_MEASUREMENT /end REF_MEASUREMENT
/end GROUP
/begin GROUP FordMsg459BusHiSpd.FordTrlrBackupAssiEnad.Logl "MICROSAR RTE" /begin SUB_GROUP /end SUB_GROUP /begin FUNCTION_LIST /end FUNCTION_LIST /begin REF_CHARACTERISTIC /end REF_CHARACTERISTIC /begin REF_MEASUREMENT FordMsg459BusHiSpd.FordTrlrBackupAssiEnad.Logl /end REF_MEASUREMENT /end GROUP
/begin GROUP FordMsg459BusHiSpd.FordVehMsg459Miss "MICROSAR RTE" /begin SUB_GROUP /end SUB_GROUP /begin FUNCTION_LIST /end FUNCTION_LIST /begin REF_CHARACTERISTIC /end REF_CHARACTERISTIC /begin REF_MEASUREMENT FordMsg459BusHiSpd.FordVehMsg459Miss /end REF_MEASUREMENT /end GROUP
/begin GROUP FordMsg459BusHiSpd.FordVehMsg459MissTmr "MICROSAR RTE" /begin SUB_GROUP /end SUB_GROUP /begin FUNCTION_LIST /end FUNCTION_LIST /begin REF_CHARACTERISTIC /end REF_CHARACTERISTIC /begin REF_MEASUREMENT FordMsg459BusHiSpd.FordVehMsg459MissTmr /end REF_MEASUREMENT /end GROUP
/begin GROUP FordMsg459BusHiSpd.FordVehMsg459RxdTmr "MICROSAR RTE" /begin SUB_GROUP /end SUB_GROUP /begin FUNCTION_LIST /end FUNCTION_LIST /begin REF_CHARACTERISTIC /end REF_CHARACTERISTIC /begin REF_MEASUREMENT FordMsg459BusHiSpd.FordVehMsg459RxdTmr /end REF_MEASUREMENT /end GROUP
/begin GROUP FordMsg459BusHiSpd.FordVehTrlrAidAcqSts.Val "MICROSAR RTE" /begin SUB_GROUP /end SUB_GROUP /begin FUNCTION_LIST /end FUNCTION_LIST /begin REF_CHARACTERISTIC /end REF_CHARACTERISTIC /begin REF_MEASUREMENT FordMsg459BusHiSpd.FordVehTrlrAidAcqSts.Val /end REF_MEASUREMENT /end GROUP
/begin GROUP FordMsg459BusHiSpd.FordVehTrlrAidAcqStsPrev "MICROSAR RTE" /begin SUB_GROUP /end SUB_GROUP /begin FUNCTION_LIST /end FUNCTION_LIST /begin REF_CHARACTERISTIC /end REF_CHARACTERISTIC /begin REF_MEASUREMENT FordMsg459BusHiSpd.FordVehTrlrAidAcqStsPrev /end REF_MEASUREMENT /end GROUP
/begin GROUP FordMsg459BusHiSpd.FordVehTrlrAidGuidcRevsStsPrev "MICROSAR RTE" /begin SUB_GROUP /end SUB_GROUP /begin FUNCTION_LIST /end FUNCTION_LIST /begin REF_CHARACTERISTIC /end REF_CHARACTERISTIC /begin REF_MEASUREMENT FordMsg459BusHiSpd.FordVehTrlrAidGuidcRevsStsPrev /end REF_MEASUREMENT /end GROUP
/begin GROUP FordMsg459BusHiSpd.FordVehTrlrAidHitchAg.Val "MICROSAR RTE" /begin SUB_GROUP /end SUB_GROUP /begin FUNCTION_LIST /end FUNCTION_LIST /begin REF_CHARACTERISTIC /end REF_CHARACTERISTIC /begin REF_MEASUREMENT FordMsg459BusHiSpd.FordVehTrlrAidHitchAg.Val /end REF_MEASUREMENT /end GROUP
/begin GROUP FordMsg459BusHiSpd.FordVehTrlrAidHitchAgPrev "MICROSAR RTE" /begin SUB_GROUP /end SUB_GROUP /begin FUNCTION_LIST /end FUNCTION_LIST /begin REF_CHARACTERISTIC /end REF_CHARACTERISTIC /begin REF_MEASUREMENT FordMsg459BusHiSpd.FordVehTrlrAidHitchAgPrev /end REF_MEASUREMENT /end GROUP
/begin GROUP FordMsg459BusHiSpd.FordVehTrlrAidHitchAgRate.Val "MICROSAR RTE" /begin SUB_GROUP /end SUB_GROUP /begin FUNCTION_LIST /end FUNCTION_LIST /begin REF_CHARACTERISTIC /end REF_CHARACTERISTIC /begin REF_MEASUREMENT FordMsg459BusHiSpd.FordVehTrlrAidHitchAgRate.Val /end REF_MEASUREMENT /end GROUP
/begin GROUP FordMsg459BusHiSpd.FordVehTrlrAidHitchAgRatePrev "MICROSAR RTE" /begin SUB_GROUP /end SUB_GROUP /begin FUNCTION_LIST /end FUNCTION_LIST /begin REF_CHARACTERISTIC /end REF_CHARACTERISTIC /begin REF_MEASUREMENT FordMsg459BusHiSpd.FordVehTrlrAidHitchAgRatePrev /end REF_MEASUREMENT /end GROUP
/begin GROUP FordMsg459BusHiSpd.FordVehTrlrAidIdnVal.Val "MICROSAR RTE" /begin SUB_GROUP /end SUB_GROUP /begin FUNCTION_LIST /end FUNCTION_LIST /begin REF_CHARACTERISTIC /end REF_CHARACTERISTIC /begin REF_MEASUREMENT FordMsg459BusHiSpd.FordVehTrlrAidIdnVal.Val /end REF_MEASUREMENT /end GROUP
/begin GROUP FordMsg459BusHiSpd.FordVehTrlrAidIdnValPrev "MICROSAR RTE" /begin SUB_GROUP /end SUB_GROUP /begin FUNCTION_LIST /end FUNCTION_LIST /begin REF_CHARACTERISTIC /end REF_CHARACTERISTIC /begin REF_MEASUREMENT FordMsg459BusHiSpd.FordVehTrlrAidIdnValPrev /end REF_MEASUREMENT /end GROUP
/begin GROUP FordMsg459BusHiSpd.FordVehTrlrAidTrackStFaildTmr "MICROSAR RTE" /begin SUB_GROUP /end SUB_GROUP /begin FUNCTION_LIST /end FUNCTION_LIST /begin REF_CHARACTERISTIC /end REF_CHARACTERISTIC /begin REF_MEASUREMENT FordMsg459BusHiSpd.FordVehTrlrAidTrackStFaildTmr /end REF_MEASUREMENT /end GROUP
/begin GROUP FordMsg459BusHiSpd.FordVehTrlrAidTrackStPassdTmr "MICROSAR RTE" /begin SUB_GROUP /end SUB_GROUP /begin FUNCTION_LIST /end FUNCTION_LIST /begin REF_CHARACTERISTIC /end REF_CHARACTERISTIC /begin REF_MEASUREMENT FordMsg459BusHiSpd.FordVehTrlrAidTrackStPassdTmr /end REF_MEASUREMENT /end GROUP
/begin GROUP FordMsg459BusHiSpd.FordVehTrlrAidTrackStPrev "MICROSAR RTE" /begin SUB_GROUP /end SUB_GROUP /begin FUNCTION_LIST /end FUNCTION_LIST /begin REF_CHARACTERISTIC /end REF_CHARACTERISTIC /begin REF_MEASUREMENT FordMsg459BusHiSpd.FordVehTrlrAidTrackStPrev /end REF_MEASUREMENT /end GROUP
/begin GROUP FordMsg459BusHiSpd.FordVehTrlrAidTrakgSt.Val "MICROSAR RTE" /begin SUB_GROUP /end SUB_GROUP /begin FUNCTION_LIST /end FUNCTION_LIST /begin REF_CHARACTERISTIC /end REF_CHARACTERISTIC /begin REF_MEASUREMENT FordMsg459BusHiSpd.FordVehTrlrAidTrakgSt.Val /end REF_MEASUREMENT /end GROUP
/begin GROUP FordMsg459BusHiSpd.FordVehTrlrAidTrakgStVld.Logl "MICROSAR RTE" /begin SUB_GROUP /end SUB_GROUP /begin FUNCTION_LIST /end FUNCTION_LIST /begin REF_CHARACTERISTIC /end REF_CHARACTERISTIC /begin REF_MEASUREMENT FordMsg459BusHiSpd.FordVehTrlrAidTrakgStVld.Logl /end REF_MEASUREMENT /end GROUP
/begin GROUP FordMsg459BusHiSpd.FordVehTrlrAidTrlrRvsGuidcSts.Val "MICROSAR RTE" /begin SUB_GROUP /end SUB_GROUP /begin FUNCTION_LIST /end FUNCTION_LIST /begin REF_CHARACTERISTIC /end REF_CHARACTERISTIC /begin REF_MEASUREMENT FordMsg459BusHiSpd.FordVehTrlrAidTrlrRvsGuidcSts.Val /end REF_MEASUREMENT /end GROUP
/begin GROUP FordMsg459BusHiSpd.FordVehTrlrBallToAxle.Val "MICROSAR RTE" /begin SUB_GROUP /end SUB_GROUP /begin FUNCTION_LIST /end FUNCTION_LIST /begin REF_CHARACTERISTIC /end REF_CHARACTERISTIC /begin REF_MEASUREMENT FordMsg459BusHiSpd.FordVehTrlrBallToAxle.Val /end REF_MEASUREMENT /end GROUP
/begin GROUP FordMsg459BusHiSpd.FordVehTrlrBallToAxlePrev "MICROSAR RTE" /begin SUB_GROUP /end SUB_GROUP /begin FUNCTION_LIST /end FUNCTION_LIST /begin REF_CHARACTERISTIC /end REF_CHARACTERISTIC /begin REF_MEASUREMENT FordMsg459BusHiSpd.FordVehTrlrBallToAxlePrev /end REF_MEASUREMENT /end GROUP
/begin GROUP FordMsg459BusHiSpd.FordVehTrlrHitchAgFaildTmr "MICROSAR RTE" /begin SUB_GROUP /end SUB_GROUP /begin FUNCTION_LIST /end FUNCTION_LIST /begin REF_CHARACTERISTIC /end REF_CHARACTERISTIC /begin REF_MEASUREMENT FordMsg459BusHiSpd.FordVehTrlrHitchAgFaildTmr /end REF_MEASUREMENT /end GROUP
/begin GROUP FordMsg459BusHiSpd.FordVehTrlrHitchAgPassdTmr "MICROSAR RTE" /begin SUB_GROUP /end SUB_GROUP /begin FUNCTION_LIST /end FUNCTION_LIST /begin REF_CHARACTERISTIC /end REF_CHARACTERISTIC /begin REF_MEASUREMENT FordMsg459BusHiSpd.FordVehTrlrHitchAgPassdTmr /end REF_MEASUREMENT /end GROUP
/begin GROUP FordMsg459BusHiSpd.FordVehTrlrHitchAgRateFaildTmr "MICROSAR RTE" /begin SUB_GROUP /end SUB_GROUP /begin FUNCTION_LIST /end FUNCTION_LIST /begin REF_CHARACTERISTIC /end REF_CHARACTERISTIC /begin REF_MEASUREMENT FordMsg459BusHiSpd.FordVehTrlrHitchAgRateFaildTmr /end REF_MEASUREMENT /end GROUP
/begin GROUP FordMsg459BusHiSpd.FordVehTrlrHitchAgRatePassdTmr "MICROSAR RTE" /begin SUB_GROUP /end SUB_GROUP /begin FUNCTION_LIST /end FUNCTION_LIST /begin REF_CHARACTERISTIC /end REF_CHARACTERISTIC /begin REF_MEASUREMENT FordMsg459BusHiSpd.FordVehTrlrHitchAgRatePassdTmr /end REF_MEASUREMENT /end GROUP
/begin GROUP FordMsg459BusHiSpd.FordVehTrlrHitchAgVld.Logl "MICROSAR RTE" /begin SUB_GROUP /end SUB_GROUP /begin FUNCTION_LIST /end FUNCTION_LIST /begin REF_CHARACTERISTIC /end REF_CHARACTERISTIC /begin REF_MEASUREMENT FordMsg459BusHiSpd.FordVehTrlrHitchAgVld.Logl /end REF_MEASUREMENT /end GROUP
/begin GROUP FordMsg459BusHiSpd.FordVehTrlrHitchAgVldPrev "MICROSAR RTE" /begin SUB_GROUP /end SUB_GROUP /begin FUNCTION_LIST /end FUNCTION_LIST /begin REF_CHARACTERISTIC /end REF_CHARACTERISTIC /begin REF_MEASUREMENT FordMsg459BusHiSpd.FordVehTrlrHitchAgVldPrev /end REF_MEASUREMENT /end GROUP
/begin GROUP FordMsg459BusHiSpd.FordVehTrlrHitchRateVld.Logl "MICROSAR RTE" /begin SUB_GROUP /end SUB_GROUP /begin FUNCTION_LIST /end FUNCTION_LIST /begin REF_CHARACTERISTIC /end REF_CHARACTERISTIC /begin REF_MEASUREMENT FordMsg459BusHiSpd.FordVehTrlrHitchRateVld.Logl /end REF_MEASUREMENT /end GROUP
/begin GROUP FordMsg459BusHiSpd.FordVehTrlrHitchRateVldPrev "MICROSAR RTE" /begin SUB_GROUP /end SUB_GROUP /begin FUNCTION_LIST /end FUNCTION_LIST /begin REF_CHARACTERISTIC /end REF_CHARACTERISTIC /begin REF_MEASUREMENT FordMsg459BusHiSpd.FordVehTrlrHitchRateVldPrev /end REF_MEASUREMENT /end GROUP
/begin GROUP FordMsg459BusHiSpd.FordVehTrlrTarVld.Logl "MICROSAR RTE" /begin SUB_GROUP /end SUB_GROUP /begin FUNCTION_LIST /end FUNCTION_LIST /begin REF_CHARACTERISTIC /end REF_CHARACTERISTIC /begin REF_MEASUREMENT FordMsg459BusHiSpd.FordVehTrlrTarVld.Logl /end REF_MEASUREMENT /end GROUP
/begin GROUP FordMsg459BusHiSpd.FordVehTrlrTarVldPrev "MICROSAR RTE" /begin SUB_GROUP /end SUB_GROUP /begin FUNCTION_LIST /end FUNCTION_LIST /begin REF_CHARACTERISTIC /end REF_CHARACTERISTIC /begin REF_MEASUREMENT FordMsg459BusHiSpd.FordVehTrlrTarVldPrev /end REF_MEASUREMENT /end GROUP
/begin GROUP FordMsg459BusHiSpd.FordVehTrlrTrackStVldPrev "MICROSAR RTE" /begin SUB_GROUP /end SUB_GROUP /begin FUNCTION_LIST /end FUNCTION_LIST /begin REF_CHARACTERISTIC /end REF_CHARACTERISTIC /begin REF_MEASUREMENT FordMsg459BusHiSpd.FordVehTrlrTrackStVldPrev /end REF_MEASUREMENT /end GROUP
/begin GROUP FordMsg459BusHiSpd.PerInstanceMemories "MICROSAR RTE"
 /begin SUB_GROUP FordMsg459BusHiSpd.ClrDiagcFlgProxyPrev FordMsg459BusHiSpd.FirstTranVldFlg FordMsg459BusHiSpd.FordVehMsg459Miss FordMsg459BusHiSpd.FordVehMsg459MissTmr FordMsg459BusHiSpd.FordVehMsg459RxdTmr FordMsg459BusHiSpd.FordVehTrlrAidAcqStsPrev FordMsg459BusHiSpd.FordVehTrlrAidGuidcRevsStsPrev FordMsg459BusHiSpd.FordVehTrlrAidHitchAgPrev FordMsg459BusHiSpd.FordVehTrlrAidHitchAgRatePrev FordMsg459BusHiSpd.FordVehTrlrAidIdnValPrev FordMsg459BusHiSpd.FordVehTrlrAidTrackStFaildTmr FordMsg459BusHiSpd.FordVehTrlrAidTrackStPassdTmr FordMsg459BusHiSpd.FordVehTrlrAidTrackStPrev FordMsg459BusHiSpd.FordVehTrlrBallToAxlePrev FordMsg459BusHiSpd.FordVehTrlrHitchAgFaildTmr FordMsg459BusHiSpd.FordVehTrlrHitchAgPassdTmr FordMsg459BusHiSpd.FordVehTrlrHitchAgRateFaildTmr FordMsg459BusHiSpd.FordVehTrlrHitchAgRatePassdTmr FordMsg459BusHiSpd.FordVehTrlrHitchAgVldPrev FordMsg459BusHiSpd.FordVehTrlrHitchRateVldPrev FordMsg459BusHiSpd.FordVehTrlrTarVldPrev FordMsg459BusHiSpd.FordVehTrlrTrackStVldPrev FordMsg459BusHiSpd.TrlrAidStsThreePrsntIntPrev /end SUB_GROUP
 /begin FUNCTION_LIST /end FUNCTION_LIST
 /begin REF_CHARACTERISTIC /end REF_CHARACTERISTIC
 /begin REF_MEASUREMENT /end REF_MEASUREMENT
/end GROUP
/begin GROUP FordMsg459BusHiSpd.ReceiverPorts "MICROSAR RTE"
 /begin SUB_GROUP FordMsg459BusHiSpd.ClrDiagcFlgProxy.Val FordMsg459BusHiSpd.FordCanDtcInhb.Logl FordMsg459BusHiSpd.FordEpsLifeCycMod.Val FordMsg459BusHiSpd.FordTrlrBackupAssiEnad.Logl /end SUB_GROUP
 /begin FUNCTION_LIST /end FUNCTION_LIST
 /begin REF_CHARACTERISTIC /end REF_CHARACTERISTIC
 /begin REF_MEASUREMENT /end REF_MEASUREMENT
/end GROUP
/begin GROUP FordMsg459BusHiSpd.SenderPorts "MICROSAR RTE"
 /begin SUB_GROUP FordMsg459BusHiSpd.FordVehTrlrAidAcqSts.Val FordMsg459BusHiSpd.FordVehTrlrAidHitchAg.Val FordMsg459BusHiSpd.FordVehTrlrAidHitchAgRate.Val FordMsg459BusHiSpd.FordVehTrlrAidIdnVal.Val FordMsg459BusHiSpd.FordVehTrlrAidTrakgSt.Val FordMsg459BusHiSpd.FordVehTrlrAidTrakgStVld.Logl FordMsg459BusHiSpd.FordVehTrlrAidTrlrRvsGuidcSts.Val FordMsg459BusHiSpd.FordVehTrlrBallToAxle.Val FordMsg459BusHiSpd.FordVehTrlrHitchAgVld.Logl FordMsg459BusHiSpd.FordVehTrlrHitchRateVld.Logl FordMsg459BusHiSpd.FordVehTrlrTarVld.Logl FordMsg459BusHiSpd.TrlrAidStsThreePrsntInt.Logl /end SUB_GROUP
 /begin FUNCTION_LIST /end FUNCTION_LIST
 /begin REF_CHARACTERISTIC /end REF_CHARACTERISTIC
 /begin REF_MEASUREMENT /end REF_MEASUREMENT
/end GROUP
/begin GROUP FordMsg459BusHiSpd.TrlrAidStsThreePrsntInt.Logl "MICROSAR RTE" /begin SUB_GROUP /end SUB_GROUP /begin FUNCTION_LIST /end FUNCTION_LIST /begin REF_CHARACTERISTIC /end REF_CHARACTERISTIC /begin REF_MEASUREMENT FordMsg459BusHiSpd.TrlrAidStsThreePrsntInt.Logl /end REF_MEASUREMENT /end GROUP
/begin GROUP FordMsg459BusHiSpd.TrlrAidStsThreePrsntIntPrev "MICROSAR RTE" /begin SUB_GROUP /end SUB_GROUP /begin FUNCTION_LIST /end FUNCTION_LIST /begin REF_CHARACTERISTIC /end REF_CHARACTERISTIC /begin REF_MEASUREMENT FordMsg459BusHiSpd.TrlrAidStsThreePrsntIntPrev /end REF_MEASUREMENT /end GROUP
/begin GROUP FordMsg47ABusHiSpd "MICROSAR RTE"
 /begin SUB_GROUP FordMsg47ABusHiSpd.CalibrationPorts FordMsg47ABusHiSpd.PerInstanceMemories FordMsg47ABusHiSpd.ReceiverPorts FordMsg47ABusHiSpd.SenderPorts /end SUB_GROUP
 /begin FUNCTION_LIST /end FUNCTION_LIST
 /begin REF_CHARACTERISTIC /end REF_CHARACTERISTIC
 /begin REF_MEASUREMENT /end REF_MEASUREMENT
/end GROUP
/begin GROUP FordMsg47ABusHiSpd.CalibrationPorts "MICROSAR RTE"
 /begin SUB_GROUP FordMsg47ABusHiSpd.FordMsg47ABusHiSpdMissMsgFaildTiThd.Val FordMsg47ABusHiSpd.FordMsg47ABusHiSpdMissMsgPassdTiThd.Val FordMsg47ABusHiSpd.FordMsg47ABusHiSpdTrlrAidKnobBtnFaildTiThd.Val FordMsg47ABusHiSpd.FordMsg47ABusHiSpdTrlrAidKnobBtnInvldPassdTiThd.Val FordMsg47ABusHiSpd.FordMsg47ABusHiSpdTrlrAidKnobBtnMissTiThd.Val FordMsg47ABusHiSpd.FordMsg47ABusHiSpdTrlrAidKnobBtnPassdTiThd.Val FordMsg47ABusHiSpd.FordMsg47ABusHiSpdTrlrAidKnobPosFaildTiThd.Val FordMsg47ABusHiSpd.FordMsg47ABusHiSpdTrlrAidKnobPosInvldPassdTiThd.Val FordMsg47ABusHiSpd.FordMsg47ABusHiSpdTrlrAidKnobPosMissTiThd.Val FordMsg47ABusHiSpd.FordMsg47ABusHiSpdTrlrAidKnobPosPassdTiThd.Val /end SUB_GROUP
 /begin FUNCTION_LIST /end FUNCTION_LIST
 /begin REF_CHARACTERISTIC /end REF_CHARACTERISTIC
 /begin REF_MEASUREMENT /end REF_MEASUREMENT
/end GROUP
/begin GROUP FordMsg47ABusHiSpd.ClrDiagcFlgProxy.Val "MICROSAR RTE" /begin SUB_GROUP /end SUB_GROUP /begin FUNCTION_LIST /end FUNCTION_LIST /begin REF_CHARACTERISTIC /end REF_CHARACTERISTIC /begin REF_MEASUREMENT FordMsg47ABusHiSpd.ClrDiagcFlgProxy.Val /end REF_MEASUREMENT /end GROUP
/begin GROUP FordMsg47ABusHiSpd.ClrDiagcFlgProxyPrev "MICROSAR RTE" /begin SUB_GROUP /end SUB_GROUP /begin FUNCTION_LIST /end FUNCTION_LIST /begin REF_CHARACTERISTIC /end REF_CHARACTERISTIC /begin REF_MEASUREMENT FordMsg47ABusHiSpd.ClrDiagcFlgProxyPrev /end REF_MEASUREMENT /end GROUP
/begin GROUP FordMsg47ABusHiSpd.FirstTranTrlrAidKnobBtnVldFlg "MICROSAR RTE" /begin SUB_GROUP /end SUB_GROUP /begin FUNCTION_LIST /end FUNCTION_LIST /begin REF_CHARACTERISTIC /end REF_CHARACTERISTIC /begin REF_MEASUREMENT FordMsg47ABusHiSpd.FirstTranTrlrAidKnobBtnVldFlg /end REF_MEASUREMENT /end GROUP
/begin GROUP FordMsg47ABusHiSpd.FirstTranTrlrAidKnobPosVldFlg "MICROSAR RTE" /begin SUB_GROUP /end SUB_GROUP /begin FUNCTION_LIST /end FUNCTION_LIST /begin REF_CHARACTERISTIC /end REF_CHARACTERISTIC /begin REF_MEASUREMENT FordMsg47ABusHiSpd.FirstTranTrlrAidKnobPosVldFlg /end REF_MEASUREMENT /end GROUP
/begin GROUP FordMsg47ABusHiSpd.FordCanDtcInhb.Logl "MICROSAR RTE" /begin SUB_GROUP /end SUB_GROUP /begin FUNCTION_LIST /end FUNCTION_LIST /begin REF_CHARACTERISTIC /end REF_CHARACTERISTIC /begin REF_MEASUREMENT FordMsg47ABusHiSpd.FordCanDtcInhb.Logl /end REF_MEASUREMENT /end GROUP
/begin GROUP FordMsg47ABusHiSpd.FordEpsLifeCycMod.Val "MICROSAR RTE" /begin SUB_GROUP /end SUB_GROUP /begin FUNCTION_LIST /end FUNCTION_LIST /begin REF_CHARACTERISTIC /end REF_CHARACTERISTIC /begin REF_MEASUREMENT FordMsg47ABusHiSpd.FordEpsLifeCycMod.Val /end REF_MEASUREMENT /end GROUP
/begin GROUP FordMsg47ABusHiSpd.FordMsg47ABusHiSpdMissMsgFaildTiThd.Val "MICROSAR RTE" /begin SUB_GROUP /end SUB_GROUP /begin FUNCTION_LIST /end FUNCTION_LIST /begin REF_CHARACTERISTIC FordMsg47ABusHiSpd.FordMsg47ABusHiSpdMissMsgFaildTiThd.Val /end REF_CHARACTERISTIC /begin REF_MEASUREMENT /end REF_MEASUREMENT /end GROUP
/begin GROUP FordMsg47ABusHiSpd.FordMsg47ABusHiSpdMissMsgPassdTiThd.Val "MICROSAR RTE" /begin SUB_GROUP /end SUB_GROUP /begin FUNCTION_LIST /end FUNCTION_LIST /begin REF_CHARACTERISTIC FordMsg47ABusHiSpd.FordMsg47ABusHiSpdMissMsgPassdTiThd.Val /end REF_CHARACTERISTIC /begin REF_MEASUREMENT /end REF_MEASUREMENT /end GROUP
/begin GROUP FordMsg47ABusHiSpd.FordMsg47ABusHiSpdTrlrAidKnobBtnFaildTiThd.Val "MICROSAR RTE" /begin SUB_GROUP /end SUB_GROUP /begin FUNCTION_LIST /end FUNCTION_LIST
 /begin REF_CHARACTERISTIC FordMsg47ABusHiSpd.FordMsg47ABusHiSpdTrlrAidKnobBtnFaildTiThd.Val /end REF_CHARACTERISTIC
 /begin REF_MEASUREMENT /end REF_MEASUREMENT
/end GROUP
/begin GROUP FordMsg47ABusHiSpd.FordMsg47ABusHiSpdTrlrAidKnobBtnInvldPassdTiThd.Val "MICROSAR RTE" /begin SUB_GROUP /end SUB_GROUP /begin FUNCTION_LIST /end FUNCTION_LIST
 /begin REF_CHARACTERISTIC FordMsg47ABusHiSpd.FordMsg47ABusHiSpdTrlrAidKnobBtnInvldPassdTiThd.Val /end REF_CHARACTERISTIC
 /begin REF_MEASUREMENT /end REF_MEASUREMENT
/end GROUP
/begin GROUP FordMsg47ABusHiSpd.FordMsg47ABusHiSpdTrlrAidKnobBtnMissTiThd.Val "MICROSAR RTE" /begin SUB_GROUP /end SUB_GROUP /begin FUNCTION_LIST /end FUNCTION_LIST
 /begin REF_CHARACTERISTIC FordMsg47ABusHiSpd.FordMsg47ABusHiSpdTrlrAidKnobBtnMissTiThd.Val /end REF_CHARACTERISTIC
 /begin REF_MEASUREMENT /end REF_MEASUREMENT
/end GROUP
/begin GROUP FordMsg47ABusHiSpd.FordMsg47ABusHiSpdTrlrAidKnobBtnPassdTiThd.Val "MICROSAR RTE" /begin SUB_GROUP /end SUB_GROUP /begin FUNCTION_LIST /end FUNCTION_LIST
 /begin REF_CHARACTERISTIC FordMsg47ABusHiSpd.FordMsg47ABusHiSpdTrlrAidKnobBtnPassdTiThd.Val /end REF_CHARACTERISTIC
 /begin REF_MEASUREMENT /end REF_MEASUREMENT
/end GROUP
/begin GROUP FordMsg47ABusHiSpd.FordMsg47ABusHiSpdTrlrAidKnobPosFaildTiThd.Val "MICROSAR RTE" /begin SUB_GROUP /end SUB_GROUP /begin FUNCTION_LIST /end FUNCTION_LIST
 /begin REF_CHARACTERISTIC FordMsg47ABusHiSpd.FordMsg47ABusHiSpdTrlrAidKnobPosFaildTiThd.Val /end REF_CHARACTERISTIC
 /begin REF_MEASUREMENT /end REF_MEASUREMENT
/end GROUP
/begin GROUP FordMsg47ABusHiSpd.FordMsg47ABusHiSpdTrlrAidKnobPosInvldPassdTiThd.Val "MICROSAR RTE" /begin SUB_GROUP /end SUB_GROUP /begin FUNCTION_LIST /end FUNCTION_LIST
 /begin REF_CHARACTERISTIC FordMsg47ABusHiSpd.FordMsg47ABusHiSpdTrlrAidKnobPosInvldPassdTiThd.Val /end REF_CHARACTERISTIC
 /begin REF_MEASUREMENT /end REF_MEASUREMENT
/end GROUP
/begin GROUP FordMsg47ABusHiSpd.FordMsg47ABusHiSpdTrlrAidKnobPosMissTiThd.Val "MICROSAR RTE" /begin SUB_GROUP /end SUB_GROUP /begin FUNCTION_LIST /end FUNCTION_LIST
 /begin REF_CHARACTERISTIC FordMsg47ABusHiSpd.FordMsg47ABusHiSpdTrlrAidKnobPosMissTiThd.Val /end REF_CHARACTERISTIC
 /begin REF_MEASUREMENT /end REF_MEASUREMENT
/end GROUP
/begin GROUP FordMsg47ABusHiSpd.FordMsg47ABusHiSpdTrlrAidKnobPosPassdTiThd.Val "MICROSAR RTE" /begin SUB_GROUP /end SUB_GROUP /begin FUNCTION_LIST /end FUNCTION_LIST
 /begin REF_CHARACTERISTIC FordMsg47ABusHiSpd.FordMsg47ABusHiSpdTrlrAidKnobPosPassdTiThd.Val /end REF_CHARACTERISTIC
 /begin REF_MEASUREMENT /end REF_MEASUREMENT
/end GROUP
/begin GROUP FordMsg47ABusHiSpd.FordTrlrBackupAssiEnad.Logl "MICROSAR RTE" /begin SUB_GROUP /end SUB_GROUP /begin FUNCTION_LIST /end FUNCTION_LIST /begin REF_CHARACTERISTIC /end REF_CHARACTERISTIC /begin REF_MEASUREMENT FordMsg47ABusHiSpd.FordTrlrBackupAssiEnad.Logl /end REF_MEASUREMENT /end GROUP
/begin GROUP FordMsg47ABusHiSpd.FordVehMsg47Miss "MICROSAR RTE" /begin SUB_GROUP /end SUB_GROUP /begin FUNCTION_LIST /end FUNCTION_LIST /begin REF_CHARACTERISTIC /end REF_CHARACTERISTIC /begin REF_MEASUREMENT FordMsg47ABusHiSpd.FordVehMsg47Miss /end REF_MEASUREMENT /end GROUP
/begin GROUP FordMsg47ABusHiSpd.FordVehMsg47Rxd "MICROSAR RTE" /begin SUB_GROUP /end SUB_GROUP /begin FUNCTION_LIST /end FUNCTION_LIST /begin REF_CHARACTERISTIC /end REF_CHARACTERISTIC /begin REF_MEASUREMENT FordMsg47ABusHiSpd.FordVehMsg47Rxd /end REF_MEASUREMENT /end GROUP
/begin GROUP FordMsg47ABusHiSpd.FordVehTrlrAidKnobBtn.Val "MICROSAR RTE" /begin SUB_GROUP /end SUB_GROUP /begin FUNCTION_LIST /end FUNCTION_LIST /begin REF_CHARACTERISTIC /end REF_CHARACTERISTIC /begin REF_MEASUREMENT FordMsg47ABusHiSpd.FordVehTrlrAidKnobBtn.Val /end REF_MEASUREMENT /end GROUP
/begin GROUP FordMsg47ABusHiSpd.FordVehTrlrAidKnobBtnInvldFaildRefTi "MICROSAR RTE" /begin SUB_GROUP /end SUB_GROUP /begin FUNCTION_LIST /end FUNCTION_LIST /begin REF_CHARACTERISTIC /end REF_CHARACTERISTIC /begin REF_MEASUREMENT FordMsg47ABusHiSpd.FordVehTrlrAidKnobBtnInvldFaildRefTi /end REF_MEASUREMENT /end GROUP
/begin GROUP FordMsg47ABusHiSpd.FordVehTrlrAidKnobBtnInvldPassdRefTi "MICROSAR RTE" /begin SUB_GROUP /end SUB_GROUP /begin FUNCTION_LIST /end FUNCTION_LIST /begin REF_CHARACTERISTIC /end REF_CHARACTERISTIC /begin REF_MEASUREMENT FordMsg47ABusHiSpd.FordVehTrlrAidKnobBtnInvldPassdRefTi /end REF_MEASUREMENT /end GROUP
/begin GROUP FordMsg47ABusHiSpd.FordVehTrlrAidKnobBtnPrev "MICROSAR RTE" /begin SUB_GROUP /end SUB_GROUP /begin FUNCTION_LIST /end FUNCTION_LIST /begin REF_CHARACTERISTIC /end REF_CHARACTERISTIC /begin REF_MEASUREMENT FordMsg47ABusHiSpd.FordVehTrlrAidKnobBtnPrev /end REF_MEASUREMENT /end GROUP
/begin GROUP FordMsg47ABusHiSpd.FordVehTrlrAidKnobPosn.Val "MICROSAR RTE" /begin SUB_GROUP /end SUB_GROUP /begin FUNCTION_LIST /end FUNCTION_LIST /begin REF_CHARACTERISTIC /end REF_CHARACTERISTIC /begin REF_MEASUREMENT FordMsg47ABusHiSpd.FordVehTrlrAidKnobPosn.Val /end REF_MEASUREMENT /end GROUP
/begin GROUP FordMsg47ABusHiSpd.FordVehTrlrAidKnobPosnInvldFaildRefTi "MICROSAR RTE" /begin SUB_GROUP /end SUB_GROUP /begin FUNCTION_LIST /end FUNCTION_LIST /begin REF_CHARACTERISTIC /end REF_CHARACTERISTIC /begin REF_MEASUREMENT FordMsg47ABusHiSpd.FordVehTrlrAidKnobPosnInvldFaildRefTi /end REF_MEASUREMENT /end GROUP
/begin GROUP FordMsg47ABusHiSpd.FordVehTrlrAidKnobPosnInvldPassdRefTi "MICROSAR RTE" /begin SUB_GROUP /end SUB_GROUP /begin FUNCTION_LIST /end FUNCTION_LIST /begin REF_CHARACTERISTIC /end REF_CHARACTERISTIC /begin REF_MEASUREMENT FordMsg47ABusHiSpd.FordVehTrlrAidKnobPosnInvldPassdRefTi /end REF_MEASUREMENT /end GROUP
/begin GROUP FordMsg47ABusHiSpd.FordVehTrlrAidKnobPosnPrev "MICROSAR RTE" /begin SUB_GROUP /end SUB_GROUP /begin FUNCTION_LIST /end FUNCTION_LIST /begin REF_CHARACTERISTIC /end REF_CHARACTERISTIC /begin REF_MEASUREMENT FordMsg47ABusHiSpd.FordVehTrlrAidKnobPosnPrev /end REF_MEASUREMENT /end GROUP
/begin GROUP FordMsg47ABusHiSpd.FordVehTrlrBackupAssiKnobPosVld.Logl "MICROSAR RTE" /begin SUB_GROUP /end SUB_GROUP /begin FUNCTION_LIST /end FUNCTION_LIST /begin REF_CHARACTERISTIC /end REF_CHARACTERISTIC /begin REF_MEASUREMENT FordMsg47ABusHiSpd.FordVehTrlrBackupAssiKnobPosVld.Logl /end REF_MEASUREMENT /end GROUP
/begin GROUP FordMsg47ABusHiSpd.FordVehTrlrBackupAssiKnobVld.Logl "MICROSAR RTE" /begin SUB_GROUP /end SUB_GROUP /begin FUNCTION_LIST /end FUNCTION_LIST /begin REF_CHARACTERISTIC /end REF_CHARACTERISTIC /begin REF_MEASUREMENT FordMsg47ABusHiSpd.FordVehTrlrBackupAssiKnobVld.Logl /end REF_MEASUREMENT /end GROUP
/begin GROUP FordMsg47ABusHiSpd.MissMsgFaildRefTi "MICROSAR RTE" /begin SUB_GROUP /end SUB_GROUP /begin FUNCTION_LIST /end FUNCTION_LIST /begin REF_CHARACTERISTIC /end REF_CHARACTERISTIC /begin REF_MEASUREMENT FordMsg47ABusHiSpd.MissMsgFaildRefTi /end REF_MEASUREMENT /end GROUP
/begin GROUP FordMsg47ABusHiSpd.MissMsgPassdRefTi "MICROSAR RTE" /begin SUB_GROUP /end SUB_GROUP /begin FUNCTION_LIST /end FUNCTION_LIST /begin REF_CHARACTERISTIC /end REF_CHARACTERISTIC /begin REF_MEASUREMENT FordMsg47ABusHiSpd.MissMsgPassdRefTi /end REF_MEASUREMENT /end GROUP
/begin GROUP FordMsg47ABusHiSpd.PerInstanceMemories "MICROSAR RTE"
 /begin SUB_GROUP FordMsg47ABusHiSpd.ClrDiagcFlgProxyPrev FordMsg47ABusHiSpd.FirstTranTrlrAidKnobBtnVldFlg FordMsg47ABusHiSpd.FirstTranTrlrAidKnobPosVldFlg FordMsg47ABusHiSpd.FordVehMsg47Miss FordMsg47ABusHiSpd.FordVehMsg47Rxd FordMsg47ABusHiSpd.FordVehTrlrAidKnobBtnInvldFaildRefTi FordMsg47ABusHiSpd.FordVehTrlrAidKnobBtnInvldPassdRefTi FordMsg47ABusHiSpd.FordVehTrlrAidKnobBtnPrev FordMsg47ABusHiSpd.FordVehTrlrAidKnobPosnInvldFaildRefTi FordMsg47ABusHiSpd.FordVehTrlrAidKnobPosnInvldPassdRefTi FordMsg47ABusHiSpd.FordVehTrlrAidKnobPosnPrev FordMsg47ABusHiSpd.MissMsgFaildRefTi FordMsg47ABusHiSpd.MissMsgPassdRefTi FordMsg47ABusHiSpd.TrlrAidKnobBtnVldFaildRefTi FordMsg47ABusHiSpd.TrlrAidKnobBtnVldMissRefTi FordMsg47ABusHiSpd.TrlrAidKnobBtnVldPassdRefTi FordMsg47ABusHiSpd.TrlrAidKnobBtnVldPrev FordMsg47ABusHiSpd.TrlrAidKnobPosVldFaildRefTi FordMsg47ABusHiSpd.TrlrAidKnobPosVldMissRefTi FordMsg47ABusHiSpd.TrlrAidKnobPosVldPassdRefTi FordMsg47ABusHiSpd.TrlrAidKnobPosVldPrev /end SUB_GROUP
 /begin FUNCTION_LIST /end FUNCTION_LIST
 /begin REF_CHARACTERISTIC /end REF_CHARACTERISTIC
 /begin REF_MEASUREMENT /end REF_MEASUREMENT
/end GROUP
/begin GROUP FordMsg47ABusHiSpd.ReceiverPorts "MICROSAR RTE"
 /begin SUB_GROUP FordMsg47ABusHiSpd.ClrDiagcFlgProxy.Val FordMsg47ABusHiSpd.FordCanDtcInhb.Logl FordMsg47ABusHiSpd.FordEpsLifeCycMod.Val FordMsg47ABusHiSpd.FordTrlrBackupAssiEnad.Logl /end SUB_GROUP
 /begin FUNCTION_LIST /end FUNCTION_LIST
 /begin REF_CHARACTERISTIC /end REF_CHARACTERISTIC
 /begin REF_MEASUREMENT /end REF_MEASUREMENT
/end GROUP
/begin GROUP FordMsg47ABusHiSpd.SenderPorts "MICROSAR RTE"
 /begin SUB_GROUP FordMsg47ABusHiSpd.FordVehTrlrAidKnobBtn.Val FordMsg47ABusHiSpd.FordVehTrlrAidKnobPosn.Val FordMsg47ABusHiSpd.FordVehTrlrBackupAssiKnobPosVld.Logl FordMsg47ABusHiSpd.FordVehTrlrBackupAssiKnobVld.Logl /end SUB_GROUP
 /begin FUNCTION_LIST /end FUNCTION_LIST
 /begin REF_CHARACTERISTIC /end REF_CHARACTERISTIC
 /begin REF_MEASUREMENT /end REF_MEASUREMENT
/end GROUP
/begin GROUP FordMsg47ABusHiSpd.TrlrAidKnobBtnVldFaildRefTi "MICROSAR RTE" /begin SUB_GROUP /end SUB_GROUP /begin FUNCTION_LIST /end FUNCTION_LIST /begin REF_CHARACTERISTIC /end REF_CHARACTERISTIC /begin REF_MEASUREMENT FordMsg47ABusHiSpd.TrlrAidKnobBtnVldFaildRefTi /end REF_MEASUREMENT /end GROUP
/begin GROUP FordMsg47ABusHiSpd.TrlrAidKnobBtnVldMissRefTi "MICROSAR RTE" /begin SUB_GROUP /end SUB_GROUP /begin FUNCTION_LIST /end FUNCTION_LIST /begin REF_CHARACTERISTIC /end REF_CHARACTERISTIC /begin REF_MEASUREMENT FordMsg47ABusHiSpd.TrlrAidKnobBtnVldMissRefTi /end REF_MEASUREMENT /end GROUP
/begin GROUP FordMsg47ABusHiSpd.TrlrAidKnobBtnVldPassdRefTi "MICROSAR RTE" /begin SUB_GROUP /end SUB_GROUP /begin FUNCTION_LIST /end FUNCTION_LIST /begin REF_CHARACTERISTIC /end REF_CHARACTERISTIC /begin REF_MEASUREMENT FordMsg47ABusHiSpd.TrlrAidKnobBtnVldPassdRefTi /end REF_MEASUREMENT /end GROUP
/begin GROUP FordMsg47ABusHiSpd.TrlrAidKnobBtnVldPrev "MICROSAR RTE" /begin SUB_GROUP /end SUB_GROUP /begin FUNCTION_LIST /end FUNCTION_LIST /begin REF_CHARACTERISTIC /end REF_CHARACTERISTIC /begin REF_MEASUREMENT FordMsg47ABusHiSpd.TrlrAidKnobBtnVldPrev /end REF_MEASUREMENT /end GROUP
/begin GROUP FordMsg47ABusHiSpd.TrlrAidKnobPosVldFaildRefTi "MICROSAR RTE" /begin SUB_GROUP /end SUB_GROUP /begin FUNCTION_LIST /end FUNCTION_LIST /begin REF_CHARACTERISTIC /end REF_CHARACTERISTIC /begin REF_MEASUREMENT FordMsg47ABusHiSpd.TrlrAidKnobPosVldFaildRefTi /end REF_MEASUREMENT /end GROUP
/begin GROUP FordMsg47ABusHiSpd.TrlrAidKnobPosVldMissRefTi "MICROSAR RTE" /begin SUB_GROUP /end SUB_GROUP /begin FUNCTION_LIST /end FUNCTION_LIST /begin REF_CHARACTERISTIC /end REF_CHARACTERISTIC /begin REF_MEASUREMENT FordMsg47ABusHiSpd.TrlrAidKnobPosVldMissRefTi /end REF_MEASUREMENT /end GROUP
/begin GROUP FordMsg47ABusHiSpd.TrlrAidKnobPosVldPassdRefTi "MICROSAR RTE" /begin SUB_GROUP /end SUB_GROUP /begin FUNCTION_LIST /end FUNCTION_LIST /begin REF_CHARACTERISTIC /end REF_CHARACTERISTIC /begin REF_MEASUREMENT FordMsg47ABusHiSpd.TrlrAidKnobPosVldPassdRefTi /end REF_MEASUREMENT /end GROUP
/begin GROUP FordMsg47ABusHiSpd.TrlrAidKnobPosVldPrev "MICROSAR RTE" /begin SUB_GROUP /end SUB_GROUP /begin FUNCTION_LIST /end FUNCTION_LIST /begin REF_CHARACTERISTIC /end REF_CHARACTERISTIC /begin REF_MEASUREMENT FordMsg47ABusHiSpd.TrlrAidKnobPosVldPrev /end REF_MEASUREMENT /end GROUP
/begin GROUP FordMsg4B0BusHiSpd "MICROSAR RTE"
 /begin SUB_GROUP FordMsg4B0BusHiSpd.CalibrationPorts FordMsg4B0BusHiSpd.PerInstanceMemories FordMsg4B0BusHiSpd.ReceiverPorts FordMsg4B0BusHiSpd.SenderPorts /end SUB_GROUP
 /begin FUNCTION_LIST /end FUNCTION_LIST
 /begin REF_CHARACTERISTIC /end REF_CHARACTERISTIC
 /begin REF_MEASUREMENT /end REF_MEASUREMENT
/end GROUP
/begin GROUP FordMsg4B0BusHiSpd.CalibrationPorts "MICROSAR RTE"
 /begin SUB_GROUP FordMsg4B0BusHiSpd.FordMsg4B0BusHiSpdCanDtcInhbTiThd.Val FordMsg4B0BusHiSpd.FordMsg4B0BusHiSpdMsgFltNtcDiagcTiThd.Val FordMsg4B0BusHiSpd.FordMsg4B0BusHiSpdMsgFltTiThd.Val FordMsg4B0BusHiSpd.FordMsg4B0BusHiSpdMsgMissNtcDiagcTiThd.Val FordMsg4B0BusHiSpd.FordMsg4B0BusHiSpdMsgMissTiThd.Val FordMsg4B0BusHiSpd.FordMsg4B0BusHiSpdMsgRxdNtcDiagcTiThd.Val FordMsg4B0BusHiSpd.FordMsg4B0BusHiSpdMsgVldNtcDiagcTiThd.Val FordMsg4B0BusHiSpd.FordMsg4B0BusHiSpdMsgVldTiThd.Val /end SUB_GROUP
 /begin FUNCTION_LIST /end FUNCTION_LIST
 /begin REF_CHARACTERISTIC /end REF_CHARACTERISTIC
 /begin REF_MEASUREMENT /end REF_MEASUREMENT
/end GROUP
/begin GROUP FordMsg4B0BusHiSpd.CanDtcInhbRefTi "MICROSAR RTE" /begin SUB_GROUP /end SUB_GROUP /begin FUNCTION_LIST /end FUNCTION_LIST /begin REF_CHARACTERISTIC /end REF_CHARACTERISTIC /begin REF_MEASUREMENT FordMsg4B0BusHiSpd.CanDtcInhbRefTi /end REF_MEASUREMENT /end GROUP
/begin GROUP FordMsg4B0BusHiSpd.ClrDiagcFlgProxy.Val "MICROSAR RTE" /begin SUB_GROUP /end SUB_GROUP /begin FUNCTION_LIST /end FUNCTION_LIST /begin REF_CHARACTERISTIC /end REF_CHARACTERISTIC /begin REF_MEASUREMENT FordMsg4B0BusHiSpd.ClrDiagcFlgProxy.Val /end REF_MEASUREMENT /end GROUP
/begin GROUP FordMsg4B0BusHiSpd.ClrDiagcFlgProxyPrev "MICROSAR RTE" /begin SUB_GROUP /end SUB_GROUP /begin FUNCTION_LIST /end FUNCTION_LIST /begin REF_CHARACTERISTIC /end REF_CHARACTERISTIC /begin REF_MEASUREMENT FordMsg4B0BusHiSpd.ClrDiagcFlgProxyPrev /end REF_MEASUREMENT /end GROUP
/begin GROUP FordMsg4B0BusHiSpd.FordBrkOscnRednEnad.Logl "MICROSAR RTE" /begin SUB_GROUP /end SUB_GROUP /begin FUNCTION_LIST /end FUNCTION_LIST /begin REF_CHARACTERISTIC /end REF_CHARACTERISTIC /begin REF_MEASUREMENT FordMsg4B0BusHiSpd.FordBrkOscnRednEnad.Logl /end REF_MEASUREMENT /end GROUP
/begin GROUP FordMsg4B0BusHiSpd.FordCanDtcInhb.Logl "MICROSAR RTE" /begin SUB_GROUP /end SUB_GROUP /begin FUNCTION_LIST /end FUNCTION_LIST /begin REF_CHARACTERISTIC /end REF_CHARACTERISTIC /begin REF_MEASUREMENT FordMsg4B0BusHiSpd.FordCanDtcInhb.Logl /end REF_MEASUREMENT /end GROUP
/begin GROUP FordMsg4B0BusHiSpd.FordEpsLifeCycMod.Val "MICROSAR RTE" /begin SUB_GROUP /end SUB_GROUP /begin FUNCTION_LIST /end FUNCTION_LIST /begin REF_CHARACTERISTIC /end REF_CHARACTERISTIC /begin REF_MEASUREMENT FordMsg4B0BusHiSpd.FordEpsLifeCycMod.Val /end REF_MEASUREMENT /end GROUP
/begin GROUP FordMsg4B0BusHiSpd.FordEvasSteerAssiEnad.Logl "MICROSAR RTE" /begin SUB_GROUP /end SUB_GROUP /begin FUNCTION_LIST /end FUNCTION_LIST /begin REF_CHARACTERISTIC /end REF_CHARACTERISTIC /begin REF_MEASUREMENT FordMsg4B0BusHiSpd.FordEvasSteerAssiEnad.Logl /end REF_MEASUREMENT /end GROUP
/begin GROUP FordMsg4B0BusHiSpd.FordLaneCentrAssiEnad.Logl "MICROSAR RTE" /begin SUB_GROUP /end SUB_GROUP /begin FUNCTION_LIST /end FUNCTION_LIST /begin REF_CHARACTERISTIC /end REF_CHARACTERISTIC /begin REF_MEASUREMENT FordMsg4B0BusHiSpd.FordLaneCentrAssiEnad.Logl /end REF_MEASUREMENT /end GROUP
/begin GROUP FordMsg4B0BusHiSpd.FordMsg4B0BusHiSpdCanDtcInhbTiThd.Val "MICROSAR RTE" /begin SUB_GROUP /end SUB_GROUP /begin FUNCTION_LIST /end FUNCTION_LIST /begin REF_CHARACTERISTIC FordMsg4B0BusHiSpd.FordMsg4B0BusHiSpdCanDtcInhbTiThd.Val /end REF_CHARACTERISTIC /begin REF_MEASUREMENT /end REF_MEASUREMENT /end GROUP
/begin GROUP FordMsg4B0BusHiSpd.FordMsg4B0BusHiSpdMsgFltNtcDiagcTiThd.Val "MICROSAR RTE" /begin SUB_GROUP /end SUB_GROUP /begin FUNCTION_LIST /end FUNCTION_LIST
 /begin REF_CHARACTERISTIC FordMsg4B0BusHiSpd.FordMsg4B0BusHiSpdMsgFltNtcDiagcTiThd.Val /end REF_CHARACTERISTIC
 /begin REF_MEASUREMENT /end REF_MEASUREMENT
/end GROUP
/begin GROUP FordMsg4B0BusHiSpd.FordMsg4B0BusHiSpdMsgFltTiThd.Val "MICROSAR RTE" /begin SUB_GROUP /end SUB_GROUP /begin FUNCTION_LIST /end FUNCTION_LIST /begin REF_CHARACTERISTIC FordMsg4B0BusHiSpd.FordMsg4B0BusHiSpdMsgFltTiThd.Val /end REF_CHARACTERISTIC /begin REF_MEASUREMENT /end REF_MEASUREMENT /end GROUP
/begin GROUP FordMsg4B0BusHiSpd.FordMsg4B0BusHiSpdMsgMissNtcDiagcTiThd.Val "MICROSAR RTE" /begin SUB_GROUP /end SUB_GROUP /begin FUNCTION_LIST /end FUNCTION_LIST
 /begin REF_CHARACTERISTIC FordMsg4B0BusHiSpd.FordMsg4B0BusHiSpdMsgMissNtcDiagcTiThd.Val /end REF_CHARACTERISTIC
 /begin REF_MEASUREMENT /end REF_MEASUREMENT
/end GROUP
/begin GROUP FordMsg4B0BusHiSpd.FordMsg4B0BusHiSpdMsgMissTiThd.Val "MICROSAR RTE" /begin SUB_GROUP /end SUB_GROUP /begin FUNCTION_LIST /end FUNCTION_LIST /begin REF_CHARACTERISTIC FordMsg4B0BusHiSpd.FordMsg4B0BusHiSpdMsgMissTiThd.Val /end REF_CHARACTERISTIC /begin REF_MEASUREMENT /end REF_MEASUREMENT /end GROUP
/begin GROUP FordMsg4B0BusHiSpd.FordMsg4B0BusHiSpdMsgRxdNtcDiagcTiThd.Val "MICROSAR RTE" /begin SUB_GROUP /end SUB_GROUP /begin FUNCTION_LIST /end FUNCTION_LIST
 /begin REF_CHARACTERISTIC FordMsg4B0BusHiSpd.FordMsg4B0BusHiSpdMsgRxdNtcDiagcTiThd.Val /end REF_CHARACTERISTIC
 /begin REF_MEASUREMENT /end REF_MEASUREMENT
/end GROUP
/begin GROUP FordMsg4B0BusHiSpd.FordMsg4B0BusHiSpdMsgVldNtcDiagcTiThd.Val "MICROSAR RTE" /begin SUB_GROUP /end SUB_GROUP /begin FUNCTION_LIST /end FUNCTION_LIST
 /begin REF_CHARACTERISTIC FordMsg4B0BusHiSpd.FordMsg4B0BusHiSpdMsgVldNtcDiagcTiThd.Val /end REF_CHARACTERISTIC
 /begin REF_MEASUREMENT /end REF_MEASUREMENT
/end GROUP
/begin GROUP FordMsg4B0BusHiSpd.FordMsg4B0BusHiSpdMsgVldTiThd.Val "MICROSAR RTE" /begin SUB_GROUP /end SUB_GROUP /begin FUNCTION_LIST /end FUNCTION_LIST /begin REF_CHARACTERISTIC FordMsg4B0BusHiSpd.FordMsg4B0BusHiSpdMsgVldTiThd.Val /end REF_CHARACTERISTIC /begin REF_MEASUREMENT /end REF_MEASUREMENT /end GROUP
/begin GROUP FordMsg4B0BusHiSpd.FordMsg4B0Miss "MICROSAR RTE" /begin SUB_GROUP /end SUB_GROUP /begin FUNCTION_LIST /end FUNCTION_LIST /begin REF_CHARACTERISTIC /end REF_CHARACTERISTIC /begin REF_MEASUREMENT FordMsg4B0BusHiSpd.FordMsg4B0Miss /end REF_MEASUREMENT /end GROUP
/begin GROUP FordMsg4B0BusHiSpd.FordTqSteerCmpEnad.Logl "MICROSAR RTE" /begin SUB_GROUP /end SUB_GROUP /begin FUNCTION_LIST /end FUNCTION_LIST /begin REF_CHARACTERISTIC /end REF_CHARACTERISTIC /begin REF_MEASUREMENT FordMsg4B0BusHiSpd.FordTqSteerCmpEnad.Logl /end REF_MEASUREMENT /end GROUP
/begin GROUP FordMsg4B0BusHiSpd.FordVehYawStabyRaw.Val "MICROSAR RTE" /begin SUB_GROUP /end SUB_GROUP /begin FUNCTION_LIST /end FUNCTION_LIST /begin REF_CHARACTERISTIC /end REF_CHARACTERISTIC /begin REF_MEASUREMENT FordMsg4B0BusHiSpd.FordVehYawStabyRaw.Val /end REF_MEASUREMENT /end GROUP
/begin GROUP FordMsg4B0BusHiSpd.FordVehYawStabyRawPrev "MICROSAR RTE" /begin SUB_GROUP /end SUB_GROUP /begin FUNCTION_LIST /end FUNCTION_LIST /begin REF_CHARACTERISTIC /end REF_CHARACTERISTIC /begin REF_MEASUREMENT FordMsg4B0BusHiSpd.FordVehYawStabyRawPrev /end REF_MEASUREMENT /end GROUP
/begin GROUP FordMsg4B0BusHiSpd.FordVehYawStabyVld.Logl "MICROSAR RTE" /begin SUB_GROUP /end SUB_GROUP /begin FUNCTION_LIST /end FUNCTION_LIST /begin REF_CHARACTERISTIC /end REF_CHARACTERISTIC /begin REF_MEASUREMENT FordMsg4B0BusHiSpd.FordVehYawStabyVld.Logl /end REF_MEASUREMENT /end GROUP
/begin GROUP FordMsg4B0BusHiSpd.FordVehYawStabyVldPrev "MICROSAR RTE" /begin SUB_GROUP /end SUB_GROUP /begin FUNCTION_LIST /end FUNCTION_LIST /begin REF_CHARACTERISTIC /end REF_CHARACTERISTIC /begin REF_MEASUREMENT FordMsg4B0BusHiSpd.FordVehYawStabyVldPrev /end REF_MEASUREMENT /end GROUP
/begin GROUP FordMsg4B0BusHiSpd.IniVehYawStabyInvld "MICROSAR RTE" /begin SUB_GROUP /end SUB_GROUP /begin FUNCTION_LIST /end FUNCTION_LIST /begin REF_CHARACTERISTIC /end REF_CHARACTERISTIC /begin REF_MEASUREMENT FordMsg4B0BusHiSpd.IniVehYawStabyInvld /end REF_MEASUREMENT /end GROUP
/begin GROUP FordMsg4B0BusHiSpd.LaneDetnWarnEnad.Logl "MICROSAR RTE" /begin SUB_GROUP /end SUB_GROUP /begin FUNCTION_LIST /end FUNCTION_LIST /begin REF_CHARACTERISTIC /end REF_CHARACTERISTIC /begin REF_MEASUREMENT FordMsg4B0BusHiSpd.LaneDetnWarnEnad.Logl /end REF_MEASUREMENT /end GROUP
/begin RECORD_LAYOUT RTE_RL_UWORD FNC_VALUES 1 UWORD ROW_DIR DIRECT /end RECORD_LAYOUT
/**********************************************************************************************************************
* COMPU_METHOD / COMPU_VTAB_RANGE
*********************************************************************************************************************/
/begin COMPU_METHOD RTE_CM_BOOLEAN "" TAB_VERB "%3.1" "" COMPU_TAB_REF RTE_CM_BOOLEAN /end COMPU_METHOD
/begin COMPU_VTAB_RANGE RTE_CM_BOOLEAN "" 2 0 0 "false" 1 255 "true" /end COMPU_VTAB_RANGE
/begin COMPU_METHOD RTE_CM_ENUM_Ford_LatCtlLim_D_Stat "" TAB_VERB "%.1" "" COMPU_TAB_REF RTE_CM_ENUM_Ford_LatCtlLim_D_Stat /end COMPU_METHOD
/begin COMPU_VTAB_RANGE RTE_CM_ENUM_Ford_LatCtlLim_D_Stat "" 5 0 3 "RANGE" 0 0 "Cx0_LimitNotReached" 1 1 "Cx1_LimitClose" 2 2 "Cx2_LimitReached" 3 3 "Cx3_LimitWithDriverActive" /end COMPU_VTAB_RANGE
/begin COMPU_METHOD RTE_CM_ENUM_Ford_LatCtlSte_D_Stat "" TAB_VERB "%.1" "" COMPU_TAB_REF RTE_CM_ENUM_Ford_LatCtlSte_D_Stat /end COMPU_METHOD
/begin COMPU_VTAB_RANGE RTE_CM_ENUM_Ford_LatCtlSte_D_Stat "" 9 0 7 "RANGE" 0 0 "Cx0_Unavailable" 1 1 "Cx1_Available" 2 2 "Cx2_ContLatControlInProgress" 3 3 "Cx3_RampOut" 4 4 "Cx4_Denied" 5 5 "Cx5_NotUsed1" 6 6 "Cx6_NotUsed2" 7 7 "Cx7_NotUsed3" /end COMPU_VTAB_RANGE
/begin COMPU_METHOD RTE_CM_ENUM_Ford_LsmcBrkDecel_D_Stat "" TAB_VERB "%.1" "" COMPU_TAB_REF RTE_CM_ENUM_Ford_LsmcBrkDecel_D_Stat /end COMPU_METHOD
/begin COMPU_VTAB_RANGE RTE_CM_ENUM_Ford_LsmcBrkDecel_D_Stat "" 9 0 7 "RANGE" 0 0 "Cx0_Off" 1 1 "Cx1_On" 2 2 "Cx2_FaultExt" 3 3 "Cx3_FaultDegraded" 4 4 "Cx4_Denied" 5 5 "Cx5_NotUsed_1" 6 6 "Cx6_NotUsed_2" 7 7 "Cx7_NotUsed_3" /end COMPU_VTAB_RANGE
/begin COMPU_METHOD RTE_CM_ENUM_Ford_VehVActlBrk_D_Qf "" TAB_VERB "%.1" "" COMPU_TAB_REF RTE_CM_ENUM_Ford_VehVActlBrk_D_Qf /end COMPU_METHOD
/begin COMPU_VTAB_RANGE RTE_CM_ENUM_Ford_VehVActlBrk_D_Qf "" 5 0 3 "RANGE" 0 0 "Cx0_Faulty" 1 1 "Cx1_No_Data_Exists" 2 2 "Cx2_Not_Within_Specifications" 3 3 "Cx3_OK" /end COMPU_VTAB_RANGE
/begin COMPU_METHOD RTE_CM_ENUM_Ford_SelDrvMdeSte_D_Stat "" TAB_VERB "%.1" "" COMPU_TAB_REF RTE_CM_ENUM_Ford_SelDrvMdeSte_D_Stat /end COMPU_METHOD
/begin COMPU_VTAB_RANGE RTE_CM_ENUM_Ford_SelDrvMdeSte_D_Stat "" 5 0 3 "RANGE" 0 0 "Cx0_NotAvailable" 1 1 "Cx1_Available" 2 2 "Cx2_TemporarilyNotAvailable" 3 3 "Cx3_Faulty" /end COMPU_VTAB_RANGE
/begin COMPU_METHOD RTE_CM_ENUM_Ford_TrlrAidEnbl_D2_Stat "" TAB_VERB "%.1" "" COMPU_TAB_REF RTE_CM_ENUM_Ford_TrlrAidEnbl_D2_Stat /end COMPU_METHOD
/begin COMPU_VTAB_RANGE RTE_CM_ENUM_Ford_TrlrAidEnbl_D2_Stat "" 9 0 7 "RANGE" 0 0 "Cx0_Inactive" 1 1 "Cx1_TbaActive" 2 2 "Cx2_TbaSetup" 3 3 "Cx3_TbaOffTrgSetup" 4 4 "Cx4_TbaOffTrgActive" 5 5 "Cx5_TbaActiveExpertAvail" 6 6 "Cx6_TbaActiveExpertActive" 7 7 "Cx7_NotUsed_1" /end COMPU_VTAB_RANGE
/begin COMPU_METHOD RTE_CM_ENUM_Ford_TrlrAidMsgTxt_D2_Rq "" TAB_VERB "%.1" "" COMPU_TAB_REF RTE_CM_ENUM_Ford_TrlrAidMsgTxt_D2_Rq /end COMPU_METHOD
/begin COMPU_VTAB_RANGE RTE_CM_ENUM_Ford_TrlrAidMsgTxt_D2_Rq "" 42 0 63 "RANGE" 0 0 "Cx00_NoMessage" 1 1 "Cx01_Message1" 2 2 "Cx02_Message2" 3 3 "Cx03_Message3" 4 4 "Cx04_Message4" 5 5 "Cx05_Message5" 6 6 "Cx06_Message6" 7 7 "Cx07_Message7" 8 8 "Cx08_Message8" 9 9 "Cx09_Message9" 10 10 "Cx0A_Message10" 11 11 "Cx0B_Message11" 12 12 "Cx0C_Message12" 13 13 "Cx0D_Message13" 14 14 "Cx0E_Message14" 15 15 "Cx0F_Message15" 16 16 "Cx10_Message16" 17 17 "Cx11_Message17" 18 18 "Cx12_Message18" 19 19 "Cx13_Message19" 20 20 "Cx14_Message20" 21 21 "Cx15_Message21" 22 22 "Cx16_Message22" 23 23 "Cx17_Message23" 24 24 "Cx18_Message24" 25 25 "Cx19_Message25" 26 26 "Cx1A_Message26" 27 27 "Cx1B_Message27" 28 28 "Cx1C_Message28" 29 29 "Cx1D_Message29" 30 30 "Cx1E_Message30" 31 31 "Cx1F_Message31" 35 35 "Cx23_Message35" 40 40 "Cx28_Message40" 45 45 "Cx2D_Message45" 50 50 "Cx32_Message50" 55 55 "Cx37_Message55" 60 60 "Cx3C_Message60" 61 61 "Cx3D_Message61" 62 62 "Cx3E_Message62" 63 63 "Cx3F_Message63" /end COMPU_VTAB_RANGE
/begin COMPU_METHOD RTE_CM_ENUM_Ford_SelDrvMdeChassis2_D_Rq "" TAB_VERB "%.1" "" COMPU_TAB_REF RTE_CM_ENUM_Ford_SelDrvMdeChassis2_D_Rq /end COMPU_METHOD
/begin COMPU_VTAB_RANGE RTE_CM_ENUM_Ford_SelDrvMdeChassis2_D_Rq "" 33 0 31 "RANGE" 0 0 "Cx00_NormalMode" 1 1 "Cx01_NormalAdaptiveMode" 2 2 "Cx02_EconomyMode" 3 3 "Cx03_SportMode" 4 4 "Cx04_SportAdaptiveMode" 5 5 "Cx05_ComfortMode" 6 6 "Cx06_ComfortAdaptiveMode" 7 7 "Cx07_LowMuMode" 8 8 "Cx08_MudAndRutsMode" 9 9 "Cx09_SandMode" 10 10 "Cx0A_RockCrawlMode" 11 11 "Cx0B_TowHaulMode" 12 12 "Cx0C_HighSpeedDesertMode" 13 13 "Cx0D_TrackMode" 14 14 "Cx0E_RoughRoadMode" 15 15 "Cx0F_NotUsed2" 16 16 "Cx10_NotUsed3" 17 17 "Cx11_NotUsed4" 18 18 "Cx12_NotUsed5" 19 19 "Cx13_NotUsed6" 20 20 "Cx14_NotUsed7" 21 21 "Cx15_NotUsed8" 22 22 "Cx16_NotUsed9" 23 23 "Cx17_NotUsed10" 24 24 "Cx18_NotUsed11" 25 25 "Cx19_NotUsed12" 26 26 "Cx1A_NotUsed13" 27 27 "Cx1B_NotUsed14" 28 28 "Cx1C_NotUsed15" 29 29 "Cx1D_NotUsed16" 30 30 "Cx1E_NotUsed17" 31 31 "Cx1F_Faulty" /end COMPU_VTAB_RANGE
/begin COMPU_METHOD RTE_CM_ENUM_Ford_TrlrAidSwtch_D_RqDrv "" TAB_VERB "%.1" "" COMPU_TAB_REF RTE_CM_ENUM_Ford_TrlrAidSwtch_D_RqDrv /end COMPU_METHOD
/begin COMPU_VTAB_RANGE RTE_CM_ENUM_Ford_TrlrAidSwtch_D_RqDrv "" 5 0 3 "RANGE" 0 0 "Cx0_Not_Pressed" 1 1 "Cx1_Pressed" 2 2 "Cx2_NotUsed" 3 3 "Cx3_Faulty" /end COMPU_VTAB_RANGE
