/begin CHARACTERISTIC DutyCycThermProtn.DutyCycThermProtnAbsltCtrlTFetMtgtnTblX.Ary1D "MICROSAR RTE" VAL_BLK 0x0 RTE_RL_SWORD 0 NO_COMPU_METHOD -32768 32767 MATRIX_DIM 4 1 1 SYMBOL_LINK "Rte_CalprmRom_CalRegn01Cmn_DEFAULT_RTE_CALPRM_GROUP.DutyCycThermProtnAbsltCtrlTFetMtgtnTblX_Ary1D" 0 DISPLAY_IDENTIFIER DutyCycThermProtn.CalibrationPorts.DutyCycThermProtnAbsltCtrlTFetMtgtnTblX.Ary1D /end CHARACTERISTIC
/begin CHARACTERISTIC DutyCycThermProtn.DutyCycThermProtnAbsltCtrlTTblX.Ary1D "MICROSAR RTE" VAL_BLK 0x0 RTE_RL_SWORD 0 NO_COMPU_METHOD -32768 32767 MATRIX_DIM 4 1 1 SYMBOL_LINK "Rte_CalprmRom_CalRegn01Cmn_DEFAULT_RTE_CALPRM_GROUP.DutyCycThermProtnAbsltCtrlTTblX_Ary1D" 0 DISPLAY_IDENTIFIER DutyCycThermProtn.CalibrationPorts.DutyCycThermProtnAbsltCtrlTTblX.Ary1D /end CHARACTERISTIC
/begin CHARACTERISTIC DutyCycThermProtn.DutyCycThermProtnAbsltCtrlTTqFetMtgtnTblY.Ary1D "MICROSAR RTE" VAL_BLK 0x0 RTE_RL_UWORD 0 NO_COMPU_METHOD 0 65535 MATRIX_DIM 4 1 1 SYMBOL_LINK "Rte_CalprmRom_CalRegn01Cmn_DEFAULT_RTE_CALPRM_GROUP.DutyCycThermProtnAbsltCtrlTTqFetMtgtnTblY_Ary1D" 0 DISPLAY_IDENTIFIER DutyCycThermProtn.CalibrationPorts.DutyCycThermProtnAbsltCtrlTTqFetMtgtnTblY.Ary1D /end CHARACTERISTIC
/begin CHARACTERISTIC DutyCycThermProtn.DutyCycThermProtnAbsltCtrlTTqTblY.Ary1D "MICROSAR RTE" VAL_BLK 0x0 RTE_RL_UWORD 0 NO_COMPU_METHOD 0 65535 MATRIX_DIM 4 1 1 SYMBOL_LINK "Rte_CalprmRom_CalRegn01Cmn_DEFAULT_RTE_CALPRM_GROUP.DutyCycThermProtnAbsltCtrlTTqTblY_Ary1D" 0 DISPLAY_IDENTIFIER DutyCycThermProtn.CalibrationPorts.DutyCycThermProtnAbsltCtrlTTqTblY.Ary1D /end CHARACTERISTIC
/begin CHARACTERISTIC DutyCycThermProtn.DutyCycThermProtnAbsltCuTFetMtgtnTblX.Ary1D "MICROSAR RTE" VAL_BLK 0x0 RTE_RL_SWORD 0 NO_COMPU_METHOD -32768 32767 MATRIX_DIM 4 1 1 SYMBOL_LINK "Rte_CalprmRom_CalRegn01Cmn_DEFAULT_RTE_CALPRM_GROUP.DutyCycThermProtnAbsltCuTFetMtgtnTblX_Ary1D" 0 DISPLAY_IDENTIFIER DutyCycThermProtn.CalibrationPorts.DutyCycThermProtnAbsltCuTFetMtgtnTblX.Ary1D /end CHARACTERISTIC
/begin CHARACTERISTIC DutyCycThermProtn.DutyCycThermProtnAbsltCuTTblX.Ary1D "MICROSAR RTE" VAL_BLK 0x0 RTE_RL_SWORD 0 NO_COMPU_METHOD -32768 32767 MATRIX_DIM 4 1 1 SYMBOL_LINK "Rte_CalprmRom_CalRegn01Cmn_DEFAULT_RTE_CALPRM_GROUP.DutyCycThermProtnAbsltCuTTblX_Ary1D" 0 DISPLAY_IDENTIFIER DutyCycThermProtn.CalibrationPorts.DutyCycThermProtnAbsltCuTTblX.Ary1D /end CHARACTERISTIC
/begin CHARACTERISTIC DutyCycThermProtn.DutyCycThermProtnAbsltCuTTqFetMtgtnTblY.Ary1D "MICROSAR RTE" VAL_BLK 0x0 RTE_RL_UWORD 0 NO_COMPU_METHOD 0 65535 MATRIX_DIM 4 1 1 SYMBOL_LINK "Rte_CalprmRom_CalRegn01Cmn_DEFAULT_RTE_CALPRM_GROUP.DutyCycThermProtnAbsltCuTTqFetMtgtnTblY_Ary1D" 0 DISPLAY_IDENTIFIER DutyCycThermProtn.CalibrationPorts.DutyCycThermProtnAbsltCuTTqFetMtgtnTblY.Ary1D /end CHARACTERISTIC
/begin CHARACTERISTIC DutyCycThermProtn.DutyCycThermProtnAbsltCuTTqTblY.Ary1D "MICROSAR RTE" VAL_BLK 0x0 RTE_RL_UWORD 0 NO_COMPU_METHOD 0 65535 MATRIX_DIM 4 1 1 SYMBOL_LINK "Rte_CalprmRom_CalRegn01Cmn_DEFAULT_RTE_CALPRM_GROUP.DutyCycThermProtnAbsltCuTTqTblY_Ary1D" 0 DISPLAY_IDENTIFIER DutyCycThermProtn.CalibrationPorts.DutyCycThermProtnAbsltCuTTqTblY.Ary1D /end CHARACTERISTIC
/begin CHARACTERISTIC DutyCycThermProtn.DutyCycThermProtnAbsltMotVelBreakPt.Val "MICROSAR RTE" VALUE 0x0 RTE_RL_FLOAT32_IEEE 0 NO_COMPU_METHOD -3.402823466e+38 3.402823466e+38 SYMBOL_LINK "Rte_CalprmRom_CalRegn01Cmn_DEFAULT_RTE_CALPRM_GROUP.DutyCycThermProtnAbsltMotVelBreakPt_Val" 0 DISPLAY_IDENTIFIER DutyCycThermProtn.CalibrationPorts.DutyCycThermProtnAbsltMotVelBreakPt.Val /end CHARACTERISTIC
/begin CHARACTERISTIC DutyCycThermProtn.DutyCycThermProtnAbsltTTqSlewHiLim.Val "MICROSAR RTE" VALUE 0x0 RTE_RL_FLOAT32_IEEE 0 NO_COMPU_METHOD -3.402823466e+38 3.402823466e+38 SYMBOL_LINK "Rte_CalprmRom_CalRegn01Cmn_DEFAULT_RTE_CALPRM_GROUP.DutyCycThermProtnAbsltTTqSlewHiLim_Val" 0 DISPLAY_IDENTIFIER DutyCycThermProtn.CalibrationPorts.DutyCycThermProtnAbsltTTqSlewHiLim.Val /end CHARACTERISTIC
/begin CHARACTERISTIC DutyCycThermProtn.DutyCycThermProtnAbsltTTqSlewLoLim.Val "MICROSAR RTE" VALUE 0x0 RTE_RL_FLOAT32_IEEE 0 NO_COMPU_METHOD -3.402823466e+38 3.402823466e+38 SYMBOL_LINK "Rte_CalprmRom_CalRegn01Cmn_DEFAULT_RTE_CALPRM_GROUP.DutyCycThermProtnAbsltTTqSlewLoLim_Val" 0 DISPLAY_IDENTIFIER DutyCycThermProtn.CalibrationPorts.DutyCycThermProtnAbsltTTqSlewLoLim.Val /end CHARACTERISTIC
/begin CHARACTERISTIC DutyCycThermProtn.DutyCycThermProtnCtrlT.Val "MICROSAR RTE" VALUE 0x0 RTE_RL_FLOAT32_IEEE 0 NO_COMPU_METHOD -3.402823466e+38 3.402823466e+38 SYMBOL_LINK "Rte_CalprmRom_CalRegn01Cmn_DEFAULT_RTE_CALPRM_GROUP.DutyCycThermProtnCtrlT_Val" 0 DISPLAY_IDENTIFIER DutyCycThermProtn.CalibrationPorts.DutyCycThermProtnCtrlT.Val /end CHARACTERISTIC
/begin CHARACTERISTIC DutyCycThermProtn.DutyCycThermProtnCtrlTSeln.Logl "MICROSAR RTE" VALUE 0x0 RTE_RL_BOOLEAN 0 RTE_CM_BOOLEAN 0 255 SYMBOL_LINK "Rte_CalprmRom_CalRegn01Cmn_DEFAULT_RTE_CALPRM_GROUP.DutyCycThermProtnCtrlTSeln_Logl" 0 DISPLAY_IDENTIFIER DutyCycThermProtn.CalibrationPorts.DutyCycThermProtnCtrlTSeln.Logl /end CHARACTERISTIC
/begin CHARACTERISTIC DutyCycThermProtn.DutyCycThermProtnDutyCycFildThd.Val "MICROSAR RTE" VALUE 0x0 RTE_RL_UWORD 0 NO_COMPU_METHOD 0 65535 SYMBOL_LINK "Rte_CalprmRom_CalRegn01Cmn_DEFAULT_RTE_CALPRM_GROUP.DutyCycThermProtnDutyCycFildThd_Val" 0 DISPLAY_IDENTIFIER DutyCycThermProtn.CalibrationPorts.DutyCycThermProtnDutyCycFildThd.Val /end CHARACTERISTIC
/begin CHARACTERISTIC DutyCycThermProtn.DutyCycThermProtnIgnOffCtrlEna.Logl "MICROSAR RTE" VALUE 0x0 RTE_RL_BOOLEAN 0 RTE_CM_BOOLEAN 0 255 SYMBOL_LINK "Rte_CalprmRom_CalRegn01Cmn_DEFAULT_RTE_CALPRM_GROUP.DutyCycThermProtnIgnOffCtrlEna_Logl" 0 DISPLAY_IDENTIFIER DutyCycThermProtn.CalibrationPorts.DutyCycThermProtnIgnOffCtrlEna.Logl /end CHARACTERISTIC
/begin CHARACTERISTIC DutyCycThermProtn.DutyCycThermProtnIgnOffMsgWaitTi.Val "MICROSAR RTE" VALUE 0x0 RTE_RL_FLOAT32_IEEE 0 NO_COMPU_METHOD -3.402823466e+38 3.402823466e+38 SYMBOL_LINK "Rte_CalprmRom_CalRegn01Cmn_DEFAULT_RTE_CALPRM_GROUP.DutyCycThermProtnIgnOffMsgWaitTi_Val" 0 DISPLAY_IDENTIFIER DutyCycThermProtn.CalibrationPorts.DutyCycThermProtnIgnOffMsgWaitTi.Val /end CHARACTERISTIC
/begin CHARACTERISTIC DutyCycThermProtn.DutyCycThermProtnLstTblValNonStall.Ary2D "MICROSAR RTE" VAL_BLK 0x0 RTE_RL_UWORD 0 NO_COMPU_METHOD 0 65535 MATRIX_DIM 5 2 1 SYMBOL_LINK "Rte_CalprmRom_CalRegn01Cmn_DEFAULT_RTE_CALPRM_GROUP.DutyCycThermProtnLstTblValNonStall_Ary2D" 0 DISPLAY_IDENTIFIER DutyCycThermProtn.CalibrationPorts.DutyCycThermProtnLstTblValNonStall.Ary2D /end CHARACTERISTIC
/begin CHARACTERISTIC DutyCycThermProtn.DutyCycThermProtnLstTblValStall.Ary2D "MICROSAR RTE" VAL_BLK 0x0 RTE_RL_UWORD 0 NO_COMPU_METHOD 0 65535 MATRIX_DIM 5 2 1 SYMBOL_LINK "Rte_CalprmRom_CalRegn01Cmn_DEFAULT_RTE_CALPRM_GROUP.DutyCycThermProtnLstTblValStall_Ary2D" 0 DISPLAY_IDENTIFIER DutyCycThermProtn.CalibrationPorts.DutyCycThermProtnLstTblValStall.Ary2D /end CHARACTERISTIC
/begin CHARACTERISTIC DutyCycThermProtn.DutyCycThermProtnMotPrTSeln.Logl "MICROSAR RTE" VALUE 0x0 RTE_RL_BOOLEAN 0 RTE_CM_BOOLEAN 0 255 SYMBOL_LINK "Rte_CalprmRom_CalRegn01Cmn_DEFAULT_RTE_CALPRM_GROUP.DutyCycThermProtnMotPrTSeln_Logl" 0 DISPLAY_IDENTIFIER DutyCycThermProtn.CalibrationPorts.DutyCycThermProtnMotPrTSeln.Logl /end CHARACTERISTIC
/begin CHARACTERISTIC DutyCycThermProtn.DutyCycThermProtnMplr1FetMtgtnNonStallTblY.Ary1D "MICROSAR RTE" VAL_BLK 0x0 RTE_RL_UWORD 0 NO_COMPU_METHOD 0 65535 MATRIX_DIM 5 1 1 SYMBOL_LINK "Rte_CalprmRom_CalRegn01Cmn_DEFAULT_RTE_CALPRM_GROUP.DutyCycThermProtnMplr1FetMtgtnNonStallTblY_Ary1D" 0 DISPLAY_IDENTIFIER DutyCycThermProtn.CalibrationPorts.DutyCycThermProtnMplr1FetMtgtnNonStallTblY.Ary1D /end CHARACTERISTIC
/begin CHARACTERISTIC DutyCycThermProtn.DutyCycThermProtnMplr1FetMtgtnStallTblY.Ary1D "MICROSAR RTE" VAL_BLK 0x0 RTE_RL_UWORD 0 NO_COMPU_METHOD 0 65535 MATRIX_DIM 5 1 1 SYMBOL_LINK "Rte_CalprmRom_CalRegn01Cmn_DEFAULT_RTE_CALPRM_GROUP.DutyCycThermProtnMplr1FetMtgtnStallTblY_Ary1D" 0 DISPLAY_IDENTIFIER DutyCycThermProtn.CalibrationPorts.DutyCycThermProtnMplr1FetMtgtnStallTblY.Ary1D /end CHARACTERISTIC
/begin CHARACTERISTIC DutyCycThermProtn.DutyCycThermProtnMplr1NonStallTblY.Ary1D "MICROSAR RTE" VAL_BLK 0x0 RTE_RL_UWORD 0 NO_COMPU_METHOD 0 65535 MATRIX_DIM 5 1 1 SYMBOL_LINK "Rte_CalprmRom_CalRegn01Cmn_DEFAULT_RTE_CALPRM_GROUP.DutyCycThermProtnMplr1NonStallTblY_Ary1D" 0 DISPLAY_IDENTIFIER DutyCycThermProtn.CalibrationPorts.DutyCycThermProtnMplr1NonStallTblY.Ary1D /end CHARACTERISTIC
/begin CHARACTERISTIC DutyCycThermProtn.DutyCycThermProtnMplr1StallTblY.Ary1D "MICROSAR RTE" VAL_BLK 0x0 RTE_RL_UWORD 0 NO_COMPU_METHOD 0 65535 MATRIX_DIM 5 1 1 SYMBOL_LINK "Rte_CalprmRom_CalRegn01Cmn_DEFAULT_RTE_CALPRM_GROUP.DutyCycThermProtnMplr1StallTblY_Ary1D" 0 DISPLAY_IDENTIFIER DutyCycThermProtn.CalibrationPorts.DutyCycThermProtnMplr1StallTblY.Ary1D /end CHARACTERISTIC
/begin CHARACTERISTIC DutyCycThermProtn.DutyCycThermProtnMplr2FetMtgtnNonStallTblY.Ary1D "MICROSAR RTE" VAL_BLK 0x0 RTE_RL_UWORD 0 NO_COMPU_METHOD 0 65535 MATRIX_DIM 5 1 1 SYMBOL_LINK "Rte_CalprmRom_CalRegn01Cmn_DEFAULT_RTE_CALPRM_GROUP.DutyCycThermProtnMplr2FetMtgtnNonStallTblY_Ary1D" 0 DISPLAY_IDENTIFIER DutyCycThermProtn.CalibrationPorts.DutyCycThermProtnMplr2FetMtgtnNonStallTblY.Ary1D /end CHARACTERISTIC
/begin CHARACTERISTIC DutyCycThermProtn.DutyCycThermProtnMplr2FetMtgtnStallTblY.Ary1D "MICROSAR RTE" VAL_BLK 0x0 RTE_RL_UWORD 0 NO_COMPU_METHOD 0 65535 MATRIX_DIM 5 1 1 SYMBOL_LINK "Rte_CalprmRom_CalRegn01Cmn_DEFAULT_RTE_CALPRM_GROUP.DutyCycThermProtnMplr2FetMtgtnStallTblY_Ary1D" 0 DISPLAY_IDENTIFIER DutyCycThermProtn.CalibrationPorts.DutyCycThermProtnMplr2FetMtgtnStallTblY.Ary1D /end CHARACTERISTIC
/begin CHARACTERISTIC DutyCycThermProtn.DutyCycThermProtnMplr2NonStallTblY.Ary1D "MICROSAR RTE" VAL_BLK 0x0 RTE_RL_UWORD 0 NO_COMPU_METHOD 0 65535 MATRIX_DIM 5 1 1 SYMBOL_LINK "Rte_CalprmRom_CalRegn01Cmn_DEFAULT_RTE_CALPRM_GROUP.DutyCycThermProtnMplr2NonStallTblY_Ary1D" 0 DISPLAY_IDENTIFIER DutyCycThermProtn.CalibrationPorts.DutyCycThermProtnMplr2NonStallTblY.Ary1D /end CHARACTERISTIC
/begin CHARACTERISTIC DutyCycThermProtn.DutyCycThermProtnMplr2StallTblY.Ary1D "MICROSAR RTE" VAL_BLK 0x0 RTE_RL_UWORD 0 NO_COMPU_METHOD 0 65535 MATRIX_DIM 5 1 1 SYMBOL_LINK "Rte_CalprmRom_CalRegn01Cmn_DEFAULT_RTE_CALPRM_GROUP.DutyCycThermProtnMplr2StallTblY_Ary1D" 0 DISPLAY_IDENTIFIER DutyCycThermProtn.CalibrationPorts.DutyCycThermProtnMplr2StallTblY.Ary1D /end CHARACTERISTIC
/begin CHARACTERISTIC DutyCycThermProtn.DutyCycThermProtnMplr3FetMtgtnNonStallTblY.Ary1D "MICROSAR RTE" VAL_BLK 0x0 RTE_RL_UWORD 0 NO_COMPU_METHOD 0 65535 MATRIX_DIM 5 1 1 SYMBOL_LINK "Rte_CalprmRom_CalRegn01Cmn_DEFAULT_RTE_CALPRM_GROUP.DutyCycThermProtnMplr3FetMtgtnNonStallTblY_Ary1D" 0 DISPLAY_IDENTIFIER DutyCycThermProtn.CalibrationPorts.DutyCycThermProtnMplr3FetMtgtnNonStallTblY.Ary1D /end CHARACTERISTIC
/begin CHARACTERISTIC DutyCycThermProtn.DutyCycThermProtnMplr3FetMtgtnStallTblY.Ary1D "MICROSAR RTE" VAL_BLK 0x0 RTE_RL_UWORD 0 NO_COMPU_METHOD 0 65535 MATRIX_DIM 5 1 1 SYMBOL_LINK "Rte_CalprmRom_CalRegn01Cmn_DEFAULT_RTE_CALPRM_GROUP.DutyCycThermProtnMplr3FetMtgtnStallTblY_Ary1D" 0 DISPLAY_IDENTIFIER DutyCycThermProtn.CalibrationPorts.DutyCycThermProtnMplr3FetMtgtnStallTblY.Ary1D /end CHARACTERISTIC
/begin CHARACTERISTIC DutyCycThermProtn.DutyCycThermProtnMplr3NonStallTblY.Ary1D "MICROSAR RTE" VAL_BLK 0x0 RTE_RL_UWORD 0 NO_COMPU_METHOD 0 65535 MATRIX_DIM 5 1 1 SYMBOL_LINK "Rte_CalprmRom_CalRegn01Cmn_DEFAULT_RTE_CALPRM_GROUP.DutyCycThermProtnMplr3NonStallTblY_Ary1D" 0 DISPLAY_IDENTIFIER DutyCycThermProtn.CalibrationPorts.DutyCycThermProtnMplr3NonStallTblY.Ary1D /end CHARACTERISTIC
/begin CHARACTERISTIC DutyCycThermProtn.DutyCycThermProtnMplr3StallTblY.Ary1D "MICROSAR RTE" VAL_BLK 0x0 RTE_RL_UWORD 0 NO_COMPU_METHOD 0 65535 MATRIX_DIM 5 1 1 SYMBOL_LINK "Rte_CalprmRom_CalRegn01Cmn_DEFAULT_RTE_CALPRM_GROUP.DutyCycThermProtnMplr3StallTblY_Ary1D" 0 DISPLAY_IDENTIFIER DutyCycThermProtn.CalibrationPorts.DutyCycThermProtnMplr3StallTblY.Ary1D /end CHARACTERISTIC
/begin CHARACTERISTIC DutyCycThermProtn.DutyCycThermProtnMplr4FetMtgtnNonStallTblY.Ary1D "MICROSAR RTE" VAL_BLK 0x0 RTE_RL_UWORD 0 NO_COMPU_METHOD 0 65535 MATRIX_DIM 5 1 1 SYMBOL_LINK "Rte_CalprmRom_CalRegn01Cmn_DEFAULT_RTE_CALPRM_GROUP.DutyCycThermProtnMplr4FetMtgtnNonStallTblY_Ary1D" 0 DISPLAY_IDENTIFIER DutyCycThermProtn.CalibrationPorts.DutyCycThermProtnMplr4FetMtgtnNonStallTblY.Ary1D /end CHARACTERISTIC
/begin CHARACTERISTIC DutyCycThermProtn.DutyCycThermProtnMplr4FetMtgtnStallTblY.Ary1D "MICROSAR RTE" VAL_BLK 0x0 RTE_RL_UWORD 0 NO_COMPU_METHOD 0 65535 MATRIX_DIM 5 1 1 SYMBOL_LINK "Rte_CalprmRom_CalRegn01Cmn_DEFAULT_RTE_CALPRM_GROUP.DutyCycThermProtnMplr4FetMtgtnStallTblY_Ary1D" 0 DISPLAY_IDENTIFIER DutyCycThermProtn.CalibrationPorts.DutyCycThermProtnMplr4FetMtgtnStallTblY.Ary1D /end CHARACTERISTIC
/begin CHARACTERISTIC DutyCycThermProtn.DutyCycThermProtnMplr4NonStallTblY.Ary1D "MICROSAR RTE" VAL_BLK 0x0 RTE_RL_UWORD 0 NO_COMPU_METHOD 0 65535 MATRIX_DIM 5 1 1 SYMBOL_LINK "Rte_CalprmRom_CalRegn01Cmn_DEFAULT_RTE_CALPRM_GROUP.DutyCycThermProtnMplr4NonStallTblY_Ary1D" 0 DISPLAY_IDENTIFIER DutyCycThermProtn.CalibrationPorts.DutyCycThermProtnMplr4NonStallTblY.Ary1D /end CHARACTERISTIC
/begin CHARACTERISTIC DutyCycThermProtn.DutyCycThermProtnMplr4StallTblY.Ary1D "MICROSAR RTE" VAL_BLK 0x0 RTE_RL_UWORD 0 NO_COMPU_METHOD 0 65535 MATRIX_DIM 5 1 1 SYMBOL_LINK "Rte_CalprmRom_CalRegn01Cmn_DEFAULT_RTE_CALPRM_GROUP.DutyCycThermProtnMplr4StallTblY_Ary1D" 0 DISPLAY_IDENTIFIER DutyCycThermProtn.CalibrationPorts.DutyCycThermProtnMplr4StallTblY.Ary1D /end CHARACTERISTIC
/begin CHARACTERISTIC DutyCycThermProtn.DutyCycThermProtnMplr5FetMtgtnNonStallTblY.Ary1D "MICROSAR RTE" VAL_BLK 0x0 RTE_RL_UWORD 0 NO_COMPU_METHOD 0 65535 MATRIX_DIM 5 1 1 SYMBOL_LINK "Rte_CalprmRom_CalRegn01Cmn_DEFAULT_RTE_CALPRM_GROUP.DutyCycThermProtnMplr5FetMtgtnNonStallTblY_Ary1D" 0 DISPLAY_IDENTIFIER DutyCycThermProtn.CalibrationPorts.DutyCycThermProtnMplr5FetMtgtnNonStallTblY.Ary1D /end CHARACTERISTIC
/begin CHARACTERISTIC DutyCycThermProtn.DutyCycThermProtnMplr5FetMtgtnStallTblY.Ary1D "MICROSAR RTE" VAL_BLK 0x0 RTE_RL_UWORD 0 NO_COMPU_METHOD 0 65535 MATRIX_DIM 5 1 1 SYMBOL_LINK "Rte_CalprmRom_CalRegn01Cmn_DEFAULT_RTE_CALPRM_GROUP.DutyCycThermProtnMplr5FetMtgtnStallTblY_Ary1D" 0 DISPLAY_IDENTIFIER DutyCycThermProtn.CalibrationPorts.DutyCycThermProtnMplr5FetMtgtnStallTblY.Ary1D /end CHARACTERISTIC
/begin CHARACTERISTIC DutyCycThermProtn.DutyCycThermProtnMplr5NonStallTblY.Ary1D "MICROSAR RTE" VAL_BLK 0x0 RTE_RL_UWORD 0 NO_COMPU_METHOD 0 65535 MATRIX_DIM 5 1 1 SYMBOL_LINK "Rte_CalprmRom_CalRegn01Cmn_DEFAULT_RTE_CALPRM_GROUP.DutyCycThermProtnMplr5NonStallTblY_Ary1D" 0 DISPLAY_IDENTIFIER DutyCycThermProtn.CalibrationPorts.DutyCycThermProtnMplr5NonStallTblY.Ary1D /end CHARACTERISTIC
/begin CHARACTERISTIC DutyCycThermProtn.DutyCycThermProtnMplr5StallTblY.Ary1D "MICROSAR RTE" VAL_BLK 0x0 RTE_RL_UWORD 0 NO_COMPU_METHOD 0 65535 MATRIX_DIM 5 1 1 SYMBOL_LINK "Rte_CalprmRom_CalRegn01Cmn_DEFAULT_RTE_CALPRM_GROUP.DutyCycThermProtnMplr5StallTblY_Ary1D" 0 DISPLAY_IDENTIFIER DutyCycThermProtn.CalibrationPorts.DutyCycThermProtnMplr5StallTblY.Ary1D /end CHARACTERISTIC
/begin CHARACTERISTIC DutyCycThermProtn.DutyCycThermProtnMplr6FetMtgtnNonStallTblY.Ary1D "MICROSAR RTE" VAL_BLK 0x0 RTE_RL_UWORD 0 NO_COMPU_METHOD 0 65535 MATRIX_DIM 5 1 1 SYMBOL_LINK "Rte_CalprmRom_CalRegn01Cmn_DEFAULT_RTE_CALPRM_GROUP.DutyCycThermProtnMplr6FetMtgtnNonStallTblY_Ary1D" 0 DISPLAY_IDENTIFIER DutyCycThermProtn.CalibrationPorts.DutyCycThermProtnMplr6FetMtgtnNonStallTblY.Ary1D /end CHARACTERISTIC
/begin CHARACTERISTIC DutyCycThermProtn.DutyCycThermProtnMplr6FetMtgtnStallTblY.Ary1D "MICROSAR RTE" VAL_BLK 0x0 RTE_RL_UWORD 0 NO_COMPU_METHOD 0 65535 MATRIX_DIM 5 1 1 SYMBOL_LINK "Rte_CalprmRom_CalRegn01Cmn_DEFAULT_RTE_CALPRM_GROUP.DutyCycThermProtnMplr6FetMtgtnStallTblY_Ary1D" 0 DISPLAY_IDENTIFIER DutyCycThermProtn.CalibrationPorts.DutyCycThermProtnMplr6FetMtgtnStallTblY.Ary1D /end CHARACTERISTIC
/begin CHARACTERISTIC DutyCycThermProtn.DutyCycThermProtnMplr6NonStallTblY.Ary1D "MICROSAR RTE" VAL_BLK 0x0 RTE_RL_UWORD 0 NO_COMPU_METHOD 0 65535 MATRIX_DIM 5 1 1 SYMBOL_LINK "Rte_CalprmRom_CalRegn01Cmn_DEFAULT_RTE_CALPRM_GROUP.DutyCycThermProtnMplr6NonStallTblY_Ary1D" 0 DISPLAY_IDENTIFIER DutyCycThermProtn.CalibrationPorts.DutyCycThermProtnMplr6NonStallTblY.Ary1D /end CHARACTERISTIC
/begin CHARACTERISTIC DutyCycThermProtn.DutyCycThermProtnMplr6StallTblY.Ary1D "MICROSAR RTE" VAL_BLK 0x0 RTE_RL_UWORD 0 NO_COMPU_METHOD 0 65535 MATRIX_DIM 5 1 1 SYMBOL_LINK "Rte_CalprmRom_CalRegn01Cmn_DEFAULT_RTE_CALPRM_GROUP.DutyCycThermProtnMplr6StallTblY_Ary1D" 0 DISPLAY_IDENTIFIER DutyCycThermProtn.CalibrationPorts.DutyCycThermProtnMplr6StallTblY.Ary1D /end CHARACTERISTIC
/begin CHARACTERISTIC DutyCycThermProtn.DutyCycThermProtnMplrFetMtgtnTblX.Ary1D "MICROSAR RTE" VAL_BLK 0x0 RTE_RL_SWORD 0 NO_COMPU_METHOD -32768 32767 MATRIX_DIM 5 1 1 SYMBOL_LINK "Rte_CalprmRom_CalRegn01Cmn_DEFAULT_RTE_CALPRM_GROUP.DutyCycThermProtnMplrFetMtgtnTblX_Ary1D" 0 DISPLAY_IDENTIFIER DutyCycThermProtn.CalibrationPorts.DutyCycThermProtnMplrFetMtgtnTblX.Ary1D /end CHARACTERISTIC
/begin CHARACTERISTIC DutyCycThermProtn.DutyCycThermProtnMplrTSeln.Logl "MICROSAR RTE" VALUE 0x0 RTE_RL_BOOLEAN 0 RTE_CM_BOOLEAN 0 255 SYMBOL_LINK "Rte_CalprmRom_CalRegn01Cmn_DEFAULT_RTE_CALPRM_GROUP.DutyCycThermProtnMplrTSeln_Logl" 0 DISPLAY_IDENTIFIER DutyCycThermProtn.CalibrationPorts.DutyCycThermProtnMplrTSeln.Logl /end CHARACTERISTIC
/begin CHARACTERISTIC DutyCycThermProtn.DutyCycThermProtnMplrTblX.Ary1D "MICROSAR RTE" VAL_BLK 0x0 RTE_RL_SWORD 0 NO_COMPU_METHOD -32768 32767 MATRIX_DIM 5 1 1 SYMBOL_LINK "Rte_CalprmRom_CalRegn01Cmn_DEFAULT_RTE_CALPRM_GROUP.DutyCycThermProtnMplrTblX_Ary1D" 0 DISPLAY_IDENTIFIER DutyCycThermProtn.CalibrationPorts.DutyCycThermProtnMplrTblX.Ary1D /end CHARACTERISTIC
/begin CHARACTERISTIC DutyCycThermProtn.DutyCycThermProtnSlowFilTSeln.Logl "MICROSAR RTE" VALUE 0x0 RTE_RL_BOOLEAN 0 RTE_CM_BOOLEAN 0 255 SYMBOL_LINK "Rte_CalprmRom_CalRegn01Cmn_DEFAULT_RTE_CALPRM_GROUP.DutyCycThermProtnSlowFilTSeln_Logl" 0 DISPLAY_IDENTIFIER DutyCycThermProtn.CalibrationPorts.DutyCycThermProtnSlowFilTSeln.Logl /end CHARACTERISTIC
/begin CHARACTERISTIC DutyCycThermProtn.DutyCycThermProtnThermLimScaFac.Val "MICROSAR RTE" VALUE 0x0 RTE_RL_FLOAT32_IEEE 0 NO_COMPU_METHOD -3.402823466e+38 3.402823466e+38 SYMBOL_LINK "Rte_CalprmRom_CalRegn01Cmn_DEFAULT_RTE_CALPRM_GROUP.DutyCycThermProtnThermLimScaFac_Val" 0 DISPLAY_IDENTIFIER DutyCycThermProtn.CalibrationPorts.DutyCycThermProtnThermLimScaFac.Val /end CHARACTERISTIC
/begin CHARACTERISTIC DutyCycThermProtn.DutyCycThermProtnThermLoadLimTblX.Ary2D "MICROSAR RTE" VAL_BLK 0x0 RTE_RL_UWORD 0 NO_COMPU_METHOD 0 65535 MATRIX_DIM 8 2 1 SYMBOL_LINK "Rte_CalprmRom_CalRegn01Cmn_DEFAULT_RTE_CALPRM_GROUP.DutyCycThermProtnThermLoadLimTblX_Ary2D" 0 DISPLAY_IDENTIFIER DutyCycThermProtn.CalibrationPorts.DutyCycThermProtnThermLoadLimTblX.Ary2D /end CHARACTERISTIC
/begin CHARACTERISTIC DutyCycThermProtn.DutyCycThermProtnThermLoadLimTblY.Ary2D "MICROSAR RTE" VAL_BLK 0x0 RTE_RL_UWORD 0 NO_COMPU_METHOD 0 65535 MATRIX_DIM 8 2 1 SYMBOL_LINK "Rte_CalprmRom_CalRegn01Cmn_DEFAULT_RTE_CALPRM_GROUP.DutyCycThermProtnThermLoadLimTblY_Ary2D" 0 DISPLAY_IDENTIFIER DutyCycThermProtn.CalibrationPorts.DutyCycThermProtnThermLoadLimTblY.Ary2D /end CHARACTERISTIC
/begin CHARACTERISTIC DutyCycThermProtn.DutyCycThermProtnTqCmdSlewDwn.Val "MICROSAR RTE" VALUE 0x0 RTE_RL_FLOAT32_IEEE 0 NO_COMPU_METHOD -3.402823466e+38 3.402823466e+38 SYMBOL_LINK "Rte_CalprmRom_CalRegn01Cmn_DEFAULT_RTE_CALPRM_GROUP.DutyCycThermProtnTqCmdSlewDwn_Val" 0 DISPLAY_IDENTIFIER DutyCycThermProtn.CalibrationPorts.DutyCycThermProtnTqCmdSlewDwn.Val /end CHARACTERISTIC
/begin CHARACTERISTIC DutyCycThermProtn.DutyCycThermProtnTqCmdSlewUp.Val "MICROSAR RTE" VALUE 0x0 RTE_RL_FLOAT32_IEEE 0 NO_COMPU_METHOD -3.402823466e+38 3.402823466e+38 SYMBOL_LINK "Rte_CalprmRom_CalRegn01Cmn_DEFAULT_RTE_CALPRM_GROUP.DutyCycThermProtnTqCmdSlewUp_Val" 0 DISPLAY_IDENTIFIER DutyCycThermProtn.CalibrationPorts.DutyCycThermProtnTqCmdSlewUp.Val /end CHARACTERISTIC
/begin CHARACTERISTIC ElecPwrCns.ElecPwrCnsCtrlrInpR.Val "MICROSAR RTE" VALUE 0x0 RTE_RL_FLOAT32_IEEE 0 NO_COMPU_METHOD -3.402823466e+38 3.402823466e+38 SYMBOL_LINK "Rte_CalprmRom_CalRegn01Cmn_DEFAULT_RTE_CALPRM_GROUP.ElecPwrCnsCtrlrInpR_Val" 0 DISPLAY_IDENTIFIER ElecPwrCns.CalibrationPorts.ElecPwrCnsCtrlrInpR.Val /end CHARACTERISTIC
/begin CHARACTERISTIC ElecPwrCns.ElecPwrCnsPrstcPwrLoss.Val "MICROSAR RTE" VALUE 0x0 RTE_RL_FLOAT32_IEEE 0 NO_COMPU_METHOD -3.402823466e+38 3.402823466e+38 SYMBOL_LINK "Rte_CalprmRom_CalRegn01CmnGroupA_DEFAULT_RTE_CALPRM_GROUP.ElecPwrCnsPrstcPwrLoss_Val" 0 DISPLAY_IDENTIFIER ElecPwrCns.CalibrationPorts.ElecPwrCnsPrstcPwrLoss.Val /end CHARACTERISTIC
/begin CHARACTERISTIC EotLrng.EotLrngAuthyStrtLrn.Val "MICROSAR RTE" VALUE 0x0 RTE_RL_FLOAT32_IEEE 0 NO_COMPU_METHOD -3.402823466e+38 3.402823466e+38 SYMBOL_LINK "Rte_CalprmRom_CalRegn02Inin00GroupB_DEFAULT_RTE_CALPRM_GROUP.EotLrngAuthyStrtLrn_Val" 0 DISPLAY_IDENTIFIER EotLrng.CalibrationPorts.EotLrngAuthyStrtLrn.Val /end CHARACTERISTIC
/begin CHARACTERISTIC EotLrng.EotLrngEntrAndExitHysRngLimr.Val "MICROSAR RTE" VALUE 0x0 RTE_RL_FLOAT32_IEEE 0 NO_COMPU_METHOD -3.402823466e+38 3.402823466e+38 SYMBOL_LINK "Rte_CalprmRom_CalRegn02Inin00GroupB_DEFAULT_RTE_CALPRM_GROUP.EotLrngEntrAndExitHysRngLimr_Val" 0 DISPLAY_IDENTIFIER EotLrng.CalibrationPorts.EotLrngEntrAndExitHysRngLimr.Val /end CHARACTERISTIC
/begin CHARACTERISTIC EotLrng.EotLrngEotLrnTmr.Val "MICROSAR RTE" VALUE 0x0 RTE_RL_UWORD 0 NO_COMPU_METHOD 0 65535 SYMBOL_LINK "Rte_CalprmRom_CalRegn02Inin00GroupB_DEFAULT_RTE_CALPRM_GROUP.EotLrngEotLrnTmr_Val" 0 DISPLAY_IDENTIFIER EotLrng.CalibrationPorts.EotLrngEotLrnTmr.Val /end CHARACTERISTIC
/begin CHARACTERISTIC EotLrng.EotLrngHwAgOverTrvlCntThd.Val "MICROSAR RTE" VALUE 0x0 RTE_RL_UBYTE 0 NO_COMPU_METHOD 0 255 SYMBOL_LINK "Rte_CalprmRom_CalRegn02CmnGroupB_DEFAULT_RTE_CALPRM_GROUP.EotLrngHwAgOverTrvlCntThd_Val" 0 DISPLAY_IDENTIFIER EotLrng.CalibrationPorts.EotLrngHwAgOverTrvlCntThd.Val /end CHARACTERISTIC
/begin CHARACTERISTIC EotLrng.EotLrngHwTqEotLrn.Val "MICROSAR RTE" VALUE 0x0 RTE_RL_FLOAT32_IEEE 0 NO_COMPU_METHOD -3.402823466e+38 3.402823466e+38 SYMBOL_LINK "Rte_CalprmRom_CalRegn02Inin00GroupB_DEFAULT_RTE_CALPRM_GROUP.EotLrngHwTqEotLrn_Val" 0 DISPLAY_IDENTIFIER EotLrng.CalibrationPorts.EotLrngHwTqEotLrn.Val /end CHARACTERISTIC
/begin CHARACTERISTIC EotLrng.EotLrngMotVelEotLrn.Val "MICROSAR RTE" VALUE 0x0 RTE_RL_FLOAT32_IEEE 0 NO_COMPU_METHOD -3.402823466e+38 3.402823466e+38 SYMBOL_LINK "Rte_CalprmRom_CalRegn02Inin00GroupB_DEFAULT_RTE_CALPRM_GROUP.EotLrngMotVelEotLrn_Val" 0 DISPLAY_IDENTIFIER EotLrng.CalibrationPorts.EotLrngMotVelEotLrn.Val /end CHARACTERISTIC
/begin CHARACTERISTIC EotLrng.EotLrngRackTrvlMax.Val "MICROSAR RTE" VALUE 0x0 RTE_RL_FLOAT32_IEEE 0 NO_COMPU_METHOD -3.402823466e+38 3.402823466e+38 SYMBOL_LINK "Rte_CalprmRom_CalRegn02Inin00GroupB_DEFAULT_RTE_CALPRM_GROUP.EotLrngRackTrvlMax_Val" 0 DISPLAY_IDENTIFIER EotLrng.CalibrationPorts.EotLrngRackTrvlMax.Val /end CHARACTERISTIC
/begin CHARACTERISTIC EotLrng.EotLrngRackTrvlMin.Val "MICROSAR RTE" VALUE 0x0 RTE_RL_FLOAT32_IEEE 0 NO_COMPU_METHOD -3.402823466e+38 3.402823466e+38 SYMBOL_LINK "Rte_CalprmRom_CalRegn02Inin00GroupB_DEFAULT_RTE_CALPRM_GROUP.EotLrngRackTrvlMin_Val" 0 DISPLAY_IDENTIFIER EotLrng.CalibrationPorts.EotLrngRackTrvlMin.Val /end CHARACTERISTIC
/begin CHARACTERISTIC EotLrng.EotLrngRstAuthyMin.Val "MICROSAR RTE" VALUE 0x0 RTE_RL_FLOAT32_IEEE 0 NO_COMPU_METHOD -3.402823466e+38 3.402823466e+38 SYMBOL_LINK "Rte_CalprmRom_CalRegn02Inin00GroupB_DEFAULT_RTE_CALPRM_GROUP.EotLrngRstAuthyMin_Val" 0 DISPLAY_IDENTIFIER EotLrng.CalibrationPorts.EotLrngRstAuthyMin.Val /end CHARACTERISTIC
/begin CHARACTERISTIC EotLrng.EotNvmDataDft.CcwEot "MICROSAR RTE" VALUE 0x0 RTE_RL_FLOAT32_IEEE 0 NO_COMPU_METHOD -3.402823466e+38 3.402823466e+38 SYMBOL_LINK "Rte_CalprmRom_EotLrng_DEFAULT_RTE_CDATA_GROUP.EotNvmDataDft.CcwEot" 0 DISPLAY_IDENTIFIER EotLrng.CalibrationParameters.EotNvmDataDft.CcwEot /end CHARACTERISTIC
/begin CHARACTERISTIC EotLrng.EotNvmDataDft.CcwEotDetd "MICROSAR RTE" VALUE 0x0 RTE_RL_BOOLEAN 0 RTE_CM_BOOLEAN 0 255 SYMBOL_LINK "Rte_CalprmRom_EotLrng_DEFAULT_RTE_CDATA_GROUP.EotNvmDataDft.CcwEotDetd" 0 DISPLAY_IDENTIFIER EotLrng.CalibrationParameters.EotNvmDataDft.CcwEotDetd /end CHARACTERISTIC
/begin CHARACTERISTIC EotLrng.EotNvmDataDft.CwEot "MICROSAR RTE" VALUE 0x0 RTE_RL_FLOAT32_IEEE 0 NO_COMPU_METHOD -3.402823466e+38 3.402823466e+38 SYMBOL_LINK "Rte_CalprmRom_EotLrng_DEFAULT_RTE_CDATA_GROUP.EotNvmDataDft.CwEot" 0 DISPLAY_IDENTIFIER EotLrng.CalibrationParameters.EotNvmDataDft.CwEot /end CHARACTERISTIC
/begin CHARACTERISTIC EotLrng.EotNvmDataDft.CwEotDetd "MICROSAR RTE" VALUE 0x0 RTE_RL_BOOLEAN 0 RTE_CM_BOOLEAN 0 255 SYMBOL_LINK "Rte_CalprmRom_EotLrng_DEFAULT_RTE_CDATA_GROUP.EotNvmDataDft.CwEotDetd" 0 DISPLAY_IDENTIFIER EotLrng.CalibrationParameters.EotNvmDataDft.CwEotDetd /end CHARACTERISTIC
/begin CHARACTERISTIC EotLrng.EotProtnRackTrvlLimrEna.Logl "MICROSAR RTE" VALUE 0x0 RTE_RL_BOOLEAN 0 RTE_CM_BOOLEAN 0 255 SYMBOL_LINK "Rte_CalprmRom_CalRegn02Inin00GroupB_DEFAULT_RTE_CALPRM_GROUP.EotProtnRackTrvlLimrEna_Logl" 0 DISPLAY_IDENTIFIER EotLrng.CalibrationPorts.EotProtnRackTrvlLimrEna.Logl /end CHARACTERISTIC
/begin CHARACTERISTIC EotLrng.EotProtnRackTrvlLimrRngLimd.Val "MICROSAR RTE" VALUE 0x0 RTE_RL_FLOAT32_IEEE 0 NO_COMPU_METHOD -3.402823466e+38 3.402823466e+38 SYMBOL_LINK "Rte_CalprmRom_CalRegn02Inin00GroupB_DEFAULT_RTE_CALPRM_GROUP.EotProtnRackTrvlLimrRngLimd_Val" 0 DISPLAY_IDENTIFIER EotLrng.CalibrationPorts.EotProtnRackTrvlLimrRngLimd.Val /end CHARACTERISTIC
/begin CHARACTERISTIC EotProtn.EotProtnActvRegnBypMaxThd.Val "MICROSAR RTE" VALUE 0x0 RTE_RL_FLOAT32_IEEE 0 NO_COMPU_METHOD -3.402823466e+38 3.402823466e+38 SYMBOL_LINK "Rte_CalprmRom_CalRegn02CmnGroupB_DEFAULT_RTE_CALPRM_GROUP.EotProtnActvRegnBypMaxThd_Val" 0 DISPLAY_IDENTIFIER EotProtn.CalibrationPorts.EotProtnActvRegnBypMaxThd.Val /end CHARACTERISTIC
/begin CHARACTERISTIC EotProtn.EotProtnDampgSlew.Val "MICROSAR RTE" VALUE 0x0 RTE_RL_FLOAT32_IEEE 0 NO_COMPU_METHOD -3.402823466e+38 3.402823466e+38 SYMBOL_LINK "Rte_CalprmRom_CalRegn02Inin00GroupB_DEFAULT_RTE_CALPRM_GROUP.EotProtnDampgSlew_Val" 0 DISPLAY_IDENTIFIER EotProtn.CalibrationPorts.EotProtnDampgSlew.Val /end CHARACTERISTIC
/begin CHARACTERISTIC EotProtn.EotProtnDampgVehSpdTbl.Ary1D "MICROSAR RTE" VAL_BLK 0x0 RTE_RL_UWORD 0 NO_COMPU_METHOD 0 65535 MATRIX_DIM 4 1 1 SYMBOL_LINK "Rte_CalprmRom_CalRegn02Rt00GroupB_DEFAULT_RTE_CALPRM_GROUP.EotProtnDampgVehSpdTbl_Ary1D" 0 DISPLAY_IDENTIFIER EotProtn.CalibrationPorts.EotProtnDampgVehSpdTbl.Ary1D /end CHARACTERISTIC
/begin CHARACTERISTIC EotProtn.EotProtnDeltaTqThd.Val "MICROSAR RTE" VALUE 0x0 RTE_RL_FLOAT32_IEEE 0 NO_COMPU_METHOD -3.402823466e+38 3.402823466e+38 SYMBOL_LINK "Rte_CalprmRom_CalRegn02Rt00GroupB_DEFAULT_RTE_CALPRM_GROUP.EotProtnDeltaTqThd_Val" 0 DISPLAY_IDENTIFIER EotProtn.CalibrationPorts.EotProtnDeltaTqThd.Val /end CHARACTERISTIC
/begin CHARACTERISTIC EotProtn.EotProtnDftPosn.Val "MICROSAR RTE" VALUE 0x0 RTE_RL_FLOAT32_IEEE 0 NO_COMPU_METHOD -3.402823466e+38 3.402823466e+38 SYMBOL_LINK "Rte_CalprmRom_CalRegn02Inin00GroupB_DEFAULT_RTE_CALPRM_GROUP.EotProtnDftPosn_Val" 0 DISPLAY_IDENTIFIER EotProtn.CalibrationPorts.EotProtnDftPosn.Val /end CHARACTERISTIC
/begin CHARACTERISTIC EotProtn.EotProtnEntrGainAuthyThd.Val "MICROSAR RTE" VALUE 0x0 RTE_RL_FLOAT32_IEEE 0 NO_COMPU_METHOD -3.402823466e+38 3.402823466e+38 SYMBOL_LINK "Rte_CalprmRom_CalRegn02Inin00GroupB_DEFAULT_RTE_CALPRM_GROUP.EotProtnEntrGainAuthyThd_Val" 0 DISPLAY_IDENTIFIER EotProtn.CalibrationPorts.EotProtnEntrGainAuthyThd.Val /end CHARACTERISTIC
/begin CHARACTERISTIC EotProtn.EotProtnEntrGainVehSpdTbl.Ary1D "MICROSAR RTE" VAL_BLK 0x0 RTE_RL_UWORD 0 NO_COMPU_METHOD 0 65535 MATRIX_DIM 5 1 1 SYMBOL_LINK "Rte_CalprmRom_CalRegn02Rt00GroupB_DEFAULT_RTE_CALPRM_GROUP.EotProtnEntrGainVehSpdTbl_Ary1D" 0 DISPLAY_IDENTIFIER EotProtn.CalibrationPorts.EotProtnEntrGainVehSpdTbl.Ary1D /end CHARACTERISTIC
/begin CHARACTERISTIC EotProtn.EotProtnEntrGainX.Ary2D "MICROSAR RTE" VAL_BLK 0x0 RTE_RL_UWORD 0 NO_COMPU_METHOD 0 65535 MATRIX_DIM 4 5 1 SYMBOL_LINK "Rte_CalprmRom_CalRegn02Inin00GroupB_DEFAULT_RTE_CALPRM_GROUP.EotProtnEntrGainX_Ary2D" 0 DISPLAY_IDENTIFIER EotProtn.CalibrationPorts.EotProtnEntrGainX.Ary2D /end CHARACTERISTIC
/begin CHARACTERISTIC EotProtn.EotProtnEntrGainY.Ary2D "MICROSAR RTE" VAL_BLK 0x0 RTE_RL_UWORD 0 NO_COMPU_METHOD 0 65535 MATRIX_DIM 4 5 1 SYMBOL_LINK "Rte_CalprmRom_CalRegn02Rt00GroupB_DEFAULT_RTE_CALPRM_GROUP.EotProtnEntrGainY_Ary2D" 0 DISPLAY_IDENTIFIER EotProtn.CalibrationPorts.EotProtnEntrGainY.Ary2D /end CHARACTERISTIC
/begin CHARACTERISTIC EotProtn.EotProtnEntrStLpFilFrq.Val "MICROSAR RTE" VALUE 0x0 RTE_RL_FLOAT32_IEEE 0 NO_COMPU_METHOD -3.402823466e+38 3.402823466e+38 SYMBOL_LINK "Rte_CalprmRom_CalRegn02Inin00GroupB_DEFAULT_RTE_CALPRM_GROUP.EotProtnEntrStLpFilFrq_Val" 0 DISPLAY_IDENTIFIER EotProtn.CalibrationPorts.EotProtnEntrStLpFilFrq.Val /end CHARACTERISTIC
/begin CHARACTERISTIC EotProtn.EotProtnExitDampgY.Ary2D "MICROSAR RTE" VAL_BLK 0x0 RTE_RL_UWORD 0 NO_COMPU_METHOD 0 65535 MATRIX_DIM 2 4 1 SYMBOL_LINK "Rte_CalprmRom_CalRegn02Inin00GroupB_DEFAULT_RTE_CALPRM_GROUP.EotProtnExitDampgY_Ary2D" 0 DISPLAY_IDENTIFIER EotProtn.CalibrationPorts.EotProtnExitDampgY.Ary2D /end CHARACTERISTIC
/begin CHARACTERISTIC EotProtn.EotProtnExitStLpFilFrq.Val "MICROSAR RTE" VALUE 0x0 RTE_RL_FLOAT32_IEEE 0 NO_COMPU_METHOD -3.402823466e+38 3.402823466e+38 SYMBOL_LINK "Rte_CalprmRom_CalRegn02Inin00GroupB_DEFAULT_RTE_CALPRM_GROUP.EotProtnExitStLpFilFrq_Val" 0 DISPLAY_IDENTIFIER EotProtn.CalibrationPorts.EotProtnExitStLpFilFrq.Val /end CHARACTERISTIC
/begin CHARACTERISTIC EotProtn.EotProtnHwAgGain.Val "MICROSAR RTE" VALUE 0x0 RTE_RL_FLOAT32_IEEE 0 NO_COMPU_METHOD -3.402823466e+38 3.402823466e+38 SYMBOL_LINK "Rte_CalprmRom_CalRegn02Inin00GroupB_DEFAULT_RTE_CALPRM_GROUP.EotProtnHwAgGain_Val" 0 DISPLAY_IDENTIFIER EotProtn.CalibrationPorts.EotProtnHwAgGain.Val /end CHARACTERISTIC
/begin CHARACTERISTIC EotProtn.EotProtnHwAgMax.Val "MICROSAR RTE" VALUE 0x0 RTE_RL_FLOAT32_IEEE 0 NO_COMPU_METHOD -3.402823466e+38 3.402823466e+38 SYMBOL_LINK "Rte_CalprmRom_CalRegn02Inin00GroupB_DEFAULT_RTE_CALPRM_GROUP.EotProtnHwAgMax_Val" 0 DISPLAY_IDENTIFIER EotProtn.CalibrationPorts.EotProtnHwAgMax.Val /end CHARACTERISTIC
/begin CHARACTERISTIC EotProtn.EotProtnHwAgMin.Val "MICROSAR RTE" VALUE 0x0 RTE_RL_FLOAT32_IEEE 0 NO_COMPU_METHOD -3.402823466e+38 3.402823466e+38 SYMBOL_LINK "Rte_CalprmRom_CalRegn02Inin00GroupB_DEFAULT_RTE_CALPRM_GROUP.EotProtnHwAgMin_Val" 0 DISPLAY_IDENTIFIER EotProtn.CalibrationPorts.EotProtnHwAgMin.Val /end CHARACTERISTIC
/begin CHARACTERISTIC EotProtn.EotProtnHwDegDampgX.Ary2D "MICROSAR RTE" VAL_BLK 0x0 RTE_RL_UWORD 0 NO_COMPU_METHOD 0 65535 MATRIX_DIM 2 4 1 SYMBOL_LINK "Rte_CalprmRom_CalRegn02Inin00GroupB_DEFAULT_RTE_CALPRM_GROUP.EotProtnHwDegDampgX_Ary2D" 0 DISPLAY_IDENTIFIER EotProtn.CalibrationPorts.EotProtnHwDegDampgX.Ary2D /end CHARACTERISTIC
/begin CHARACTERISTIC EotProtn.EotProtnHwTqLpFilFrq.Val "MICROSAR RTE" VALUE 0x0 RTE_RL_FLOAT32_IEEE 0 NO_COMPU_METHOD -3.402823466e+38 3.402823466e+38 SYMBOL_LINK "Rte_CalprmRom_CalRegn02Inin00GroupB_DEFAULT_RTE_CALPRM_GROUP.EotProtnHwTqLpFilFrq_Val" 0 DISPLAY_IDENTIFIER EotProtn.CalibrationPorts.EotProtnHwTqLpFilFrq.Val /end CHARACTERISTIC
/begin CHARACTERISTIC EotProtn.EotProtnHwTqScaX.Ary1D "MICROSAR RTE" VAL_BLK 0x0 RTE_RL_UWORD 0 NO_COMPU_METHOD 0 65535 MATRIX_DIM 2 1 1 SYMBOL_LINK "Rte_CalprmRom_CalRegn02Inin00GroupB_DEFAULT_RTE_CALPRM_GROUP.EotProtnHwTqScaX_Ary1D" 0 DISPLAY_IDENTIFIER EotProtn.CalibrationPorts.EotProtnHwTqScaX.Ary1D /end CHARACTERISTIC
/begin CHARACTERISTIC EotProtn.EotProtnLoAuthyEntrGainY.Ary2D "MICROSAR RTE" VAL_BLK 0x0 RTE_RL_UWORD 0 NO_COMPU_METHOD 0 65535 MATRIX_DIM 4 5 1 SYMBOL_LINK "Rte_CalprmRom_CalRegn02Rt00GroupB_DEFAULT_RTE_CALPRM_GROUP.EotProtnLoAuthyEntrGainY_Ary2D" 0 DISPLAY_IDENTIFIER EotProtn.CalibrationPorts.EotProtnLoAuthyEntrGainY.Ary2D /end CHARACTERISTIC
/begin CHARACTERISTIC EotProtn.EotProtnMotSpdIncptSca.Val "MICROSAR RTE" VALUE 0x0 RTE_RL_FLOAT32_IEEE 0 NO_COMPU_METHOD -3.402823466e+38 3.402823466e+38 SYMBOL_LINK "Rte_CalprmRom_CalRegn02Inin00GroupB_DEFAULT_RTE_CALPRM_GROUP.EotProtnMotSpdIncptSca_Val" 0 DISPLAY_IDENTIFIER EotProtn.CalibrationPorts.EotProtnMotSpdIncptSca.Val /end CHARACTERISTIC
/begin CHARACTERISTIC EotProtn.EotProtnMotSpdIncptX.Ary1D "MICROSAR RTE" VAL_BLK 0x0 RTE_RL_UWORD 0 NO_COMPU_METHOD 0 65535 MATRIX_DIM 2 1 1 SYMBOL_LINK "Rte_CalprmRom_CalRegn02Inin00GroupB_DEFAULT_RTE_CALPRM_GROUP.EotProtnMotSpdIncptX_Ary1D" 0 DISPLAY_IDENTIFIER EotProtn.CalibrationPorts.EotProtnMotSpdIncptX.Ary1D /end CHARACTERISTIC
/begin CHARACTERISTIC EotProtn.EotProtnMotSpdIncptY.Ary1D "MICROSAR RTE" VAL_BLK 0x0 RTE_RL_UWORD 0 NO_COMPU_METHOD 0 65535 MATRIX_DIM 2 1 1 SYMBOL_LINK "Rte_CalprmRom_CalRegn02Rt00GroupB_DEFAULT_RTE_CALPRM_GROUP.EotProtnMotSpdIncptY_Ary1D" 0 DISPLAY_IDENTIFIER EotProtn.CalibrationPorts.EotProtnMotSpdIncptY.Ary1D /end CHARACTERISTIC
/begin CHARACTERISTIC EotProtn.EotProtnMotVelGain.Val "MICROSAR RTE" VALUE 0x0 RTE_RL_FLOAT32_IEEE 0 NO_COMPU_METHOD -3.402823466e+38 3.402823466e+38 SYMBOL_LINK "Rte_CalprmRom_CalRegn02Inin00GroupB_DEFAULT_RTE_CALPRM_GROUP.EotProtnMotVelGain_Val" 0 DISPLAY_IDENTIFIER EotProtn.CalibrationPorts.EotProtnMotVelGain.Val /end CHARACTERISTIC
/begin CHARACTERISTIC EotProtn.EotProtnNormDampgY.Ary2D "MICROSAR RTE" VAL_BLK 0x0 RTE_RL_UWORD 0 NO_COMPU_METHOD 0 65535 MATRIX_DIM 2 4 1 SYMBOL_LINK "Rte_CalprmRom_CalRegn02Rt00GroupB_DEFAULT_RTE_CALPRM_GROUP.EotProtnNormDampgY_Ary2D" 0 DISPLAY_IDENTIFIER EotProtn.CalibrationPorts.EotProtnNormDampgY.Ary2D /end CHARACTERISTIC
/begin CHARACTERISTIC EotProtn.EotProtnPosnRampStep.Val "MICROSAR RTE" VALUE 0x0 RTE_RL_FLOAT32_IEEE 0 NO_COMPU_METHOD -3.402823466e+38 3.402823466e+38 SYMBOL_LINK "Rte_CalprmRom_CalRegn02Inin00GroupB_DEFAULT_RTE_CALPRM_GROUP.EotProtnPosnRampStep_Val" 0 DISPLAY_IDENTIFIER EotProtn.CalibrationPorts.EotProtnPosnRampStep.Val /end CHARACTERISTIC
/begin CHARACTERISTIC EotProtn.EotProtnRackTrvlLimrAuthyThd.Val "MICROSAR RTE" VALUE 0x0 RTE_RL_FLOAT32_IEEE 0 NO_COMPU_METHOD -3.402823466e+38 3.402823466e+38 SYMBOL_LINK "Rte_CalprmRom_CalRegn02Inin00GroupB_DEFAULT_RTE_CALPRM_GROUP.EotProtnRackTrvlLimrAuthyThd_Val" 0 DISPLAY_IDENTIFIER EotProtn.CalibrationPorts.EotProtnRackTrvlLimrAuthyThd.Val /end CHARACTERISTIC
/begin CHARACTERISTIC EotProtn.EotProtnRackTrvlLimrAuthyThdLimd.Val "MICROSAR RTE" VALUE 0x0 RTE_RL_FLOAT32_IEEE 0 NO_COMPU_METHOD -3.402823466e+38 3.402823466e+38 SYMBOL_LINK "Rte_CalprmRom_CalRegn02Inin00GroupB_DEFAULT_RTE_CALPRM_GROUP.EotProtnRackTrvlLimrAuthyThdLimd_Val" 0 DISPLAY_IDENTIFIER EotProtn.CalibrationPorts.EotProtnRackTrvlLimrAuthyThdLimd.Val /end CHARACTERISTIC
/begin CHARACTERISTIC EotProtn.EotProtnRackTrvlLimrEna.Logl "MICROSAR RTE" VALUE 0x0 RTE_RL_BOOLEAN 0 RTE_CM_BOOLEAN 0 255 SYMBOL_LINK "Rte_CalprmRom_CalRegn02Inin00GroupB_DEFAULT_RTE_CALPRM_GROUP.EotProtnRackTrvlLimrEna_Logl" 0 DISPLAY_IDENTIFIER EotProtn.CalibrationPorts.EotProtnRackTrvlLimrEna.Logl /end CHARACTERISTIC
/begin CHARACTERISTIC EotProtn.EotProtnRackTrvlLimrRng.Val "MICROSAR RTE" VALUE 0x0 RTE_RL_FLOAT32_IEEE 0 NO_COMPU_METHOD -3.402823466e+38 3.402823466e+38 SYMBOL_LINK "Rte_CalprmRom_CalRegn02Inin00GroupB_DEFAULT_RTE_CALPRM_GROUP.EotProtnRackTrvlLimrRng_Val" 0 DISPLAY_IDENTIFIER EotProtn.CalibrationPorts.EotProtnRackTrvlLimrRng.Val /end CHARACTERISTIC
/begin CHARACTERISTIC EotProtn.EotProtnRackTrvlLimrRngLimd.Val "MICROSAR RTE" VALUE 0x0 RTE_RL_FLOAT32_IEEE 0 NO_COMPU_METHOD -3.402823466e+38 3.402823466e+38 SYMBOL_LINK "Rte_CalprmRom_CalRegn02Inin00GroupB_DEFAULT_RTE_CALPRM_GROUP.EotProtnRackTrvlLimrRngLimd_Val" 0 DISPLAY_IDENTIFIER EotProtn.CalibrationPorts.EotProtnRackTrvlLimrRngLimd.Val /end CHARACTERISTIC
/begin CHARACTERISTIC EotProtn.EotProtnRackTrvlLimrVehSpdThd.Val "MICROSAR RTE" VALUE 0x0 RTE_RL_FLOAT32_IEEE 0 NO_COMPU_METHOD -3.402823466e+38 3.402823466e+38 SYMBOL_LINK "Rte_CalprmRom_CalRegn02Inin00GroupB_DEFAULT_RTE_CALPRM_GROUP.EotProtnRackTrvlLimrVehSpdThd_Val" 0 DISPLAY_IDENTIFIER EotProtn.CalibrationPorts.EotProtnRackTrvlLimrVehSpdThd.Val /end CHARACTERISTIC
/begin CHARACTERISTIC EotProtn.EotProtnRunEotVelImpctAndSoftEndStop.Logl "MICROSAR RTE" VALUE 0x0 RTE_RL_BOOLEAN 0 RTE_CM_BOOLEAN 0 255 SYMBOL_LINK "Rte_CalprmRom_CalRegn02Inin00GroupB_DEFAULT_RTE_CALPRM_GROUP.EotProtnRunEotVelImpctAndSoftEndStop_Logl" 0 DISPLAY_IDENTIFIER EotProtn.CalibrationPorts.EotProtnRunEotVelImpctAndSoftEndStop.Logl /end CHARACTERISTIC
/begin CHARACTERISTIC EotProtn.EotProtnSoftEndStopAuthyThd.Val "MICROSAR RTE" VALUE 0x0 RTE_RL_FLOAT32_IEEE 0 NO_COMPU_METHOD -3.402823466e+38 3.402823466e+38 SYMBOL_LINK "Rte_CalprmRom_CalRegn02Rt00GroupB_DEFAULT_RTE_CALPRM_GROUP.EotProtnSoftEndStopAuthyThd_Val" 0 DISPLAY_IDENTIFIER EotProtn.CalibrationPorts.EotProtnSoftEndStopAuthyThd.Val /end CHARACTERISTIC
/begin CHARACTERISTIC EotProtn.EotProtnSoftEndStopEna.Logl "MICROSAR RTE" VALUE 0x0 RTE_RL_BOOLEAN 0 RTE_CM_BOOLEAN 0 255 SYMBOL_LINK "Rte_CalprmRom_CalRegn02Inin00GroupB_DEFAULT_RTE_CALPRM_GROUP.EotProtnSoftEndStopEna_Logl" 0 DISPLAY_IDENTIFIER EotProtn.CalibrationPorts.EotProtnSoftEndStopEna.Logl /end CHARACTERISTIC
/begin CHARACTERISTIC EotProtn.EotProtnSoftEndStopVehSpdThd.Val "MICROSAR RTE" VALUE 0x0 RTE_RL_FLOAT32_IEEE 0 NO_COMPU_METHOD -3.402823466e+38 3.402823466e+38 SYMBOL_LINK "Rte_CalprmRom_CalRegn02Inin00GroupB_DEFAULT_RTE_CALPRM_GROUP.EotProtnSoftEndStopVehSpdThd_Val" 0 DISPLAY_IDENTIFIER EotProtn.CalibrationPorts.EotProtnSoftEndStopVehSpdThd.Val /end CHARACTERISTIC
/begin CHARACTERISTIC EotProtnFwl.EotProtnFwlActvCmdLowrBnd.Ary1D "MICROSAR RTE" VAL_BLK 0x0 RTE_RL_SWORD 0 NO_COMPU_METHOD -32768 32767 MATRIX_DIM 4 1 1 SYMBOL_LINK "Rte_CalprmRom_CalRegn02Inin00GroupB_DEFAULT_RTE_CALPRM_GROUP.EotProtnFwlActvCmdLowrBnd_Ary1D" 0 DISPLAY_IDENTIFIER EotProtnFwl.CalibrationPorts.EotProtnFwlActvCmdLowrBnd.Ary1D /end CHARACTERISTIC
/begin CHARACTERISTIC EotProtnFwl.EotProtnFwlActvCmdUpprBnd.Ary1D "MICROSAR RTE" VAL_BLK 0x0 RTE_RL_SWORD 0 NO_COMPU_METHOD -32768 32767 MATRIX_DIM 4 1 1 SYMBOL_LINK "Rte_CalprmRom_CalRegn02Inin00GroupB_DEFAULT_RTE_CALPRM_GROUP.EotProtnFwlActvCmdUpprBnd_Ary1D" 0 DISPLAY_IDENTIFIER EotProtnFwl.CalibrationPorts.EotProtnFwlActvCmdUpprBnd.Ary1D /end CHARACTERISTIC
/begin CHARACTERISTIC EotProtnFwl.EotProtnFwlEotDampgActvBndX.Ary1D "MICROSAR RTE" VAL_BLK 0x0 RTE_RL_SWORD 0 NO_COMPU_METHOD -32768 32767 MATRIX_DIM 5 1 1 SYMBOL_LINK "Rte_CalprmRom_CalRegn02CmnGroupB_DEFAULT_RTE_CALPRM_GROUP.EotProtnFwlEotDampgActvBndX_Ary1D" 0 DISPLAY_IDENTIFIER EotProtnFwl.CalibrationPorts.EotProtnFwlEotDampgActvBndX.Ary1D /end CHARACTERISTIC
/begin CHARACTERISTIC EotProtnFwl.EotProtnFwlEotDampgActvBndY.Ary2D "MICROSAR RTE" VAL_BLK 0x0 RTE_RL_SWORD 0 NO_COMPU_METHOD -32768 32767 MATRIX_DIM 5 4 1 SYMBOL_LINK "Rte_CalprmRom_CalRegn02Inin00GroupB_DEFAULT_RTE_CALPRM_GROUP.EotProtnFwlEotDampgActvBndY_Ary2D" 0 DISPLAY_IDENTIFIER EotProtnFwl.CalibrationPorts.EotProtnFwlEotDampgActvBndY.Ary2D /end CHARACTERISTIC
/begin CHARACTERISTIC EotProtnFwl.EotProtnFwlInactvLim.Val "MICROSAR RTE" VALUE 0x0 RTE_RL_FLOAT32_IEEE 0 NO_COMPU_METHOD -3.402823466e+38 3.402823466e+38 SYMBOL_LINK "Rte_CalprmRom_CalRegn02CmnGroupB_DEFAULT_RTE_CALPRM_GROUP.EotProtnFwlInactvLim_Val" 0 DISPLAY_IDENTIFIER EotProtnFwl.CalibrationPorts.EotProtnFwlInactvLim.Val /end CHARACTERISTIC
/begin CHARACTERISTIC EotProtnFwl.EotProtnFwlVehSpd.Ary1D "MICROSAR RTE" VAL_BLK 0x0 RTE_RL_UWORD 0 NO_COMPU_METHOD 0 65535 MATRIX_DIM 4 1 1 SYMBOL_LINK "Rte_CalprmRom_CalRegn02CmnGroupB_DEFAULT_RTE_CALPRM_GROUP.EotProtnFwlVehSpd_Ary1D" 0 DISPLAY_IDENTIFIER EotProtnFwl.CalibrationPorts.EotProtnFwlVehSpd.Ary1D /end CHARACTERISTIC
/begin CHARACTERISTIC EotProtnFwl.EotProtnHwAgMin.Val "MICROSAR RTE" VALUE 0x0 RTE_RL_FLOAT32_IEEE 0 NO_COMPU_METHOD -3.402823466e+38 3.402823466e+38 SYMBOL_LINK "Rte_CalprmRom_CalRegn02Inin00GroupB_DEFAULT_RTE_CALPRM_GROUP.EotProtnHwAgMin_Val" 0 DISPLAY_IDENTIFIER EotProtnFwl.CalibrationPorts.EotProtnHwAgMin.Val /end CHARACTERISTIC
/begin CHARACTERISTIC EotProtnFwl.EotProtnHwDegDampgX.Ary2D "MICROSAR RTE" VAL_BLK 0x0 RTE_RL_UWORD 0 NO_COMPU_METHOD 0 65535 MATRIX_DIM 2 4 1 SYMBOL_LINK "Rte_CalprmRom_CalRegn02Inin00GroupB_DEFAULT_RTE_CALPRM_GROUP.EotProtnHwDegDampgX_Ary2D" 0 DISPLAY_IDENTIFIER EotProtnFwl.CalibrationPorts.EotProtnHwDegDampgX.Ary2D /end CHARACTERISTIC
/begin CHARACTERISTIC EotProtnFwl.EotProtnRackTrvlLimrRng.Val "MICROSAR RTE" VALUE 0x0 RTE_RL_FLOAT32_IEEE 0 NO_COMPU_METHOD -3.402823466e+38 3.402823466e+38 SYMBOL_LINK "Rte_CalprmRom_CalRegn02Inin00GroupB_DEFAULT_RTE_CALPRM_GROUP.EotProtnRackTrvlLimrRng_Val" 0 DISPLAY_IDENTIFIER EotProtnFwl.CalibrationPorts.EotProtnRackTrvlLimrRng.Val /end CHARACTERISTIC
/begin CHARACTERISTIC EotProtnFwl.EotProtnSoftEndStopAuthyThd.Val "MICROSAR RTE" VALUE 0x0 RTE_RL_FLOAT32_IEEE 0 NO_COMPU_METHOD -3.402823466e+38 3.402823466e+38 SYMBOL_LINK "Rte_CalprmRom_CalRegn02Rt00GroupB_DEFAULT_RTE_CALPRM_GROUP.EotProtnSoftEndStopAuthyThd_Val" 0 DISPLAY_IDENTIFIER EotProtnFwl.CalibrationPorts.EotProtnSoftEndStopAuthyThd.Val /end CHARACTERISTIC
/begin MEASUREMENT DutyCycThermProtn.DiagcStsLimdTPrfmnc.Logl "MICROSAR RTE" UBYTE RTE_CM_BOOLEAN 0 0 0 255 ECU_ADDRESS 0 SYMBOL_LINK "Rte_EcuTMeas_DiagcStsLimdTPrfmnc_Logl" 0 DISPLAY_IDENTIFIER DutyCycThermProtn.ReceiverPorts.DiagcStsLimdTPrfmnc.Logl /end MEASUREMENT
/begin MEASUREMENT DutyCycThermProtn.DualEcuFltMtgtnEna.Logl "MICROSAR RTE" UBYTE RTE_CM_BOOLEAN 0 0 0 255 ECU_ADDRESS 0 SYMBOL_LINK "Rte_DualCtrlrOutpMgr_DualEcuFltMtgtnEna_Logl" 0 DISPLAY_IDENTIFIER DutyCycThermProtn.ReceiverPorts.DualEcuFltMtgtnEna.Logl /end MEASUREMENT
/begin MEASUREMENT DutyCycThermProtn.DutyCycThermProtnDi.Logl "MICROSAR RTE" UBYTE RTE_CM_BOOLEAN 0 0 0 255 ECU_ADDRESS 0 SYMBOL_LINK "Rte_CmnMfgSrv_DutyCycThermProtnDi_Logl" 0 DISPLAY_IDENTIFIER DutyCycThermProtn.ReceiverPorts.DutyCycThermProtnDi.Logl /end MEASUREMENT
/begin MEASUREMENT DutyCycThermProtn.DutyCycThermProtnMaxOutp.Val "MICROSAR RTE" UWORD NO_COMPU_METHOD 0 0 0 65535 ECU_ADDRESS 0 SYMBOL_LINK "Rte_DutyCycThermProtn_DutyCycThermProtnMaxOutp_Val" 0 DISPLAY_IDENTIFIER DutyCycThermProtn.SenderPorts.DutyCycThermProtnMaxOutp.Val /end MEASUREMENT
/begin MEASUREMENT DutyCycThermProtn.EcuTFild.Val "MICROSAR RTE" FLOAT32_IEEE NO_COMPU_METHOD 0 0 -3.402823466e+38 3.402823466e+38 ECU_ADDRESS 0 SYMBOL_LINK "Rte_EcuTMeas_EcuTFild_Val" 0 DISPLAY_IDENTIFIER DutyCycThermProtn.ReceiverPorts.EcuTFild.Val /end MEASUREMENT
/begin MEASUREMENT DutyCycThermProtn.FetLoaMtgtnEnaPrev "MICROSAR RTE" UBYTE RTE_CM_BOOLEAN 0 0 0 255 ECU_ADDRESS 0 SYMBOL_LINK "Rte_DutyCycThermProtn_FetLoaMtgtnEnaPrev" 0 DISPLAY_IDENTIFIER DutyCycThermProtn.PerInstanceMemories.FetLoaMtgtnEnaPrev /end MEASUREMENT
/begin MEASUREMENT DutyCycThermProtn.FetMtgtnEnaCalIdx "MICROSAR RTE" UBYTE NO_COMPU_METHOD 0 0 0 255 ECU_ADDRESS 0 SYMBOL_LINK "Rte_DutyCycThermProtn_FetMtgtnEnaCalIdx" 0 DISPLAY_IDENTIFIER DutyCycThermProtn.PerInstanceMemories.FetMtgtnEnaCalIdx /end MEASUREMENT
/begin MEASUREMENT DutyCycThermProtn.Fil1ValStVari.FilGain "MICROSAR RTE" FLOAT32_IEEE NO_COMPU_METHOD 0 0 -3.402823466e+38 3.402823466e+38 ECU_ADDRESS 0 SYMBOL_LINK "Rte_DutyCycThermProtn_Fil1ValStVari.FilGain" 0 DISPLAY_IDENTIFIER DutyCycThermProtn.PerInstanceMemories.Fil1ValStVari.FilGain /end MEASUREMENT
/begin MEASUREMENT DutyCycThermProtn.Fil1ValStVari.FilSt "MICROSAR RTE" FLOAT32_IEEE NO_COMPU_METHOD 0 0 -3.402823466e+38 3.402823466e+38 ECU_ADDRESS 0 SYMBOL_LINK "Rte_DutyCycThermProtn_Fil1ValStVari.FilSt" 0 DISPLAY_IDENTIFIER DutyCycThermProtn.PerInstanceMemories.Fil1ValStVari.FilSt /end MEASUREMENT
/begin MEASUREMENT DutyCycThermProtn.Fil2ValStVari.FilGain "MICROSAR RTE" FLOAT32_IEEE NO_COMPU_METHOD 0 0 -3.402823466e+38 3.402823466e+38 ECU_ADDRESS 0 SYMBOL_LINK "Rte_DutyCycThermProtn_Fil2ValStVari.FilGain" 0 DISPLAY_IDENTIFIER DutyCycThermProtn.PerInstanceMemories.Fil2ValStVari.FilGain /end MEASUREMENT
/begin MEASUREMENT DutyCycThermProtn.Fil2ValStVari.FilSt "MICROSAR RTE" FLOAT32_IEEE NO_COMPU_METHOD 0 0 -3.402823466e+38 3.402823466e+38 ECU_ADDRESS 0 SYMBOL_LINK "Rte_DutyCycThermProtn_Fil2ValStVari.FilSt" 0 DISPLAY_IDENTIFIER DutyCycThermProtn.PerInstanceMemories.Fil2ValStVari.FilSt /end MEASUREMENT
/begin MEASUREMENT DutyCycThermProtn.Fil3ValPwrUp "MICROSAR RTE" UBYTE NO_COMPU_METHOD 0 0 0 255 ECU_ADDRESS 0 SYMBOL_LINK "Rte_DutyCycThermProtn_Fil3ValPwrUp" 0 DISPLAY_IDENTIFIER DutyCycThermProtn.PerInstanceMemories.Fil3ValPwrUp /end MEASUREMENT
/begin MEASUREMENT DutyCycThermProtn.Fil4ValPwrUp "MICROSAR RTE" UBYTE NO_COMPU_METHOD 0 0 0 255 ECU_ADDRESS 0 SYMBOL_LINK "Rte_DutyCycThermProtn_Fil4ValPwrUp" 0 DISPLAY_IDENTIFIER DutyCycThermProtn.PerInstanceMemories.Fil4ValPwrUp /end MEASUREMENT
/begin MEASUREMENT DutyCycThermProtn.Fil5ValPwrUp "MICROSAR RTE" UBYTE NO_COMPU_METHOD 0 0 0 255 ECU_ADDRESS 0 SYMBOL_LINK "Rte_DutyCycThermProtn_Fil5ValPwrUp" 0 DISPLAY_IDENTIFIER DutyCycThermProtn.PerInstanceMemories.Fil5ValPwrUp /end MEASUREMENT
/begin MEASUREMENT DutyCycThermProtn.Fil6ValPwrUp "MICROSAR RTE" UBYTE NO_COMPU_METHOD 0 0 0 255 ECU_ADDRESS 0 SYMBOL_LINK "Rte_DutyCycThermProtn_Fil6ValPwrUp" 0 DISPLAY_IDENTIFIER DutyCycThermProtn.PerInstanceMemories.Fil6ValPwrUp /end MEASUREMENT
/begin MEASUREMENT DutyCycThermProtn.FilStVal.Fil3StVal "MICROSAR RTE" UBYTE NO_COMPU_METHOD 0 0 0 255 ECU_ADDRESS 0 SYMBOL_LINK "Rte_DutyCycThermProtn_FilStVal.Fil3StVal" 0 DISPLAY_IDENTIFIER DutyCycThermProtn.PerInstanceMemories.FilStVal.Fil3StVal /end MEASUREMENT
/begin MEASUREMENT DutyCycThermProtn.FilStVal.Fil4StVal "MICROSAR RTE" UBYTE NO_COMPU_METHOD 0 0 0 255 ECU_ADDRESS 0 SYMBOL_LINK "Rte_DutyCycThermProtn_FilStVal.Fil4StVal" 0 DISPLAY_IDENTIFIER DutyCycThermProtn.PerInstanceMemories.FilStVal.Fil4StVal /end MEASUREMENT
/begin MEASUREMENT DutyCycThermProtn.FilStVal.Fil5StVal "MICROSAR RTE" UBYTE NO_COMPU_METHOD 0 0 0 255 ECU_ADDRESS 0 SYMBOL_LINK "Rte_DutyCycThermProtn_FilStVal.Fil5StVal" 0 DISPLAY_IDENTIFIER DutyCycThermProtn.PerInstanceMemories.FilStVal.Fil5StVal /end MEASUREMENT
/begin MEASUREMENT DutyCycThermProtn.FilStVal.Fil6StVal "MICROSAR RTE" UBYTE NO_COMPU_METHOD 0 0 0 255 ECU_ADDRESS 0 SYMBOL_LINK "Rte_DutyCycThermProtn_FilStVal.Fil6StVal" 0 DISPLAY_IDENTIFIER DutyCycThermProtn.PerInstanceMemories.FilStVal.Fil6StVal /end MEASUREMENT
/begin MEASUREMENT DutyCycThermProtn.Fild3Val.FilGain "MICROSAR RTE" FLOAT32_IEEE NO_COMPU_METHOD 0 0 -3.402823466e+38 3.402823466e+38 ECU_ADDRESS 0 SYMBOL_LINK "Rte_DutyCycThermProtn_Fild3Val.FilGain" 0 DISPLAY_IDENTIFIER DutyCycThermProtn.PerInstanceMemories.Fild3Val.FilGain /end MEASUREMENT
/begin MEASUREMENT DutyCycThermProtn.Fild3Val.FilSt "MICROSAR RTE" FLOAT32_IEEE NO_COMPU_METHOD 0 0 -3.402823466e+38 3.402823466e+38 ECU_ADDRESS 0 SYMBOL_LINK "Rte_DutyCycThermProtn_Fild3Val.FilSt" 0 DISPLAY_IDENTIFIER DutyCycThermProtn.PerInstanceMemories.Fild3Val.FilSt /end MEASUREMENT
/begin MEASUREMENT DutyCycThermProtn.Fild4Val.FilGain "MICROSAR RTE" FLOAT32_IEEE NO_COMPU_METHOD 0 0 -3.402823466e+38 3.402823466e+38 ECU_ADDRESS 0 SYMBOL_LINK "Rte_DutyCycThermProtn_Fild4Val.FilGain" 0 DISPLAY_IDENTIFIER DutyCycThermProtn.PerInstanceMemories.Fild4Val.FilGain /end MEASUREMENT
/begin MEASUREMENT DutyCycThermProtn.Fild4Val.FilSt "MICROSAR RTE" FLOAT32_IEEE NO_COMPU_METHOD 0 0 -3.402823466e+38 3.402823466e+38 ECU_ADDRESS 0 SYMBOL_LINK "Rte_DutyCycThermProtn_Fild4Val.FilSt" 0 DISPLAY_IDENTIFIER DutyCycThermProtn.PerInstanceMemories.Fild4Val.FilSt /end MEASUREMENT
/begin MEASUREMENT DutyCycThermProtn.Fild5Val.FilGain "MICROSAR RTE" FLOAT32_IEEE NO_COMPU_METHOD 0 0 -3.402823466e+38 3.402823466e+38 ECU_ADDRESS 0 SYMBOL_LINK "Rte_DutyCycThermProtn_Fild5Val.FilGain" 0 DISPLAY_IDENTIFIER DutyCycThermProtn.PerInstanceMemories.Fild5Val.FilGain /end MEASUREMENT
/begin MEASUREMENT DutyCycThermProtn.Fild5Val.FilSt "MICROSAR RTE" FLOAT32_IEEE NO_COMPU_METHOD 0 0 -3.402823466e+38 3.402823466e+38 ECU_ADDRESS 0 SYMBOL_LINK "Rte_DutyCycThermProtn_Fild5Val.FilSt" 0 DISPLAY_IDENTIFIER DutyCycThermProtn.PerInstanceMemories.Fild5Val.FilSt /end MEASUREMENT
/begin MEASUREMENT DutyCycThermProtn.Fild6Val.FilGain "MICROSAR RTE" FLOAT32_IEEE NO_COMPU_METHOD 0 0 -3.402823466e+38 3.402823466e+38 ECU_ADDRESS 0 SYMBOL_LINK "Rte_DutyCycThermProtn_Fild6Val.FilGain" 0 DISPLAY_IDENTIFIER DutyCycThermProtn.PerInstanceMemories.Fild6Val.FilGain /end MEASUREMENT
/begin MEASUREMENT DutyCycThermProtn.Fild6Val.FilSt "MICROSAR RTE" FLOAT32_IEEE NO_COMPU_METHOD 0 0 -3.402823466e+38 3.402823466e+38 ECU_ADDRESS 0 SYMBOL_LINK "Rte_DutyCycThermProtn_Fild6Val.FilSt" 0 DISPLAY_IDENTIFIER DutyCycThermProtn.PerInstanceMemories.Fild6Val.FilSt /end MEASUREMENT
/begin MEASUREMENT DutyCycThermProtn.IgnTiOff.Val "MICROSAR RTE" ULONG NO_COMPU_METHOD 0 0 0 4294967295 ECU_ADDRESS 0 SYMBOL_LINK "Rte_DutyCycThermProtn_IgnTiOff_Val" 0 DISPLAY_IDENTIFIER DutyCycThermProtn.ReceiverPorts.IgnTiOff.Val /end MEASUREMENT
/begin MEASUREMENT DutyCycThermProtn.LstTblValRateLimrStVari "MICROSAR RTE" FLOAT32_IEEE NO_COMPU_METHOD 0 0 -3.402823466e+38 3.402823466e+38 ECU_ADDRESS 0 SYMBOL_LINK "Rte_DutyCycThermProtn_LstTblValRateLimrStVari" 0 DISPLAY_IDENTIFIER DutyCycThermProtn.PerInstanceMemories.LstTblValRateLimrStVari /end MEASUREMENT
/begin MEASUREMENT DutyCycThermProtn.MotAndThermProtnLoaMod.Val "MICROSAR RTE" UBYTE NO_COMPU_METHOD 0 0 0 255 ECU_ADDRESS 0 SYMBOL_LINK "Rte_LoaMgr_MotAndThermProtnLoaMod_Val" 0 DISPLAY_IDENTIFIER DutyCycThermProtn.ReceiverPorts.MotAndThermProtnLoaMod.Val /end MEASUREMENT
/begin MEASUREMENT DutyCycThermProtn.MotCurrPeakEstimd.Val "MICROSAR RTE" FLOAT32_IEEE NO_COMPU_METHOD 0 0 -3.402823466e+38 3.402823466e+38 ECU_ADDRESS 0 SYMBOL_LINK "Rte_MotCurrPeakEstimn_MotCurrPeakEstimd_Val" 0 DISPLAY_IDENTIFIER DutyCycThermProtn.ReceiverPorts.MotCurrPeakEstimd.Val /end MEASUREMENT
/begin MEASUREMENT DutyCycThermProtn.MotCurrPeakEstimdFild.Val "MICROSAR RTE" FLOAT32_IEEE NO_COMPU_METHOD 0 0 -3.402823466e+38 3.402823466e+38 ECU_ADDRESS 0 SYMBOL_LINK "Rte_MotCurrPeakEstimn_MotCurrPeakEstimdFild_Val" 0 DISPLAY_IDENTIFIER DutyCycThermProtn.ReceiverPorts.MotCurrPeakEstimdFild.Val /end MEASUREMENT
/begin MEASUREMENT DutyCycThermProtn.MotFetT.Val "MICROSAR RTE" FLOAT32_IEEE NO_COMPU_METHOD 0 0 -3.402823466e+38 3.402823466e+38 ECU_ADDRESS 0 SYMBOL_LINK "Rte_TEstimn_MotFetT_Val" 0 DISPLAY_IDENTIFIER DutyCycThermProtn.ReceiverPorts.MotFetT.Val /end MEASUREMENT
/begin MEASUREMENT DutyCycThermProtn.MotMagT.Val "MICROSAR RTE" FLOAT32_IEEE NO_COMPU_METHOD 0 0 -3.402823466e+38 3.402823466e+38 ECU_ADDRESS 0 SYMBOL_LINK "Rte_TEstimn_MotMagT_Val" 0 DISPLAY_IDENTIFIER DutyCycThermProtn.ReceiverPorts.MotMagT.Val /end MEASUREMENT
/begin MEASUREMENT DutyCycThermProtn.MotVelCrf.Val "MICROSAR RTE" FLOAT32_IEEE NO_COMPU_METHOD 0 0 -3.402823466e+38 3.402823466e+38 ECU_ADDRESS 0 SYMBOL_LINK "Rte_ImcSigArbn_MotVelCrfImcCorrd_Val" 0 DISPLAY_IDENTIFIER DutyCycThermProtn.ReceiverPorts.MotVelCrf.Val /end MEASUREMENT
/begin MEASUREMENT DutyCycThermProtn.MotWidgT.Val "MICROSAR RTE" FLOAT32_IEEE NO_COMPU_METHOD 0 0 -3.402823466e+38 3.402823466e+38 ECU_ADDRESS 0 SYMBOL_LINK "Rte_TEstimn_MotWidgT_Val" 0 DISPLAY_IDENTIFIER DutyCycThermProtn.ReceiverPorts.MotWidgT.Val /end MEASUREMENT
/begin MEASUREMENT DutyCycThermProtn.ReInitCntrFlg "MICROSAR RTE" UBYTE RTE_CM_BOOLEAN 0 0 0 255 ECU_ADDRESS 0 SYMBOL_LINK "Rte_DutyCycThermProtn_ReInitCntrFlg" 0 DISPLAY_IDENTIFIER DutyCycThermProtn.PerInstanceMemories.ReInitCntrFlg /end MEASUREMENT
/begin MEASUREMENT DutyCycThermProtn.ReInitCntrVal "MICROSAR RTE" FLOAT32_IEEE NO_COMPU_METHOD 0 0 -3.402823466e+38 3.402823466e+38 ECU_ADDRESS 0 SYMBOL_LINK "Rte_DutyCycThermProtn_ReInitCntrVal" 0 DISPLAY_IDENTIFIER DutyCycThermProtn.PerInstanceMemories.ReInitCntrVal /end MEASUREMENT
/begin MEASUREMENT DutyCycThermProtn.ThermDutyCycProtnLoadDptLim.Val "MICROSAR RTE" FLOAT32_IEEE NO_COMPU_METHOD 0 0 -3.402823466e+38 3.402823466e+38 ECU_ADDRESS 0 SYMBOL_LINK "Rte_DutyCycThermProtn_ThermDutyCycProtnLoadDptLim_Val" 0 DISPLAY_IDENTIFIER DutyCycThermProtn.SenderPorts.ThermDutyCycProtnLoadDptLim.Val /end MEASUREMENT
/begin MEASUREMENT DutyCycThermProtn.ThermDutyCycProtnTDptLim.Val "MICROSAR RTE" FLOAT32_IEEE NO_COMPU_METHOD 0 0 -3.402823466e+38 3.402823466e+38 ECU_ADDRESS 0 SYMBOL_LINK "Rte_DutyCycThermProtn_ThermDutyCycProtnTDptLim_Val" 0 DISPLAY_IDENTIFIER DutyCycThermProtn.SenderPorts.ThermDutyCycProtnTDptLim.Val /end MEASUREMENT
/begin MEASUREMENT DutyCycThermProtn.ThermLimSlowFilMax.Val "MICROSAR RTE" FLOAT32_IEEE NO_COMPU_METHOD 0 0 -3.402823466e+38 3.402823466e+38 ECU_ADDRESS 0 SYMBOL_LINK "Rte_DutyCycThermProtn_ThermLimSlowFilMax_Val" 0 DISPLAY_IDENTIFIER DutyCycThermProtn.SenderPorts.ThermLimSlowFilMax.Val /end MEASUREMENT
/begin MEASUREMENT DutyCycThermProtn.ThermMotTqLim.Val "MICROSAR RTE" FLOAT32_IEEE NO_COMPU_METHOD 0 0 -3.402823466e+38 3.402823466e+38 ECU_ADDRESS 0 SYMBOL_LINK "Rte_DutyCycThermProtn_ThermMotTqLim_Val" 0 DISPLAY_IDENTIFIER DutyCycThermProtn.SenderPorts.ThermMotTqLim.Val /end MEASUREMENT
/begin MEASUREMENT DutyCycThermProtn.ThermRednFac.Val "MICROSAR RTE" FLOAT32_IEEE NO_COMPU_METHOD 0 0 -3.402823466e+38 3.402823466e+38 ECU_ADDRESS 0 SYMBOL_LINK "Rte_DutyCycThermProtn_ThermRednFac_Val" 0 DISPLAY_IDENTIFIER DutyCycThermProtn.SenderPorts.ThermRednFac.Val /end MEASUREMENT
/begin MEASUREMENT DutyCycThermProtn.VehTiVld.Logl "MICROSAR RTE" UBYTE RTE_CM_BOOLEAN 0 0 0 255 ECU_ADDRESS 0 SYMBOL_LINK "Rte_DutyCycThermProtn_VehTiVld_Logl" 0 DISPLAY_IDENTIFIER DutyCycThermProtn.ReceiverPorts.VehTiVld.Logl /end MEASUREMENT
/begin MEASUREMENT DutyCycThermProtn.dDutyCycThermProtnAbsltCtrlrTTqLim "MICROSAR RTE" FLOAT32_IEEE NO_COMPU_METHOD 0 0 -3.402823466e+38 3.402823466e+38 ECU_ADDRESS 0 SYMBOL_LINK "Rte_DutyCycThermProtn_dDutyCycThermProtnAbsltCtrlrTTqLim" 0 DISPLAY_IDENTIFIER DutyCycThermProtn.PerInstanceMemories.dDutyCycThermProtnAbsltCtrlrTTqLim /end MEASUREMENT
/begin MEASUREMENT DutyCycThermProtn.dDutyCycThermProtnAbsltCuTTqLim "MICROSAR RTE" FLOAT32_IEEE NO_COMPU_METHOD 0 0 -3.402823466e+38 3.402823466e+38 ECU_ADDRESS 0 SYMBOL_LINK "Rte_DutyCycThermProtn_dDutyCycThermProtnAbsltCuTTqLim" 0 DISPLAY_IDENTIFIER DutyCycThermProtn.PerInstanceMemories.dDutyCycThermProtnAbsltCuTTqLim /end MEASUREMENT
/begin MEASUREMENT DutyCycThermProtn.dDutyCycThermProtnAbsltTTqLim "MICROSAR RTE" FLOAT32_IEEE NO_COMPU_METHOD 0 0 -3.402823466e+38 3.402823466e+38 ECU_ADDRESS 0 SYMBOL_LINK "Rte_DutyCycThermProtn_dDutyCycThermProtnAbsltTTqLim" 0 DISPLAY_IDENTIFIER DutyCycThermProtn.PerInstanceMemories.dDutyCycThermProtnAbsltTTqLim /end MEASUREMENT
/begin MEASUREMENT DutyCycThermProtn.dDutyCycThermProtnLstTblVal "MICROSAR RTE" UWORD NO_COMPU_METHOD 0 0 0 65535 ECU_ADDRESS 0 SYMBOL_LINK "Rte_DutyCycThermProtn_dDutyCycThermProtnLstTblVal" 0 DISPLAY_IDENTIFIER DutyCycThermProtn.PerInstanceMemories.dDutyCycThermProtnLstTblVal /end MEASUREMENT
/begin MEASUREMENT DutyCycThermProtn.dDutyCycThermProtnLstTblValSlew "MICROSAR RTE" UWORD NO_COMPU_METHOD 0 0 0 65535 ECU_ADDRESS 0 SYMBOL_LINK "Rte_DutyCycThermProtn_dDutyCycThermProtnLstTblValSlew" 0 DISPLAY_IDENTIFIER DutyCycThermProtn.PerInstanceMemories.dDutyCycThermProtnLstTblValSlew /end MEASUREMENT
/begin MEASUREMENT DutyCycThermProtn.dDutyCycThermProtnMplr1 "MICROSAR RTE" UWORD NO_COMPU_METHOD 0 0 0 65535 ECU_ADDRESS 0 SYMBOL_LINK "Rte_DutyCycThermProtn_dDutyCycThermProtnMplr1" 0 DISPLAY_IDENTIFIER DutyCycThermProtn.PerInstanceMemories.dDutyCycThermProtnMplr1 /end MEASUREMENT
/begin MEASUREMENT DutyCycThermProtn.dDutyCycThermProtnMplr12T "MICROSAR RTE" FLOAT32_IEEE NO_COMPU_METHOD 0 0 -3.402823466e+38 3.402823466e+38 ECU_ADDRESS 0 SYMBOL_LINK "Rte_DutyCycThermProtn_dDutyCycThermProtnMplr12T" 0 DISPLAY_IDENTIFIER DutyCycThermProtn.PerInstanceMemories.dDutyCycThermProtnMplr12T /end MEASUREMENT
/begin MEASUREMENT DutyCycThermProtn.dDutyCycThermProtnMplr2 "MICROSAR RTE" UWORD NO_COMPU_METHOD 0 0 0 65535 ECU_ADDRESS 0 SYMBOL_LINK "Rte_DutyCycThermProtn_dDutyCycThermProtnMplr2" 0 DISPLAY_IDENTIFIER DutyCycThermProtn.PerInstanceMemories.dDutyCycThermProtnMplr2 /end MEASUREMENT
/begin MEASUREMENT DutyCycThermProtn.dDutyCycThermProtnMplr3 "MICROSAR RTE" UWORD NO_COMPU_METHOD 0 0 0 65535 ECU_ADDRESS 0 SYMBOL_LINK "Rte_DutyCycThermProtn_dDutyCycThermProtnMplr3" 0 DISPLAY_IDENTIFIER DutyCycThermProtn.PerInstanceMemories.dDutyCycThermProtnMplr3 /end MEASUREMENT
/begin MEASUREMENT DutyCycThermProtn.dDutyCycThermProtnMplr36T "MICROSAR RTE" FLOAT32_IEEE NO_COMPU_METHOD 0 0 -3.402823466e+38 3.402823466e+38 ECU_ADDRESS 0 SYMBOL_LINK "Rte_DutyCycThermProtn_dDutyCycThermProtnMplr36T" 0 DISPLAY_IDENTIFIER DutyCycThermProtn.PerInstanceMemories.dDutyCycThermProtnMplr36T /end MEASUREMENT
/begin MEASUREMENT DutyCycThermProtn.dDutyCycThermProtnMplr4 "MICROSAR RTE" UWORD NO_COMPU_METHOD 0 0 0 65535 ECU_ADDRESS 0 SYMBOL_LINK "Rte_DutyCycThermProtn_dDutyCycThermProtnMplr4" 0 DISPLAY_IDENTIFIER DutyCycThermProtn.PerInstanceMemories.dDutyCycThermProtnMplr4 /end MEASUREMENT
/begin MEASUREMENT DutyCycThermProtn.dDutyCycThermProtnMplr5 "MICROSAR RTE" UWORD NO_COMPU_METHOD 0 0 0 65535 ECU_ADDRESS 0 SYMBOL_LINK "Rte_DutyCycThermProtn_dDutyCycThermProtnMplr5" 0 DISPLAY_IDENTIFIER DutyCycThermProtn.PerInstanceMemories.dDutyCycThermProtnMplr5 /end MEASUREMENT
/begin MEASUREMENT DutyCycThermProtn.dDutyCycThermProtnMplr6 "MICROSAR RTE" UWORD NO_COMPU_METHOD 0 0 0 65535 ECU_ADDRESS 0 SYMBOL_LINK "Rte_DutyCycThermProtn_dDutyCycThermProtnMplr6" 0 DISPLAY_IDENTIFIER DutyCycThermProtn.PerInstanceMemories.dDutyCycThermProtnMplr6 /end MEASUREMENT
/begin MEASUREMENT DutyCycThermProtn.dDutyCycThermProtnThermLoadLim "MICROSAR RTE" FLOAT32_IEEE NO_COMPU_METHOD 0 0 -3.402823466e+38 3.402823466e+38 ECU_ADDRESS 0 SYMBOL_LINK "Rte_DutyCycThermProtn_dDutyCycThermProtnThermLoadLim" 0 DISPLAY_IDENTIFIER DutyCycThermProtn.PerInstanceMemories.dDutyCycThermProtnThermLoadLim /end MEASUREMENT
/begin MEASUREMENT DutyCycThermProtn.dDutyCycThermProtnThermLoadLimTblYVal "MICROSAR RTE" FLOAT32_IEEE NO_COMPU_METHOD 0 0 -3.402823466e+38 3.402823466e+38 ECU_ADDRESS 0 SYMBOL_LINK "Rte_DutyCycThermProtn_dDutyCycThermProtnThermLoadLimTblYVal" 0 DISPLAY_IDENTIFIER DutyCycThermProtn.PerInstanceMemories.dDutyCycThermProtnThermLoadLimTblYVal /end MEASUREMENT
/begin MEASUREMENT EcuTMeas.DiagcStsLimdTPrfmnc.Logl "MICROSAR RTE" UBYTE RTE_CM_BOOLEAN 0 0 0 255 ECU_ADDRESS 0 SYMBOL_LINK "Rte_EcuTMeas_DiagcStsLimdTPrfmnc_Logl" 0 DISPLAY_IDENTIFIER EcuTMeas.SenderPorts.DiagcStsLimdTPrfmnc.Logl /end MEASUREMENT
/begin MEASUREMENT EcuTMeas.EcuT.Val "MICROSAR RTE" FLOAT32_IEEE NO_COMPU_METHOD 0 0 -3.402823466e+38 3.402823466e+38 ECU_ADDRESS 0 SYMBOL_LINK "Rte_CDD_FordT3T6McuCfg_EcuT_Val" 0 DISPLAY_IDENTIFIER EcuTMeas.ReceiverPorts.EcuT.Val /end MEASUREMENT
/begin MEASUREMENT EcuTMeas.EcuTAdcFaild.Logl "MICROSAR RTE" UBYTE RTE_CM_BOOLEAN 0 0 0 255 ECU_ADDRESS 0 SYMBOL_LINK "Rte_CDD_FordT3T6McuCfg_EcuTAdcFaild_Logl" 0 DISPLAY_IDENTIFIER EcuTMeas.ReceiverPorts.EcuTAdcFaild.Logl /end MEASUREMENT
/begin MEASUREMENT EcuTMeas.EcuTFilStVari.FilGain "MICROSAR RTE" FLOAT32_IEEE NO_COMPU_METHOD 0 0 -3.402823466e+38 3.402823466e+38 ECU_ADDRESS 0 SYMBOL_LINK "Rte_EcuTMeas_EcuTFilStVari.FilGain" 0 DISPLAY_IDENTIFIER EcuTMeas.PerInstanceMemories.EcuTFilStVari.FilGain /end MEASUREMENT
/begin MEASUREMENT EcuTMeas.EcuTFilStVari.FilSt "MICROSAR RTE" FLOAT32_IEEE NO_COMPU_METHOD 0 0 -3.402823466e+38 3.402823466e+38 ECU_ADDRESS 0 SYMBOL_LINK "Rte_EcuTMeas_EcuTFilStVari.FilSt" 0 DISPLAY_IDENTIFIER EcuTMeas.PerInstanceMemories.EcuTFilStVari.FilSt /end MEASUREMENT
/begin MEASUREMENT EcuTMeas.EcuTFild.Val "MICROSAR RTE" FLOAT32_IEEE NO_COMPU_METHOD 0 0 -3.402823466e+38 3.402823466e+38 ECU_ADDRESS 0 SYMBOL_LINK "Rte_EcuTMeas_EcuTFild_Val" 0 DISPLAY_IDENTIFIER EcuTMeas.SenderPorts.EcuTFild.Val /end MEASUREMENT
/begin MEASUREMENT EcuTMeas.dEcuTMeasEcuTCalcd "MICROSAR RTE" FLOAT32_IEEE NO_COMPU_METHOD 0 0 -3.402823466e+38 3.402823466e+38 ECU_ADDRESS 0 SYMBOL_LINK "Rte_EcuTMeas_dEcuTMeasEcuTCalcd" 0 DISPLAY_IDENTIFIER EcuTMeas.PerInstanceMemories.dEcuTMeasEcuTCalcd /end MEASUREMENT
/begin MEASUREMENT ElecPwrCns.BrdgVltg.Val "MICROSAR RTE" FLOAT32_IEEE NO_COMPU_METHOD 0 0 -3.402823466e+38 3.402823466e+38 ECU_ADDRESS 0 SYMBOL_LINK "Rte_BattVltg_BrdgVltg_Val" 0 DISPLAY_IDENTIFIER ElecPwrCns.ReceiverPorts.BrdgVltg.Val /end MEASUREMENT
/begin MEASUREMENT ElecPwrCns.ElecInpPwrEstim.Val "MICROSAR RTE" FLOAT32_IEEE NO_COMPU_METHOD 0 0 -3.402823466e+38 3.402823466e+38 ECU_ADDRESS 0 SYMBOL_LINK "Rte_ElecPwrCns_ElecInpPwrEstim_Val" 0 DISPLAY_IDENTIFIER ElecPwrCns.SenderPorts.ElecInpPwrEstim.Val /end MEASUREMENT
/begin MEASUREMENT ElecPwrCns.MotAndThermProtnLoaMod.Val "MICROSAR RTE" UBYTE NO_COMPU_METHOD 0 0 0 255 ECU_ADDRESS 0 SYMBOL_LINK "Rte_LoaMgr_MotAndThermProtnLoaMod_Val" 0 DISPLAY_IDENTIFIER ElecPwrCns.ReceiverPorts.MotAndThermProtnLoaMod.Val /end MEASUREMENT
/begin MEASUREMENT ElecPwrCns.MotCurrDax.Val "MICROSAR RTE" FLOAT32_IEEE NO_COMPU_METHOD 0 0 -3.402823466e+38 3.402823466e+38 ECU_ADDRESS 0 SYMBOL_LINK "Rte_CDD_MotCtrlMgr_MotCurrDax_Val" 0 DISPLAY_IDENTIFIER ElecPwrCns.ReceiverPorts.MotCurrDax.Val /end MEASUREMENT
/begin MEASUREMENT ElecPwrCns.MotCurrDaxCmd.Val "MICROSAR RTE" FLOAT32_IEEE NO_COMPU_METHOD 0 0 -3.402823466e+38 3.402823466e+38 ECU_ADDRESS 0 SYMBOL_LINK "Rte_MotRefMdl_MotCurrDaxCmd_Val" 0 DISPLAY_IDENTIFIER ElecPwrCns.ReceiverPorts.MotCurrDaxCmd.Val /end MEASUREMENT
/begin MEASUREMENT ElecPwrCns.MotCurrQax.Val "MICROSAR RTE" FLOAT32_IEEE NO_COMPU_METHOD 0 0 -3.402823466e+38 3.402823466e+38 ECU_ADDRESS 0 SYMBOL_LINK "Rte_CDD_MotCtrlMgr_MotCurrQax_Val" 0 DISPLAY_IDENTIFIER ElecPwrCns.ReceiverPorts.MotCurrQax.Val /end MEASUREMENT
/begin MEASUREMENT ElecPwrCns.MotCurrQaxCmd.Val "MICROSAR RTE" FLOAT32_IEEE NO_COMPU_METHOD 0 0 -3.402823466e+38 3.402823466e+38 ECU_ADDRESS 0 SYMBOL_LINK "Rte_MotRefMdl_MotCurrQaxCmd_Val" 0 DISPLAY_IDENTIFIER ElecPwrCns.ReceiverPorts.MotCurrQaxCmd.Val /end MEASUREMENT
/begin MEASUREMENT ElecPwrCns.MotVltgDax.Val "MICROSAR RTE" FLOAT32_IEEE NO_COMPU_METHOD 0 0 -3.402823466e+38 3.402823466e+38 ECU_ADDRESS 0 SYMBOL_LINK "Rte_CDD_MotCtrlMgr_MotVltgDax_Val" 0 DISPLAY_IDENTIFIER ElecPwrCns.ReceiverPorts.MotVltgDax.Val /end MEASUREMENT
/begin MEASUREMENT ElecPwrCns.MotVltgQax.Val "MICROSAR RTE" FLOAT32_IEEE NO_COMPU_METHOD 0 0 -3.402823466e+38 3.402823466e+38 ECU_ADDRESS 0 SYMBOL_LINK "Rte_CDD_MotCtrlMgr_MotVltgQax_Val" 0 DISPLAY_IDENTIFIER ElecPwrCns.ReceiverPorts.MotVltgQax.Val /end MEASUREMENT
/begin MEASUREMENT ElecPwrCns.SplyCurrEstim.Val "MICROSAR RTE" FLOAT32_IEEE NO_COMPU_METHOD 0 0 -3.402823466e+38 3.402823466e+38 ECU_ADDRESS 0 SYMBOL_LINK "Rte_ElecPwrCns_SplyCurrEstim_Val" 0 DISPLAY_IDENTIFIER ElecPwrCns.SenderPorts.SplyCurrEstim.Val /end MEASUREMENT
/begin MEASUREMENT ElecPwrCns.dElecPwrCnsDrpInpPwr "MICROSAR RTE" FLOAT32_IEEE NO_COMPU_METHOD 0 0 -3.402823466e+38 3.402823466e+38 ECU_ADDRESS 0 SYMBOL_LINK "Rte_ElecPwrCns_dElecPwrCnsDrpInpPwr" 0 DISPLAY_IDENTIFIER ElecPwrCns.PerInstanceMemories.dElecPwrCnsDrpInpPwr /end MEASUREMENT
/begin MEASUREMENT ElecPwrCns.dElecPwrCnsModInpPwr "MICROSAR RTE" FLOAT32_IEEE NO_COMPU_METHOD 0 0 -3.402823466e+38 3.402823466e+38 ECU_ADDRESS 0 SYMBOL_LINK "Rte_ElecPwrCns_dElecPwrCnsModInpPwr" 0 DISPLAY_IDENTIFIER ElecPwrCns.PerInstanceMemories.dElecPwrCnsModInpPwr /end MEASUREMENT
/begin MEASUREMENT ElecPwrCns.dElecPwrCnsMotCurrDaxEstim "MICROSAR RTE" FLOAT32_IEEE NO_COMPU_METHOD 0 0 -3.402823466e+38 3.402823466e+38 ECU_ADDRESS 0 SYMBOL_LINK "Rte_ElecPwrCns_dElecPwrCnsMotCurrDaxEstim" 0 DISPLAY_IDENTIFIER ElecPwrCns.PerInstanceMemories.dElecPwrCnsMotCurrDaxEstim /end MEASUREMENT
/begin MEASUREMENT ElecPwrCns.dElecPwrCnsMotCurrQaxEstim "MICROSAR RTE" FLOAT32_IEEE NO_COMPU_METHOD 0 0 -3.402823466e+38 3.402823466e+38 ECU_ADDRESS 0 SYMBOL_LINK "Rte_ElecPwrCns_dElecPwrCnsMotCurrQaxEstim" 0 DISPLAY_IDENTIFIER ElecPwrCns.PerInstanceMemories.dElecPwrCnsMotCurrQaxEstim /end MEASUREMENT
/begin MEASUREMENT EotLrng.CcwEotRefTmr "MICROSAR RTE" ULONG NO_COMPU_METHOD 0 0 0 4294967295 ECU_ADDRESS 0 SYMBOL_LINK "Rte_EotLrng_CcwEotRefTmr" 0 DISPLAY_IDENTIFIER EotLrng.PerInstanceMemories.CcwEotRefTmr /end MEASUREMENT
/begin MEASUREMENT EotLrng.CwEotRefTmr "MICROSAR RTE" ULONG NO_COMPU_METHOD 0 0 0 4294967295 ECU_ADDRESS 0 SYMBOL_LINK "Rte_EotLrng_CwEotRefTmr" 0 DISPLAY_IDENTIFIER EotLrng.PerInstanceMemories.CwEotRefTmr /end MEASUREMENT
/begin MEASUREMENT EotLrng.EotNvmData.CcwEot "MICROSAR RTE" FLOAT32_IEEE NO_COMPU_METHOD 0 0 -3.402823466e+38 3.402823466e+38 ECU_ADDRESS 0 SYMBOL_LINK "Rte_EotLrng_EotNvmData.CcwEot" 0 DISPLAY_IDENTIFIER EotLrng.PerInstanceMemories.EotNvmData.CcwEot /end MEASUREMENT
/begin MEASUREMENT EotLrng.EotNvmData.CcwEotDetd "MICROSAR RTE" UBYTE RTE_CM_BOOLEAN 0 0 0 255 ECU_ADDRESS 0 SYMBOL_LINK "Rte_EotLrng_EotNvmData.CcwEotDetd" 0 DISPLAY_IDENTIFIER EotLrng.PerInstanceMemories.EotNvmData.CcwEotDetd /end MEASUREMENT
/begin MEASUREMENT EotLrng.EotNvmData.CwEot "MICROSAR RTE" FLOAT32_IEEE NO_COMPU_METHOD 0 0 -3.402823466e+38 3.402823466e+38 ECU_ADDRESS 0 SYMBOL_LINK "Rte_EotLrng_EotNvmData.CwEot" 0 DISPLAY_IDENTIFIER EotLrng.PerInstanceMemories.EotNvmData.CwEot /end MEASUREMENT
/begin MEASUREMENT EotLrng.EotNvmData.CwEotDetd "MICROSAR RTE" UBYTE RTE_CM_BOOLEAN 0 0 0 255 ECU_ADDRESS 0 SYMBOL_LINK "Rte_EotLrng_EotNvmData.CwEotDetd" 0 DISPLAY_IDENTIFIER EotLrng.PerInstanceMemories.EotNvmData.CwEotDetd /end MEASUREMENT
/begin MEASUREMENT EotLrng.HwAg.Val "MICROSAR RTE" FLOAT32_IEEE NO_COMPU_METHOD 0 0 -3.402823466e+38 3.402823466e+38 ECU_ADDRESS 0 SYMBOL_LINK "Rte_ImcSigArbn_HwAgImcCorrd_Val" 0 DISPLAY_IDENTIFIER EotLrng.ReceiverPorts.HwAg.Val /end MEASUREMENT
/begin MEASUREMENT EotLrng.HwAgAuthy.Val "MICROSAR RTE" FLOAT32_IEEE NO_COMPU_METHOD 0 0 -3.402823466e+38 3.402823466e+38 ECU_ADDRESS 0 SYMBOL_LINK "Rte_HwAgSysArbn_PinionAgConf_Val" 0 DISPLAY_IDENTIFIER EotLrng.ReceiverPorts.HwAgAuthy.Val /end MEASUREMENT
/begin MEASUREMENT EotLrng.HwAgCcwDetd.Logl "MICROSAR RTE" UBYTE RTE_CM_BOOLEAN 0 0 0 255 ECU_ADDRESS 0 SYMBOL_LINK "Rte_EotLrng_HwAgCcwDetd_Logl" 0 DISPLAY_IDENTIFIER EotLrng.SenderPorts.HwAgCcwDetd.Logl /end MEASUREMENT
/begin MEASUREMENT EotLrng.HwAgCwDetd.Logl "MICROSAR RTE" UBYTE RTE_CM_BOOLEAN 0 0 0 255 ECU_ADDRESS 0 SYMBOL_LINK "Rte_EotLrng_HwAgCwDetd_Logl" 0 DISPLAY_IDENTIFIER EotLrng.SenderPorts.HwAgCwDetd.Logl /end MEASUREMENT
/begin MEASUREMENT EotLrng.HwAgDiDiagSts.Logl "MICROSAR RTE" UBYTE RTE_CM_BOOLEAN 0 0 0 255 ECU_ADDRESS 0 SYMBOL_LINK "Rte_EotLrng_HwAgDiDiagSts_Logl" 0 DISPLAY_IDENTIFIER EotLrng.ReceiverPorts.HwAgDiDiagSts.Logl /end MEASUREMENT
/begin MEASUREMENT EotLrng.HwAgEotCcw.Val "MICROSAR RTE" FLOAT32_IEEE NO_COMPU_METHOD 0 0 -3.402823466e+38 3.402823466e+38 ECU_ADDRESS 0 SYMBOL_LINK "Rte_EotLrng_HwAgEotCcw_Val" 0 DISPLAY_IDENTIFIER EotLrng.SenderPorts.HwAgEotCcw.Val /end MEASUREMENT
/begin MEASUREMENT EotLrng.HwAgEotCw.Val "MICROSAR RTE" FLOAT32_IEEE NO_COMPU_METHOD 0 0 -3.402823466e+38 3.402823466e+38 ECU_ADDRESS 0 SYMBOL_LINK "Rte_EotLrng_HwAgEotCw_Val" 0 DISPLAY_IDENTIFIER EotLrng.SenderPorts.HwAgEotCw.Val /end MEASUREMENT
/begin MEASUREMENT EotLrng.HwAgEotSig0Avl.Logl "MICROSAR RTE" UBYTE RTE_CM_BOOLEAN 0 0 0 255 ECU_ADDRESS 0 SYMBOL_LINK "Rte_CDD_HwTq8Meas_RackLimrEotSig8Avl_Logl" 0 DISPLAY_IDENTIFIER EotLrng.ReceiverPorts.HwAgEotSig0Avl.Logl /end MEASUREMENT
/begin MEASUREMENT EotLrng.HwAgEotSig0Ccw.Val "MICROSAR RTE" FLOAT32_IEEE NO_COMPU_METHOD 0 0 -3.402823466e+38 3.402823466e+38 ECU_ADDRESS 0 SYMBOL_LINK "Rte_CDD_HwTq8Meas_RackLimrCcwEotSig8_Val" 0 DISPLAY_IDENTIFIER EotLrng.ReceiverPorts.HwAgEotSig0Ccw.Val /end MEASUREMENT
/begin MEASUREMENT EotLrng.HwAgEotSig0Cw.Val "MICROSAR RTE" FLOAT32_IEEE NO_COMPU_METHOD 0 0 -3.402823466e+38 3.402823466e+38 ECU_ADDRESS 0 SYMBOL_LINK "Rte_CDD_HwTq8Meas_RackLimrCwEotSig8_Val" 0 DISPLAY_IDENTIFIER EotLrng.ReceiverPorts.HwAgEotSig0Cw.Val /end MEASUREMENT
/begin MEASUREMENT EotLrng.HwAgEotSig1Avl.Logl "MICROSAR RTE" UBYTE RTE_CM_BOOLEAN 0 0 0 255 ECU_ADDRESS 0 SYMBOL_LINK "Rte_CDD_HwTq1Meas_RackLimrEotSig1Avl_Logl" 0 DISPLAY_IDENTIFIER EotLrng.ReceiverPorts.HwAgEotSig1Avl.Logl /end MEASUREMENT
/begin MEASUREMENT EotLrng.HwAgEotSig1Ccw.Val "MICROSAR RTE" FLOAT32_IEEE NO_COMPU_METHOD 0 0 -3.402823466e+38 3.402823466e+38 ECU_ADDRESS 0 SYMBOL_LINK "Rte_CDD_HwTq1Meas_RackLimrCcwEotSig1_Val" 0 DISPLAY_IDENTIFIER EotLrng.ReceiverPorts.HwAgEotSig1Ccw.Val /end MEASUREMENT
/begin MEASUREMENT EotLrng.HwAgEotSig1Cw.Val "MICROSAR RTE" FLOAT32_IEEE NO_COMPU_METHOD 0 0 -3.402823466e+38 3.402823466e+38 ECU_ADDRESS 0 SYMBOL_LINK "Rte_CDD_HwTq1Meas_RackLimrCwEotSig1_Val" 0 DISPLAY_IDENTIFIER EotLrng.ReceiverPorts.HwAgEotSig1Cw.Val /end MEASUREMENT
/begin MEASUREMENT EotLrng.HwAgOverTrvlCntrNegDi "MICROSAR RTE" UBYTE RTE_CM_BOOLEAN 0 0 0 255 ECU_ADDRESS 0 SYMBOL_LINK "Rte_EotLrng_HwAgOverTrvlCntrNegDi" 0 DISPLAY_IDENTIFIER EotLrng.PerInstanceMemories.HwAgOverTrvlCntrNegDi /end MEASUREMENT
/begin MEASUREMENT EotLrng.HwAgOverTrvlCntrPosDi "MICROSAR RTE" UBYTE RTE_CM_BOOLEAN 0 0 0 255 ECU_ADDRESS 0 SYMBOL_LINK "Rte_EotLrng_HwAgOverTrvlCntrPosDi" 0 DISPLAY_IDENTIFIER EotLrng.PerInstanceMemories.HwAgOverTrvlCntrPosDi /end MEASUREMENT
/begin MEASUREMENT EotLrng.HwTq.Val "MICROSAR RTE" FLOAT32_IEEE NO_COMPU_METHOD 0 0 -3.402823466e+38 3.402823466e+38 ECU_ADDRESS 0 SYMBOL_LINK "Rte_ImcSigArbn_HwTqImcCorrd_Val" 0 DISPLAY_IDENTIFIER EotLrng.ReceiverPorts.HwTq.Val /end MEASUREMENT
/begin MEASUREMENT EotLrng.MaxHwAgCwAndCcw.HwAgCcwMax "MICROSAR RTE" FLOAT32_IEEE NO_COMPU_METHOD 0 0 -3.402823466e+38 3.402823466e+38 ECU_ADDRESS 0 SYMBOL_LINK "Rte_EotLrng_MaxHwAgCwAndCcw.HwAgCcwMax" 0 DISPLAY_IDENTIFIER EotLrng.PerInstanceMemories.MaxHwAgCwAndCcw.HwAgCcwMax /end MEASUREMENT
/begin MEASUREMENT EotLrng.MaxHwAgCwAndCcw.HwAgCwMax "MICROSAR RTE" FLOAT32_IEEE NO_COMPU_METHOD 0 0 -3.402823466e+38 3.402823466e+38 ECU_ADDRESS 0 SYMBOL_LINK "Rte_EotLrng_MaxHwAgCwAndCcw.HwAgCwMax" 0 DISPLAY_IDENTIFIER EotLrng.PerInstanceMemories.MaxHwAgCwAndCcw.HwAgCwMax /end MEASUREMENT
/begin MEASUREMENT EotLrng.MaxHwAgCwAndCcw.HwAgOverTrvlCnt "MICROSAR RTE" UBYTE NO_COMPU_METHOD 0 0 0 255 ECU_ADDRESS 0 SYMBOL_LINK "Rte_EotLrng_MaxHwAgCwAndCcw.HwAgOverTrvlCnt" 0 DISPLAY_IDENTIFIER EotLrng.PerInstanceMemories.MaxHwAgCwAndCcw.HwAgOverTrvlCnt /end MEASUREMENT
/begin MEASUREMENT EotLrng.MotVelCrf.Val "MICROSAR RTE" FLOAT32_IEEE NO_COMPU_METHOD 0 0 -3.402823466e+38 3.402823466e+38 ECU_ADDRESS 0 SYMBOL_LINK "Rte_ImcSigArbn_MotVelCrfImcCorrd_Val" 0 DISPLAY_IDENTIFIER EotLrng.ReceiverPorts.MotVelCrf.Val /end MEASUREMENT
/begin MEASUREMENT EotLrng.PrevCcwEot "MICROSAR RTE" FLOAT32_IEEE NO_COMPU_METHOD 0 0 -3.402823466e+38 3.402823466e+38 ECU_ADDRESS 0 SYMBOL_LINK "Rte_EotLrng_PrevCcwEot" 0 DISPLAY_IDENTIFIER EotLrng.PerInstanceMemories.PrevCcwEot /end MEASUREMENT
/begin MEASUREMENT EotLrng.PrevCwEot "MICROSAR RTE" FLOAT32_IEEE NO_COMPU_METHOD 0 0 -3.402823466e+38 3.402823466e+38 ECU_ADDRESS 0 SYMBOL_LINK "Rte_EotLrng_PrevCwEot" 0 DISPLAY_IDENTIFIER EotLrng.PerInstanceMemories.PrevCwEot /end MEASUREMENT
/begin MEASUREMENT EotLrng.RstLimReq "MICROSAR RTE" UBYTE RTE_CM_BOOLEAN 0 0 0 255 ECU_ADDRESS 0 SYMBOL_LINK "Rte_EotLrng_RstLimReq" 0 DISPLAY_IDENTIFIER EotLrng.PerInstanceMemories.RstLimReq /end MEASUREMENT
/begin MEASUREMENT EotProtn.EotActvCmd.Val "MICROSAR RTE" FLOAT32_IEEE NO_COMPU_METHOD 0 0 -3.402823466e+38 3.402823466e+38 ECU_ADDRESS 0 SYMBOL_LINK "Rte_EotProtn_EotActvCmd_Val" 0 DISPLAY_IDENTIFIER EotProtn.SenderPorts.EotActvCmd.Val /end MEASUREMENT
/begin MEASUREMENT EotProtn.EotAssiSca.Val "MICROSAR RTE" FLOAT32_IEEE NO_COMPU_METHOD 0 0 -3.402823466e+38 3.402823466e+38 ECU_ADDRESS 0 SYMBOL_LINK "Rte_EotProtn_EotAssiSca_Val" 0 DISPLAY_IDENTIFIER EotProtn.SenderPorts.EotAssiSca.Val /end MEASUREMENT
/begin MEASUREMENT EotProtn.EotAssiScaLpFil.FilGain "MICROSAR RTE" FLOAT32_IEEE NO_COMPU_METHOD 0 0 -3.402823466e+38 3.402823466e+38 ECU_ADDRESS 0 SYMBOL_LINK "Rte_EotProtn_EotAssiScaLpFil.FilGain" 0 DISPLAY_IDENTIFIER EotProtn.PerInstanceMemories.EotAssiScaLpFil.FilGain /end MEASUREMENT
/begin MEASUREMENT EotProtn.EotAssiScaLpFil.FilSt "MICROSAR RTE" FLOAT32_IEEE NO_COMPU_METHOD 0 0 -3.402823466e+38 3.402823466e+38 ECU_ADDRESS 0 SYMBOL_LINK "Rte_EotProtn_EotAssiScaLpFil.FilSt" 0 DISPLAY_IDENTIFIER EotProtn.PerInstanceMemories.EotAssiScaLpFil.FilSt /end MEASUREMENT
/begin MEASUREMENT EotProtn.EotDampgCmd.Val "MICROSAR RTE" FLOAT32_IEEE NO_COMPU_METHOD 0 0 -3.402823466e+38 3.402823466e+38 ECU_ADDRESS 0 SYMBOL_LINK "Rte_EotProtn_EotDampgCmd_Val" 0 DISPLAY_IDENTIFIER EotProtn.SenderPorts.EotDampgCmd.Val /end MEASUREMENT
/begin MEASUREMENT EotProtn.EotMotTqLim.Val "MICROSAR RTE" FLOAT32_IEEE NO_COMPU_METHOD 0 0 -3.402823466e+38 3.402823466e+38 ECU_ADDRESS 0 SYMBOL_LINK "Rte_EotProtn_EotMotTqLim_Val" 0 DISPLAY_IDENTIFIER EotProtn.SenderPorts.EotMotTqLim.Val /end MEASUREMENT
/begin MEASUREMENT EotProtn.EotProtnDi.Logl "MICROSAR RTE" UBYTE RTE_CM_BOOLEAN 0 0 0 255 ECU_ADDRESS 0 SYMBOL_LINK "Rte_CmnMfgSrv_EotProtnDi_Logl" 0 DISPLAY_IDENTIFIER EotProtn.ReceiverPorts.EotProtnDi.Logl /end MEASUREMENT
/begin MEASUREMENT EotProtn.HwAg.Val "MICROSAR RTE" FLOAT32_IEEE NO_COMPU_METHOD 0 0 -3.402823466e+38 3.402823466e+38 ECU_ADDRESS 0 SYMBOL_LINK "Rte_ImcSigArbn_HwAgImcCorrd_Val" 0 DISPLAY_IDENTIFIER EotProtn.ReceiverPorts.HwAg.Val /end MEASUREMENT
/begin MEASUREMENT EotProtn.HwAgAuthy.Val "MICROSAR RTE" FLOAT32_IEEE NO_COMPU_METHOD 0 0 -3.402823466e+38 3.402823466e+38 ECU_ADDRESS 0 SYMBOL_LINK "Rte_HwAgSysArbn_PinionAgConf_Val" 0 DISPLAY_IDENTIFIER EotProtn.ReceiverPorts.HwAgAuthy.Val /end MEASUREMENT
/begin MEASUREMENT EotProtn.HwAgCcwDetd.Logl "MICROSAR RTE" UBYTE RTE_CM_BOOLEAN 0 0 0 255 ECU_ADDRESS 0 SYMBOL_LINK "Rte_EotLrng_HwAgCcwDetd_Logl" 0 DISPLAY_IDENTIFIER EotProtn.ReceiverPorts.HwAgCcwDetd.Logl /end MEASUREMENT
/begin MEASUREMENT EotProtn.HwAgCwDetd.Logl "MICROSAR RTE" UBYTE RTE_CM_BOOLEAN 0 0 0 255 ECU_ADDRESS 0 SYMBOL_LINK "Rte_EotLrng_HwAgCwDetd_Logl" 0 DISPLAY_IDENTIFIER EotProtn.ReceiverPorts.HwAgCwDetd.Logl /end MEASUREMENT
/begin MEASUREMENT EotProtn.HwAgEotCcw.Val "MICROSAR RTE" FLOAT32_IEEE NO_COMPU_METHOD 0 0 -3.402823466e+38 3.402823466e+38 ECU_ADDRESS 0 SYMBOL_LINK "Rte_EotLrng_HwAgEotCcw_Val" 0 DISPLAY_IDENTIFIER EotProtn.ReceiverPorts.HwAgEotCcw.Val /end MEASUREMENT
/begin MEASUREMENT EotProtn.HwAgEotCw.Val "MICROSAR RTE" FLOAT32_IEEE NO_COMPU_METHOD 0 0 -3.402823466e+38 3.402823466e+38 ECU_ADDRESS 0 SYMBOL_LINK "Rte_EotLrng_HwAgEotCw_Val" 0 DISPLAY_IDENTIFIER EotProtn.ReceiverPorts.HwAgEotCw.Val /end MEASUREMENT
/begin MEASUREMENT EotProtn.HwTq.Val "MICROSAR RTE" FLOAT32_IEEE NO_COMPU_METHOD 0 0 -3.402823466e+38 3.402823466e+38 ECU_ADDRESS 0 SYMBOL_LINK "Rte_ImcSigArbn_HwTqImcCorrd_Val" 0 DISPLAY_IDENTIFIER EotProtn.ReceiverPorts.HwTq.Val /end MEASUREMENT
/begin MEASUREMENT EotProtn.HwTqLpFil.FilGain "MICROSAR RTE" FLOAT32_IEEE NO_COMPU_METHOD 0 0 -3.402823466e+38 3.402823466e+38 ECU_ADDRESS 0 SYMBOL_LINK "Rte_EotProtn_HwTqLpFil.FilGain" 0 DISPLAY_IDENTIFIER EotProtn.PerInstanceMemories.HwTqLpFil.FilGain /end MEASUREMENT
/begin MEASUREMENT EotProtn.HwTqLpFil.FilSt "MICROSAR RTE" FLOAT32_IEEE NO_COMPU_METHOD 0 0 -3.402823466e+38 3.402823466e+38 ECU_ADDRESS 0 SYMBOL_LINK "Rte_EotProtn_HwTqLpFil.FilSt" 0 DISPLAY_IDENTIFIER EotProtn.PerInstanceMemories.HwTqLpFil.FilSt /end MEASUREMENT
/begin MEASUREMENT EotProtn.MotVelCrf.Val "MICROSAR RTE" FLOAT32_IEEE NO_COMPU_METHOD 0 0 -3.402823466e+38 3.402823466e+38 ECU_ADDRESS 0 SYMBOL_LINK "Rte_ImcSigArbn_MotVelCrfImcCorrd_Val" 0 DISPLAY_IDENTIFIER EotProtn.ReceiverPorts.MotVelCrf.Val /end MEASUREMENT
/begin MEASUREMENT EotProtn.NewSoftEndStopSt "MICROSAR RTE" UBYTE NO_COMPU_METHOD 0 0 0 255 ECU_ADDRESS 0 SYMBOL_LINK "Rte_EotProtn_NewSoftEndStopSt" 0 DISPLAY_IDENTIFIER EotProtn.PerInstanceMemories.NewSoftEndStopSt /end MEASUREMENT
/begin MEASUREMENT EotProtn.PrevEotAssiSca "MICROSAR RTE" FLOAT32_IEEE NO_COMPU_METHOD 0 0 -3.402823466e+38 3.402823466e+38 ECU_ADDRESS 0 SYMBOL_LINK "Rte_EotProtn_PrevEotAssiSca" 0 DISPLAY_IDENTIFIER EotProtn.PerInstanceMemories.PrevEotAssiSca /end MEASUREMENT
/begin MEASUREMENT EotProtn.PrevEotDampg "MICROSAR RTE" FLOAT32_IEEE NO_COMPU_METHOD 0 0 -3.402823466e+38 3.402823466e+38 ECU_ADDRESS 0 SYMBOL_LINK "Rte_EotProtn_PrevEotDampg" 0 DISPLAY_IDENTIFIER EotProtn.PerInstanceMemories.PrevEotDampg /end MEASUREMENT
/begin MEASUREMENT EotProtn.PrevImpctPosn "MICROSAR RTE" FLOAT32_IEEE NO_COMPU_METHOD 0 0 -3.402823466e+38 3.402823466e+38 ECU_ADDRESS 0 SYMBOL_LINK "Rte_EotProtn_PrevImpctPosn" 0 DISPLAY_IDENTIFIER EotProtn.PerInstanceMemories.PrevImpctPosn /end MEASUREMENT
/begin MEASUREMENT EotProtn.PrevRackTrvlLimrEna "MICROSAR RTE" UBYTE RTE_CM_BOOLEAN 0 0 0 255 ECU_ADDRESS 0 SYMBOL_LINK "Rte_EotProtn_PrevRackTrvlLimrEna" 0 DISPLAY_IDENTIFIER EotProtn.PerInstanceMemories.PrevRackTrvlLimrEna /end MEASUREMENT
/begin MEASUREMENT EotProtn.PrevRackTrvlLimrInin "MICROSAR RTE" UBYTE RTE_CM_BOOLEAN 0 0 0 255 ECU_ADDRESS 0 SYMBOL_LINK "Rte_EotProtn_PrevRackTrvlLimrInin" 0 DISPLAY_IDENTIFIER EotProtn.PerInstanceMemories.PrevRackTrvlLimrInin /end MEASUREMENT
/begin MEASUREMENT EotProtn.PrevSoftEndStopSt "MICROSAR RTE" UBYTE NO_COMPU_METHOD 0 0 0 255 ECU_ADDRESS 0 SYMBOL_LINK "Rte_EotProtn_PrevSoftEndStopSt" 0 DISPLAY_IDENTIFIER EotProtn.PerInstanceMemories.PrevSoftEndStopSt /end MEASUREMENT
/begin MEASUREMENT EotProtn.SysMotTqCmdSca.Val "MICROSAR RTE" FLOAT32_IEEE NO_COMPU_METHOD 0 0 -3.402823466e+38 3.402823466e+38 ECU_ADDRESS 0 SYMBOL_LINK "Rte_StOutpCtrl_SysMotTqCmdSca_Val" 0 DISPLAY_IDENTIFIER EotProtn.ReceiverPorts.SysMotTqCmdSca.Val /end MEASUREMENT
/begin MEASUREMENT EotProtn.VehSpd.Val "MICROSAR RTE" FLOAT32_IEEE NO_COMPU_METHOD 0 0 -3.402823466e+38 3.402823466e+38 ECU_ADDRESS 0 SYMBOL_LINK "Rte_ImcSigArbn_VehSpdImcCorrd_Val" 0 DISPLAY_IDENTIFIER EotProtn.ReceiverPorts.VehSpd.Val /end MEASUREMENT
/begin MEASUREMENT EotProtn.dEotProtnDampg "MICROSAR RTE" FLOAT32_IEEE NO_COMPU_METHOD 0 0 -3.402823466e+38 3.402823466e+38 ECU_ADDRESS 0 SYMBOL_LINK "Rte_EotProtn_dEotProtnDampg" 0 DISPLAY_IDENTIFIER EotProtn.PerInstanceMemories.dEotProtnDampg /end MEASUREMENT
/begin MEASUREMENT EotProtn.dEotProtnDetd "MICROSAR RTE" UBYTE RTE_CM_BOOLEAN 0 0 0 255 ECU_ADDRESS 0 SYMBOL_LINK "Rte_EotProtn_dEotProtnDetd" 0 DISPLAY_IDENTIFIER EotProtn.PerInstanceMemories.dEotProtnDetd /end MEASUREMENT
/begin MEASUREMENT EotProtn.dEotProtnEntrGain "MICROSAR RTE" FLOAT32_IEEE NO_COMPU_METHOD 0 0 -3.402823466e+38 3.402823466e+38 ECU_ADDRESS 0 SYMBOL_LINK "Rte_EotProtn_dEotProtnEntrGain" 0 DISPLAY_IDENTIFIER EotProtn.PerInstanceMemories.dEotProtnEntrGain /end MEASUREMENT
/begin MEASUREMENT EotProtn.dEotProtnEotAssiSca "MICROSAR RTE" FLOAT32_IEEE NO_COMPU_METHOD 0 0 -3.402823466e+38 3.402823466e+38 ECU_ADDRESS 0 SYMBOL_LINK "Rte_EotProtn_dEotProtnEotAssiSca" 0 DISPLAY_IDENTIFIER EotProtn.PerInstanceMemories.dEotProtnEotAssiSca /end MEASUREMENT
/begin MEASUREMENT EotProtn.dEotProtnEotGain "MICROSAR RTE" FLOAT32_IEEE NO_COMPU_METHOD 0 0 -3.402823466e+38 3.402823466e+38 ECU_ADDRESS 0 SYMBOL_LINK "Rte_EotProtn_dEotProtnEotGain" 0 DISPLAY_IDENTIFIER EotProtn.PerInstanceMemories.dEotProtnEotGain /end MEASUREMENT
/begin MEASUREMENT EotProtn.dEotProtnExitGain "MICROSAR RTE" FLOAT32_IEEE NO_COMPU_METHOD 0 0 -3.402823466e+38 3.402823466e+38 ECU_ADDRESS 0 SYMBOL_LINK "Rte_EotProtn_dEotProtnExitGain" 0 DISPLAY_IDENTIFIER EotProtn.PerInstanceMemories.dEotProtnExitGain /end MEASUREMENT
/begin MEASUREMENT EotProtn.dEotProtnLimPosn "MICROSAR RTE" FLOAT32_IEEE NO_COMPU_METHOD 0 0 -3.402823466e+38 3.402823466e+38 ECU_ADDRESS 0 SYMBOL_LINK "Rte_EotProtn_dEotProtnLimPosn" 0 DISPLAY_IDENTIFIER EotProtn.PerInstanceMemories.dEotProtnLimPosn /end MEASUREMENT
/begin MEASUREMENT EotProtn.dEotProtnRackTrvlLimrDi "MICROSAR RTE" UBYTE RTE_CM_BOOLEAN 0 0 0 255 ECU_ADDRESS 0 SYMBOL_LINK "Rte_EotProtn_dEotProtnRackTrvlLimrDi" 0 DISPLAY_IDENTIFIER EotProtn.PerInstanceMemories.dEotProtnRackTrvlLimrDi /end MEASUREMENT
/begin MEASUREMENT EotProtnFwl.EotActvCmd.Val "MICROSAR RTE" FLOAT32_IEEE NO_COMPU_METHOD 0 0 -3.402823466e+38 3.402823466e+38 ECU_ADDRESS 0 SYMBOL_LINK "Rte_EotProtn_EotActvCmd_Val" 0 DISPLAY_IDENTIFIER EotProtnFwl.ReceiverPorts.EotActvCmd.Val /end MEASUREMENT
/begin MEASUREMENT EotProtnFwl.EotActvCmdLimd.Val "MICROSAR RTE" FLOAT32_IEEE NO_COMPU_METHOD 0 0 -3.402823466e+38 3.402823466e+38 ECU_ADDRESS 0 SYMBOL_LINK "Rte_EotProtnFwl_EotActvCmdLimd_Val" 0 DISPLAY_IDENTIFIER EotProtnFwl.SenderPorts.EotActvCmdLimd.Val /end MEASUREMENT
/begin MEASUREMENT EotProtnFwl.EotDampgCmd.Val "MICROSAR RTE" FLOAT32_IEEE NO_COMPU_METHOD 0 0 -3.402823466e+38 3.402823466e+38 ECU_ADDRESS 0 SYMBOL_LINK "Rte_EotProtn_EotDampgCmd_Val" 0 DISPLAY_IDENTIFIER EotProtnFwl.ReceiverPorts.EotDampgCmd.Val /end MEASUREMENT
/begin MEASUREMENT EotProtnFwl.EotDampgCmdLimd.Val "MICROSAR RTE" FLOAT32_IEEE NO_COMPU_METHOD 0 0 -3.402823466e+38 3.402823466e+38 ECU_ADDRESS 0 SYMBOL_LINK "Rte_EotProtnFwl_EotDampgCmdLimd_Val" 0 DISPLAY_IDENTIFIER EotProtnFwl.SenderPorts.EotDampgCmdLimd.Val /end MEASUREMENT
/begin MEASUREMENT EotProtnFwl.EotProtnDi.Logl "MICROSAR RTE" UBYTE RTE_CM_BOOLEAN 0 0 0 255 ECU_ADDRESS 0 SYMBOL_LINK "Rte_CmnMfgSrv_EotProtnDi_Logl" 0 DISPLAY_IDENTIFIER EotProtnFwl.ReceiverPorts.EotProtnDi.Logl /end MEASUREMENT
/begin MEASUREMENT EotProtnFwl.HwAg.Val "MICROSAR RTE" FLOAT32_IEEE NO_COMPU_METHOD 0 0 -3.402823466e+38 3.402823466e+38 ECU_ADDRESS 0 SYMBOL_LINK "Rte_ImcSigArbn_HwAgImcCorrd_Val" 0 DISPLAY_IDENTIFIER EotProtnFwl.ReceiverPorts.HwAg.Val /end MEASUREMENT
/begin MEASUREMENT EotProtnFwl.MotVelCrf.Val "MICROSAR RTE" FLOAT32_IEEE NO_COMPU_METHOD 0 0 -3.402823466e+38 3.402823466e+38 ECU_ADDRESS 0 SYMBOL_LINK "Rte_ImcSigArbn_MotVelCrfImcCorrd_Val" 0 DISPLAY_IDENTIFIER EotProtnFwl.ReceiverPorts.MotVelCrf.Val /end MEASUREMENT
/begin MEASUREMENT EotProtnFwl.PinionAgConf.Val "MICROSAR RTE" FLOAT32_IEEE NO_COMPU_METHOD 0 0 -3.402823466e+38 3.402823466e+38 ECU_ADDRESS 0 SYMBOL_LINK "Rte_HwAgSysArbn_PinionAgConf_Val" 0 DISPLAY_IDENTIFIER EotProtnFwl.ReceiverPorts.PinionAgConf.Val /end MEASUREMENT
/begin MEASUREMENT EotProtnFwl.VehSpd.Val "MICROSAR RTE" FLOAT32_IEEE NO_COMPU_METHOD 0 0 -3.402823466e+38 3.402823466e+38 ECU_ADDRESS 0 SYMBOL_LINK "Rte_ImcSigArbn_VehSpdImcCorrd_Val" 0 DISPLAY_IDENTIFIER EotProtnFwl.ReceiverPorts.VehSpd.Val /end MEASUREMENT
/begin MEASUREMENT EotProtnFwl.dEotProtnFwlEotActvCmdActvLowrBnd "MICROSAR RTE" FLOAT32_IEEE NO_COMPU_METHOD 0 0 -3.402823466e+38 3.402823466e+38 ECU_ADDRESS 0 SYMBOL_LINK "Rte_EotProtnFwl_dEotProtnFwlEotActvCmdActvLowrBnd" 0 DISPLAY_IDENTIFIER EotProtnFwl.PerInstanceMemories.dEotProtnFwlEotActvCmdActvLowrBnd /end MEASUREMENT
/begin MEASUREMENT EotProtnFwl.dEotProtnFwlEotActvCmdActvUpprBnd "MICROSAR RTE" FLOAT32_IEEE NO_COMPU_METHOD 0 0 -3.402823466e+38 3.402823466e+38 ECU_ADDRESS 0 SYMBOL_LINK "Rte_EotProtnFwl_dEotProtnFwlEotActvCmdActvUpprBnd" 0 DISPLAY_IDENTIFIER EotProtnFwl.PerInstanceMemories.dEotProtnFwlEotActvCmdActvUpprBnd /end MEASUREMENT
/begin MEASUREMENT EotProtnFwl.dEotProtnFwlEotActvCmdMod "MICROSAR RTE" UBYTE NO_COMPU_METHOD 0 0 0 255 ECU_ADDRESS 0 SYMBOL_LINK "Rte_EotProtnFwl_dEotProtnFwlEotActvCmdMod" 0 DISPLAY_IDENTIFIER EotProtnFwl.PerInstanceMemories.dEotProtnFwlEotActvCmdMod /end MEASUREMENT
/begin MEASUREMENT EotProtnFwl.dEotProtnFwlEotActvCmdOverActvLim "MICROSAR RTE" UBYTE RTE_CM_BOOLEAN 0 0 0 255 ECU_ADDRESS 0 SYMBOL_LINK "Rte_EotProtnFwl_dEotProtnFwlEotActvCmdOverActvLim" 0 DISPLAY_IDENTIFIER EotProtnFwl.PerInstanceMemories.dEotProtnFwlEotActvCmdOverActvLim /end MEASUREMENT
/begin MEASUREMENT EotProtnFwl.dEotProtnFwlEotActvCmdOverInactvLim "MICROSAR RTE" UBYTE RTE_CM_BOOLEAN 0 0 0 255 ECU_ADDRESS 0 SYMBOL_LINK "Rte_EotProtnFwl_dEotProtnFwlEotActvCmdOverInactvLim" 0 DISPLAY_IDENTIFIER EotProtnFwl.PerInstanceMemories.dEotProtnFwlEotActvCmdOverInactvLim /end MEASUREMENT
/begin MEASUREMENT EotProtnFwl.dEotProtnFwlEotDampgActvLowrBnd "MICROSAR RTE" FLOAT32_IEEE NO_COMPU_METHOD 0 0 -3.402823466e+38 3.402823466e+38 ECU_ADDRESS 0 SYMBOL_LINK "Rte_EotProtnFwl_dEotProtnFwlEotDampgActvLowrBnd" 0 DISPLAY_IDENTIFIER EotProtnFwl.PerInstanceMemories.dEotProtnFwlEotDampgActvLowrBnd /end MEASUREMENT
/begin MEASUREMENT EotProtnFwl.dEotProtnFwlEotDampgActvUpprBnd "MICROSAR RTE" FLOAT32_IEEE NO_COMPU_METHOD 0 0 -3.402823466e+38 3.402823466e+38 ECU_ADDRESS 0 SYMBOL_LINK "Rte_EotProtnFwl_dEotProtnFwlEotDampgActvUpprBnd" 0 DISPLAY_IDENTIFIER EotProtnFwl.PerInstanceMemories.dEotProtnFwlEotDampgActvUpprBnd /end MEASUREMENT
/begin MEASUREMENT EotProtnFwl.dEotProtnFwlEotDampgFwX0 "MICROSAR RTE" FLOAT32_IEEE NO_COMPU_METHOD 0 0 -3.402823466e+38 3.402823466e+38 ECU_ADDRESS 0 SYMBOL_LINK "Rte_EotProtnFwl_dEotProtnFwlEotDampgFwX0" 0 DISPLAY_IDENTIFIER EotProtnFwl.PerInstanceMemories.dEotProtnFwlEotDampgFwX0 /end MEASUREMENT
/begin MEASUREMENT EotProtnFwl.dEotProtnFwlEotDampgMod "MICROSAR RTE" UBYTE NO_COMPU_METHOD 0 0 0 255 ECU_ADDRESS 0 SYMBOL_LINK "Rte_EotProtnFwl_dEotProtnFwlEotDampgMod" 0 DISPLAY_IDENTIFIER EotProtnFwl.PerInstanceMemories.dEotProtnFwlEotDampgMod /end MEASUREMENT
/begin MEASUREMENT EotProtnFwl.dEotProtnFwlEotDampgOverActvLim "MICROSAR RTE" UBYTE RTE_CM_BOOLEAN 0 0 0 255 ECU_ADDRESS 0 SYMBOL_LINK "Rte_EotProtnFwl_dEotProtnFwlEotDampgOverActvLim" 0 DISPLAY_IDENTIFIER EotProtnFwl.PerInstanceMemories.dEotProtnFwlEotDampgOverActvLim /end MEASUREMENT
/begin MEASUREMENT EotProtnFwl.dEotProtnFwlEotDampgOverInactvLim "MICROSAR RTE" UBYTE RTE_CM_BOOLEAN 0 0 0 255 ECU_ADDRESS 0 SYMBOL_LINK "Rte_EotProtnFwl_dEotProtnFwlEotDampgOverInactvLim" 0 DISPLAY_IDENTIFIER EotProtnFwl.PerInstanceMemories.dEotProtnFwlEotDampgOverInactvLim /end MEASUREMENT
/begin MEASUREMENT EotProtnFwl.dEotProtnFwlPinionAgConfSts "MICROSAR RTE" UBYTE RTE_CM_BOOLEAN 0 0 0 255 ECU_ADDRESS 0 SYMBOL_LINK "Rte_EotProtnFwl_dEotProtnFwlPinionAgConfSts" 0 DISPLAY_IDENTIFIER EotProtnFwl.PerInstanceMemories.dEotProtnFwlPinionAgConfSts /end MEASUREMENT
/begin MEASUREMENT FltInj.HwVel.Val "MICROSAR RTE" FLOAT32_IEEE NO_COMPU_METHOD 0 0 -3.402823466e+38 3.402823466e+38 ECU_ADDRESS 0 SYMBOL_LINK "Rte_HwAgSysArbn_HwVel_Val" 0 DISPLAY_IDENTIFIER FltInj.ReceiverPorts.HwVel.Val /end MEASUREMENT
/begin MEASUREMENT FordCanDtcInhb.CanDtcInhbRefTi "MICROSAR RTE" ULONG NO_COMPU_METHOD 0 0 0 4294967295 ECU_ADDRESS 0 SYMBOL_LINK "Rte_FordCanDtcInhb_CanDtcInhbRefTi" 0 DISPLAY_IDENTIFIER FordCanDtcInhb.PerInstanceMemories.CanDtcInhbRefTi /end MEASUREMENT
/begin MEASUREMENT FordCanDtcInhb.EpsFactryModRefTi "MICROSAR RTE" ULONG NO_COMPU_METHOD 0 0 0 4294967295 ECU_ADDRESS 0 SYMBOL_LINK "Rte_FordCanDtcInhb_EpsFactryModRefTi" 0 DISPLAY_IDENTIFIER FordCanDtcInhb.PerInstanceMemories.EpsFactryModRefTi /end MEASUREMENT
/begin MEASUREMENT FordCanDtcInhb.EpsLifeCycModPrev "MICROSAR RTE" UBYTE RTE_CM_BOOLEAN 0 0 0 255 ECU_ADDRESS 0 SYMBOL_LINK "Rte_FordCanDtcInhb_EpsLifeCycModPrev" 0 DISPLAY_IDENTIFIER FordCanDtcInhb.PerInstanceMemories.EpsLifeCycModPrev /end MEASUREMENT
/begin MEASUREMENT FordCanDtcInhb.EpsLifeCycModRefTi "MICROSAR RTE" ULONG NO_COMPU_METHOD 0 0 0 4294967295 ECU_ADDRESS 0 SYMBOL_LINK "Rte_FordCanDtcInhb_EpsLifeCycModRefTi" 0 DISPLAY_IDENTIFIER FordCanDtcInhb.PerInstanceMemories.EpsLifeCycModRefTi /end MEASUREMENT
/begin MEASUREMENT FordCanDtcInhb.EpsTransptModRefTi "MICROSAR RTE" ULONG NO_COMPU_METHOD 0 0 0 4294967295 ECU_ADDRESS 0 SYMBOL_LINK "Rte_FordCanDtcInhb_EpsTransptModRefTi" 0 DISPLAY_IDENTIFIER FordCanDtcInhb.PerInstanceMemories.EpsTransptModRefTi /end MEASUREMENT
/begin MEASUREMENT FordCanDtcInhb.FordBattVltgEstimn.Val "MICROSAR RTE" FLOAT32_IEEE NO_COMPU_METHOD 0 0 -3.402823466e+38 3.402823466e+38 ECU_ADDRESS 0 SYMBOL_LINK "Rte_BattVltg_BrdgVltg_Val" 0 DISPLAY_IDENTIFIER FordCanDtcInhb.ReceiverPorts.FordBattVltgEstimn.Val /end MEASUREMENT
/begin MEASUREMENT FordCanDtcInhb.FordCanDtcInhb8.Val "MICROSAR RTE" UBYTE NO_COMPU_METHOD 0 0 0 255 ECU_ADDRESS 0 SYMBOL_LINK "Rte_FordCanDtcInhb_FordCanDtcInhb8_Val" 0 DISPLAY_IDENTIFIER FordCanDtcInhb.SenderPorts.FordCanDtcInhb8.Val /end MEASUREMENT
/begin GROUP DutyCycThermProtn.CalibrationPorts "MICROSAR RTE"
 /begin SUB_GROUP DutyCycThermProtn.DutyCycThermProtnAbsltCtrlTFetMtgtnTblX.Ary1D DutyCycThermProtn.DutyCycThermProtnAbsltCtrlTTblX.Ary1D DutyCycThermProtn.DutyCycThermProtnAbsltCtrlTTqFetMtgtnTblY.Ary1D DutyCycThermProtn.DutyCycThermProtnAbsltCtrlTTqTblY.Ary1D DutyCycThermProtn.DutyCycThermProtnAbsltCuTFetMtgtnTblX.Ary1D DutyCycThermProtn.DutyCycThermProtnAbsltCuTTblX.Ary1D DutyCycThermProtn.DutyCycThermProtnAbsltCuTTqFetMtgtnTblY.Ary1D DutyCycThermProtn.DutyCycThermProtnAbsltCuTTqTblY.Ary1D DutyCycThermProtn.DutyCycThermProtnAbsltMotVelBreakPt.Val DutyCycThermProtn.DutyCycThermProtnAbsltTTqSlewHiLim.Val DutyCycThermProtn.DutyCycThermProtnAbsltTTqSlewLoLim.Val DutyCycThermProtn.DutyCycThermProtnCtrlT.Val DutyCycThermProtn.DutyCycThermProtnCtrlTSeln.Logl DutyCycThermProtn.DutyCycThermProtnDutyCycFildThd.Val DutyCycThermProtn.DutyCycThermProtnIgnOffCtrlEna.Logl DutyCycThermProtn.DutyCycThermProtnIgnOffMsgWaitTi.Val DutyCycThermProtn.DutyCycThermProtnLstTblValNonStall.Ary2D DutyCycThermProtn.DutyCycThermProtnLstTblValStall.Ary2D DutyCycThermProtn.DutyCycThermProtnMotPrTSeln.Logl DutyCycThermProtn.DutyCycThermProtnMplr1FetMtgtnNonStallTblY.Ary1D DutyCycThermProtn.DutyCycThermProtnMplr1FetMtgtnStallTblY.Ary1D DutyCycThermProtn.DutyCycThermProtnMplr1NonStallTblY.Ary1D DutyCycThermProtn.DutyCycThermProtnMplr1StallTblY.Ary1D DutyCycThermProtn.DutyCycThermProtnMplr2FetMtgtnNonStallTblY.Ary1D DutyCycThermProtn.DutyCycThermProtnMplr2FetMtgtnStallTblY.Ary1D DutyCycThermProtn.DutyCycThermProtnMplr2NonStallTblY.Ary1D DutyCycThermProtn.DutyCycThermProtnMplr2StallTblY.Ary1D DutyCycThermProtn.DutyCycThermProtnMplr3FetMtgtnNonStallTblY.Ary1D DutyCycThermProtn.DutyCycThermProtnMplr3FetMtgtnStallTblY.Ary1D DutyCycThermProtn.DutyCycThermProtnMplr3NonStallTblY.Ary1D DutyCycThermProtn.DutyCycThermProtnMplr3StallTblY.Ary1D DutyCycThermProtn.DutyCycThermProtnMplr4FetMtgtnNonStallTblY.Ary1D DutyCycThermProtn.DutyCycThermProtnMplr4FetMtgtnStallTblY.Ary1D DutyCycThermProtn.DutyCycThermProtnMplr4NonStallTblY.Ary1D DutyCycThermProtn.DutyCycThermProtnMplr4StallTblY.Ary1D DutyCycThermProtn.DutyCycThermProtnMplr5FetMtgtnNonStallTblY.Ary1D DutyCycThermProtn.DutyCycThermProtnMplr5FetMtgtnStallTblY.Ary1D DutyCycThermProtn.DutyCycThermProtnMplr5NonStallTblY.Ary1D DutyCycThermProtn.DutyCycThermProtnMplr5StallTblY.Ary1D DutyCycThermProtn.DutyCycThermProtnMplr6FetMtgtnNonStallTblY.Ary1D DutyCycThermProtn.DutyCycThermProtnMplr6FetMtgtnStallTblY.Ary1D DutyCycThermProtn.DutyCycThermProtnMplr6NonStallTblY.Ary1D DutyCycThermProtn.DutyCycThermProtnMplr6StallTblY.Ary1D DutyCycThermProtn.DutyCycThermProtnMplrFetMtgtnTblX.Ary1D DutyCycThermProtn.DutyCycThermProtnMplrTSeln.Logl DutyCycThermProtn.DutyCycThermProtnMplrTblX.Ary1D DutyCycThermProtn.DutyCycThermProtnSlowFilTSeln.Logl DutyCycThermProtn.DutyCycThermProtnThermLimScaFac.Val DutyCycThermProtn.DutyCycThermProtnThermLoadLimTblX.Ary2D DutyCycThermProtn.DutyCycThermProtnThermLoadLimTblY.Ary2D DutyCycThermProtn.DutyCycThermProtnTqCmdSlewDwn.Val DutyCycThermProtn.DutyCycThermProtnTqCmdSlewUp.Val /end SUB_GROUP
 /begin FUNCTION_LIST /end FUNCTION_LIST
 /begin REF_CHARACTERISTIC /end REF_CHARACTERISTIC
 /begin REF_MEASUREMENT /end REF_MEASUREMENT
/end GROUP
/begin GROUP DutyCycThermProtn.DiagcStsLimdTPrfmnc.Logl "MICROSAR RTE" /begin SUB_GROUP /end SUB_GROUP /begin FUNCTION_LIST /end FUNCTION_LIST /begin REF_CHARACTERISTIC /end REF_CHARACTERISTIC /begin REF_MEASUREMENT DutyCycThermProtn.DiagcStsLimdTPrfmnc.Logl /end REF_MEASUREMENT /end GROUP
/begin GROUP DutyCycThermProtn.DualEcuFltMtgtnEna.Logl "MICROSAR RTE" /begin SUB_GROUP /end SUB_GROUP /begin FUNCTION_LIST /end FUNCTION_LIST /begin REF_CHARACTERISTIC /end REF_CHARACTERISTIC /begin REF_MEASUREMENT DutyCycThermProtn.DualEcuFltMtgtnEna.Logl /end REF_MEASUREMENT /end GROUP
/begin GROUP DutyCycThermProtn.DutyCycThermProtnAbsltCtrlTFetMtgtnTblX.Ary1D "MICROSAR RTE" /begin SUB_GROUP /end SUB_GROUP /begin FUNCTION_LIST /end FUNCTION_LIST
 /begin REF_CHARACTERISTIC DutyCycThermProtn.DutyCycThermProtnAbsltCtrlTFetMtgtnTblX.Ary1D /end REF_CHARACTERISTIC
 /begin REF_MEASUREMENT /end REF_MEASUREMENT
/end GROUP
/begin GROUP DutyCycThermProtn.DutyCycThermProtnAbsltCtrlTTblX.Ary1D "MICROSAR RTE" /begin SUB_GROUP /end SUB_GROUP /begin FUNCTION_LIST /end FUNCTION_LIST /begin REF_CHARACTERISTIC DutyCycThermProtn.DutyCycThermProtnAbsltCtrlTTblX.Ary1D /end REF_CHARACTERISTIC /begin REF_MEASUREMENT /end REF_MEASUREMENT /end GROUP
/begin GROUP DutyCycThermProtn.DutyCycThermProtnAbsltCtrlTTqFetMtgtnTblY.Ary1D "MICROSAR RTE" /begin SUB_GROUP /end SUB_GROUP /begin FUNCTION_LIST /end FUNCTION_LIST
 /begin REF_CHARACTERISTIC DutyCycThermProtn.DutyCycThermProtnAbsltCtrlTTqFetMtgtnTblY.Ary1D /end REF_CHARACTERISTIC
 /begin REF_MEASUREMENT /end REF_MEASUREMENT
/end GROUP
/begin GROUP DutyCycThermProtn.DutyCycThermProtnAbsltCtrlTTqTblY.Ary1D "MICROSAR RTE" /begin SUB_GROUP /end SUB_GROUP /begin FUNCTION_LIST /end FUNCTION_LIST /begin REF_CHARACTERISTIC DutyCycThermProtn.DutyCycThermProtnAbsltCtrlTTqTblY.Ary1D /end REF_CHARACTERISTIC /begin REF_MEASUREMENT /end REF_MEASUREMENT /end GROUP
/begin GROUP DutyCycThermProtn.DutyCycThermProtnAbsltCuTFetMtgtnTblX.Ary1D "MICROSAR RTE" /begin SUB_GROUP /end SUB_GROUP /begin FUNCTION_LIST /end FUNCTION_LIST
 /begin REF_CHARACTERISTIC DutyCycThermProtn.DutyCycThermProtnAbsltCuTFetMtgtnTblX.Ary1D /end REF_CHARACTERISTIC
 /begin REF_MEASUREMENT /end REF_MEASUREMENT
/end GROUP
/begin GROUP DutyCycThermProtn.DutyCycThermProtnAbsltCuTTblX.Ary1D "MICROSAR RTE" /begin SUB_GROUP /end SUB_GROUP /begin FUNCTION_LIST /end FUNCTION_LIST /begin REF_CHARACTERISTIC DutyCycThermProtn.DutyCycThermProtnAbsltCuTTblX.Ary1D /end REF_CHARACTERISTIC /begin REF_MEASUREMENT /end REF_MEASUREMENT /end GROUP
/begin GROUP DutyCycThermProtn.DutyCycThermProtnAbsltCuTTqFetMtgtnTblY.Ary1D "MICROSAR RTE" /begin SUB_GROUP /end SUB_GROUP /begin FUNCTION_LIST /end FUNCTION_LIST
 /begin REF_CHARACTERISTIC DutyCycThermProtn.DutyCycThermProtnAbsltCuTTqFetMtgtnTblY.Ary1D /end REF_CHARACTERISTIC
 /begin REF_MEASUREMENT /end REF_MEASUREMENT
/end GROUP
/begin GROUP DutyCycThermProtn.DutyCycThermProtnAbsltCuTTqTblY.Ary1D "MICROSAR RTE" /begin SUB_GROUP /end SUB_GROUP /begin FUNCTION_LIST /end FUNCTION_LIST /begin REF_CHARACTERISTIC DutyCycThermProtn.DutyCycThermProtnAbsltCuTTqTblY.Ary1D /end REF_CHARACTERISTIC /begin REF_MEASUREMENT /end REF_MEASUREMENT /end GROUP
/begin GROUP DutyCycThermProtn.DutyCycThermProtnAbsltMotVelBreakPt.Val "MICROSAR RTE" /begin SUB_GROUP /end SUB_GROUP /begin FUNCTION_LIST /end FUNCTION_LIST /begin REF_CHARACTERISTIC DutyCycThermProtn.DutyCycThermProtnAbsltMotVelBreakPt.Val /end REF_CHARACTERISTIC /begin REF_MEASUREMENT /end REF_MEASUREMENT /end GROUP
/begin GROUP DutyCycThermProtn.DutyCycThermProtnAbsltTTqSlewHiLim.Val "MICROSAR RTE" /begin SUB_GROUP /end SUB_GROUP /begin FUNCTION_LIST /end FUNCTION_LIST /begin REF_CHARACTERISTIC DutyCycThermProtn.DutyCycThermProtnAbsltTTqSlewHiLim.Val /end REF_CHARACTERISTIC /begin REF_MEASUREMENT /end REF_MEASUREMENT /end GROUP
/begin GROUP DutyCycThermProtn.DutyCycThermProtnAbsltTTqSlewLoLim.Val "MICROSAR RTE" /begin SUB_GROUP /end SUB_GROUP /begin FUNCTION_LIST /end FUNCTION_LIST /begin REF_CHARACTERISTIC DutyCycThermProtn.DutyCycThermProtnAbsltTTqSlewLoLim.Val /end REF_CHARACTERISTIC /begin REF_MEASUREMENT /end REF_MEASUREMENT /end GROUP
/begin GROUP DutyCycThermProtn.DutyCycThermProtnCtrlT.Val "MICROSAR RTE" /begin SUB_GROUP /end SUB_GROUP /begin FUNCTION_LIST /end FUNCTION_LIST /begin REF_CHARACTERISTIC DutyCycThermProtn.DutyCycThermProtnCtrlT.Val /end REF_CHARACTERISTIC /begin REF_MEASUREMENT /end REF_MEASUREMENT /end GROUP
/begin GROUP DutyCycThermProtn.DutyCycThermProtnCtrlTSeln.Logl "MICROSAR RTE" /begin SUB_GROUP /end SUB_GROUP /begin FUNCTION_LIST /end FUNCTION_LIST /begin REF_CHARACTERISTIC DutyCycThermProtn.DutyCycThermProtnCtrlTSeln.Logl /end REF_CHARACTERISTIC /begin REF_MEASUREMENT /end REF_MEASUREMENT /end GROUP
/begin GROUP DutyCycThermProtn.DutyCycThermProtnDi.Logl "MICROSAR RTE" /begin SUB_GROUP /end SUB_GROUP /begin FUNCTION_LIST /end FUNCTION_LIST /begin REF_CHARACTERISTIC /end REF_CHARACTERISTIC /begin REF_MEASUREMENT DutyCycThermProtn.DutyCycThermProtnDi.Logl /end REF_MEASUREMENT /end GROUP
/begin GROUP DutyCycThermProtn.DutyCycThermProtnDutyCycFildThd.Val "MICROSAR RTE" /begin SUB_GROUP /end SUB_GROUP /begin FUNCTION_LIST /end FUNCTION_LIST /begin REF_CHARACTERISTIC DutyCycThermProtn.DutyCycThermProtnDutyCycFildThd.Val /end REF_CHARACTERISTIC /begin REF_MEASUREMENT /end REF_MEASUREMENT /end GROUP
/begin GROUP DutyCycThermProtn.DutyCycThermProtnIgnOffCtrlEna.Logl "MICROSAR RTE" /begin SUB_GROUP /end SUB_GROUP /begin FUNCTION_LIST /end FUNCTION_LIST /begin REF_CHARACTERISTIC DutyCycThermProtn.DutyCycThermProtnIgnOffCtrlEna.Logl /end REF_CHARACTERISTIC /begin REF_MEASUREMENT /end REF_MEASUREMENT /end GROUP
/begin GROUP DutyCycThermProtn.DutyCycThermProtnIgnOffMsgWaitTi.Val "MICROSAR RTE" /begin SUB_GROUP /end SUB_GROUP /begin FUNCTION_LIST /end FUNCTION_LIST /begin REF_CHARACTERISTIC DutyCycThermProtn.DutyCycThermProtnIgnOffMsgWaitTi.Val /end REF_CHARACTERISTIC /begin REF_MEASUREMENT /end REF_MEASUREMENT /end GROUP
/begin GROUP DutyCycThermProtn.DutyCycThermProtnLstTblValNonStall.Ary2D "MICROSAR RTE" /begin SUB_GROUP /end SUB_GROUP /begin FUNCTION_LIST /end FUNCTION_LIST /begin REF_CHARACTERISTIC DutyCycThermProtn.DutyCycThermProtnLstTblValNonStall.Ary2D /end REF_CHARACTERISTIC /begin REF_MEASUREMENT /end REF_MEASUREMENT /end GROUP
/begin GROUP DutyCycThermProtn.DutyCycThermProtnLstTblValStall.Ary2D "MICROSAR RTE" /begin SUB_GROUP /end SUB_GROUP /begin FUNCTION_LIST /end FUNCTION_LIST /begin REF_CHARACTERISTIC DutyCycThermProtn.DutyCycThermProtnLstTblValStall.Ary2D /end REF_CHARACTERISTIC /begin REF_MEASUREMENT /end REF_MEASUREMENT /end GROUP
/begin GROUP DutyCycThermProtn.DutyCycThermProtnMaxOutp.Val "MICROSAR RTE" /begin SUB_GROUP /end SUB_GROUP /begin FUNCTION_LIST /end FUNCTION_LIST /begin REF_CHARACTERISTIC /end REF_CHARACTERISTIC /begin REF_MEASUREMENT DutyCycThermProtn.DutyCycThermProtnMaxOutp.Val /end REF_MEASUREMENT /end GROUP
/begin GROUP DutyCycThermProtn.DutyCycThermProtnMotPrTSeln.Logl "MICROSAR RTE" /begin SUB_GROUP /end SUB_GROUP /begin FUNCTION_LIST /end FUNCTION_LIST /begin REF_CHARACTERISTIC DutyCycThermProtn.DutyCycThermProtnMotPrTSeln.Logl /end REF_CHARACTERISTIC /begin REF_MEASUREMENT /end REF_MEASUREMENT /end GROUP
/begin GROUP DutyCycThermProtn.DutyCycThermProtnMplr1FetMtgtnNonStallTblY.Ary1D "MICROSAR RTE" /begin SUB_GROUP /end SUB_GROUP /begin FUNCTION_LIST /end FUNCTION_LIST
 /begin REF_CHARACTERISTIC DutyCycThermProtn.DutyCycThermProtnMplr1FetMtgtnNonStallTblY.Ary1D /end REF_CHARACTERISTIC
 /begin REF_MEASUREMENT /end REF_MEASUREMENT
/end GROUP
/begin GROUP DutyCycThermProtn.DutyCycThermProtnMplr1FetMtgtnStallTblY.Ary1D "MICROSAR RTE" /begin SUB_GROUP /end SUB_GROUP /begin FUNCTION_LIST /end FUNCTION_LIST
 /begin REF_CHARACTERISTIC DutyCycThermProtn.DutyCycThermProtnMplr1FetMtgtnStallTblY.Ary1D /end REF_CHARACTERISTIC
 /begin REF_MEASUREMENT /end REF_MEASUREMENT
/end GROUP
/begin GROUP DutyCycThermProtn.DutyCycThermProtnMplr1NonStallTblY.Ary1D "MICROSAR RTE" /begin SUB_GROUP /end SUB_GROUP /begin FUNCTION_LIST /end FUNCTION_LIST /begin REF_CHARACTERISTIC DutyCycThermProtn.DutyCycThermProtnMplr1NonStallTblY.Ary1D /end REF_CHARACTERISTIC /begin REF_MEASUREMENT /end REF_MEASUREMENT /end GROUP
/begin GROUP DutyCycThermProtn.DutyCycThermProtnMplr1StallTblY.Ary1D "MICROSAR RTE" /begin SUB_GROUP /end SUB_GROUP /begin FUNCTION_LIST /end FUNCTION_LIST /begin REF_CHARACTERISTIC DutyCycThermProtn.DutyCycThermProtnMplr1StallTblY.Ary1D /end REF_CHARACTERISTIC /begin REF_MEASUREMENT /end REF_MEASUREMENT /end GROUP
/begin GROUP DutyCycThermProtn.DutyCycThermProtnMplr2FetMtgtnNonStallTblY.Ary1D "MICROSAR RTE" /begin SUB_GROUP /end SUB_GROUP /begin FUNCTION_LIST /end FUNCTION_LIST
 /begin REF_CHARACTERISTIC DutyCycThermProtn.DutyCycThermProtnMplr2FetMtgtnNonStallTblY.Ary1D /end REF_CHARACTERISTIC
 /begin REF_MEASUREMENT /end REF_MEASUREMENT
/end GROUP
/begin GROUP DutyCycThermProtn.DutyCycThermProtnMplr2FetMtgtnStallTblY.Ary1D "MICROSAR RTE" /begin SUB_GROUP /end SUB_GROUP /begin FUNCTION_LIST /end FUNCTION_LIST
 /begin REF_CHARACTERISTIC DutyCycThermProtn.DutyCycThermProtnMplr2FetMtgtnStallTblY.Ary1D /end REF_CHARACTERISTIC
 /begin REF_MEASUREMENT /end REF_MEASUREMENT
/end GROUP
/begin GROUP DutyCycThermProtn.DutyCycThermProtnMplr2NonStallTblY.Ary1D "MICROSAR RTE" /begin SUB_GROUP /end SUB_GROUP /begin FUNCTION_LIST /end FUNCTION_LIST /begin REF_CHARACTERISTIC DutyCycThermProtn.DutyCycThermProtnMplr2NonStallTblY.Ary1D /end REF_CHARACTERISTIC /begin REF_MEASUREMENT /end REF_MEASUREMENT /end GROUP
/begin GROUP DutyCycThermProtn.DutyCycThermProtnMplr2StallTblY.Ary1D "MICROSAR RTE" /begin SUB_GROUP /end SUB_GROUP /begin FUNCTION_LIST /end FUNCTION_LIST /begin REF_CHARACTERISTIC DutyCycThermProtn.DutyCycThermProtnMplr2StallTblY.Ary1D /end REF_CHARACTERISTIC /begin REF_MEASUREMENT /end REF_MEASUREMENT /end GROUP
/begin GROUP DutyCycThermProtn.DutyCycThermProtnMplr3FetMtgtnNonStallTblY.Ary1D "MICROSAR RTE" /begin SUB_GROUP /end SUB_GROUP /begin FUNCTION_LIST /end FUNCTION_LIST
 /begin REF_CHARACTERISTIC DutyCycThermProtn.DutyCycThermProtnMplr3FetMtgtnNonStallTblY.Ary1D /end REF_CHARACTERISTIC
 /begin REF_MEASUREMENT /end REF_MEASUREMENT
/end GROUP
/begin GROUP DutyCycThermProtn.DutyCycThermProtnMplr3FetMtgtnStallTblY.Ary1D "MICROSAR RTE" /begin SUB_GROUP /end SUB_GROUP /begin FUNCTION_LIST /end FUNCTION_LIST
 /begin REF_CHARACTERISTIC DutyCycThermProtn.DutyCycThermProtnMplr3FetMtgtnStallTblY.Ary1D /end REF_CHARACTERISTIC
 /begin REF_MEASUREMENT /end REF_MEASUREMENT
/end GROUP
/begin GROUP DutyCycThermProtn.DutyCycThermProtnMplr3NonStallTblY.Ary1D "MICROSAR RTE" /begin SUB_GROUP /end SUB_GROUP /begin FUNCTION_LIST /end FUNCTION_LIST /begin REF_CHARACTERISTIC DutyCycThermProtn.DutyCycThermProtnMplr3NonStallTblY.Ary1D /end REF_CHARACTERISTIC /begin REF_MEASUREMENT /end REF_MEASUREMENT /end GROUP
/begin GROUP DutyCycThermProtn.DutyCycThermProtnMplr3StallTblY.Ary1D "MICROSAR RTE" /begin SUB_GROUP /end SUB_GROUP /begin FUNCTION_LIST /end FUNCTION_LIST /begin REF_CHARACTERISTIC DutyCycThermProtn.DutyCycThermProtnMplr3StallTblY.Ary1D /end REF_CHARACTERISTIC /begin REF_MEASUREMENT /end REF_MEASUREMENT /end GROUP
/begin GROUP DutyCycThermProtn.DutyCycThermProtnMplr4FetMtgtnNonStallTblY.Ary1D "MICROSAR RTE" /begin SUB_GROUP /end SUB_GROUP /begin FUNCTION_LIST /end FUNCTION_LIST
 /begin REF_CHARACTERISTIC DutyCycThermProtn.DutyCycThermProtnMplr4FetMtgtnNonStallTblY.Ary1D /end REF_CHARACTERISTIC
 /begin REF_MEASUREMENT /end REF_MEASUREMENT
/end GROUP
/begin GROUP DutyCycThermProtn.DutyCycThermProtnMplr4FetMtgtnStallTblY.Ary1D "MICROSAR RTE" /begin SUB_GROUP /end SUB_GROUP /begin FUNCTION_LIST /end FUNCTION_LIST
 /begin REF_CHARACTERISTIC DutyCycThermProtn.DutyCycThermProtnMplr4FetMtgtnStallTblY.Ary1D /end REF_CHARACTERISTIC
 /begin REF_MEASUREMENT /end REF_MEASUREMENT
/end GROUP
/begin GROUP DutyCycThermProtn.DutyCycThermProtnMplr4NonStallTblY.Ary1D "MICROSAR RTE" /begin SUB_GROUP /end SUB_GROUP /begin FUNCTION_LIST /end FUNCTION_LIST /begin REF_CHARACTERISTIC DutyCycThermProtn.DutyCycThermProtnMplr4NonStallTblY.Ary1D /end REF_CHARACTERISTIC /begin REF_MEASUREMENT /end REF_MEASUREMENT /end GROUP
/begin GROUP DutyCycThermProtn.DutyCycThermProtnMplr4StallTblY.Ary1D "MICROSAR RTE" /begin SUB_GROUP /end SUB_GROUP /begin FUNCTION_LIST /end FUNCTION_LIST /begin REF_CHARACTERISTIC DutyCycThermProtn.DutyCycThermProtnMplr4StallTblY.Ary1D /end REF_CHARACTERISTIC /begin REF_MEASUREMENT /end REF_MEASUREMENT /end GROUP
/begin GROUP DutyCycThermProtn.DutyCycThermProtnMplr5FetMtgtnNonStallTblY.Ary1D "MICROSAR RTE" /begin SUB_GROUP /end SUB_GROUP /begin FUNCTION_LIST /end FUNCTION_LIST
 /begin REF_CHARACTERISTIC DutyCycThermProtn.DutyCycThermProtnMplr5FetMtgtnNonStallTblY.Ary1D /end REF_CHARACTERISTIC
 /begin REF_MEASUREMENT /end REF_MEASUREMENT
/end GROUP
/begin GROUP DutyCycThermProtn.DutyCycThermProtnMplr5FetMtgtnStallTblY.Ary1D "MICROSAR RTE" /begin SUB_GROUP /end SUB_GROUP /begin FUNCTION_LIST /end FUNCTION_LIST
 /begin REF_CHARACTERISTIC DutyCycThermProtn.DutyCycThermProtnMplr5FetMtgtnStallTblY.Ary1D /end REF_CHARACTERISTIC
 /begin REF_MEASUREMENT /end REF_MEASUREMENT
/end GROUP
/begin GROUP DutyCycThermProtn.DutyCycThermProtnMplr5NonStallTblY.Ary1D "MICROSAR RTE" /begin SUB_GROUP /end SUB_GROUP /begin FUNCTION_LIST /end FUNCTION_LIST /begin REF_CHARACTERISTIC DutyCycThermProtn.DutyCycThermProtnMplr5NonStallTblY.Ary1D /end REF_CHARACTERISTIC /begin REF_MEASUREMENT /end REF_MEASUREMENT /end GROUP
/begin GROUP DutyCycThermProtn.DutyCycThermProtnMplr5StallTblY.Ary1D "MICROSAR RTE" /begin SUB_GROUP /end SUB_GROUP /begin FUNCTION_LIST /end FUNCTION_LIST /begin REF_CHARACTERISTIC DutyCycThermProtn.DutyCycThermProtnMplr5StallTblY.Ary1D /end REF_CHARACTERISTIC /begin REF_MEASUREMENT /end REF_MEASUREMENT /end GROUP
/begin GROUP DutyCycThermProtn.DutyCycThermProtnMplr6FetMtgtnNonStallTblY.Ary1D "MICROSAR RTE" /begin SUB_GROUP /end SUB_GROUP /begin FUNCTION_LIST /end FUNCTION_LIST
 /begin REF_CHARACTERISTIC DutyCycThermProtn.DutyCycThermProtnMplr6FetMtgtnNonStallTblY.Ary1D /end REF_CHARACTERISTIC
 /begin REF_MEASUREMENT /end REF_MEASUREMENT
/end GROUP
/begin GROUP DutyCycThermProtn.DutyCycThermProtnMplr6FetMtgtnStallTblY.Ary1D "MICROSAR RTE" /begin SUB_GROUP /end SUB_GROUP /begin FUNCTION_LIST /end FUNCTION_LIST
 /begin REF_CHARACTERISTIC DutyCycThermProtn.DutyCycThermProtnMplr6FetMtgtnStallTblY.Ary1D /end REF_CHARACTERISTIC
 /begin REF_MEASUREMENT /end REF_MEASUREMENT
/end GROUP
/begin GROUP DutyCycThermProtn.DutyCycThermProtnMplr6NonStallTblY.Ary1D "MICROSAR RTE" /begin SUB_GROUP /end SUB_GROUP /begin FUNCTION_LIST /end FUNCTION_LIST /begin REF_CHARACTERISTIC DutyCycThermProtn.DutyCycThermProtnMplr6NonStallTblY.Ary1D /end REF_CHARACTERISTIC /begin REF_MEASUREMENT /end REF_MEASUREMENT /end GROUP
/begin GROUP DutyCycThermProtn.DutyCycThermProtnMplr6StallTblY.Ary1D "MICROSAR RTE" /begin SUB_GROUP /end SUB_GROUP /begin FUNCTION_LIST /end FUNCTION_LIST /begin REF_CHARACTERISTIC DutyCycThermProtn.DutyCycThermProtnMplr6StallTblY.Ary1D /end REF_CHARACTERISTIC /begin REF_MEASUREMENT /end REF_MEASUREMENT /end GROUP
/begin GROUP DutyCycThermProtn.DutyCycThermProtnMplrFetMtgtnTblX.Ary1D "MICROSAR RTE" /begin SUB_GROUP /end SUB_GROUP /begin FUNCTION_LIST /end FUNCTION_LIST /begin REF_CHARACTERISTIC DutyCycThermProtn.DutyCycThermProtnMplrFetMtgtnTblX.Ary1D /end REF_CHARACTERISTIC /begin REF_MEASUREMENT /end REF_MEASUREMENT /end GROUP
/begin GROUP DutyCycThermProtn.DutyCycThermProtnMplrTSeln.Logl "MICROSAR RTE" /begin SUB_GROUP /end SUB_GROUP /begin FUNCTION_LIST /end FUNCTION_LIST /begin REF_CHARACTERISTIC DutyCycThermProtn.DutyCycThermProtnMplrTSeln.Logl /end REF_CHARACTERISTIC /begin REF_MEASUREMENT /end REF_MEASUREMENT /end GROUP
/begin GROUP DutyCycThermProtn.DutyCycThermProtnMplrTblX.Ary1D "MICROSAR RTE" /begin SUB_GROUP /end SUB_GROUP /begin FUNCTION_LIST /end FUNCTION_LIST /begin REF_CHARACTERISTIC DutyCycThermProtn.DutyCycThermProtnMplrTblX.Ary1D /end REF_CHARACTERISTIC /begin REF_MEASUREMENT /end REF_MEASUREMENT /end GROUP
/begin GROUP DutyCycThermProtn.DutyCycThermProtnSlowFilTSeln.Logl "MICROSAR RTE" /begin SUB_GROUP /end SUB_GROUP /begin FUNCTION_LIST /end FUNCTION_LIST /begin REF_CHARACTERISTIC DutyCycThermProtn.DutyCycThermProtnSlowFilTSeln.Logl /end REF_CHARACTERISTIC /begin REF_MEASUREMENT /end REF_MEASUREMENT /end GROUP
/begin GROUP DutyCycThermProtn.DutyCycThermProtnThermLimScaFac.Val "MICROSAR RTE" /begin SUB_GROUP /end SUB_GROUP /begin FUNCTION_LIST /end FUNCTION_LIST /begin REF_CHARACTERISTIC DutyCycThermProtn.DutyCycThermProtnThermLimScaFac.Val /end REF_CHARACTERISTIC /begin REF_MEASUREMENT /end REF_MEASUREMENT /end GROUP
/begin GROUP DutyCycThermProtn.DutyCycThermProtnThermLoadLimTblX.Ary2D "MICROSAR RTE" /begin SUB_GROUP /end SUB_GROUP /begin FUNCTION_LIST /end FUNCTION_LIST /begin REF_CHARACTERISTIC DutyCycThermProtn.DutyCycThermProtnThermLoadLimTblX.Ary2D /end REF_CHARACTERISTIC /begin REF_MEASUREMENT /end REF_MEASUREMENT /end GROUP
/begin GROUP DutyCycThermProtn.DutyCycThermProtnThermLoadLimTblY.Ary2D "MICROSAR RTE" /begin SUB_GROUP /end SUB_GROUP /begin FUNCTION_LIST /end FUNCTION_LIST /begin REF_CHARACTERISTIC DutyCycThermProtn.DutyCycThermProtnThermLoadLimTblY.Ary2D /end REF_CHARACTERISTIC /begin REF_MEASUREMENT /end REF_MEASUREMENT /end GROUP
/begin GROUP DutyCycThermProtn.DutyCycThermProtnTqCmdSlewDwn.Val "MICROSAR RTE" /begin SUB_GROUP /end SUB_GROUP /begin FUNCTION_LIST /end FUNCTION_LIST /begin REF_CHARACTERISTIC DutyCycThermProtn.DutyCycThermProtnTqCmdSlewDwn.Val /end REF_CHARACTERISTIC /begin REF_MEASUREMENT /end REF_MEASUREMENT /end GROUP
/begin GROUP DutyCycThermProtn.DutyCycThermProtnTqCmdSlewUp.Val "MICROSAR RTE" /begin SUB_GROUP /end SUB_GROUP /begin FUNCTION_LIST /end FUNCTION_LIST /begin REF_CHARACTERISTIC DutyCycThermProtn.DutyCycThermProtnTqCmdSlewUp.Val /end REF_CHARACTERISTIC /begin REF_MEASUREMENT /end REF_MEASUREMENT /end GROUP
/begin GROUP DutyCycThermProtn.EcuTFild.Val "MICROSAR RTE" /begin SUB_GROUP /end SUB_GROUP /begin FUNCTION_LIST /end FUNCTION_LIST /begin REF_CHARACTERISTIC /end REF_CHARACTERISTIC /begin REF_MEASUREMENT DutyCycThermProtn.EcuTFild.Val /end REF_MEASUREMENT /end GROUP
/begin GROUP DutyCycThermProtn.FetLoaMtgtnEnaPrev "MICROSAR RTE" /begin SUB_GROUP /end SUB_GROUP /begin FUNCTION_LIST /end FUNCTION_LIST /begin REF_CHARACTERISTIC /end REF_CHARACTERISTIC /begin REF_MEASUREMENT DutyCycThermProtn.FetLoaMtgtnEnaPrev /end REF_MEASUREMENT /end GROUP
/begin GROUP DutyCycThermProtn.FetMtgtnEnaCalIdx "MICROSAR RTE" /begin SUB_GROUP /end SUB_GROUP /begin FUNCTION_LIST /end FUNCTION_LIST /begin REF_CHARACTERISTIC /end REF_CHARACTERISTIC /begin REF_MEASUREMENT DutyCycThermProtn.FetMtgtnEnaCalIdx /end REF_MEASUREMENT /end GROUP
/begin GROUP DutyCycThermProtn.Fil1ValStVari "MICROSAR RTE" /begin SUB_GROUP /end SUB_GROUP /begin FUNCTION_LIST /end FUNCTION_LIST /begin REF_CHARACTERISTIC /end REF_CHARACTERISTIC
 /begin REF_MEASUREMENT DutyCycThermProtn.Fil1ValStVari.FilGain DutyCycThermProtn.Fil1ValStVari.FilSt /end REF_MEASUREMENT
/end GROUP
/begin GROUP DutyCycThermProtn.Fil2ValStVari "MICROSAR RTE" /begin SUB_GROUP /end SUB_GROUP /begin FUNCTION_LIST /end FUNCTION_LIST /begin REF_CHARACTERISTIC /end REF_CHARACTERISTIC
 /begin REF_MEASUREMENT DutyCycThermProtn.Fil2ValStVari.FilGain DutyCycThermProtn.Fil2ValStVari.FilSt /end REF_MEASUREMENT
/end GROUP
/begin GROUP DutyCycThermProtn.Fil3ValPwrUp "MICROSAR RTE" /begin SUB_GROUP /end SUB_GROUP /begin FUNCTION_LIST /end FUNCTION_LIST /begin REF_CHARACTERISTIC /end REF_CHARACTERISTIC /begin REF_MEASUREMENT DutyCycThermProtn.Fil3ValPwrUp /end REF_MEASUREMENT /end GROUP
/begin GROUP DutyCycThermProtn.Fil4ValPwrUp "MICROSAR RTE" /begin SUB_GROUP /end SUB_GROUP /begin FUNCTION_LIST /end FUNCTION_LIST /begin REF_CHARACTERISTIC /end REF_CHARACTERISTIC /begin REF_MEASUREMENT DutyCycThermProtn.Fil4ValPwrUp /end REF_MEASUREMENT /end GROUP
/begin GROUP DutyCycThermProtn.Fil5ValPwrUp "MICROSAR RTE" /begin SUB_GROUP /end SUB_GROUP /begin FUNCTION_LIST /end FUNCTION_LIST /begin REF_CHARACTERISTIC /end REF_CHARACTERISTIC /begin REF_MEASUREMENT DutyCycThermProtn.Fil5ValPwrUp /end REF_MEASUREMENT /end GROUP
/begin GROUP DutyCycThermProtn.Fil6ValPwrUp "MICROSAR RTE" /begin SUB_GROUP /end SUB_GROUP /begin FUNCTION_LIST /end FUNCTION_LIST /begin REF_CHARACTERISTIC /end REF_CHARACTERISTIC /begin REF_MEASUREMENT DutyCycThermProtn.Fil6ValPwrUp /end REF_MEASUREMENT /end GROUP
/begin GROUP DutyCycThermProtn.FilStVal "MICROSAR RTE" /begin SUB_GROUP /end SUB_GROUP /begin FUNCTION_LIST /end FUNCTION_LIST /begin REF_CHARACTERISTIC /end REF_CHARACTERISTIC
 /begin REF_MEASUREMENT DutyCycThermProtn.FilStVal.Fil3StVal DutyCycThermProtn.FilStVal.Fil4StVal DutyCycThermProtn.FilStVal.Fil5StVal DutyCycThermProtn.FilStVal.Fil6StVal /end REF_MEASUREMENT
/end GROUP
/begin GROUP DutyCycThermProtn.Fild3Val "MICROSAR RTE" /begin SUB_GROUP /end SUB_GROUP /begin FUNCTION_LIST /end FUNCTION_LIST /begin REF_CHARACTERISTIC /end REF_CHARACTERISTIC
 /begin REF_MEASUREMENT DutyCycThermProtn.Fild3Val.FilGain DutyCycThermProtn.Fild3Val.FilSt /end REF_MEASUREMENT
/end GROUP
/begin GROUP DutyCycThermProtn.Fild4Val "MICROSAR RTE" /begin SUB_GROUP /end SUB_GROUP /begin FUNCTION_LIST /end FUNCTION_LIST /begin REF_CHARACTERISTIC /end REF_CHARACTERISTIC
 /begin REF_MEASUREMENT DutyCycThermProtn.Fild4Val.FilGain DutyCycThermProtn.Fild4Val.FilSt /end REF_MEASUREMENT
/end GROUP
/begin GROUP DutyCycThermProtn.Fild5Val "MICROSAR RTE" /begin SUB_GROUP /end SUB_GROUP /begin FUNCTION_LIST /end FUNCTION_LIST /begin REF_CHARACTERISTIC /end REF_CHARACTERISTIC
 /begin REF_MEASUREMENT DutyCycThermProtn.Fild5Val.FilGain DutyCycThermProtn.Fild5Val.FilSt /end REF_MEASUREMENT
/end GROUP
/begin GROUP DutyCycThermProtn.Fild6Val "MICROSAR RTE" /begin SUB_GROUP /end SUB_GROUP /begin FUNCTION_LIST /end FUNCTION_LIST /begin REF_CHARACTERISTIC /end REF_CHARACTERISTIC
 /begin REF_MEASUREMENT DutyCycThermProtn.Fild6Val.FilGain DutyCycThermProtn.Fild6Val.FilSt /end REF_MEASUREMENT
/end GROUP
/begin GROUP DutyCycThermProtn.IgnTiOff.Val "MICROSAR RTE" /begin SUB_GROUP /end SUB_GROUP /begin FUNCTION_LIST /end FUNCTION_LIST /begin REF_CHARACTERISTIC /end REF_CHARACTERISTIC /begin REF_MEASUREMENT DutyCycThermProtn.IgnTiOff.Val /end REF_MEASUREMENT /end GROUP
/begin GROUP DutyCycThermProtn.LstTblValRateLimrStVari "MICROSAR RTE" /begin SUB_GROUP /end SUB_GROUP /begin FUNCTION_LIST /end FUNCTION_LIST /begin REF_CHARACTERISTIC /end REF_CHARACTERISTIC /begin REF_MEASUREMENT DutyCycThermProtn.LstTblValRateLimrStVari /end REF_MEASUREMENT /end GROUP
/begin GROUP DutyCycThermProtn.MotAndThermProtnLoaMod.Val "MICROSAR RTE" /begin SUB_GROUP /end SUB_GROUP /begin FUNCTION_LIST /end FUNCTION_LIST /begin REF_CHARACTERISTIC /end REF_CHARACTERISTIC /begin REF_MEASUREMENT DutyCycThermProtn.MotAndThermProtnLoaMod.Val /end REF_MEASUREMENT /end GROUP
/begin GROUP DutyCycThermProtn.MotCurrPeakEstimd.Val "MICROSAR RTE" /begin SUB_GROUP /end SUB_GROUP /begin FUNCTION_LIST /end FUNCTION_LIST /begin REF_CHARACTERISTIC /end REF_CHARACTERISTIC /begin REF_MEASUREMENT DutyCycThermProtn.MotCurrPeakEstimd.Val /end REF_MEASUREMENT /end GROUP
/begin GROUP DutyCycThermProtn.MotCurrPeakEstimdFild.Val "MICROSAR RTE" /begin SUB_GROUP /end SUB_GROUP /begin FUNCTION_LIST /end FUNCTION_LIST /begin REF_CHARACTERISTIC /end REF_CHARACTERISTIC /begin REF_MEASUREMENT DutyCycThermProtn.MotCurrPeakEstimdFild.Val /end REF_MEASUREMENT /end GROUP
/begin GROUP DutyCycThermProtn.MotFetT.Val "MICROSAR RTE" /begin SUB_GROUP /end SUB_GROUP /begin FUNCTION_LIST /end FUNCTION_LIST /begin REF_CHARACTERISTIC /end REF_CHARACTERISTIC /begin REF_MEASUREMENT DutyCycThermProtn.MotFetT.Val /end REF_MEASUREMENT /end GROUP
/begin GROUP DutyCycThermProtn.MotMagT.Val "MICROSAR RTE" /begin SUB_GROUP /end SUB_GROUP /begin FUNCTION_LIST /end FUNCTION_LIST /begin REF_CHARACTERISTIC /end REF_CHARACTERISTIC /begin REF_MEASUREMENT DutyCycThermProtn.MotMagT.Val /end REF_MEASUREMENT /end GROUP
/begin GROUP DutyCycThermProtn.MotVelCrf.Val "MICROSAR RTE" /begin SUB_GROUP /end SUB_GROUP /begin FUNCTION_LIST /end FUNCTION_LIST /begin REF_CHARACTERISTIC /end REF_CHARACTERISTIC /begin REF_MEASUREMENT DutyCycThermProtn.MotVelCrf.Val /end REF_MEASUREMENT /end GROUP
/begin GROUP DutyCycThermProtn.MotWidgT.Val "MICROSAR RTE" /begin SUB_GROUP /end SUB_GROUP /begin FUNCTION_LIST /end FUNCTION_LIST /begin REF_CHARACTERISTIC /end REF_CHARACTERISTIC /begin REF_MEASUREMENT DutyCycThermProtn.MotWidgT.Val /end REF_MEASUREMENT /end GROUP
/begin GROUP DutyCycThermProtn.PerInstanceMemories "MICROSAR RTE"
 /begin SUB_GROUP DutyCycThermProtn.AbsltTLimSlewStVari DutyCycThermProtn.FetLoaMtgtnEnaPrev DutyCycThermProtn.FetMtgtnEnaCalIdx DutyCycThermProtn.Fil1ValStVari DutyCycThermProtn.Fil2ValStVari DutyCycThermProtn.Fil3ValPwrUp DutyCycThermProtn.Fil4ValPwrUp DutyCycThermProtn.Fil5ValPwrUp DutyCycThermProtn.Fil6ValPwrUp DutyCycThermProtn.FilStVal DutyCycThermProtn.Fild3Val DutyCycThermProtn.Fild4Val DutyCycThermProtn.Fild5Val DutyCycThermProtn.Fild6Val DutyCycThermProtn.LstTblValRateLimrStVari DutyCycThermProtn.ReInitCntrFlg DutyCycThermProtn.ReInitCntrVal DutyCycThermProtn.dDutyCycThermProtnAbsltCtrlrTTqLim DutyCycThermProtn.dDutyCycThermProtnAbsltCuTTqLim DutyCycThermProtn.dDutyCycThermProtnAbsltTTqLim DutyCycThermProtn.dDutyCycThermProtnLstTblVal DutyCycThermProtn.dDutyCycThermProtnLstTblValSlew DutyCycThermProtn.dDutyCycThermProtnMplr1 DutyCycThermProtn.dDutyCycThermProtnMplr12T DutyCycThermProtn.dDutyCycThermProtnMplr2 DutyCycThermProtn.dDutyCycThermProtnMplr3 DutyCycThermProtn.dDutyCycThermProtnMplr36T DutyCycThermProtn.dDutyCycThermProtnMplr4 DutyCycThermProtn.dDutyCycThermProtnMplr5 DutyCycThermProtn.dDutyCycThermProtnMplr6 DutyCycThermProtn.dDutyCycThermProtnThermLoadLim DutyCycThermProtn.dDutyCycThermProtnThermLoadLimTblYVal /end SUB_GROUP
 /begin FUNCTION_LIST /end FUNCTION_LIST
 /begin REF_CHARACTERISTIC /end REF_CHARACTERISTIC
 /begin REF_MEASUREMENT /end REF_MEASUREMENT
/end GROUP
/begin GROUP DutyCycThermProtn.ReInitCntrFlg "MICROSAR RTE" /begin SUB_GROUP /end SUB_GROUP /begin FUNCTION_LIST /end FUNCTION_LIST /begin REF_CHARACTERISTIC /end REF_CHARACTERISTIC /begin REF_MEASUREMENT DutyCycThermProtn.ReInitCntrFlg /end REF_MEASUREMENT /end GROUP
/begin GROUP DutyCycThermProtn.ReInitCntrVal "MICROSAR RTE" /begin SUB_GROUP /end SUB_GROUP /begin FUNCTION_LIST /end FUNCTION_LIST /begin REF_CHARACTERISTIC /end REF_CHARACTERISTIC /begin REF_MEASUREMENT DutyCycThermProtn.ReInitCntrVal /end REF_MEASUREMENT /end GROUP
/begin GROUP DutyCycThermProtn.ReceiverPorts "MICROSAR RTE"
 /begin SUB_GROUP DutyCycThermProtn.DiagcStsLimdTPrfmnc.Logl DutyCycThermProtn.DualEcuFltMtgtnEna.Logl DutyCycThermProtn.DutyCycThermProtnDi.Logl DutyCycThermProtn.EcuTFild.Val DutyCycThermProtn.IgnTiOff.Val DutyCycThermProtn.MotAndThermProtnLoaMod.Val DutyCycThermProtn.MotCurrPeakEstimd.Val DutyCycThermProtn.MotCurrPeakEstimdFild.Val DutyCycThermProtn.MotFetT.Val DutyCycThermProtn.MotMagT.Val DutyCycThermProtn.MotVelCrf.Val DutyCycThermProtn.MotWidgT.Val DutyCycThermProtn.VehTiVld.Logl /end SUB_GROUP
 /begin FUNCTION_LIST /end FUNCTION_LIST
 /begin REF_CHARACTERISTIC /end REF_CHARACTERISTIC
 /begin REF_MEASUREMENT /end REF_MEASUREMENT
/end GROUP
/begin GROUP DutyCycThermProtn.SenderPorts "MICROSAR RTE"
 /begin SUB_GROUP DutyCycThermProtn.DutyCycThermProtnMaxOutp.Val DutyCycThermProtn.ThermDutyCycProtnLoadDptLim.Val DutyCycThermProtn.ThermDutyCycProtnTDptLim.Val DutyCycThermProtn.ThermLimSlowFilMax.Val DutyCycThermProtn.ThermMotTqLim.Val DutyCycThermProtn.ThermRednFac.Val /end SUB_GROUP
 /begin FUNCTION_LIST /end FUNCTION_LIST
 /begin REF_CHARACTERISTIC /end REF_CHARACTERISTIC
 /begin REF_MEASUREMENT /end REF_MEASUREMENT
/end GROUP
/begin GROUP DutyCycThermProtn.ThermDutyCycProtnLoadDptLim.Val "MICROSAR RTE" /begin SUB_GROUP /end SUB_GROUP /begin FUNCTION_LIST /end FUNCTION_LIST /begin REF_CHARACTERISTIC /end REF_CHARACTERISTIC /begin REF_MEASUREMENT DutyCycThermProtn.ThermDutyCycProtnLoadDptLim.Val /end REF_MEASUREMENT /end GROUP
/begin GROUP DutyCycThermProtn.ThermDutyCycProtnTDptLim.Val "MICROSAR RTE" /begin SUB_GROUP /end SUB_GROUP /begin FUNCTION_LIST /end FUNCTION_LIST /begin REF_CHARACTERISTIC /end REF_CHARACTERISTIC /begin REF_MEASUREMENT DutyCycThermProtn.ThermDutyCycProtnTDptLim.Val /end REF_MEASUREMENT /end GROUP
/begin GROUP DutyCycThermProtn.ThermLimSlowFilMax.Val "MICROSAR RTE" /begin SUB_GROUP /end SUB_GROUP /begin FUNCTION_LIST /end FUNCTION_LIST /begin REF_CHARACTERISTIC /end REF_CHARACTERISTIC /begin REF_MEASUREMENT DutyCycThermProtn.ThermLimSlowFilMax.Val /end REF_MEASUREMENT /end GROUP
/begin GROUP DutyCycThermProtn.ThermMotTqLim.Val "MICROSAR RTE" /begin SUB_GROUP /end SUB_GROUP /begin FUNCTION_LIST /end FUNCTION_LIST /begin REF_CHARACTERISTIC /end REF_CHARACTERISTIC /begin REF_MEASUREMENT DutyCycThermProtn.ThermMotTqLim.Val /end REF_MEASUREMENT /end GROUP
/begin GROUP DutyCycThermProtn.ThermRednFac.Val "MICROSAR RTE" /begin SUB_GROUP /end SUB_GROUP /begin FUNCTION_LIST /end FUNCTION_LIST /begin REF_CHARACTERISTIC /end REF_CHARACTERISTIC /begin REF_MEASUREMENT DutyCycThermProtn.ThermRednFac.Val /end REF_MEASUREMENT /end GROUP
/begin GROUP DutyCycThermProtn.VehTiVld.Logl "MICROSAR RTE" /begin SUB_GROUP /end SUB_GROUP /begin FUNCTION_LIST /end FUNCTION_LIST /begin REF_CHARACTERISTIC /end REF_CHARACTERISTIC /begin REF_MEASUREMENT DutyCycThermProtn.VehTiVld.Logl /end REF_MEASUREMENT /end GROUP
/begin GROUP DutyCycThermProtn.dDutyCycThermProtnAbsltCtrlrTTqLim "MICROSAR RTE" /begin SUB_GROUP /end SUB_GROUP /begin FUNCTION_LIST /end FUNCTION_LIST /begin REF_CHARACTERISTIC /end REF_CHARACTERISTIC /begin REF_MEASUREMENT DutyCycThermProtn.dDutyCycThermProtnAbsltCtrlrTTqLim /end REF_MEASUREMENT /end GROUP
/begin GROUP DutyCycThermProtn.dDutyCycThermProtnAbsltCuTTqLim "MICROSAR RTE" /begin SUB_GROUP /end SUB_GROUP /begin FUNCTION_LIST /end FUNCTION_LIST /begin REF_CHARACTERISTIC /end REF_CHARACTERISTIC /begin REF_MEASUREMENT DutyCycThermProtn.dDutyCycThermProtnAbsltCuTTqLim /end REF_MEASUREMENT /end GROUP
/begin GROUP DutyCycThermProtn.dDutyCycThermProtnAbsltTTqLim "MICROSAR RTE" /begin SUB_GROUP /end SUB_GROUP /begin FUNCTION_LIST /end FUNCTION_LIST /begin REF_CHARACTERISTIC /end REF_CHARACTERISTIC /begin REF_MEASUREMENT DutyCycThermProtn.dDutyCycThermProtnAbsltTTqLim /end REF_MEASUREMENT /end GROUP
/begin GROUP DutyCycThermProtn.dDutyCycThermProtnLstTblVal "MICROSAR RTE" /begin SUB_GROUP /end SUB_GROUP /begin FUNCTION_LIST /end FUNCTION_LIST /begin REF_CHARACTERISTIC /end REF_CHARACTERISTIC /begin REF_MEASUREMENT DutyCycThermProtn.dDutyCycThermProtnLstTblVal /end REF_MEASUREMENT /end GROUP
/begin GROUP DutyCycThermProtn.dDutyCycThermProtnLstTblValSlew "MICROSAR RTE" /begin SUB_GROUP /end SUB_GROUP /begin FUNCTION_LIST /end FUNCTION_LIST /begin REF_CHARACTERISTIC /end REF_CHARACTERISTIC /begin REF_MEASUREMENT DutyCycThermProtn.dDutyCycThermProtnLstTblValSlew /end REF_MEASUREMENT /end GROUP
/begin GROUP DutyCycThermProtn.dDutyCycThermProtnMplr1 "MICROSAR RTE" /begin SUB_GROUP /end SUB_GROUP /begin FUNCTION_LIST /end FUNCTION_LIST /begin REF_CHARACTERISTIC /end REF_CHARACTERISTIC /begin REF_MEASUREMENT DutyCycThermProtn.dDutyCycThermProtnMplr1 /end REF_MEASUREMENT /end GROUP
/begin GROUP DutyCycThermProtn.dDutyCycThermProtnMplr12T "MICROSAR RTE" /begin SUB_GROUP /end SUB_GROUP /begin FUNCTION_LIST /end FUNCTION_LIST /begin REF_CHARACTERISTIC /end REF_CHARACTERISTIC /begin REF_MEASUREMENT DutyCycThermProtn.dDutyCycThermProtnMplr12T /end REF_MEASUREMENT /end GROUP
/begin GROUP DutyCycThermProtn.dDutyCycThermProtnMplr2 "MICROSAR RTE" /begin SUB_GROUP /end SUB_GROUP /begin FUNCTION_LIST /end FUNCTION_LIST /begin REF_CHARACTERISTIC /end REF_CHARACTERISTIC /begin REF_MEASUREMENT DutyCycThermProtn.dDutyCycThermProtnMplr2 /end REF_MEASUREMENT /end GROUP
/begin GROUP DutyCycThermProtn.dDutyCycThermProtnMplr3 "MICROSAR RTE" /begin SUB_GROUP /end SUB_GROUP /begin FUNCTION_LIST /end FUNCTION_LIST /begin REF_CHARACTERISTIC /end REF_CHARACTERISTIC /begin REF_MEASUREMENT DutyCycThermProtn.dDutyCycThermProtnMplr3 /end REF_MEASUREMENT /end GROUP
/begin GROUP DutyCycThermProtn.dDutyCycThermProtnMplr36T "MICROSAR RTE" /begin SUB_GROUP /end SUB_GROUP /begin FUNCTION_LIST /end FUNCTION_LIST /begin REF_CHARACTERISTIC /end REF_CHARACTERISTIC /begin REF_MEASUREMENT DutyCycThermProtn.dDutyCycThermProtnMplr36T /end REF_MEASUREMENT /end GROUP
/begin GROUP DutyCycThermProtn.dDutyCycThermProtnMplr4 "MICROSAR RTE" /begin SUB_GROUP /end SUB_GROUP /begin FUNCTION_LIST /end FUNCTION_LIST /begin REF_CHARACTERISTIC /end REF_CHARACTERISTIC /begin REF_MEASUREMENT DutyCycThermProtn.dDutyCycThermProtnMplr4 /end REF_MEASUREMENT /end GROUP
/begin GROUP DutyCycThermProtn.dDutyCycThermProtnMplr5 "MICROSAR RTE" /begin SUB_GROUP /end SUB_GROUP /begin FUNCTION_LIST /end FUNCTION_LIST /begin REF_CHARACTERISTIC /end REF_CHARACTERISTIC /begin REF_MEASUREMENT DutyCycThermProtn.dDutyCycThermProtnMplr5 /end REF_MEASUREMENT /end GROUP
/begin GROUP DutyCycThermProtn.dDutyCycThermProtnMplr6 "MICROSAR RTE" /begin SUB_GROUP /end SUB_GROUP /begin FUNCTION_LIST /end FUNCTION_LIST /begin REF_CHARACTERISTIC /end REF_CHARACTERISTIC /begin REF_MEASUREMENT DutyCycThermProtn.dDutyCycThermProtnMplr6 /end REF_MEASUREMENT /end GROUP
/begin GROUP DutyCycThermProtn.dDutyCycThermProtnThermLoadLim "MICROSAR RTE" /begin SUB_GROUP /end SUB_GROUP /begin FUNCTION_LIST /end FUNCTION_LIST /begin REF_CHARACTERISTIC /end REF_CHARACTERISTIC /begin REF_MEASUREMENT DutyCycThermProtn.dDutyCycThermProtnThermLoadLim /end REF_MEASUREMENT /end GROUP
/begin GROUP DutyCycThermProtn.dDutyCycThermProtnThermLoadLimTblYVal "MICROSAR RTE" /begin SUB_GROUP /end SUB_GROUP /begin FUNCTION_LIST /end FUNCTION_LIST /begin REF_CHARACTERISTIC /end REF_CHARACTERISTIC /begin REF_MEASUREMENT DutyCycThermProtn.dDutyCycThermProtnThermLoadLimTblYVal /end REF_MEASUREMENT /end GROUP
/begin GROUP EcuTMeas "MICROSAR RTE"
 /begin SUB_GROUP EcuTMeas.PerInstanceMemories EcuTMeas.ReceiverPorts EcuTMeas.SenderPorts /end SUB_GROUP
 /begin FUNCTION_LIST /end FUNCTION_LIST
 /begin REF_CHARACTERISTIC /end REF_CHARACTERISTIC
 /begin REF_MEASUREMENT /end REF_MEASUREMENT
/end GROUP
/begin GROUP EcuTMeas.DiagcStsLimdTPrfmnc.Logl "MICROSAR RTE" /begin SUB_GROUP /end SUB_GROUP /begin FUNCTION_LIST /end FUNCTION_LIST /begin REF_CHARACTERISTIC /end REF_CHARACTERISTIC /begin REF_MEASUREMENT EcuTMeas.DiagcStsLimdTPrfmnc.Logl /end REF_MEASUREMENT /end GROUP
/begin GROUP EcuTMeas.EcuT.Val "MICROSAR RTE" /begin SUB_GROUP /end SUB_GROUP /begin FUNCTION_LIST /end FUNCTION_LIST /begin REF_CHARACTERISTIC /end REF_CHARACTERISTIC /begin REF_MEASUREMENT EcuTMeas.EcuT.Val /end REF_MEASUREMENT /end GROUP
/begin GROUP EcuTMeas.EcuTAdcFaild.Logl "MICROSAR RTE" /begin SUB_GROUP /end SUB_GROUP /begin FUNCTION_LIST /end FUNCTION_LIST /begin REF_CHARACTERISTIC /end REF_CHARACTERISTIC /begin REF_MEASUREMENT EcuTMeas.EcuTAdcFaild.Logl /end REF_MEASUREMENT /end GROUP
/begin GROUP EcuTMeas.EcuTFilStVari "MICROSAR RTE" /begin SUB_GROUP /end SUB_GROUP /begin FUNCTION_LIST /end FUNCTION_LIST /begin REF_CHARACTERISTIC /end REF_CHARACTERISTIC
 /begin REF_MEASUREMENT EcuTMeas.EcuTFilStVari.FilGain EcuTMeas.EcuTFilStVari.FilSt /end REF_MEASUREMENT
/end GROUP
/begin GROUP EcuTMeas.EcuTFild.Val "MICROSAR RTE" /begin SUB_GROUP /end SUB_GROUP /begin FUNCTION_LIST /end FUNCTION_LIST /begin REF_CHARACTERISTIC /end REF_CHARACTERISTIC /begin REF_MEASUREMENT EcuTMeas.EcuTFild.Val /end REF_MEASUREMENT /end GROUP
/begin GROUP EcuTMeas.PerInstanceMemories "MICROSAR RTE" /begin SUB_GROUP EcuTMeas.EcuTFilStVari EcuTMeas.dEcuTMeasEcuTCalcd /end SUB_GROUP /begin FUNCTION_LIST /end FUNCTION_LIST /begin REF_CHARACTERISTIC /end REF_CHARACTERISTIC /begin REF_MEASUREMENT /end REF_MEASUREMENT /end GROUP
/begin GROUP EcuTMeas.ReceiverPorts "MICROSAR RTE" /begin SUB_GROUP EcuTMeas.EcuT.Val EcuTMeas.EcuTAdcFaild.Logl /end SUB_GROUP /begin FUNCTION_LIST /end FUNCTION_LIST /begin REF_CHARACTERISTIC /end REF_CHARACTERISTIC /begin REF_MEASUREMENT /end REF_MEASUREMENT /end GROUP
/begin GROUP EcuTMeas.SenderPorts "MICROSAR RTE" /begin SUB_GROUP EcuTMeas.DiagcStsLimdTPrfmnc.Logl EcuTMeas.EcuTFild.Val /end SUB_GROUP /begin FUNCTION_LIST /end FUNCTION_LIST /begin REF_CHARACTERISTIC /end REF_CHARACTERISTIC /begin REF_MEASUREMENT /end REF_MEASUREMENT /end GROUP
/begin GROUP EcuTMeas.dEcuTMeasEcuTCalcd "MICROSAR RTE" /begin SUB_GROUP /end SUB_GROUP /begin FUNCTION_LIST /end FUNCTION_LIST /begin REF_CHARACTERISTIC /end REF_CHARACTERISTIC /begin REF_MEASUREMENT EcuTMeas.dEcuTMeasEcuTCalcd /end REF_MEASUREMENT /end GROUP
/begin GROUP ElecPwrCns "MICROSAR RTE"
 /begin SUB_GROUP ElecPwrCns.CalibrationPorts ElecPwrCns.PerInstanceMemories ElecPwrCns.ReceiverPorts ElecPwrCns.SenderPorts /end SUB_GROUP
 /begin FUNCTION_LIST /end FUNCTION_LIST
 /begin REF_CHARACTERISTIC /end REF_CHARACTERISTIC
 /begin REF_MEASUREMENT /end REF_MEASUREMENT
/end GROUP
/begin GROUP ElecPwrCns.BrdgVltg.Val "MICROSAR RTE" /begin SUB_GROUP /end SUB_GROUP /begin FUNCTION_LIST /end FUNCTION_LIST /begin REF_CHARACTERISTIC /end REF_CHARACTERISTIC /begin REF_MEASUREMENT ElecPwrCns.BrdgVltg.Val /end REF_MEASUREMENT /end GROUP
/begin GROUP ElecPwrCns.CalibrationPorts "MICROSAR RTE"
 /begin SUB_GROUP ElecPwrCns.ElecPwrCnsCtrlrInpR.Val ElecPwrCns.ElecPwrCnsPrstcPwrLoss.Val /end SUB_GROUP
 /begin FUNCTION_LIST /end FUNCTION_LIST
 /begin REF_CHARACTERISTIC /end REF_CHARACTERISTIC
 /begin REF_MEASUREMENT /end REF_MEASUREMENT
/end GROUP
/begin GROUP ElecPwrCns.ElecInpPwrEstim.Val "MICROSAR RTE" /begin SUB_GROUP /end SUB_GROUP /begin FUNCTION_LIST /end FUNCTION_LIST /begin REF_CHARACTERISTIC /end REF_CHARACTERISTIC /begin REF_MEASUREMENT ElecPwrCns.ElecInpPwrEstim.Val /end REF_MEASUREMENT /end GROUP
/begin GROUP ElecPwrCns.ElecPwrCnsCtrlrInpR.Val "MICROSAR RTE" /begin SUB_GROUP /end SUB_GROUP /begin FUNCTION_LIST /end FUNCTION_LIST /begin REF_CHARACTERISTIC ElecPwrCns.ElecPwrCnsCtrlrInpR.Val /end REF_CHARACTERISTIC /begin REF_MEASUREMENT /end REF_MEASUREMENT /end GROUP
/begin GROUP ElecPwrCns.ElecPwrCnsPrstcPwrLoss.Val "MICROSAR RTE" /begin SUB_GROUP /end SUB_GROUP /begin FUNCTION_LIST /end FUNCTION_LIST /begin REF_CHARACTERISTIC ElecPwrCns.ElecPwrCnsPrstcPwrLoss.Val /end REF_CHARACTERISTIC /begin REF_MEASUREMENT /end REF_MEASUREMENT /end GROUP
/begin GROUP ElecPwrCns.MotAndThermProtnLoaMod.Val "MICROSAR RTE" /begin SUB_GROUP /end SUB_GROUP /begin FUNCTION_LIST /end FUNCTION_LIST /begin REF_CHARACTERISTIC /end REF_CHARACTERISTIC /begin REF_MEASUREMENT ElecPwrCns.MotAndThermProtnLoaMod.Val /end REF_MEASUREMENT /end GROUP
/begin GROUP ElecPwrCns.MotCurrDax.Val "MICROSAR RTE" /begin SUB_GROUP /end SUB_GROUP /begin FUNCTION_LIST /end FUNCTION_LIST /begin REF_CHARACTERISTIC /end REF_CHARACTERISTIC /begin REF_MEASUREMENT ElecPwrCns.MotCurrDax.Val /end REF_MEASUREMENT /end GROUP
/begin GROUP ElecPwrCns.MotCurrDaxCmd.Val "MICROSAR RTE" /begin SUB_GROUP /end SUB_GROUP /begin FUNCTION_LIST /end FUNCTION_LIST /begin REF_CHARACTERISTIC /end REF_CHARACTERISTIC /begin REF_MEASUREMENT ElecPwrCns.MotCurrDaxCmd.Val /end REF_MEASUREMENT /end GROUP
/begin GROUP ElecPwrCns.MotCurrQax.Val "MICROSAR RTE" /begin SUB_GROUP /end SUB_GROUP /begin FUNCTION_LIST /end FUNCTION_LIST /begin REF_CHARACTERISTIC /end REF_CHARACTERISTIC /begin REF_MEASUREMENT ElecPwrCns.MotCurrQax.Val /end REF_MEASUREMENT /end GROUP
/begin GROUP ElecPwrCns.MotCurrQaxCmd.Val "MICROSAR RTE" /begin SUB_GROUP /end SUB_GROUP /begin FUNCTION_LIST /end FUNCTION_LIST /begin REF_CHARACTERISTIC /end REF_CHARACTERISTIC /begin REF_MEASUREMENT ElecPwrCns.MotCurrQaxCmd.Val /end REF_MEASUREMENT /end GROUP
/begin GROUP ElecPwrCns.MotVltgDax.Val "MICROSAR RTE" /begin SUB_GROUP /end SUB_GROUP /begin FUNCTION_LIST /end FUNCTION_LIST /begin REF_CHARACTERISTIC /end REF_CHARACTERISTIC /begin REF_MEASUREMENT ElecPwrCns.MotVltgDax.Val /end REF_MEASUREMENT /end GROUP
/begin GROUP ElecPwrCns.MotVltgQax.Val "MICROSAR RTE" /begin SUB_GROUP /end SUB_GROUP /begin FUNCTION_LIST /end FUNCTION_LIST /begin REF_CHARACTERISTIC /end REF_CHARACTERISTIC /begin REF_MEASUREMENT ElecPwrCns.MotVltgQax.Val /end REF_MEASUREMENT /end GROUP
/begin GROUP ElecPwrCns.PerInstanceMemories "MICROSAR RTE"
 /begin SUB_GROUP ElecPwrCns.dElecPwrCnsDrpInpPwr ElecPwrCns.dElecPwrCnsModInpPwr ElecPwrCns.dElecPwrCnsMotCurrDaxEstim ElecPwrCns.dElecPwrCnsMotCurrQaxEstim /end SUB_GROUP
 /begin FUNCTION_LIST /end FUNCTION_LIST
 /begin REF_CHARACTERISTIC /end REF_CHARACTERISTIC
 /begin REF_MEASUREMENT /end REF_MEASUREMENT
/end GROUP
/begin GROUP ElecPwrCns.ReceiverPorts "MICROSAR RTE"
 /begin SUB_GROUP ElecPwrCns.BrdgVltg.Val ElecPwrCns.MotAndThermProtnLoaMod.Val ElecPwrCns.MotCurrDax.Val ElecPwrCns.MotCurrDaxCmd.Val ElecPwrCns.MotCurrQax.Val ElecPwrCns.MotCurrQaxCmd.Val ElecPwrCns.MotVltgDax.Val ElecPwrCns.MotVltgQax.Val /end SUB_GROUP
 /begin FUNCTION_LIST /end FUNCTION_LIST
 /begin REF_CHARACTERISTIC /end REF_CHARACTERISTIC
 /begin REF_MEASUREMENT /end REF_MEASUREMENT
/end GROUP
/begin GROUP ElecPwrCns.SenderPorts "MICROSAR RTE"
 /begin SUB_GROUP ElecPwrCns.ElecInpPwrEstim.Val ElecPwrCns.SplyCurrEstim.Val /end SUB_GROUP
 /begin FUNCTION_LIST /end FUNCTION_LIST
 /begin REF_CHARACTERISTIC /end REF_CHARACTERISTIC
 /begin REF_MEASUREMENT /end REF_MEASUREMENT
/end GROUP
/begin GROUP ElecPwrCns.SplyCurrEstim.Val "MICROSAR RTE" /begin SUB_GROUP /end SUB_GROUP /begin FUNCTION_LIST /end FUNCTION_LIST /begin REF_CHARACTERISTIC /end REF_CHARACTERISTIC /begin REF_MEASUREMENT ElecPwrCns.SplyCurrEstim.Val /end REF_MEASUREMENT /end GROUP
/begin GROUP ElecPwrCns.dElecPwrCnsDrpInpPwr "MICROSAR RTE" /begin SUB_GROUP /end SUB_GROUP /begin FUNCTION_LIST /end FUNCTION_LIST /begin REF_CHARACTERISTIC /end REF_CHARACTERISTIC /begin REF_MEASUREMENT ElecPwrCns.dElecPwrCnsDrpInpPwr /end REF_MEASUREMENT /end GROUP
/begin GROUP ElecPwrCns.dElecPwrCnsModInpPwr "MICROSAR RTE" /begin SUB_GROUP /end SUB_GROUP /begin FUNCTION_LIST /end FUNCTION_LIST /begin REF_CHARACTERISTIC /end REF_CHARACTERISTIC /begin REF_MEASUREMENT ElecPwrCns.dElecPwrCnsModInpPwr /end REF_MEASUREMENT /end GROUP
/begin GROUP ElecPwrCns.dElecPwrCnsMotCurrDaxEstim "MICROSAR RTE" /begin SUB_GROUP /end SUB_GROUP /begin FUNCTION_LIST /end FUNCTION_LIST /begin REF_CHARACTERISTIC /end REF_CHARACTERISTIC /begin REF_MEASUREMENT ElecPwrCns.dElecPwrCnsMotCurrDaxEstim /end REF_MEASUREMENT /end GROUP
/begin GROUP ElecPwrCns.dElecPwrCnsMotCurrQaxEstim "MICROSAR RTE" /begin SUB_GROUP /end SUB_GROUP /begin FUNCTION_LIST /end FUNCTION_LIST /begin REF_CHARACTERISTIC /end REF_CHARACTERISTIC /begin REF_MEASUREMENT ElecPwrCns.dElecPwrCnsMotCurrQaxEstim /end REF_MEASUREMENT /end GROUP
/begin GROUP EotLrng "MICROSAR RTE"
 /begin SUB_GROUP EotLrng.CalibrationParameters EotLrng.CalibrationPorts EotLrng.PerInstanceMemories EotLrng.ReceiverPorts EotLrng.SenderPorts /end SUB_GROUP
 /begin FUNCTION_LIST /end FUNCTION_LIST
 /begin REF_CHARACTERISTIC /end REF_CHARACTERISTIC
 /begin REF_MEASUREMENT /end REF_MEASUREMENT
/end GROUP
/begin GROUP EotLrng.CalibrationParameters "MICROSAR RTE" /begin SUB_GROUP EotLrng.EotNvmDataDft /end SUB_GROUP /begin FUNCTION_LIST /end FUNCTION_LIST /begin REF_CHARACTERISTIC /end REF_CHARACTERISTIC /begin REF_MEASUREMENT /end REF_MEASUREMENT /end GROUP
/begin GROUP EotLrng.CalibrationPorts "MICROSAR RTE"
 /begin SUB_GROUP EotLrng.EotLrngAuthyStrtLrn.Val EotLrng.EotLrngEntrAndExitHysRngLimr.Val EotLrng.EotLrngEotLrnTmr.Val EotLrng.EotLrngHwAgOverTrvlCntThd.Val EotLrng.EotLrngHwTqEotLrn.Val EotLrng.EotLrngMotVelEotLrn.Val EotLrng.EotLrngRackTrvlMax.Val EotLrng.EotLrngRackTrvlMin.Val EotLrng.EotLrngRstAuthyMin.Val EotLrng.EotProtnRackTrvlLimrEna.Logl EotLrng.EotProtnRackTrvlLimrRngLimd.Val /end SUB_GROUP
 /begin FUNCTION_LIST /end FUNCTION_LIST
 /begin REF_CHARACTERISTIC /end REF_CHARACTERISTIC
 /begin REF_MEASUREMENT /end REF_MEASUREMENT
/end GROUP
/begin GROUP EotLrng.CcwEotRefTmr "MICROSAR RTE" /begin SUB_GROUP /end SUB_GROUP /begin FUNCTION_LIST /end FUNCTION_LIST /begin REF_CHARACTERISTIC /end REF_CHARACTERISTIC /begin REF_MEASUREMENT EotLrng.CcwEotRefTmr /end REF_MEASUREMENT /end GROUP
/begin GROUP EotLrng.CwEotRefTmr "MICROSAR RTE" /begin SUB_GROUP /end SUB_GROUP /begin FUNCTION_LIST /end FUNCTION_LIST /begin REF_CHARACTERISTIC /end REF_CHARACTERISTIC /begin REF_MEASUREMENT EotLrng.CwEotRefTmr /end REF_MEASUREMENT /end GROUP
/begin GROUP EotLrng.EotLrngAuthyStrtLrn.Val "MICROSAR RTE" /begin SUB_GROUP /end SUB_GROUP /begin FUNCTION_LIST /end FUNCTION_LIST /begin REF_CHARACTERISTIC EotLrng.EotLrngAuthyStrtLrn.Val /end REF_CHARACTERISTIC /begin REF_MEASUREMENT /end REF_MEASUREMENT /end GROUP
/begin GROUP EotLrng.EotLrngEntrAndExitHysRngLimr.Val "MICROSAR RTE" /begin SUB_GROUP /end SUB_GROUP /begin FUNCTION_LIST /end FUNCTION_LIST /begin REF_CHARACTERISTIC EotLrng.EotLrngEntrAndExitHysRngLimr.Val /end REF_CHARACTERISTIC /begin REF_MEASUREMENT /end REF_MEASUREMENT /end GROUP
/begin GROUP EotLrng.EotLrngEotLrnTmr.Val "MICROSAR RTE" /begin SUB_GROUP /end SUB_GROUP /begin FUNCTION_LIST /end FUNCTION_LIST /begin REF_CHARACTERISTIC EotLrng.EotLrngEotLrnTmr.Val /end REF_CHARACTERISTIC /begin REF_MEASUREMENT /end REF_MEASUREMENT /end GROUP
/begin GROUP EotLrng.EotLrngHwAgOverTrvlCntThd.Val "MICROSAR RTE" /begin SUB_GROUP /end SUB_GROUP /begin FUNCTION_LIST /end FUNCTION_LIST /begin REF_CHARACTERISTIC EotLrng.EotLrngHwAgOverTrvlCntThd.Val /end REF_CHARACTERISTIC /begin REF_MEASUREMENT /end REF_MEASUREMENT /end GROUP
/begin GROUP EotLrng.EotLrngHwTqEotLrn.Val "MICROSAR RTE" /begin SUB_GROUP /end SUB_GROUP /begin FUNCTION_LIST /end FUNCTION_LIST /begin REF_CHARACTERISTIC EotLrng.EotLrngHwTqEotLrn.Val /end REF_CHARACTERISTIC /begin REF_MEASUREMENT /end REF_MEASUREMENT /end GROUP
/begin GROUP EotLrng.EotLrngMotVelEotLrn.Val "MICROSAR RTE" /begin SUB_GROUP /end SUB_GROUP /begin FUNCTION_LIST /end FUNCTION_LIST /begin REF_CHARACTERISTIC EotLrng.EotLrngMotVelEotLrn.Val /end REF_CHARACTERISTIC /begin REF_MEASUREMENT /end REF_MEASUREMENT /end GROUP
/begin GROUP EotLrng.EotLrngRackTrvlMax.Val "MICROSAR RTE" /begin SUB_GROUP /end SUB_GROUP /begin FUNCTION_LIST /end FUNCTION_LIST /begin REF_CHARACTERISTIC EotLrng.EotLrngRackTrvlMax.Val /end REF_CHARACTERISTIC /begin REF_MEASUREMENT /end REF_MEASUREMENT /end GROUP
/begin GROUP EotLrng.EotLrngRackTrvlMin.Val "MICROSAR RTE" /begin SUB_GROUP /end SUB_GROUP /begin FUNCTION_LIST /end FUNCTION_LIST /begin REF_CHARACTERISTIC EotLrng.EotLrngRackTrvlMin.Val /end REF_CHARACTERISTIC /begin REF_MEASUREMENT /end REF_MEASUREMENT /end GROUP
/begin GROUP EotLrng.EotLrngRstAuthyMin.Val "MICROSAR RTE" /begin SUB_GROUP /end SUB_GROUP /begin FUNCTION_LIST /end FUNCTION_LIST /begin REF_CHARACTERISTIC EotLrng.EotLrngRstAuthyMin.Val /end REF_CHARACTERISTIC /begin REF_MEASUREMENT /end REF_MEASUREMENT /end GROUP
/begin GROUP EotLrng.EotNvmData "MICROSAR RTE" /begin SUB_GROUP /end SUB_GROUP /begin FUNCTION_LIST /end FUNCTION_LIST /begin REF_CHARACTERISTIC /end REF_CHARACTERISTIC
 /begin REF_MEASUREMENT EotLrng.EotNvmData.CcwEot EotLrng.EotNvmData.CcwEotDetd EotLrng.EotNvmData.CwEot EotLrng.EotNvmData.CwEotDetd /end REF_MEASUREMENT
/end GROUP
/begin GROUP EotLrng.EotNvmDataDft "MICROSAR RTE" /begin SUB_GROUP /end SUB_GROUP /begin FUNCTION_LIST /end FUNCTION_LIST
 /begin REF_CHARACTERISTIC EotLrng.EotNvmDataDft.CcwEot EotLrng.EotNvmDataDft.CcwEotDetd EotLrng.EotNvmDataDft.CwEot EotLrng.EotNvmDataDft.CwEotDetd /end REF_CHARACTERISTIC
 /begin REF_MEASUREMENT /end REF_MEASUREMENT
/end GROUP
/begin GROUP EotLrng.EotProtnRackTrvlLimrEna.Logl "MICROSAR RTE" /begin SUB_GROUP /end SUB_GROUP /begin FUNCTION_LIST /end FUNCTION_LIST /begin REF_CHARACTERISTIC EotLrng.EotProtnRackTrvlLimrEna.Logl /end REF_CHARACTERISTIC /begin REF_MEASUREMENT /end REF_MEASUREMENT /end GROUP
/begin GROUP EotLrng.EotProtnRackTrvlLimrRngLimd.Val "MICROSAR RTE" /begin SUB_GROUP /end SUB_GROUP /begin FUNCTION_LIST /end FUNCTION_LIST /begin REF_CHARACTERISTIC EotLrng.EotProtnRackTrvlLimrRngLimd.Val /end REF_CHARACTERISTIC /begin REF_MEASUREMENT /end REF_MEASUREMENT /end GROUP
/begin GROUP EotLrng.HwAg.Val "MICROSAR RTE" /begin SUB_GROUP /end SUB_GROUP /begin FUNCTION_LIST /end FUNCTION_LIST /begin REF_CHARACTERISTIC /end REF_CHARACTERISTIC /begin REF_MEASUREMENT EotLrng.HwAg.Val /end REF_MEASUREMENT /end GROUP
/begin GROUP EotLrng.HwAgAuthy.Val "MICROSAR RTE" /begin SUB_GROUP /end SUB_GROUP /begin FUNCTION_LIST /end FUNCTION_LIST /begin REF_CHARACTERISTIC /end REF_CHARACTERISTIC /begin REF_MEASUREMENT EotLrng.HwAgAuthy.Val /end REF_MEASUREMENT /end GROUP
/begin GROUP EotLrng.HwAgCcwDetd.Logl "MICROSAR RTE" /begin SUB_GROUP /end SUB_GROUP /begin FUNCTION_LIST /end FUNCTION_LIST /begin REF_CHARACTERISTIC /end REF_CHARACTERISTIC /begin REF_MEASUREMENT EotLrng.HwAgCcwDetd.Logl /end REF_MEASUREMENT /end GROUP
/begin GROUP EotLrng.HwAgCwDetd.Logl "MICROSAR RTE" /begin SUB_GROUP /end SUB_GROUP /begin FUNCTION_LIST /end FUNCTION_LIST /begin REF_CHARACTERISTIC /end REF_CHARACTERISTIC /begin REF_MEASUREMENT EotLrng.HwAgCwDetd.Logl /end REF_MEASUREMENT /end GROUP
/begin GROUP EotLrng.HwAgDiDiagSts.Logl "MICROSAR RTE" /begin SUB_GROUP /end SUB_GROUP /begin FUNCTION_LIST /end FUNCTION_LIST /begin REF_CHARACTERISTIC /end REF_CHARACTERISTIC /begin REF_MEASUREMENT EotLrng.HwAgDiDiagSts.Logl /end REF_MEASUREMENT /end GROUP
/begin GROUP EotLrng.HwAgEotCcw.Val "MICROSAR RTE" /begin SUB_GROUP /end SUB_GROUP /begin FUNCTION_LIST /end FUNCTION_LIST /begin REF_CHARACTERISTIC /end REF_CHARACTERISTIC /begin REF_MEASUREMENT EotLrng.HwAgEotCcw.Val /end REF_MEASUREMENT /end GROUP
/begin GROUP EotLrng.HwAgEotCw.Val "MICROSAR RTE" /begin SUB_GROUP /end SUB_GROUP /begin FUNCTION_LIST /end FUNCTION_LIST /begin REF_CHARACTERISTIC /end REF_CHARACTERISTIC /begin REF_MEASUREMENT EotLrng.HwAgEotCw.Val /end REF_MEASUREMENT /end GROUP
/begin GROUP EotLrng.HwAgEotSig0Avl.Logl "MICROSAR RTE" /begin SUB_GROUP /end SUB_GROUP /begin FUNCTION_LIST /end FUNCTION_LIST /begin REF_CHARACTERISTIC /end REF_CHARACTERISTIC /begin REF_MEASUREMENT EotLrng.HwAgEotSig0Avl.Logl /end REF_MEASUREMENT /end GROUP
/begin GROUP EotLrng.HwAgEotSig0Ccw.Val "MICROSAR RTE" /begin SUB_GROUP /end SUB_GROUP /begin FUNCTION_LIST /end FUNCTION_LIST /begin REF_CHARACTERISTIC /end REF_CHARACTERISTIC /begin REF_MEASUREMENT EotLrng.HwAgEotSig0Ccw.Val /end REF_MEASUREMENT /end GROUP
/begin GROUP EotLrng.HwAgEotSig0Cw.Val "MICROSAR RTE" /begin SUB_GROUP /end SUB_GROUP /begin FUNCTION_LIST /end FUNCTION_LIST /begin REF_CHARACTERISTIC /end REF_CHARACTERISTIC /begin REF_MEASUREMENT EotLrng.HwAgEotSig0Cw.Val /end REF_MEASUREMENT /end GROUP
/begin GROUP EotLrng.HwAgEotSig1Avl.Logl "MICROSAR RTE" /begin SUB_GROUP /end SUB_GROUP /begin FUNCTION_LIST /end FUNCTION_LIST /begin REF_CHARACTERISTIC /end REF_CHARACTERISTIC /begin REF_MEASUREMENT EotLrng.HwAgEotSig1Avl.Logl /end REF_MEASUREMENT /end GROUP
/begin GROUP EotLrng.HwAgEotSig1Ccw.Val "MICROSAR RTE" /begin SUB_GROUP /end SUB_GROUP /begin FUNCTION_LIST /end FUNCTION_LIST /begin REF_CHARACTERISTIC /end REF_CHARACTERISTIC /begin REF_MEASUREMENT EotLrng.HwAgEotSig1Ccw.Val /end REF_MEASUREMENT /end GROUP
/begin GROUP EotLrng.HwAgEotSig1Cw.Val "MICROSAR RTE" /begin SUB_GROUP /end SUB_GROUP /begin FUNCTION_LIST /end FUNCTION_LIST /begin REF_CHARACTERISTIC /end REF_CHARACTERISTIC /begin REF_MEASUREMENT EotLrng.HwAgEotSig1Cw.Val /end REF_MEASUREMENT /end GROUP
/begin GROUP EotLrng.HwAgOverTrvlCntrNegDi "MICROSAR RTE" /begin SUB_GROUP /end SUB_GROUP /begin FUNCTION_LIST /end FUNCTION_LIST /begin REF_CHARACTERISTIC /end REF_CHARACTERISTIC /begin REF_MEASUREMENT EotLrng.HwAgOverTrvlCntrNegDi /end REF_MEASUREMENT /end GROUP
/begin GROUP EotLrng.HwAgOverTrvlCntrPosDi "MICROSAR RTE" /begin SUB_GROUP /end SUB_GROUP /begin FUNCTION_LIST /end FUNCTION_LIST /begin REF_CHARACTERISTIC /end REF_CHARACTERISTIC /begin REF_MEASUREMENT EotLrng.HwAgOverTrvlCntrPosDi /end REF_MEASUREMENT /end GROUP
/begin GROUP EotLrng.HwTq.Val "MICROSAR RTE" /begin SUB_GROUP /end SUB_GROUP /begin FUNCTION_LIST /end FUNCTION_LIST /begin REF_CHARACTERISTIC /end REF_CHARACTERISTIC /begin REF_MEASUREMENT EotLrng.HwTq.Val /end REF_MEASUREMENT /end GROUP
/begin GROUP EotLrng.MaxHwAgCwAndCcw "MICROSAR RTE" /begin SUB_GROUP /end SUB_GROUP /begin FUNCTION_LIST /end FUNCTION_LIST /begin REF_CHARACTERISTIC /end REF_CHARACTERISTIC
 /begin REF_MEASUREMENT EotLrng.MaxHwAgCwAndCcw.HwAgCcwMax EotLrng.MaxHwAgCwAndCcw.HwAgCwMax EotLrng.MaxHwAgCwAndCcw.HwAgOverTrvlCnt /end REF_MEASUREMENT
/end GROUP
/begin GROUP EotLrng.MotVelCrf.Val "MICROSAR RTE" /begin SUB_GROUP /end SUB_GROUP /begin FUNCTION_LIST /end FUNCTION_LIST /begin REF_CHARACTERISTIC /end REF_CHARACTERISTIC /begin REF_MEASUREMENT EotLrng.MotVelCrf.Val /end REF_MEASUREMENT /end GROUP
/begin GROUP EotLrng.PerInstanceMemories "MICROSAR RTE"
 /begin SUB_GROUP EotLrng.CcwEotRefTmr EotLrng.CwEotRefTmr EotLrng.EotNvmData EotLrng.HwAgOverTrvlCntrNegDi EotLrng.HwAgOverTrvlCntrPosDi EotLrng.MaxHwAgCwAndCcw EotLrng.PrevCcwEot EotLrng.PrevCwEot EotLrng.RstLimReq /end SUB_GROUP
 /begin FUNCTION_LIST /end FUNCTION_LIST
 /begin REF_CHARACTERISTIC /end REF_CHARACTERISTIC
 /begin REF_MEASUREMENT /end REF_MEASUREMENT
/end GROUP
/begin GROUP EotLrng.PrevCcwEot "MICROSAR RTE" /begin SUB_GROUP /end SUB_GROUP /begin FUNCTION_LIST /end FUNCTION_LIST /begin REF_CHARACTERISTIC /end REF_CHARACTERISTIC /begin REF_MEASUREMENT EotLrng.PrevCcwEot /end REF_MEASUREMENT /end GROUP
/begin GROUP EotLrng.PrevCwEot "MICROSAR RTE" /begin SUB_GROUP /end SUB_GROUP /begin FUNCTION_LIST /end FUNCTION_LIST /begin REF_CHARACTERISTIC /end REF_CHARACTERISTIC /begin REF_MEASUREMENT EotLrng.PrevCwEot /end REF_MEASUREMENT /end GROUP
/begin GROUP EotLrng.ReceiverPorts "MICROSAR RTE"
 /begin SUB_GROUP EotLrng.HwAg.Val EotLrng.HwAgAuthy.Val EotLrng.HwAgDiDiagSts.Logl EotLrng.HwAgEotSig0Avl.Logl EotLrng.HwAgEotSig0Ccw.Val EotLrng.HwAgEotSig0Cw.Val EotLrng.HwAgEotSig1Avl.Logl EotLrng.HwAgEotSig1Ccw.Val EotLrng.HwAgEotSig1Cw.Val EotLrng.HwTq.Val EotLrng.MotVelCrf.Val /end SUB_GROUP
 /begin FUNCTION_LIST /end FUNCTION_LIST
 /begin REF_CHARACTERISTIC /end REF_CHARACTERISTIC
 /begin REF_MEASUREMENT /end REF_MEASUREMENT
/end GROUP
/begin GROUP EotLrng.RstLimReq "MICROSAR RTE" /begin SUB_GROUP /end SUB_GROUP /begin FUNCTION_LIST /end FUNCTION_LIST /begin REF_CHARACTERISTIC /end REF_CHARACTERISTIC /begin REF_MEASUREMENT EotLrng.RstLimReq /end REF_MEASUREMENT /end GROUP
/begin GROUP EotLrng.SenderPorts "MICROSAR RTE"
 /begin SUB_GROUP EotLrng.HwAgCcwDetd.Logl EotLrng.HwAgCwDetd.Logl EotLrng.HwAgEotCcw.Val EotLrng.HwAgEotCw.Val /end SUB_GROUP
 /begin FUNCTION_LIST /end FUNCTION_LIST
 /begin REF_CHARACTERISTIC /end REF_CHARACTERISTIC
 /begin REF_MEASUREMENT /end REF_MEASUREMENT
/end GROUP
/begin GROUP EotProtn "MICROSAR RTE"
 /begin SUB_GROUP EotProtn.CalibrationPorts EotProtn.PerInstanceMemories EotProtn.ReceiverPorts EotProtn.SenderPorts /end SUB_GROUP
 /begin FUNCTION_LIST /end FUNCTION_LIST
 /begin REF_CHARACTERISTIC /end REF_CHARACTERISTIC
 /begin REF_MEASUREMENT /end REF_MEASUREMENT
/end GROUP
/begin GROUP EotProtn.CalibrationPorts "MICROSAR RTE"
 /begin SUB_GROUP EotProtn.EotProtnActvRegnBypMaxThd.Val EotProtn.EotProtnDampgSlew.Val EotProtn.EotProtnDampgVehSpdTbl.Ary1D EotProtn.EotProtnDeltaTqThd.Val EotProtn.EotProtnDftPosn.Val EotProtn.EotProtnEntrGainAuthyThd.Val EotProtn.EotProtnEntrGainVehSpdTbl.Ary1D EotProtn.EotProtnEntrGainX.Ary2D EotProtn.EotProtnEntrGainY.Ary2D EotProtn.EotProtnEntrStLpFilFrq.Val EotProtn.EotProtnExitDampgY.Ary2D EotProtn.EotProtnExitStLpFilFrq.Val EotProtn.EotProtnHwAgGain.Val EotProtn.EotProtnHwAgMax.Val EotProtn.EotProtnHwAgMin.Val EotProtn.EotProtnHwDegDampgX.Ary2D EotProtn.EotProtnHwTqLpFilFrq.Val EotProtn.EotProtnHwTqScaX.Ary1D EotProtn.EotProtnLoAuthyEntrGainY.Ary2D EotProtn.EotProtnMotSpdIncptSca.Val EotProtn.EotProtnMotSpdIncptX.Ary1D EotProtn.EotProtnMotSpdIncptY.Ary1D EotProtn.EotProtnMotVelGain.Val EotProtn.EotProtnNormDampgY.Ary2D EotProtn.EotProtnPosnRampStep.Val EotProtn.EotProtnRackTrvlLimrAuthyThd.Val EotProtn.EotProtnRackTrvlLimrAuthyThdLimd.Val EotProtn.EotProtnRackTrvlLimrEna.Logl EotProtn.EotProtnRackTrvlLimrRng.Val EotProtn.EotProtnRackTrvlLimrRngLimd.Val EotProtn.EotProtnRackTrvlLimrVehSpdThd.Val EotProtn.EotProtnRunEotVelImpctAndSoftEndStop.Logl EotProtn.EotProtnSoftEndStopAuthyThd.Val EotProtn.EotProtnSoftEndStopEna.Logl EotProtn.EotProtnSoftEndStopVehSpdThd.Val /end SUB_GROUP
 /begin FUNCTION_LIST /end FUNCTION_LIST
 /begin REF_CHARACTERISTIC /end REF_CHARACTERISTIC
 /begin REF_MEASUREMENT /end REF_MEASUREMENT
/end GROUP
/begin GROUP EotProtn.EotActvCmd.Val "MICROSAR RTE" /begin SUB_GROUP /end SUB_GROUP /begin FUNCTION_LIST /end FUNCTION_LIST /begin REF_CHARACTERISTIC /end REF_CHARACTERISTIC /begin REF_MEASUREMENT EotProtn.EotActvCmd.Val /end REF_MEASUREMENT /end GROUP
/begin GROUP EotProtn.EotAssiSca.Val "MICROSAR RTE" /begin SUB_GROUP /end SUB_GROUP /begin FUNCTION_LIST /end FUNCTION_LIST /begin REF_CHARACTERISTIC /end REF_CHARACTERISTIC /begin REF_MEASUREMENT EotProtn.EotAssiSca.Val /end REF_MEASUREMENT /end GROUP
/begin GROUP EotProtn.EotAssiScaLpFil "MICROSAR RTE" /begin SUB_GROUP /end SUB_GROUP /begin FUNCTION_LIST /end FUNCTION_LIST /begin REF_CHARACTERISTIC /end REF_CHARACTERISTIC
 /begin REF_MEASUREMENT EotProtn.EotAssiScaLpFil.FilGain EotProtn.EotAssiScaLpFil.FilSt /end REF_MEASUREMENT
/end GROUP
/begin GROUP EotProtn.EotDampgCmd.Val "MICROSAR RTE" /begin SUB_GROUP /end SUB_GROUP /begin FUNCTION_LIST /end FUNCTION_LIST /begin REF_CHARACTERISTIC /end REF_CHARACTERISTIC /begin REF_MEASUREMENT EotProtn.EotDampgCmd.Val /end REF_MEASUREMENT /end GROUP
/begin GROUP EotProtn.EotMotTqLim.Val "MICROSAR RTE" /begin SUB_GROUP /end SUB_GROUP /begin FUNCTION_LIST /end FUNCTION_LIST /begin REF_CHARACTERISTIC /end REF_CHARACTERISTIC /begin REF_MEASUREMENT EotProtn.EotMotTqLim.Val /end REF_MEASUREMENT /end GROUP
/begin GROUP EotProtn.EotProtnActvRegnBypMaxThd.Val "MICROSAR RTE" /begin SUB_GROUP /end SUB_GROUP /begin FUNCTION_LIST /end FUNCTION_LIST /begin REF_CHARACTERISTIC EotProtn.EotProtnActvRegnBypMaxThd.Val /end REF_CHARACTERISTIC /begin REF_MEASUREMENT /end REF_MEASUREMENT /end GROUP
/begin GROUP EotProtn.EotProtnDampgSlew.Val "MICROSAR RTE" /begin SUB_GROUP /end SUB_GROUP /begin FUNCTION_LIST /end FUNCTION_LIST /begin REF_CHARACTERISTIC EotProtn.EotProtnDampgSlew.Val /end REF_CHARACTERISTIC /begin REF_MEASUREMENT /end REF_MEASUREMENT /end GROUP
/begin GROUP EotProtn.EotProtnDampgVehSpdTbl.Ary1D "MICROSAR RTE" /begin SUB_GROUP /end SUB_GROUP /begin FUNCTION_LIST /end FUNCTION_LIST /begin REF_CHARACTERISTIC EotProtn.EotProtnDampgVehSpdTbl.Ary1D /end REF_CHARACTERISTIC /begin REF_MEASUREMENT /end REF_MEASUREMENT /end GROUP
/begin GROUP EotProtn.EotProtnDeltaTqThd.Val "MICROSAR RTE" /begin SUB_GROUP /end SUB_GROUP /begin FUNCTION_LIST /end FUNCTION_LIST /begin REF_CHARACTERISTIC EotProtn.EotProtnDeltaTqThd.Val /end REF_CHARACTERISTIC /begin REF_MEASUREMENT /end REF_MEASUREMENT /end GROUP
/begin GROUP EotProtn.EotProtnDftPosn.Val "MICROSAR RTE" /begin SUB_GROUP /end SUB_GROUP /begin FUNCTION_LIST /end FUNCTION_LIST /begin REF_CHARACTERISTIC EotProtn.EotProtnDftPosn.Val /end REF_CHARACTERISTIC /begin REF_MEASUREMENT /end REF_MEASUREMENT /end GROUP
/begin GROUP EotProtn.EotProtnDi.Logl "MICROSAR RTE" /begin SUB_GROUP /end SUB_GROUP /begin FUNCTION_LIST /end FUNCTION_LIST /begin REF_CHARACTERISTIC /end REF_CHARACTERISTIC /begin REF_MEASUREMENT EotProtn.EotProtnDi.Logl /end REF_MEASUREMENT /end GROUP
/begin GROUP EotProtn.EotProtnEntrGainAuthyThd.Val "MICROSAR RTE" /begin SUB_GROUP /end SUB_GROUP /begin FUNCTION_LIST /end FUNCTION_LIST /begin REF_CHARACTERISTIC EotProtn.EotProtnEntrGainAuthyThd.Val /end REF_CHARACTERISTIC /begin REF_MEASUREMENT /end REF_MEASUREMENT /end GROUP
/begin GROUP EotProtn.EotProtnEntrGainVehSpdTbl.Ary1D "MICROSAR RTE" /begin SUB_GROUP /end SUB_GROUP /begin FUNCTION_LIST /end FUNCTION_LIST /begin REF_CHARACTERISTIC EotProtn.EotProtnEntrGainVehSpdTbl.Ary1D /end REF_CHARACTERISTIC /begin REF_MEASUREMENT /end REF_MEASUREMENT /end GROUP
/begin GROUP EotProtn.EotProtnEntrGainX.Ary2D "MICROSAR RTE" /begin SUB_GROUP /end SUB_GROUP /begin FUNCTION_LIST /end FUNCTION_LIST /begin REF_CHARACTERISTIC EotProtn.EotProtnEntrGainX.Ary2D /end REF_CHARACTERISTIC /begin REF_MEASUREMENT /end REF_MEASUREMENT /end GROUP
/begin GROUP EotProtn.EotProtnEntrGainY.Ary2D "MICROSAR RTE" /begin SUB_GROUP /end SUB_GROUP /begin FUNCTION_LIST /end FUNCTION_LIST /begin REF_CHARACTERISTIC EotProtn.EotProtnEntrGainY.Ary2D /end REF_CHARACTERISTIC /begin REF_MEASUREMENT /end REF_MEASUREMENT /end GROUP
/begin GROUP EotProtn.EotProtnEntrStLpFilFrq.Val "MICROSAR RTE" /begin SUB_GROUP /end SUB_GROUP /begin FUNCTION_LIST /end FUNCTION_LIST /begin REF_CHARACTERISTIC EotProtn.EotProtnEntrStLpFilFrq.Val /end REF_CHARACTERISTIC /begin REF_MEASUREMENT /end REF_MEASUREMENT /end GROUP
/begin GROUP EotProtn.EotProtnExitDampgY.Ary2D "MICROSAR RTE" /begin SUB_GROUP /end SUB_GROUP /begin FUNCTION_LIST /end FUNCTION_LIST /begin REF_CHARACTERISTIC EotProtn.EotProtnExitDampgY.Ary2D /end REF_CHARACTERISTIC /begin REF_MEASUREMENT /end REF_MEASUREMENT /end GROUP
/begin GROUP EotProtn.EotProtnExitStLpFilFrq.Val "MICROSAR RTE" /begin SUB_GROUP /end SUB_GROUP /begin FUNCTION_LIST /end FUNCTION_LIST /begin REF_CHARACTERISTIC EotProtn.EotProtnExitStLpFilFrq.Val /end REF_CHARACTERISTIC /begin REF_MEASUREMENT /end REF_MEASUREMENT /end GROUP
/begin GROUP EotProtn.EotProtnHwAgGain.Val "MICROSAR RTE" /begin SUB_GROUP /end SUB_GROUP /begin FUNCTION_LIST /end FUNCTION_LIST /begin REF_CHARACTERISTIC EotProtn.EotProtnHwAgGain.Val /end REF_CHARACTERISTIC /begin REF_MEASUREMENT /end REF_MEASUREMENT /end GROUP
/begin GROUP EotProtn.EotProtnHwAgMax.Val "MICROSAR RTE" /begin SUB_GROUP /end SUB_GROUP /begin FUNCTION_LIST /end FUNCTION_LIST /begin REF_CHARACTERISTIC EotProtn.EotProtnHwAgMax.Val /end REF_CHARACTERISTIC /begin REF_MEASUREMENT /end REF_MEASUREMENT /end GROUP
/begin GROUP EotProtn.EotProtnHwAgMin.Val "MICROSAR RTE" /begin SUB_GROUP /end SUB_GROUP /begin FUNCTION_LIST /end FUNCTION_LIST /begin REF_CHARACTERISTIC EotProtn.EotProtnHwAgMin.Val /end REF_CHARACTERISTIC /begin REF_MEASUREMENT /end REF_MEASUREMENT /end GROUP
/begin GROUP EotProtn.EotProtnHwDegDampgX.Ary2D "MICROSAR RTE" /begin SUB_GROUP /end SUB_GROUP /begin FUNCTION_LIST /end FUNCTION_LIST /begin REF_CHARACTERISTIC EotProtn.EotProtnHwDegDampgX.Ary2D /end REF_CHARACTERISTIC /begin REF_MEASUREMENT /end REF_MEASUREMENT /end GROUP
/begin GROUP EotProtn.EotProtnHwTqLpFilFrq.Val "MICROSAR RTE" /begin SUB_GROUP /end SUB_GROUP /begin FUNCTION_LIST /end FUNCTION_LIST /begin REF_CHARACTERISTIC EotProtn.EotProtnHwTqLpFilFrq.Val /end REF_CHARACTERISTIC /begin REF_MEASUREMENT /end REF_MEASUREMENT /end GROUP
/begin GROUP EotProtn.EotProtnHwTqScaX.Ary1D "MICROSAR RTE" /begin SUB_GROUP /end SUB_GROUP /begin FUNCTION_LIST /end FUNCTION_LIST /begin REF_CHARACTERISTIC EotProtn.EotProtnHwTqScaX.Ary1D /end REF_CHARACTERISTIC /begin REF_MEASUREMENT /end REF_MEASUREMENT /end GROUP
/begin GROUP EotProtn.EotProtnLoAuthyEntrGainY.Ary2D "MICROSAR RTE" /begin SUB_GROUP /end SUB_GROUP /begin FUNCTION_LIST /end FUNCTION_LIST /begin REF_CHARACTERISTIC EotProtn.EotProtnLoAuthyEntrGainY.Ary2D /end REF_CHARACTERISTIC /begin REF_MEASUREMENT /end REF_MEASUREMENT /end GROUP
/begin GROUP EotProtn.EotProtnMotSpdIncptSca.Val "MICROSAR RTE" /begin SUB_GROUP /end SUB_GROUP /begin FUNCTION_LIST /end FUNCTION_LIST /begin REF_CHARACTERISTIC EotProtn.EotProtnMotSpdIncptSca.Val /end REF_CHARACTERISTIC /begin REF_MEASUREMENT /end REF_MEASUREMENT /end GROUP
/begin GROUP EotProtn.EotProtnMotSpdIncptX.Ary1D "MICROSAR RTE" /begin SUB_GROUP /end SUB_GROUP /begin FUNCTION_LIST /end FUNCTION_LIST /begin REF_CHARACTERISTIC EotProtn.EotProtnMotSpdIncptX.Ary1D /end REF_CHARACTERISTIC /begin REF_MEASUREMENT /end REF_MEASUREMENT /end GROUP
/begin GROUP EotProtn.EotProtnMotSpdIncptY.Ary1D "MICROSAR RTE" /begin SUB_GROUP /end SUB_GROUP /begin FUNCTION_LIST /end FUNCTION_LIST /begin REF_CHARACTERISTIC EotProtn.EotProtnMotSpdIncptY.Ary1D /end REF_CHARACTERISTIC /begin REF_MEASUREMENT /end REF_MEASUREMENT /end GROUP
/begin GROUP EotProtn.EotProtnMotVelGain.Val "MICROSAR RTE" /begin SUB_GROUP /end SUB_GROUP /begin FUNCTION_LIST /end FUNCTION_LIST /begin REF_CHARACTERISTIC EotProtn.EotProtnMotVelGain.Val /end REF_CHARACTERISTIC /begin REF_MEASUREMENT /end REF_MEASUREMENT /end GROUP
/begin GROUP EotProtn.EotProtnNormDampgY.Ary2D "MICROSAR RTE" /begin SUB_GROUP /end SUB_GROUP /begin FUNCTION_LIST /end FUNCTION_LIST /begin REF_CHARACTERISTIC EotProtn.EotProtnNormDampgY.Ary2D /end REF_CHARACTERISTIC /begin REF_MEASUREMENT /end REF_MEASUREMENT /end GROUP
/begin GROUP EotProtn.EotProtnPosnRampStep.Val "MICROSAR RTE" /begin SUB_GROUP /end SUB_GROUP /begin FUNCTION_LIST /end FUNCTION_LIST /begin REF_CHARACTERISTIC EotProtn.EotProtnPosnRampStep.Val /end REF_CHARACTERISTIC /begin REF_MEASUREMENT /end REF_MEASUREMENT /end GROUP
/begin GROUP EotProtn.EotProtnRackTrvlLimrAuthyThd.Val "MICROSAR RTE" /begin SUB_GROUP /end SUB_GROUP /begin FUNCTION_LIST /end FUNCTION_LIST /begin REF_CHARACTERISTIC EotProtn.EotProtnRackTrvlLimrAuthyThd.Val /end REF_CHARACTERISTIC /begin REF_MEASUREMENT /end REF_MEASUREMENT /end GROUP
/begin GROUP EotProtn.EotProtnRackTrvlLimrAuthyThdLimd.Val "MICROSAR RTE" /begin SUB_GROUP /end SUB_GROUP /begin FUNCTION_LIST /end FUNCTION_LIST /begin REF_CHARACTERISTIC EotProtn.EotProtnRackTrvlLimrAuthyThdLimd.Val /end REF_CHARACTERISTIC /begin REF_MEASUREMENT /end REF_MEASUREMENT /end GROUP
/begin GROUP EotProtn.EotProtnRackTrvlLimrEna.Logl "MICROSAR RTE" /begin SUB_GROUP /end SUB_GROUP /begin FUNCTION_LIST /end FUNCTION_LIST /begin REF_CHARACTERISTIC EotProtn.EotProtnRackTrvlLimrEna.Logl /end REF_CHARACTERISTIC /begin REF_MEASUREMENT /end REF_MEASUREMENT /end GROUP
/begin GROUP EotProtn.EotProtnRackTrvlLimrRng.Val "MICROSAR RTE" /begin SUB_GROUP /end SUB_GROUP /begin FUNCTION_LIST /end FUNCTION_LIST /begin REF_CHARACTERISTIC EotProtn.EotProtnRackTrvlLimrRng.Val /end REF_CHARACTERISTIC /begin REF_MEASUREMENT /end REF_MEASUREMENT /end GROUP
/begin GROUP EotProtn.EotProtnRackTrvlLimrRngLimd.Val "MICROSAR RTE" /begin SUB_GROUP /end SUB_GROUP /begin FUNCTION_LIST /end FUNCTION_LIST /begin REF_CHARACTERISTIC EotProtn.EotProtnRackTrvlLimrRngLimd.Val /end REF_CHARACTERISTIC /begin REF_MEASUREMENT /end REF_MEASUREMENT /end GROUP
/begin GROUP EotProtn.EotProtnRackTrvlLimrVehSpdThd.Val "MICROSAR RTE" /begin SUB_GROUP /end SUB_GROUP /begin FUNCTION_LIST /end FUNCTION_LIST /begin REF_CHARACTERISTIC EotProtn.EotProtnRackTrvlLimrVehSpdThd.Val /end REF_CHARACTERISTIC /begin REF_MEASUREMENT /end REF_MEASUREMENT /end GROUP
/begin GROUP EotProtn.EotProtnRunEotVelImpctAndSoftEndStop.Logl "MICROSAR RTE" /begin SUB_GROUP /end SUB_GROUP /begin FUNCTION_LIST /end FUNCTION_LIST /begin REF_CHARACTERISTIC EotProtn.EotProtnRunEotVelImpctAndSoftEndStop.Logl /end REF_CHARACTERISTIC /begin REF_MEASUREMENT /end REF_MEASUREMENT /end GROUP
/begin GROUP EotProtn.EotProtnSoftEndStopAuthyThd.Val "MICROSAR RTE" /begin SUB_GROUP /end SUB_GROUP /begin FUNCTION_LIST /end FUNCTION_LIST /begin REF_CHARACTERISTIC EotProtn.EotProtnSoftEndStopAuthyThd.Val /end REF_CHARACTERISTIC /begin REF_MEASUREMENT /end REF_MEASUREMENT /end GROUP
/begin GROUP EotProtn.EotProtnSoftEndStopEna.Logl "MICROSAR RTE" /begin SUB_GROUP /end SUB_GROUP /begin FUNCTION_LIST /end FUNCTION_LIST /begin REF_CHARACTERISTIC EotProtn.EotProtnSoftEndStopEna.Logl /end REF_CHARACTERISTIC /begin REF_MEASUREMENT /end REF_MEASUREMENT /end GROUP
/begin GROUP EotProtn.EotProtnSoftEndStopVehSpdThd.Val "MICROSAR RTE" /begin SUB_GROUP /end SUB_GROUP /begin FUNCTION_LIST /end FUNCTION_LIST /begin REF_CHARACTERISTIC EotProtn.EotProtnSoftEndStopVehSpdThd.Val /end REF_CHARACTERISTIC /begin REF_MEASUREMENT /end REF_MEASUREMENT /end GROUP
/begin GROUP EotProtn.HwAg.Val "MICROSAR RTE" /begin SUB_GROUP /end SUB_GROUP /begin FUNCTION_LIST /end FUNCTION_LIST /begin REF_CHARACTERISTIC /end REF_CHARACTERISTIC /begin REF_MEASUREMENT EotProtn.HwAg.Val /end REF_MEASUREMENT /end GROUP
/begin GROUP EotProtn.HwAgAuthy.Val "MICROSAR RTE" /begin SUB_GROUP /end SUB_GROUP /begin FUNCTION_LIST /end FUNCTION_LIST /begin REF_CHARACTERISTIC /end REF_CHARACTERISTIC /begin REF_MEASUREMENT EotProtn.HwAgAuthy.Val /end REF_MEASUREMENT /end GROUP
/begin GROUP EotProtn.HwAgCcwDetd.Logl "MICROSAR RTE" /begin SUB_GROUP /end SUB_GROUP /begin FUNCTION_LIST /end FUNCTION_LIST /begin REF_CHARACTERISTIC /end REF_CHARACTERISTIC /begin REF_MEASUREMENT EotProtn.HwAgCcwDetd.Logl /end REF_MEASUREMENT /end GROUP
/begin GROUP EotProtn.HwAgCwDetd.Logl "MICROSAR RTE" /begin SUB_GROUP /end SUB_GROUP /begin FUNCTION_LIST /end FUNCTION_LIST /begin REF_CHARACTERISTIC /end REF_CHARACTERISTIC /begin REF_MEASUREMENT EotProtn.HwAgCwDetd.Logl /end REF_MEASUREMENT /end GROUP
/begin GROUP EotProtn.HwAgEotCcw.Val "MICROSAR RTE" /begin SUB_GROUP /end SUB_GROUP /begin FUNCTION_LIST /end FUNCTION_LIST /begin REF_CHARACTERISTIC /end REF_CHARACTERISTIC /begin REF_MEASUREMENT EotProtn.HwAgEotCcw.Val /end REF_MEASUREMENT /end GROUP
/begin GROUP EotProtn.HwAgEotCw.Val "MICROSAR RTE" /begin SUB_GROUP /end SUB_GROUP /begin FUNCTION_LIST /end FUNCTION_LIST /begin REF_CHARACTERISTIC /end REF_CHARACTERISTIC /begin REF_MEASUREMENT EotProtn.HwAgEotCw.Val /end REF_MEASUREMENT /end GROUP
/begin GROUP EotProtn.HwTq.Val "MICROSAR RTE" /begin SUB_GROUP /end SUB_GROUP /begin FUNCTION_LIST /end FUNCTION_LIST /begin REF_CHARACTERISTIC /end REF_CHARACTERISTIC /begin REF_MEASUREMENT EotProtn.HwTq.Val /end REF_MEASUREMENT /end GROUP
/begin GROUP EotProtn.HwTqLpFil "MICROSAR RTE" /begin SUB_GROUP /end SUB_GROUP /begin FUNCTION_LIST /end FUNCTION_LIST /begin REF_CHARACTERISTIC /end REF_CHARACTERISTIC /begin REF_MEASUREMENT EotProtn.HwTqLpFil.FilGain EotProtn.HwTqLpFil.FilSt /end REF_MEASUREMENT /end GROUP
/begin GROUP EotProtn.MotVelCrf.Val "MICROSAR RTE" /begin SUB_GROUP /end SUB_GROUP /begin FUNCTION_LIST /end FUNCTION_LIST /begin REF_CHARACTERISTIC /end REF_CHARACTERISTIC /begin REF_MEASUREMENT EotProtn.MotVelCrf.Val /end REF_MEASUREMENT /end GROUP
/begin GROUP EotProtn.NewSoftEndStopSt "MICROSAR RTE" /begin SUB_GROUP /end SUB_GROUP /begin FUNCTION_LIST /end FUNCTION_LIST /begin REF_CHARACTERISTIC /end REF_CHARACTERISTIC /begin REF_MEASUREMENT EotProtn.NewSoftEndStopSt /end REF_MEASUREMENT /end GROUP
/begin GROUP EotProtn.PerInstanceMemories "MICROSAR RTE"
 /begin SUB_GROUP EotProtn.EotAssiScaLpFil EotProtn.HwTqLpFil EotProtn.NewSoftEndStopSt EotProtn.PrevEotAssiSca EotProtn.PrevEotDampg EotProtn.PrevImpctPosn EotProtn.PrevRackTrvlLimrEna EotProtn.PrevRackTrvlLimrInin EotProtn.PrevSoftEndStopSt EotProtn.dEotProtnDampg EotProtn.dEotProtnDetd EotProtn.dEotProtnEntrGain EotProtn.dEotProtnEotAssiSca EotProtn.dEotProtnEotGain EotProtn.dEotProtnExitGain EotProtn.dEotProtnLimPosn EotProtn.dEotProtnRackTrvlLimrDi /end SUB_GROUP
 /begin FUNCTION_LIST /end FUNCTION_LIST
 /begin REF_CHARACTERISTIC /end REF_CHARACTERISTIC
 /begin REF_MEASUREMENT /end REF_MEASUREMENT
/end GROUP
/begin GROUP EotProtn.PrevEotAssiSca "MICROSAR RTE" /begin SUB_GROUP /end SUB_GROUP /begin FUNCTION_LIST /end FUNCTION_LIST /begin REF_CHARACTERISTIC /end REF_CHARACTERISTIC /begin REF_MEASUREMENT EotProtn.PrevEotAssiSca /end REF_MEASUREMENT /end GROUP
/begin GROUP EotProtn.PrevEotDampg "MICROSAR RTE" /begin SUB_GROUP /end SUB_GROUP /begin FUNCTION_LIST /end FUNCTION_LIST /begin REF_CHARACTERISTIC /end REF_CHARACTERISTIC /begin REF_MEASUREMENT EotProtn.PrevEotDampg /end REF_MEASUREMENT /end GROUP
/begin GROUP EotProtn.PrevImpctPosn "MICROSAR RTE" /begin SUB_GROUP /end SUB_GROUP /begin FUNCTION_LIST /end FUNCTION_LIST /begin REF_CHARACTERISTIC /end REF_CHARACTERISTIC /begin REF_MEASUREMENT EotProtn.PrevImpctPosn /end REF_MEASUREMENT /end GROUP
/begin GROUP EotProtn.PrevRackTrvlLimrEna "MICROSAR RTE" /begin SUB_GROUP /end SUB_GROUP /begin FUNCTION_LIST /end FUNCTION_LIST /begin REF_CHARACTERISTIC /end REF_CHARACTERISTIC /begin REF_MEASUREMENT EotProtn.PrevRackTrvlLimrEna /end REF_MEASUREMENT /end GROUP
/begin GROUP EotProtn.PrevRackTrvlLimrInin "MICROSAR RTE" /begin SUB_GROUP /end SUB_GROUP /begin FUNCTION_LIST /end FUNCTION_LIST /begin REF_CHARACTERISTIC /end REF_CHARACTERISTIC /begin REF_MEASUREMENT EotProtn.PrevRackTrvlLimrInin /end REF_MEASUREMENT /end GROUP
/begin GROUP EotProtn.PrevSoftEndStopSt "MICROSAR RTE" /begin SUB_GROUP /end SUB_GROUP /begin FUNCTION_LIST /end FUNCTION_LIST /begin REF_CHARACTERISTIC /end REF_CHARACTERISTIC /begin REF_MEASUREMENT EotProtn.PrevSoftEndStopSt /end REF_MEASUREMENT /end GROUP
/begin GROUP EotProtn.ReceiverPorts "MICROSAR RTE"
 /begin SUB_GROUP EotProtn.EotProtnDi.Logl EotProtn.HwAg.Val EotProtn.HwAgAuthy.Val EotProtn.HwAgCcwDetd.Logl EotProtn.HwAgCwDetd.Logl EotProtn.HwAgEotCcw.Val EotProtn.HwAgEotCw.Val EotProtn.HwTq.Val EotProtn.MotVelCrf.Val EotProtn.SysMotTqCmdSca.Val EotProtn.VehSpd.Val /end SUB_GROUP
 /begin FUNCTION_LIST /end FUNCTION_LIST
 /begin REF_CHARACTERISTIC /end REF_CHARACTERISTIC
 /begin REF_MEASUREMENT /end REF_MEASUREMENT
/end GROUP
/begin GROUP EotProtn.SenderPorts "MICROSAR RTE"
 /begin SUB_GROUP EotProtn.EotActvCmd.Val EotProtn.EotAssiSca.Val EotProtn.EotDampgCmd.Val EotProtn.EotMotTqLim.Val /end SUB_GROUP
 /begin FUNCTION_LIST /end FUNCTION_LIST
 /begin REF_CHARACTERISTIC /end REF_CHARACTERISTIC
 /begin REF_MEASUREMENT /end REF_MEASUREMENT
/end GROUP
/begin GROUP EotProtn.SysMotTqCmdSca.Val "MICROSAR RTE" /begin SUB_GROUP /end SUB_GROUP /begin FUNCTION_LIST /end FUNCTION_LIST /begin REF_CHARACTERISTIC /end REF_CHARACTERISTIC /begin REF_MEASUREMENT EotProtn.SysMotTqCmdSca.Val /end REF_MEASUREMENT /end GROUP
/begin GROUP EotProtn.VehSpd.Val "MICROSAR RTE" /begin SUB_GROUP /end SUB_GROUP /begin FUNCTION_LIST /end FUNCTION_LIST /begin REF_CHARACTERISTIC /end REF_CHARACTERISTIC /begin REF_MEASUREMENT EotProtn.VehSpd.Val /end REF_MEASUREMENT /end GROUP
/begin GROUP EotProtn.dEotProtnDampg "MICROSAR RTE" /begin SUB_GROUP /end SUB_GROUP /begin FUNCTION_LIST /end FUNCTION_LIST /begin REF_CHARACTERISTIC /end REF_CHARACTERISTIC /begin REF_MEASUREMENT EotProtn.dEotProtnDampg /end REF_MEASUREMENT /end GROUP
/begin GROUP EotProtn.dEotProtnDetd "MICROSAR RTE" /begin SUB_GROUP /end SUB_GROUP /begin FUNCTION_LIST /end FUNCTION_LIST /begin REF_CHARACTERISTIC /end REF_CHARACTERISTIC /begin REF_MEASUREMENT EotProtn.dEotProtnDetd /end REF_MEASUREMENT /end GROUP
/begin GROUP EotProtn.dEotProtnEntrGain "MICROSAR RTE" /begin SUB_GROUP /end SUB_GROUP /begin FUNCTION_LIST /end FUNCTION_LIST /begin REF_CHARACTERISTIC /end REF_CHARACTERISTIC /begin REF_MEASUREMENT EotProtn.dEotProtnEntrGain /end REF_MEASUREMENT /end GROUP
/begin GROUP EotProtn.dEotProtnEotAssiSca "MICROSAR RTE" /begin SUB_GROUP /end SUB_GROUP /begin FUNCTION_LIST /end FUNCTION_LIST /begin REF_CHARACTERISTIC /end REF_CHARACTERISTIC /begin REF_MEASUREMENT EotProtn.dEotProtnEotAssiSca /end REF_MEASUREMENT /end GROUP
/begin GROUP EotProtn.dEotProtnEotGain "MICROSAR RTE" /begin SUB_GROUP /end SUB_GROUP /begin FUNCTION_LIST /end FUNCTION_LIST /begin REF_CHARACTERISTIC /end REF_CHARACTERISTIC /begin REF_MEASUREMENT EotProtn.dEotProtnEotGain /end REF_MEASUREMENT /end GROUP
/begin GROUP EotProtn.dEotProtnExitGain "MICROSAR RTE" /begin SUB_GROUP /end SUB_GROUP /begin FUNCTION_LIST /end FUNCTION_LIST /begin REF_CHARACTERISTIC /end REF_CHARACTERISTIC /begin REF_MEASUREMENT EotProtn.dEotProtnExitGain /end REF_MEASUREMENT /end GROUP
/begin GROUP EotProtn.dEotProtnLimPosn "MICROSAR RTE" /begin SUB_GROUP /end SUB_GROUP /begin FUNCTION_LIST /end FUNCTION_LIST /begin REF_CHARACTERISTIC /end REF_CHARACTERISTIC /begin REF_MEASUREMENT EotProtn.dEotProtnLimPosn /end REF_MEASUREMENT /end GROUP
/begin GROUP EotProtn.dEotProtnRackTrvlLimrDi "MICROSAR RTE" /begin SUB_GROUP /end SUB_GROUP /begin FUNCTION_LIST /end FUNCTION_LIST /begin REF_CHARACTERISTIC /end REF_CHARACTERISTIC /begin REF_MEASUREMENT EotProtn.dEotProtnRackTrvlLimrDi /end REF_MEASUREMENT /end GROUP
/begin GROUP EotProtnFwl "MICROSAR RTE"
 /begin SUB_GROUP EotProtnFwl.CalibrationPorts EotProtnFwl.PerInstanceMemories EotProtnFwl.ReceiverPorts EotProtnFwl.SenderPorts /end SUB_GROUP
 /begin FUNCTION_LIST /end FUNCTION_LIST
 /begin REF_CHARACTERISTIC /end REF_CHARACTERISTIC
 /begin REF_MEASUREMENT /end REF_MEASUREMENT
/end GROUP
/begin GROUP EotProtnFwl.CalibrationPorts "MICROSAR RTE"
 /begin SUB_GROUP EotProtnFwl.EotProtnFwlActvCmdLowrBnd.Ary1D EotProtnFwl.EotProtnFwlActvCmdUpprBnd.Ary1D EotProtnFwl.EotProtnFwlEotDampgActvBndX.Ary1D EotProtnFwl.EotProtnFwlEotDampgActvBndY.Ary2D EotProtnFwl.EotProtnFwlInactvLim.Val EotProtnFwl.EotProtnFwlVehSpd.Ary1D EotProtnFwl.EotProtnHwAgMin.Val EotProtnFwl.EotProtnHwDegDampgX.Ary2D EotProtnFwl.EotProtnRackTrvlLimrRng.Val EotProtnFwl.EotProtnSoftEndStopAuthyThd.Val /end SUB_GROUP
 /begin FUNCTION_LIST /end FUNCTION_LIST
 /begin REF_CHARACTERISTIC /end REF_CHARACTERISTIC
 /begin REF_MEASUREMENT /end REF_MEASUREMENT
/end GROUP
/begin GROUP EotProtnFwl.EotActvCmd.Val "MICROSAR RTE" /begin SUB_GROUP /end SUB_GROUP /begin FUNCTION_LIST /end FUNCTION_LIST /begin REF_CHARACTERISTIC /end REF_CHARACTERISTIC /begin REF_MEASUREMENT EotProtnFwl.EotActvCmd.Val /end REF_MEASUREMENT /end GROUP
/begin GROUP EotProtnFwl.EotActvCmdLimd.Val "MICROSAR RTE" /begin SUB_GROUP /end SUB_GROUP /begin FUNCTION_LIST /end FUNCTION_LIST /begin REF_CHARACTERISTIC /end REF_CHARACTERISTIC /begin REF_MEASUREMENT EotProtnFwl.EotActvCmdLimd.Val /end REF_MEASUREMENT /end GROUP
/begin GROUP EotProtnFwl.EotDampgCmd.Val "MICROSAR RTE" /begin SUB_GROUP /end SUB_GROUP /begin FUNCTION_LIST /end FUNCTION_LIST /begin REF_CHARACTERISTIC /end REF_CHARACTERISTIC /begin REF_MEASUREMENT EotProtnFwl.EotDampgCmd.Val /end REF_MEASUREMENT /end GROUP
/begin GROUP EotProtnFwl.EotDampgCmdLimd.Val "MICROSAR RTE" /begin SUB_GROUP /end SUB_GROUP /begin FUNCTION_LIST /end FUNCTION_LIST /begin REF_CHARACTERISTIC /end REF_CHARACTERISTIC /begin REF_MEASUREMENT EotProtnFwl.EotDampgCmdLimd.Val /end REF_MEASUREMENT /end GROUP
/begin GROUP EotProtnFwl.EotProtnDi.Logl "MICROSAR RTE" /begin SUB_GROUP /end SUB_GROUP /begin FUNCTION_LIST /end FUNCTION_LIST /begin REF_CHARACTERISTIC /end REF_CHARACTERISTIC /begin REF_MEASUREMENT EotProtnFwl.EotProtnDi.Logl /end REF_MEASUREMENT /end GROUP
/begin GROUP EotProtnFwl.EotProtnFwlActvCmdLowrBnd.Ary1D "MICROSAR RTE" /begin SUB_GROUP /end SUB_GROUP /begin FUNCTION_LIST /end FUNCTION_LIST /begin REF_CHARACTERISTIC EotProtnFwl.EotProtnFwlActvCmdLowrBnd.Ary1D /end REF_CHARACTERISTIC /begin REF_MEASUREMENT /end REF_MEASUREMENT /end GROUP
/begin GROUP EotProtnFwl.EotProtnFwlActvCmdUpprBnd.Ary1D "MICROSAR RTE" /begin SUB_GROUP /end SUB_GROUP /begin FUNCTION_LIST /end FUNCTION_LIST /begin REF_CHARACTERISTIC EotProtnFwl.EotProtnFwlActvCmdUpprBnd.Ary1D /end REF_CHARACTERISTIC /begin REF_MEASUREMENT /end REF_MEASUREMENT /end GROUP
/begin GROUP EotProtnFwl.EotProtnFwlEotDampgActvBndX.Ary1D "MICROSAR RTE" /begin SUB_GROUP /end SUB_GROUP /begin FUNCTION_LIST /end FUNCTION_LIST /begin REF_CHARACTERISTIC EotProtnFwl.EotProtnFwlEotDampgActvBndX.Ary1D /end REF_CHARACTERISTIC /begin REF_MEASUREMENT /end REF_MEASUREMENT /end GROUP
/begin GROUP EotProtnFwl.EotProtnFwlEotDampgActvBndY.Ary2D "MICROSAR RTE" /begin SUB_GROUP /end SUB_GROUP /begin FUNCTION_LIST /end FUNCTION_LIST /begin REF_CHARACTERISTIC EotProtnFwl.EotProtnFwlEotDampgActvBndY.Ary2D /end REF_CHARACTERISTIC /begin REF_MEASUREMENT /end REF_MEASUREMENT /end GROUP
/begin GROUP EotProtnFwl.EotProtnFwlInactvLim.Val "MICROSAR RTE" /begin SUB_GROUP /end SUB_GROUP /begin FUNCTION_LIST /end FUNCTION_LIST /begin REF_CHARACTERISTIC EotProtnFwl.EotProtnFwlInactvLim.Val /end REF_CHARACTERISTIC /begin REF_MEASUREMENT /end REF_MEASUREMENT /end GROUP
/begin GROUP EotProtnFwl.EotProtnFwlVehSpd.Ary1D "MICROSAR RTE" /begin SUB_GROUP /end SUB_GROUP /begin FUNCTION_LIST /end FUNCTION_LIST /begin REF_CHARACTERISTIC EotProtnFwl.EotProtnFwlVehSpd.Ary1D /end REF_CHARACTERISTIC /begin REF_MEASUREMENT /end REF_MEASUREMENT /end GROUP
/begin GROUP EotProtnFwl.EotProtnHwAgMin.Val "MICROSAR RTE" /begin SUB_GROUP /end SUB_GROUP /begin FUNCTION_LIST /end FUNCTION_LIST /begin REF_CHARACTERISTIC EotProtnFwl.EotProtnHwAgMin.Val /end REF_CHARACTERISTIC /begin REF_MEASUREMENT /end REF_MEASUREMENT /end GROUP
/begin GROUP EotProtnFwl.EotProtnHwDegDampgX.Ary2D "MICROSAR RTE" /begin SUB_GROUP /end SUB_GROUP /begin FUNCTION_LIST /end FUNCTION_LIST /begin REF_CHARACTERISTIC EotProtnFwl.EotProtnHwDegDampgX.Ary2D /end REF_CHARACTERISTIC /begin REF_MEASUREMENT /end REF_MEASUREMENT /end GROUP
/begin GROUP EotProtnFwl.EotProtnRackTrvlLimrRng.Val "MICROSAR RTE" /begin SUB_GROUP /end SUB_GROUP /begin FUNCTION_LIST /end FUNCTION_LIST /begin REF_CHARACTERISTIC EotProtnFwl.EotProtnRackTrvlLimrRng.Val /end REF_CHARACTERISTIC /begin REF_MEASUREMENT /end REF_MEASUREMENT /end GROUP
/begin GROUP EotProtnFwl.EotProtnSoftEndStopAuthyThd.Val "MICROSAR RTE" /begin SUB_GROUP /end SUB_GROUP /begin FUNCTION_LIST /end FUNCTION_LIST /begin REF_CHARACTERISTIC EotProtnFwl.EotProtnSoftEndStopAuthyThd.Val /end REF_CHARACTERISTIC /begin REF_MEASUREMENT /end REF_MEASUREMENT /end GROUP
/begin GROUP EotProtnFwl.HwAg.Val "MICROSAR RTE" /begin SUB_GROUP /end SUB_GROUP /begin FUNCTION_LIST /end FUNCTION_LIST /begin REF_CHARACTERISTIC /end REF_CHARACTERISTIC /begin REF_MEASUREMENT EotProtnFwl.HwAg.Val /end REF_MEASUREMENT /end GROUP
/begin GROUP EotProtnFwl.MotVelCrf.Val "MICROSAR RTE" /begin SUB_GROUP /end SUB_GROUP /begin FUNCTION_LIST /end FUNCTION_LIST /begin REF_CHARACTERISTIC /end REF_CHARACTERISTIC /begin REF_MEASUREMENT EotProtnFwl.MotVelCrf.Val /end REF_MEASUREMENT /end GROUP
/begin GROUP EotProtnFwl.PerInstanceMemories "MICROSAR RTE"
 /begin SUB_GROUP EotProtnFwl.dEotProtnFwlEotActvCmdActvLowrBnd EotProtnFwl.dEotProtnFwlEotActvCmdActvUpprBnd EotProtnFwl.dEotProtnFwlEotActvCmdMod EotProtnFwl.dEotProtnFwlEotActvCmdOverActvLim EotProtnFwl.dEotProtnFwlEotActvCmdOverInactvLim EotProtnFwl.dEotProtnFwlEotDampgActvLowrBnd EotProtnFwl.dEotProtnFwlEotDampgActvUpprBnd EotProtnFwl.dEotProtnFwlEotDampgFwX0 EotProtnFwl.dEotProtnFwlEotDampgMod EotProtnFwl.dEotProtnFwlEotDampgOverActvLim EotProtnFwl.dEotProtnFwlEotDampgOverInactvLim EotProtnFwl.dEotProtnFwlPinionAgConfSts /end SUB_GROUP
 /begin FUNCTION_LIST /end FUNCTION_LIST
 /begin REF_CHARACTERISTIC /end REF_CHARACTERISTIC
 /begin REF_MEASUREMENT /end REF_MEASUREMENT
/end GROUP
/begin GROUP EotProtnFwl.PinionAgConf.Val "MICROSAR RTE" /begin SUB_GROUP /end SUB_GROUP /begin FUNCTION_LIST /end FUNCTION_LIST /begin REF_CHARACTERISTIC /end REF_CHARACTERISTIC /begin REF_MEASUREMENT EotProtnFwl.PinionAgConf.Val /end REF_MEASUREMENT /end GROUP
/begin GROUP EotProtnFwl.ReceiverPorts "MICROSAR RTE"
 /begin SUB_GROUP EotProtnFwl.EotActvCmd.Val EotProtnFwl.EotDampgCmd.Val EotProtnFwl.EotProtnDi.Logl EotProtnFwl.HwAg.Val EotProtnFwl.MotVelCrf.Val EotProtnFwl.PinionAgConf.Val EotProtnFwl.VehSpd.Val /end SUB_GROUP
 /begin FUNCTION_LIST /end FUNCTION_LIST
 /begin REF_CHARACTERISTIC /end REF_CHARACTERISTIC
 /begin REF_MEASUREMENT /end REF_MEASUREMENT
/end GROUP
/begin GROUP EotProtnFwl.SenderPorts "MICROSAR RTE"
 /begin SUB_GROUP EotProtnFwl.EotActvCmdLimd.Val EotProtnFwl.EotDampgCmdLimd.Val /end SUB_GROUP
 /begin FUNCTION_LIST /end FUNCTION_LIST
 /begin REF_CHARACTERISTIC /end REF_CHARACTERISTIC
 /begin REF_MEASUREMENT /end REF_MEASUREMENT
/end GROUP
/begin GROUP EotProtnFwl.VehSpd.Val "MICROSAR RTE" /begin SUB_GROUP /end SUB_GROUP /begin FUNCTION_LIST /end FUNCTION_LIST /begin REF_CHARACTERISTIC /end REF_CHARACTERISTIC /begin REF_MEASUREMENT EotProtnFwl.VehSpd.Val /end REF_MEASUREMENT /end GROUP
/begin GROUP EotProtnFwl.dEotProtnFwlEotActvCmdActvLowrBnd "MICROSAR RTE" /begin SUB_GROUP /end SUB_GROUP /begin FUNCTION_LIST /end FUNCTION_LIST /begin REF_CHARACTERISTIC /end REF_CHARACTERISTIC /begin REF_MEASUREMENT EotProtnFwl.dEotProtnFwlEotActvCmdActvLowrBnd /end REF_MEASUREMENT /end GROUP
/begin GROUP EotProtnFwl.dEotProtnFwlEotActvCmdActvUpprBnd "MICROSAR RTE" /begin SUB_GROUP /end SUB_GROUP /begin FUNCTION_LIST /end FUNCTION_LIST /begin REF_CHARACTERISTIC /end REF_CHARACTERISTIC /begin REF_MEASUREMENT EotProtnFwl.dEotProtnFwlEotActvCmdActvUpprBnd /end REF_MEASUREMENT /end GROUP
/begin GROUP EotProtnFwl.dEotProtnFwlEotActvCmdMod "MICROSAR RTE" /begin SUB_GROUP /end SUB_GROUP /begin FUNCTION_LIST /end FUNCTION_LIST /begin REF_CHARACTERISTIC /end REF_CHARACTERISTIC /begin REF_MEASUREMENT EotProtnFwl.dEotProtnFwlEotActvCmdMod /end REF_MEASUREMENT /end GROUP
/begin GROUP EotProtnFwl.dEotProtnFwlEotActvCmdOverActvLim "MICROSAR RTE" /begin SUB_GROUP /end SUB_GROUP /begin FUNCTION_LIST /end FUNCTION_LIST /begin REF_CHARACTERISTIC /end REF_CHARACTERISTIC /begin REF_MEASUREMENT EotProtnFwl.dEotProtnFwlEotActvCmdOverActvLim /end REF_MEASUREMENT /end GROUP
/begin GROUP EotProtnFwl.dEotProtnFwlEotActvCmdOverInactvLim "MICROSAR RTE" /begin SUB_GROUP /end SUB_GROUP /begin FUNCTION_LIST /end FUNCTION_LIST /begin REF_CHARACTERISTIC /end REF_CHARACTERISTIC /begin REF_MEASUREMENT EotProtnFwl.dEotProtnFwlEotActvCmdOverInactvLim /end REF_MEASUREMENT /end GROUP
/begin GROUP EotProtnFwl.dEotProtnFwlEotDampgActvLowrBnd "MICROSAR RTE" /begin SUB_GROUP /end SUB_GROUP /begin FUNCTION_LIST /end FUNCTION_LIST /begin REF_CHARACTERISTIC /end REF_CHARACTERISTIC /begin REF_MEASUREMENT EotProtnFwl.dEotProtnFwlEotDampgActvLowrBnd /end REF_MEASUREMENT /end GROUP
/begin GROUP EotProtnFwl.dEotProtnFwlEotDampgActvUpprBnd "MICROSAR RTE" /begin SUB_GROUP /end SUB_GROUP /begin FUNCTION_LIST /end FUNCTION_LIST /begin REF_CHARACTERISTIC /end REF_CHARACTERISTIC /begin REF_MEASUREMENT EotProtnFwl.dEotProtnFwlEotDampgActvUpprBnd /end REF_MEASUREMENT /end GROUP
/begin GROUP EotProtnFwl.dEotProtnFwlEotDampgFwX0 "MICROSAR RTE" /begin SUB_GROUP /end SUB_GROUP /begin FUNCTION_LIST /end FUNCTION_LIST /begin REF_CHARACTERISTIC /end REF_CHARACTERISTIC /begin REF_MEASUREMENT EotProtnFwl.dEotProtnFwlEotDampgFwX0 /end REF_MEASUREMENT /end GROUP
/begin GROUP EotProtnFwl.dEotProtnFwlEotDampgMod "MICROSAR RTE" /begin SUB_GROUP /end SUB_GROUP /begin FUNCTION_LIST /end FUNCTION_LIST /begin REF_CHARACTERISTIC /end REF_CHARACTERISTIC /begin REF_MEASUREMENT EotProtnFwl.dEotProtnFwlEotDampgMod /end REF_MEASUREMENT /end GROUP
/begin GROUP EotProtnFwl.dEotProtnFwlEotDampgOverActvLim "MICROSAR RTE" /begin SUB_GROUP /end SUB_GROUP /begin FUNCTION_LIST /end FUNCTION_LIST /begin REF_CHARACTERISTIC /end REF_CHARACTERISTIC /begin REF_MEASUREMENT EotProtnFwl.dEotProtnFwlEotDampgOverActvLim /end REF_MEASUREMENT /end GROUP
/begin GROUP EotProtnFwl.dEotProtnFwlEotDampgOverInactvLim "MICROSAR RTE" /begin SUB_GROUP /end SUB_GROUP /begin FUNCTION_LIST /end FUNCTION_LIST /begin REF_CHARACTERISTIC /end REF_CHARACTERISTIC /begin REF_MEASUREMENT EotProtnFwl.dEotProtnFwlEotDampgOverInactvLim /end REF_MEASUREMENT /end GROUP
/begin GROUP EotProtnFwl.dEotProtnFwlPinionAgConfSts "MICROSAR RTE" /begin SUB_GROUP /end SUB_GROUP /begin FUNCTION_LIST /end FUNCTION_LIST /begin REF_CHARACTERISTIC /end REF_CHARACTERISTIC /begin REF_MEASUREMENT EotProtnFwl.dEotProtnFwlPinionAgConfSts /end REF_MEASUREMENT /end GROUP
/begin GROUP FltInj "MICROSAR RTE" /begin SUB_GROUP FltInj.ReceiverPorts /end SUB_GROUP /begin FUNCTION_LIST /end FUNCTION_LIST /begin REF_CHARACTERISTIC /end REF_CHARACTERISTIC /begin REF_MEASUREMENT /end REF_MEASUREMENT /end GROUP
/begin GROUP FltInj.HwVel.Val "MICROSAR RTE" /begin SUB_GROUP /end SUB_GROUP /begin FUNCTION_LIST /end FUNCTION_LIST /begin REF_CHARACTERISTIC /end REF_CHARACTERISTIC /begin REF_MEASUREMENT FltInj.HwVel.Val /end REF_MEASUREMENT /end GROUP
/begin GROUP FltInj.ReceiverPorts "MICROSAR RTE" /begin SUB_GROUP FltInj.HwVel.Val /end SUB_GROUP /begin FUNCTION_LIST /end FUNCTION_LIST /begin REF_CHARACTERISTIC /end REF_CHARACTERISTIC /begin REF_MEASUREMENT /end REF_MEASUREMENT /end GROUP
/begin GROUP FordCanDtcInhb "MICROSAR RTE"
 /begin SUB_GROUP FordCanDtcInhb.CalibrationPorts FordCanDtcInhb.PerInstanceMemories FordCanDtcInhb.ReceiverPorts FordCanDtcInhb.SenderPorts /end SUB_GROUP
 /begin FUNCTION_LIST /end FUNCTION_LIST
 /begin REF_CHARACTERISTIC /end REF_CHARACTERISTIC
 /begin REF_MEASUREMENT /end REF_MEASUREMENT
/end GROUP
/begin GROUP FordCanDtcInhb.CalibrationPorts "MICROSAR RTE"
 /begin SUB_GROUP FordCanDtcInhb.FordCanDtcInhbFactryModThd.Val FordCanDtcInhb.FordCanDtcInhbTransptModThd.Val /end SUB_GROUP
 /begin FUNCTION_LIST /end FUNCTION_LIST
 /begin REF_CHARACTERISTIC /end REF_CHARACTERISTIC
 /begin REF_MEASUREMENT /end REF_MEASUREMENT
/end GROUP
/begin GROUP FordCanDtcInhb.CanDtcInhbRefTi "MICROSAR RTE" /begin SUB_GROUP /end SUB_GROUP /begin FUNCTION_LIST /end FUNCTION_LIST /begin REF_CHARACTERISTIC /end REF_CHARACTERISTIC /begin REF_MEASUREMENT FordCanDtcInhb.CanDtcInhbRefTi /end REF_MEASUREMENT /end GROUP
/begin GROUP FordCanDtcInhb.EpsFactryModRefTi "MICROSAR RTE" /begin SUB_GROUP /end SUB_GROUP /begin FUNCTION_LIST /end FUNCTION_LIST /begin REF_CHARACTERISTIC /end REF_CHARACTERISTIC /begin REF_MEASUREMENT FordCanDtcInhb.EpsFactryModRefTi /end REF_MEASUREMENT /end GROUP
/begin GROUP FordCanDtcInhb.EpsLifeCycModPrev "MICROSAR RTE" /begin SUB_GROUP /end SUB_GROUP /begin FUNCTION_LIST /end FUNCTION_LIST /begin REF_CHARACTERISTIC /end REF_CHARACTERISTIC /begin REF_MEASUREMENT FordCanDtcInhb.EpsLifeCycModPrev /end REF_MEASUREMENT /end GROUP
/begin GROUP FordCanDtcInhb.EpsLifeCycModRefTi "MICROSAR RTE" /begin SUB_GROUP /end SUB_GROUP /begin FUNCTION_LIST /end FUNCTION_LIST /begin REF_CHARACTERISTIC /end REF_CHARACTERISTIC /begin REF_MEASUREMENT FordCanDtcInhb.EpsLifeCycModRefTi /end REF_MEASUREMENT /end GROUP
/begin GROUP FordCanDtcInhb.EpsTransptModRefTi "MICROSAR RTE" /begin SUB_GROUP /end SUB_GROUP /begin FUNCTION_LIST /end FUNCTION_LIST /begin REF_CHARACTERISTIC /end REF_CHARACTERISTIC /begin REF_MEASUREMENT FordCanDtcInhb.EpsTransptModRefTi /end REF_MEASUREMENT /end GROUP
/begin GROUP FordCanDtcInhb.FordBattVltgEstimn.Val "MICROSAR RTE" /begin SUB_GROUP /end SUB_GROUP /begin FUNCTION_LIST /end FUNCTION_LIST /begin REF_CHARACTERISTIC /end REF_CHARACTERISTIC /begin REF_MEASUREMENT FordCanDtcInhb.FordBattVltgEstimn.Val /end REF_MEASUREMENT /end GROUP
/begin GROUP FordCanDtcInhb.FordCanDtcInhb8.Val "MICROSAR RTE" /begin SUB_GROUP /end SUB_GROUP /begin FUNCTION_LIST /end FUNCTION_LIST /begin REF_CHARACTERISTIC /end REF_CHARACTERISTIC /begin REF_MEASUREMENT FordCanDtcInhb.FordCanDtcInhb8.Val /end REF_MEASUREMENT /end GROUP
/**********************************************************************************************************************
* RECORD_LAYOUT
*********************************************************************************************************************/
/begin RECORD_LAYOUT RTE_RL_UBYTE FNC_VALUES 1 UBYTE ROW_DIR DIRECT /end RECORD_LAYOUT
/begin RECORD_LAYOUT RTE_RL_UWORD FNC_VALUES 1 UWORD ROW_DIR DIRECT /end RECORD_LAYOUT
/begin RECORD_LAYOUT RTE_RL_SWORD FNC_VALUES 1 SWORD ROW_DIR DIRECT /end RECORD_LAYOUT
/begin RECORD_LAYOUT RTE_RL_FLOAT32_IEEE FNC_VALUES 1 FLOAT32_IEEE ROW_DIR DIRECT /end RECORD_LAYOUT
/begin RECORD_LAYOUT RTE_RL_BOOLEAN FNC_VALUES 1 UBYTE ROW_DIR DIRECT /end RECORD_LAYOUT
/**********************************************************************************************************************
* COMPU_METHOD / COMPU_VTAB_RANGE
*********************************************************************************************************************/
/begin COMPU_METHOD RTE_CM_BOOLEAN "" TAB_VERB "%3.1" "" COMPU_TAB_REF RTE_CM_BOOLEAN /end COMPU_METHOD
/begin COMPU_VTAB_RANGE RTE_CM_BOOLEAN "" 2 0 0 "false" 1 255 "true" /end COMPU_VTAB_RANGE
