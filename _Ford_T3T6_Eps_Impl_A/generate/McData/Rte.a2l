/begin CHARACTERISTIC CalRegn01Inin00GroupD.StabyCmpNotchFil1Struct.Rec.FilGainA1 "MICROSAR RTE" VALUE 0x0 RTE_RL_FLOAT32_IEEE 0 NO_COMPU_METHOD -3.402823466e+38 3.402823466e+38 SYMBOL_LINK "Rte_CalprmRom_CalRegn01Inin00GroupD_DEFAULT_RTE_CALPRM_GROUP.StabyCmpNotchFil1Struct_Rec.FilGainA1" 0 DISPLAY_IDENTIFIER CalRegn01Inin00GroupD.CalibrationPorts.StabyCmpNotchFil1Struct.Rec.FilGainA1 /end CHARACTERISTIC
/begin CHARACTERISTIC CalRegn01Inin00GroupD.StabyCmpNotchFil1Struct.Rec.FilGainA2 "MICROSAR RTE" VALUE 0x0 RTE_RL_FLOAT32_IEEE 0 NO_COMPU_METHOD -3.402823466e+38 3.402823466e+38 SYMBOL_LINK "Rte_CalprmRom_CalRegn01Inin00GroupD_DEFAULT_RTE_CALPRM_GROUP.StabyCmpNotchFil1Struct_Rec.FilGainA2" 0 DISPLAY_IDENTIFIER CalRegn01Inin00GroupD.CalibrationPorts.StabyCmpNotchFil1Struct.Rec.FilGainA2 /end CHARACTERISTIC
/begin CHARACTERISTIC CalRegn01Inin00GroupD.StabyCmpNotchFil1Struct.Rec.FilGainB0 "MICROSAR RTE" VALUE 0x0 RTE_RL_FLOAT32_IEEE 0 NO_COMPU_METHOD -3.402823466e+38 3.402823466e+38 SYMBOL_LINK "Rte_CalprmRom_CalRegn01Inin00GroupD_DEFAULT_RTE_CALPRM_GROUP.StabyCmpNotchFil1Struct_Rec.FilGainB0" 0 DISPLAY_IDENTIFIER CalRegn01Inin00GroupD.CalibrationPorts.StabyCmpNotchFil1Struct.Rec.FilGainB0 /end CHARACTERISTIC
/begin CHARACTERISTIC CalRegn01Inin00GroupD.StabyCmpNotchFil1Struct.Rec.FilGainB1 "MICROSAR RTE" VALUE 0x0 RTE_RL_FLOAT32_IEEE 0 NO_COMPU_METHOD -3.402823466e+38 3.402823466e+38 SYMBOL_LINK "Rte_CalprmRom_CalRegn01Inin00GroupD_DEFAULT_RTE_CALPRM_GROUP.StabyCmpNotchFil1Struct_Rec.FilGainB1" 0 DISPLAY_IDENTIFIER CalRegn01Inin00GroupD.CalibrationPorts.StabyCmpNotchFil1Struct.Rec.FilGainB1 /end CHARACTERISTIC
/begin CHARACTERISTIC CalRegn01Inin00GroupD.StabyCmpNotchFil1Struct.Rec.FilGainB2 "MICROSAR RTE" VALUE 0x0 RTE_RL_FLOAT32_IEEE 0 NO_COMPU_METHOD -3.402823466e+38 3.402823466e+38 SYMBOL_LINK "Rte_CalprmRom_CalRegn01Inin00GroupD_DEFAULT_RTE_CALPRM_GROUP.StabyCmpNotchFil1Struct_Rec.FilGainB2" 0 DISPLAY_IDENTIFIER CalRegn01Inin00GroupD.CalibrationPorts.StabyCmpNotchFil1Struct.Rec.FilGainB2 /end CHARACTERISTIC
/begin CHARACTERISTIC CalRegn01Inin00GroupD.StabyCmpNotchFil2Struct.Rec.FilGainA1 "MICROSAR RTE" VALUE 0x0 RTE_RL_FLOAT32_IEEE 0 NO_COMPU_METHOD -3.402823466e+38 3.402823466e+38 SYMBOL_LINK "Rte_CalprmRom_CalRegn01Inin00GroupD_DEFAULT_RTE_CALPRM_GROUP.StabyCmpNotchFil2Struct_Rec.FilGainA1" 0 DISPLAY_IDENTIFIER CalRegn01Inin00GroupD.CalibrationPorts.StabyCmpNotchFil2Struct.Rec.FilGainA1 /end CHARACTERISTIC
/begin CHARACTERISTIC CalRegn01Inin00GroupD.StabyCmpNotchFil2Struct.Rec.FilGainA2 "MICROSAR RTE" VALUE 0x0 RTE_RL_FLOAT32_IEEE 0 NO_COMPU_METHOD -3.402823466e+38 3.402823466e+38 SYMBOL_LINK "Rte_CalprmRom_CalRegn01Inin00GroupD_DEFAULT_RTE_CALPRM_GROUP.StabyCmpNotchFil2Struct_Rec.FilGainA2" 0 DISPLAY_IDENTIFIER CalRegn01Inin00GroupD.CalibrationPorts.StabyCmpNotchFil2Struct.Rec.FilGainA2 /end CHARACTERISTIC
/begin CHARACTERISTIC CalRegn01Inin00GroupD.StabyCmpNotchFil2Struct.Rec.FilGainB0 "MICROSAR RTE" VALUE 0x0 RTE_RL_FLOAT32_IEEE 0 NO_COMPU_METHOD -3.402823466e+38 3.402823466e+38 SYMBOL_LINK "Rte_CalprmRom_CalRegn01Inin00GroupD_DEFAULT_RTE_CALPRM_GROUP.StabyCmpNotchFil2Struct_Rec.FilGainB0" 0 DISPLAY_IDENTIFIER CalRegn01Inin00GroupD.CalibrationPorts.StabyCmpNotchFil2Struct.Rec.FilGainB0 /end CHARACTERISTIC
/begin CHARACTERISTIC CalRegn01Inin00GroupD.StabyCmpNotchFil2Struct.Rec.FilGainB1 "MICROSAR RTE" VALUE 0x0 RTE_RL_FLOAT32_IEEE 0 NO_COMPU_METHOD -3.402823466e+38 3.402823466e+38 SYMBOL_LINK "Rte_CalprmRom_CalRegn01Inin00GroupD_DEFAULT_RTE_CALPRM_GROUP.StabyCmpNotchFil2Struct_Rec.FilGainB1" 0 DISPLAY_IDENTIFIER CalRegn01Inin00GroupD.CalibrationPorts.StabyCmpNotchFil2Struct.Rec.FilGainB1 /end CHARACTERISTIC
/begin CHARACTERISTIC CalRegn01Inin00GroupD.StabyCmpNotchFil2Struct.Rec.FilGainB2 "MICROSAR RTE" VALUE 0x0 RTE_RL_FLOAT32_IEEE 0 NO_COMPU_METHOD -3.402823466e+38 3.402823466e+38 SYMBOL_LINK "Rte_CalprmRom_CalRegn01Inin00GroupD_DEFAULT_RTE_CALPRM_GROUP.StabyCmpNotchFil2Struct_Rec.FilGainB2" 0 DISPLAY_IDENTIFIER CalRegn01Inin00GroupD.CalibrationPorts.StabyCmpNotchFil2Struct.Rec.FilGainB2 /end CHARACTERISTIC
/begin CHARACTERISTIC CalRegn01Inin00GroupD.StabyCmpNotchFil3Struct.Rec.FilGainA1 "MICROSAR RTE" VALUE 0x0 RTE_RL_FLOAT32_IEEE 0 NO_COMPU_METHOD -3.402823466e+38 3.402823466e+38 SYMBOL_LINK "Rte_CalprmRom_CalRegn01Inin00GroupD_DEFAULT_RTE_CALPRM_GROUP.StabyCmpNotchFil3Struct_Rec.FilGainA1" 0 DISPLAY_IDENTIFIER CalRegn01Inin00GroupD.CalibrationPorts.StabyCmpNotchFil3Struct.Rec.FilGainA1 /end CHARACTERISTIC
/begin CHARACTERISTIC CalRegn01Inin00GroupD.StabyCmpNotchFil3Struct.Rec.FilGainA2 "MICROSAR RTE" VALUE 0x0 RTE_RL_FLOAT32_IEEE 0 NO_COMPU_METHOD -3.402823466e+38 3.402823466e+38 SYMBOL_LINK "Rte_CalprmRom_CalRegn01Inin00GroupD_DEFAULT_RTE_CALPRM_GROUP.StabyCmpNotchFil3Struct_Rec.FilGainA2" 0 DISPLAY_IDENTIFIER CalRegn01Inin00GroupD.CalibrationPorts.StabyCmpNotchFil3Struct.Rec.FilGainA2 /end CHARACTERISTIC
/begin CHARACTERISTIC CalRegn01Inin00GroupD.StabyCmpNotchFil3Struct.Rec.FilGainB0 "MICROSAR RTE" VALUE 0x0 RTE_RL_FLOAT32_IEEE 0 NO_COMPU_METHOD -3.402823466e+38 3.402823466e+38 SYMBOL_LINK "Rte_CalprmRom_CalRegn01Inin00GroupD_DEFAULT_RTE_CALPRM_GROUP.StabyCmpNotchFil3Struct_Rec.FilGainB0" 0 DISPLAY_IDENTIFIER CalRegn01Inin00GroupD.CalibrationPorts.StabyCmpNotchFil3Struct.Rec.FilGainB0 /end CHARACTERISTIC
/begin CHARACTERISTIC CalRegn01Inin00GroupD.StabyCmpNotchFil3Struct.Rec.FilGainB1 "MICROSAR RTE" VALUE 0x0 RTE_RL_FLOAT32_IEEE 0 NO_COMPU_METHOD -3.402823466e+38 3.402823466e+38 SYMBOL_LINK "Rte_CalprmRom_CalRegn01Inin00GroupD_DEFAULT_RTE_CALPRM_GROUP.StabyCmpNotchFil3Struct_Rec.FilGainB1" 0 DISPLAY_IDENTIFIER CalRegn01Inin00GroupD.CalibrationPorts.StabyCmpNotchFil3Struct.Rec.FilGainB1 /end CHARACTERISTIC
/begin CHARACTERISTIC CalRegn01Inin00GroupD.StabyCmpNotchFil3Struct.Rec.FilGainB2 "MICROSAR RTE" VALUE 0x0 RTE_RL_FLOAT32_IEEE 0 NO_COMPU_METHOD -3.402823466e+38 3.402823466e+38 SYMBOL_LINK "Rte_CalprmRom_CalRegn01Inin00GroupD_DEFAULT_RTE_CALPRM_GROUP.StabyCmpNotchFil3Struct_Rec.FilGainB2" 0 DISPLAY_IDENTIFIER CalRegn01Inin00GroupD.CalibrationPorts.StabyCmpNotchFil3Struct.Rec.FilGainB2 /end CHARACTERISTIC
/begin CHARACTERISTIC CalRegn01Inin00GroupD.StabyCmpNotchFil4Struct.Rec.FilGainA1 "MICROSAR RTE" VALUE 0x0 RTE_RL_FLOAT32_IEEE 0 NO_COMPU_METHOD -3.402823466e+38 3.402823466e+38 SYMBOL_LINK "Rte_CalprmRom_CalRegn01Inin00GroupD_DEFAULT_RTE_CALPRM_GROUP.StabyCmpNotchFil4Struct_Rec.FilGainA1" 0 DISPLAY_IDENTIFIER CalRegn01Inin00GroupD.CalibrationPorts.StabyCmpNotchFil4Struct.Rec.FilGainA1 /end CHARACTERISTIC
/begin CHARACTERISTIC CalRegn01Inin00GroupD.StabyCmpNotchFil4Struct.Rec.FilGainA2 "MICROSAR RTE" VALUE 0x0 RTE_RL_FLOAT32_IEEE 0 NO_COMPU_METHOD -3.402823466e+38 3.402823466e+38 SYMBOL_LINK "Rte_CalprmRom_CalRegn01Inin00GroupD_DEFAULT_RTE_CALPRM_GROUP.StabyCmpNotchFil4Struct_Rec.FilGainA2" 0 DISPLAY_IDENTIFIER CalRegn01Inin00GroupD.CalibrationPorts.StabyCmpNotchFil4Struct.Rec.FilGainA2 /end CHARACTERISTIC
/begin CHARACTERISTIC CalRegn01Inin00GroupD.StabyCmpNotchFil4Struct.Rec.FilGainB0 "MICROSAR RTE" VALUE 0x0 RTE_RL_FLOAT32_IEEE 0 NO_COMPU_METHOD -3.402823466e+38 3.402823466e+38 SYMBOL_LINK "Rte_CalprmRom_CalRegn01Inin00GroupD_DEFAULT_RTE_CALPRM_GROUP.StabyCmpNotchFil4Struct_Rec.FilGainB0" 0 DISPLAY_IDENTIFIER CalRegn01Inin00GroupD.CalibrationPorts.StabyCmpNotchFil4Struct.Rec.FilGainB0 /end CHARACTERISTIC
/begin CHARACTERISTIC CalRegn01Inin00GroupD.StabyCmpNotchFil4Struct.Rec.FilGainB1 "MICROSAR RTE" VALUE 0x0 RTE_RL_FLOAT32_IEEE 0 NO_COMPU_METHOD -3.402823466e+38 3.402823466e+38 SYMBOL_LINK "Rte_CalprmRom_CalRegn01Inin00GroupD_DEFAULT_RTE_CALPRM_GROUP.StabyCmpNotchFil4Struct_Rec.FilGainB1" 0 DISPLAY_IDENTIFIER CalRegn01Inin00GroupD.CalibrationPorts.StabyCmpNotchFil4Struct.Rec.FilGainB1 /end CHARACTERISTIC
/begin CHARACTERISTIC CalRegn01Inin00GroupD.StabyCmpNotchFil4Struct.Rec.FilGainB2 "MICROSAR RTE" VALUE 0x0 RTE_RL_FLOAT32_IEEE 0 NO_COMPU_METHOD -3.402823466e+38 3.402823466e+38 SYMBOL_LINK "Rte_CalprmRom_CalRegn01Inin00GroupD_DEFAULT_RTE_CALPRM_GROUP.StabyCmpNotchFil4Struct_Rec.FilGainB2" 0 DISPLAY_IDENTIFIER CalRegn01Inin00GroupD.CalibrationPorts.StabyCmpNotchFil4Struct.Rec.FilGainB2 /end CHARACTERISTIC
/begin CHARACTERISTIC CalRegn01Inin00GroupD.StabyCmpNotchFilBilnrBlndVehSpd.Ary1D "MICROSAR RTE" VAL_BLK 0x0 RTE_RL_UWORD 0 NO_COMPU_METHOD 0 65535 MATRIX_DIM 6 1 1 SYMBOL_LINK "Rte_CalprmRom_CalRegn01Inin00GroupD_DEFAULT_RTE_CALPRM_GROUP.StabyCmpNotchFilBilnrBlndVehSpd_Ary1D" 0 DISPLAY_IDENTIFIER CalRegn01Inin00GroupD.CalibrationPorts.StabyCmpNotchFilBilnrBlndVehSpd.Ary1D /end CHARACTERISTIC
/begin CHARACTERISTIC CalRegn01Inin00GroupD.StabyCmpNotchFilBlnd02Y.Ary2D "MICROSAR RTE" VAL_BLK 0x0 RTE_RL_UWORD 0 NO_COMPU_METHOD 0 65535 MATRIX_DIM 5 6 1 SYMBOL_LINK "Rte_CalprmRom_CalRegn01Inin00GroupD_DEFAULT_RTE_CALPRM_GROUP.StabyCmpNotchFilBlnd02Y_Ary2D" 0 DISPLAY_IDENTIFIER CalRegn01Inin00GroupD.CalibrationPorts.StabyCmpNotchFilBlnd02Y.Ary2D /end CHARACTERISTIC
/begin CHARACTERISTIC CalRegn01Inin00GroupD.StabyCmpNotchFilBlnd04Y.Ary2D "MICROSAR RTE" VAL_BLK 0x0 RTE_RL_UWORD 0 NO_COMPU_METHOD 0 65535 MATRIX_DIM 5 6 1 SYMBOL_LINK "Rte_CalprmRom_CalRegn01Inin00GroupD_DEFAULT_RTE_CALPRM_GROUP.StabyCmpNotchFilBlnd04Y_Ary2D" 0 DISPLAY_IDENTIFIER CalRegn01Inin00GroupD.CalibrationPorts.StabyCmpNotchFilBlnd04Y.Ary2D /end CHARACTERISTIC
/begin CHARACTERISTIC CalRegn01Inin00GroupD.StabyCmpNotchFilBlnd12TqX.Ary2D "MICROSAR RTE" VAL_BLK 0x0 RTE_RL_UWORD 0 NO_COMPU_METHOD 0 65535 MATRIX_DIM 5 6 1 SYMBOL_LINK "Rte_CalprmRom_CalRegn01Inin00GroupD_DEFAULT_RTE_CALPRM_GROUP.StabyCmpNotchFilBlnd12TqX_Ary2D" 0 DISPLAY_IDENTIFIER CalRegn01Inin00GroupD.CalibrationPorts.StabyCmpNotchFilBlnd12TqX.Ary2D /end CHARACTERISTIC
/begin CHARACTERISTIC CalRegn01Inin00GroupD.StabyCmpNotchFilBlnd12Y.Ary2D "MICROSAR RTE" VAL_BLK 0x0 RTE_RL_UWORD 0 NO_COMPU_METHOD 0 65535 MATRIX_DIM 5 6 1 SYMBOL_LINK "Rte_CalprmRom_CalRegn01Inin00GroupD_DEFAULT_RTE_CALPRM_GROUP.StabyCmpNotchFilBlnd12Y_Ary2D" 0 DISPLAY_IDENTIFIER CalRegn01Inin00GroupD.CalibrationPorts.StabyCmpNotchFilBlnd12Y.Ary2D /end CHARACTERISTIC
/begin CHARACTERISTIC CalRegn01Inin00GroupD.StabyCmpNotchFilBlnd34TqX.Ary2D "MICROSAR RTE" VAL_BLK 0x0 RTE_RL_UWORD 0 NO_COMPU_METHOD 0 65535 MATRIX_DIM 5 6 1 SYMBOL_LINK "Rte_CalprmRom_CalRegn01Inin00GroupD_DEFAULT_RTE_CALPRM_GROUP.StabyCmpNotchFilBlnd34TqX_Ary2D" 0 DISPLAY_IDENTIFIER CalRegn01Inin00GroupD.CalibrationPorts.StabyCmpNotchFilBlnd34TqX.Ary2D /end CHARACTERISTIC
/begin CHARACTERISTIC CalRegn01Inin00GroupD.StabyCmpNotchFilBlnd34Y.Ary2D "MICROSAR RTE" VAL_BLK 0x0 RTE_RL_UWORD 0 NO_COMPU_METHOD 0 65535 MATRIX_DIM 5 6 1 SYMBOL_LINK "Rte_CalprmRom_CalRegn01Inin00GroupD_DEFAULT_RTE_CALPRM_GROUP.StabyCmpNotchFilBlnd34Y_Ary2D" 0 DISPLAY_IDENTIFIER CalRegn01Inin00GroupD.CalibrationPorts.StabyCmpNotchFilBlnd34Y.Ary2D /end CHARACTERISTIC
/begin CHARACTERISTIC CalRegn01Rt00.TEstimnMagAmbMplr.Ary1D "MICROSAR RTE" VAL_BLK 0x0 RTE_RL_FLOAT32_IEEE 0 NO_COMPU_METHOD -3.402823466e+38 3.402823466e+38 MATRIX_DIM 3 1 1 SYMBOL_LINK "Rte_CalprmRom_CalRegn01Rt00_DEFAULT_RTE_CALPRM_GROUP.TEstimnMagAmbMplr_Ary1D" 0 DISPLAY_IDENTIFIER CalRegn01Rt00.CalibrationPorts.TEstimnMagAmbMplr.Ary1D /end CHARACTERISTIC
/begin CHARACTERISTIC CalRegn01Rt01.TEstimnMagAmbMplr.Ary1D "MICROSAR RTE" VAL_BLK 0x0 RTE_RL_FLOAT32_IEEE 0 NO_COMPU_METHOD -3.402823466e+38 3.402823466e+38 MATRIX_DIM 3 1 1 SYMBOL_LINK "Rte_CalprmRom_CalRegn01Rt01_DEFAULT_RTE_CALPRM_GROUP.TEstimnMagAmbMplr_Ary1D" 0 DISPLAY_IDENTIFIER CalRegn01Rt01.CalibrationPorts.TEstimnMagAmbMplr.Ary1D /end CHARACTERISTIC
/begin CHARACTERISTIC CalRegn01Rt02.TEstimnMagAmbMplr.Ary1D "MICROSAR RTE" VAL_BLK 0x0 RTE_RL_FLOAT32_IEEE 0 NO_COMPU_METHOD -3.402823466e+38 3.402823466e+38 MATRIX_DIM 3 1 1 SYMBOL_LINK "Rte_CalprmRom_CalRegn01Rt02_DEFAULT_RTE_CALPRM_GROUP.TEstimnMagAmbMplr_Ary1D" 0 DISPLAY_IDENTIFIER CalRegn01Rt02.CalibrationPorts.TEstimnMagAmbMplr.Ary1D /end CHARACTERISTIC
/begin CHARACTERISTIC CalRegn01Rt03.TEstimnMagAmbMplr.Ary1D "MICROSAR RTE" VAL_BLK 0x0 RTE_RL_FLOAT32_IEEE 0 NO_COMPU_METHOD -3.402823466e+38 3.402823466e+38 MATRIX_DIM 3 1 1 SYMBOL_LINK "Rte_CalprmRom_CalRegn01Rt03_DEFAULT_RTE_CALPRM_GROUP.TEstimnMagAmbMplr_Ary1D" 0 DISPLAY_IDENTIFIER CalRegn01Rt03.CalibrationPorts.TEstimnMagAmbMplr.Ary1D /end CHARACTERISTIC
/begin CHARACTERISTIC CalRegn01Rt04.TEstimnMagAmbMplr.Ary1D "MICROSAR RTE" VAL_BLK 0x0 RTE_RL_FLOAT32_IEEE 0 NO_COMPU_METHOD -3.402823466e+38 3.402823466e+38 MATRIX_DIM 3 1 1 SYMBOL_LINK "Rte_CalprmRom_CalRegn01Rt04_DEFAULT_RTE_CALPRM_GROUP.TEstimnMagAmbMplr_Ary1D" 0 DISPLAY_IDENTIFIER CalRegn01Rt04.CalibrationPorts.TEstimnMagAmbMplr.Ary1D /end CHARACTERISTIC
/begin CHARACTERISTIC CalRegn01Rt05.TEstimnMagAmbMplr.Ary1D "MICROSAR RTE" VAL_BLK 0x0 RTE_RL_FLOAT32_IEEE 0 NO_COMPU_METHOD -3.402823466e+38 3.402823466e+38 MATRIX_DIM 3 1 1 SYMBOL_LINK "Rte_CalprmRom_CalRegn01Rt05_DEFAULT_RTE_CALPRM_GROUP.TEstimnMagAmbMplr_Ary1D" 0 DISPLAY_IDENTIFIER CalRegn01Rt05.CalibrationPorts.TEstimnMagAmbMplr.Ary1D /end CHARACTERISTIC
/begin CHARACTERISTIC CalRegn02Cmn.FordBlaBoxIfCmnVehSteerRat.Val "MICROSAR RTE" VALUE 0x0 RTE_RL_UWORD 0 NO_COMPU_METHOD 0 65535 SYMBOL_LINK "Rte_CalprmRom_CalRegn02Cmn_DEFAULT_RTE_CALPRM_GROUP.FordBlaBoxIfCmnVehSteerRat_Val" 0 DISPLAY_IDENTIFIER CalRegn02Cmn.CalibrationPorts.FordBlaBoxIfCmnVehSteerRat.Val /end CHARACTERISTIC
/begin CHARACTERISTIC CalRegn02Cmn.FordBlaBoxIfCmnVehWhlBas.Val "MICROSAR RTE" VALUE 0x0 RTE_RL_UWORD 0 NO_COMPU_METHOD 0 65535 SYMBOL_LINK "Rte_CalprmRom_CalRegn02Cmn_DEFAULT_RTE_CALPRM_GROUP.FordBlaBoxIfCmnVehWhlBas_Val" 0 DISPLAY_IDENTIFIER CalRegn02Cmn.CalibrationPorts.FordBlaBoxIfCmnVehWhlBas.Val /end CHARACTERISTIC
/begin CHARACTERISTIC CalRegn02Cmn.FordCanDtcInhbFactryModThd.Val "MICROSAR RTE" VALUE 0x0 RTE_RL_UWORD 0 NO_COMPU_METHOD 0 65535 SYMBOL_LINK "Rte_CalprmRom_CalRegn02Cmn_DEFAULT_RTE_CALPRM_GROUP.FordCanDtcInhbFactryModThd_Val" 0 DISPLAY_IDENTIFIER CalRegn02Cmn.CalibrationPorts.FordCanDtcInhbFactryModThd.Val /end CHARACTERISTIC
/begin CHARACTERISTIC CalRegn02Cmn.FordCanDtcInhbTransptModThd.Val "MICROSAR RTE" VALUE 0x0 RTE_RL_UWORD 0 NO_COMPU_METHOD 0 65535 SYMBOL_LINK "Rte_CalprmRom_CalRegn02Cmn_DEFAULT_RTE_CALPRM_GROUP.FordCanDtcInhbTransptModThd_Val" 0 DISPLAY_IDENTIFIER CalRegn02Cmn.CalibrationPorts.FordCanDtcInhbTransptModThd.Val /end CHARACTERISTIC
/begin CHARACTERISTIC CalRegn02Cmn.FordCmdArbnActvNiblCtrlDeactvn.Ary1D "MICROSAR RTE" VAL_BLK 0x0 RTE_RL_BOOLEAN 0 RTE_CM_BOOLEAN 0 255 MATRIX_DIM 13 1 1 SYMBOL_LINK "Rte_CalprmRom_CalRegn02Cmn_DEFAULT_RTE_CALPRM_GROUP.FordCmdArbnActvNiblCtrlDeactvn_Ary1D" 0 DISPLAY_IDENTIFIER CalRegn02Cmn.CalibrationPorts.FordCmdArbnActvNiblCtrlDeactvn.Ary1D /end CHARACTERISTIC
/begin CHARACTERISTIC CalRegn02Cmn.FordCmdArbnActvNiblCtrlDeniedActvnReq.Ary1D "MICROSAR RTE" VAL_BLK 0x0 RTE_RL_BOOLEAN 0 RTE_CM_BOOLEAN 0 255 MATRIX_DIM 13 1 1 SYMBOL_LINK "Rte_CalprmRom_CalRegn02Cmn_DEFAULT_RTE_CALPRM_GROUP.FordCmdArbnActvNiblCtrlDeniedActvnReq_Ary1D" 0 DISPLAY_IDENTIFIER CalRegn02Cmn.CalibrationPorts.FordCmdArbnActvNiblCtrlDeniedActvnReq.Ary1D /end CHARACTERISTIC
/begin CHARACTERISTIC CalRegn02Cmn.FordCmdArbnDrvrSteerDeniedActvnReq.Ary1D "MICROSAR RTE" VAL_BLK 0x0 RTE_RL_BOOLEAN 0 RTE_CM_BOOLEAN 0 255 MATRIX_DIM 13 1 1 SYMBOL_LINK "Rte_CalprmRom_CalRegn02Cmn_DEFAULT_RTE_CALPRM_GROUP.FordCmdArbnDrvrSteerDeniedActvnReq_Ary1D" 0 DISPLAY_IDENTIFIER CalRegn02Cmn.CalibrationPorts.FordCmdArbnDrvrSteerDeniedActvnReq.Ary1D /end CHARACTERISTIC
/begin CHARACTERISTIC CalRegn02Cmn.FordCmdArbnDrvrSteerRcmdnDeactvn.Ary1D "MICROSAR RTE" VAL_BLK 0x0 RTE_RL_BOOLEAN 0 RTE_CM_BOOLEAN 0 255 MATRIX_DIM 13 1 1 SYMBOL_LINK "Rte_CalprmRom_CalRegn02Cmn_DEFAULT_RTE_CALPRM_GROUP.FordCmdArbnDrvrSteerRcmdnDeactvn_Ary1D" 0 DISPLAY_IDENTIFIER CalRegn02Cmn.CalibrationPorts.FordCmdArbnDrvrSteerRcmdnDeactvn.Ary1D /end CHARACTERISTIC
/begin CHARACTERISTIC CalRegn02Cmn.FordCmdArbnEvasSteerAssiDeactvn.Ary1D "MICROSAR RTE" VAL_BLK 0x0 RTE_RL_BOOLEAN 0 RTE_CM_BOOLEAN 0 255 MATRIX_DIM 13 1 1 SYMBOL_LINK "Rte_CalprmRom_CalRegn02Cmn_DEFAULT_RTE_CALPRM_GROUP.FordCmdArbnEvasSteerAssiDeactvn_Ary1D" 0 DISPLAY_IDENTIFIER CalRegn02Cmn.CalibrationPorts.FordCmdArbnEvasSteerAssiDeactvn.Ary1D /end CHARACTERISTIC
/begin CHARACTERISTIC CalRegn02Cmn.FordCmdArbnEvasSteerDeniedActvnReq.Ary1D "MICROSAR RTE" VAL_BLK 0x0 RTE_RL_BOOLEAN 0 RTE_CM_BOOLEAN 0 255 MATRIX_DIM 13 1 1 SYMBOL_LINK "Rte_CalprmRom_CalRegn02Cmn_DEFAULT_RTE_CALPRM_GROUP.FordCmdArbnEvasSteerDeniedActvnReq_Ary1D" 0 DISPLAY_IDENTIFIER CalRegn02Cmn.CalibrationPorts.FordCmdArbnEvasSteerDeniedActvnReq.Ary1D /end CHARACTERISTIC
/begin CHARACTERISTIC CalRegn02Cmn.FordCmdArbnExtAgCtrlDeactvn.Ary1D "MICROSAR RTE" VAL_BLK 0x0 RTE_RL_BOOLEAN 0 RTE_CM_BOOLEAN 0 255 MATRIX_DIM 13 1 1 SYMBOL_LINK "Rte_CalprmRom_CalRegn02Cmn_DEFAULT_RTE_CALPRM_GROUP.FordCmdArbnExtAgCtrlDeactvn_Ary1D" 0 DISPLAY_IDENTIFIER CalRegn02Cmn.CalibrationPorts.FordCmdArbnExtAgCtrlDeactvn.Ary1D /end CHARACTERISTIC
/begin CHARACTERISTIC CalRegn02Cmn.FordCmdArbnExtAgDeniedActvnReq.Ary1D "MICROSAR RTE" VAL_BLK 0x0 RTE_RL_BOOLEAN 0 RTE_CM_BOOLEAN 0 255 MATRIX_DIM 13 1 1 SYMBOL_LINK "Rte_CalprmRom_CalRegn02Cmn_DEFAULT_RTE_CALPRM_GROUP.FordCmdArbnExtAgDeniedActvnReq_Ary1D" 0 DISPLAY_IDENTIFIER CalRegn02Cmn.CalibrationPorts.FordCmdArbnExtAgDeniedActvnReq.Ary1D /end CHARACTERISTIC
/begin CHARACTERISTIC CalRegn02Cmn.FordCmdArbnLaneDprtrWarnDeactvn.Ary1D "MICROSAR RTE" VAL_BLK 0x0 RTE_RL_BOOLEAN 0 RTE_CM_BOOLEAN 0 255 MATRIX_DIM 13 1 1 SYMBOL_LINK "Rte_CalprmRom_CalRegn02Cmn_DEFAULT_RTE_CALPRM_GROUP.FordCmdArbnLaneDprtrWarnDeactvn_Ary1D" 0 DISPLAY_IDENTIFIER CalRegn02Cmn.CalibrationPorts.FordCmdArbnLaneDprtrWarnDeactvn.Ary1D /end CHARACTERISTIC
/begin CHARACTERISTIC CalRegn02Cmn.FordCmdArbnLaneDprtrWarnDeniedActvnReq.Ary1D "MICROSAR RTE" VAL_BLK 0x0 RTE_RL_BOOLEAN 0 RTE_CM_BOOLEAN 0 255 MATRIX_DIM 13 1 1 SYMBOL_LINK "Rte_CalprmRom_CalRegn02Cmn_DEFAULT_RTE_CALPRM_GROUP.FordCmdArbnLaneDprtrWarnDeniedActvnReq_Ary1D" 0 DISPLAY_IDENTIFIER CalRegn02Cmn.CalibrationPorts.FordCmdArbnLaneDprtrWarnDeniedActvnReq.Ary1D /end CHARACTERISTIC
/begin CHARACTERISTIC CalRegn02Cmn.FordCmdArbnLaneKeepAssiDeactvn.Ary1D "MICROSAR RTE" VAL_BLK 0x0 RTE_RL_BOOLEAN 0 RTE_CM_BOOLEAN 0 255 MATRIX_DIM 13 1 1 SYMBOL_LINK "Rte_CalprmRom_CalRegn02Cmn_DEFAULT_RTE_CALPRM_GROUP.FordCmdArbnLaneKeepAssiDeactvn_Ary1D" 0 DISPLAY_IDENTIFIER CalRegn02Cmn.CalibrationPorts.FordCmdArbnLaneKeepAssiDeactvn.Ary1D /end CHARACTERISTIC
/begin CHARACTERISTIC CalRegn02Cmn.FordCmdArbnLaneKeepAssiDeniedActvnReq.Ary1D "MICROSAR RTE" VAL_BLK 0x0 RTE_RL_BOOLEAN 0 RTE_CM_BOOLEAN 0 255 MATRIX_DIM 13 1 1 SYMBOL_LINK "Rte_CalprmRom_CalRegn02Cmn_DEFAULT_RTE_CALPRM_GROUP.FordCmdArbnLaneKeepAssiDeniedActvnReq_Ary1D" 0 DISPLAY_IDENTIFIER CalRegn02Cmn.CalibrationPorts.FordCmdArbnLaneKeepAssiDeniedActvnReq.Ary1D /end CHARACTERISTIC
/begin CHARACTERISTIC CalRegn02Cmn.FordCmdArbnLatCtrlDeactvn.Ary1D "MICROSAR RTE" VAL_BLK 0x0 RTE_RL_BOOLEAN 0 RTE_CM_BOOLEAN 0 255 MATRIX_DIM 13 1 1 SYMBOL_LINK "Rte_CalprmRom_CalRegn02Cmn_DEFAULT_RTE_CALPRM_GROUP.FordCmdArbnLatCtrlDeactvn_Ary1D" 0 DISPLAY_IDENTIFIER CalRegn02Cmn.CalibrationPorts.FordCmdArbnLatCtrlDeactvn.Ary1D /end CHARACTERISTIC
/begin CHARACTERISTIC CalRegn02Cmn.FordCmdArbnLatCtrlDeniedActvnReq.Ary1D "MICROSAR RTE" VAL_BLK 0x0 RTE_RL_BOOLEAN 0 RTE_CM_BOOLEAN 0 255 MATRIX_DIM 13 1 1 SYMBOL_LINK "Rte_CalprmRom_CalRegn02Cmn_DEFAULT_RTE_CALPRM_GROUP.FordCmdArbnLatCtrlDeniedActvnReq_Ary1D" 0 DISPLAY_IDENTIFIER CalRegn02Cmn.CalibrationPorts.FordCmdArbnLatCtrlDeniedActvnReq.Ary1D /end CHARACTERISTIC
/begin CHARACTERISTIC CalRegn02Cmn.FordCmdArbnNonStMask.Ary1D "MICROSAR RTE" VAL_BLK 0x0 RTE_RL_BOOLEAN 0 RTE_CM_BOOLEAN 0 255 MATRIX_DIM 13 1 1 SYMBOL_LINK "Rte_CalprmRom_CalRegn02Cmn_DEFAULT_RTE_CALPRM_GROUP.FordCmdArbnNonStMask_Ary1D" 0 DISPLAY_IDENTIFIER CalRegn02Cmn.CalibrationPorts.FordCmdArbnNonStMask.Ary1D /end CHARACTERISTIC
/begin CHARACTERISTIC CalRegn02Cmn.FordCmdArbnNormAssiTqThd.Val "MICROSAR RTE" VALUE 0x0 RTE_RL_FLOAT32_IEEE 0 NO_COMPU_METHOD -3.402823466e+38 3.402823466e+38 SYMBOL_LINK "Rte_CalprmRom_CalRegn02Cmn_DEFAULT_RTE_CALPRM_GROUP.FordCmdArbnNormAssiTqThd_Val" 0 DISPLAY_IDENTIFIER CalRegn02Cmn.CalibrationPorts.FordCmdArbnNormAssiTqThd.Val /end CHARACTERISTIC
/begin CHARACTERISTIC CalRegn02Cmn.FordCmdArbnPullDriftCmpDeactvn.Ary1D "MICROSAR RTE" VAL_BLK 0x0 RTE_RL_BOOLEAN 0 RTE_CM_BOOLEAN 0 255 MATRIX_DIM 13 1 1 SYMBOL_LINK "Rte_CalprmRom_CalRegn02Cmn_DEFAULT_RTE_CALPRM_GROUP.FordCmdArbnPullDriftCmpDeactvn_Ary1D" 0 DISPLAY_IDENTIFIER CalRegn02Cmn.CalibrationPorts.FordCmdArbnPullDriftCmpDeactvn.Ary1D /end CHARACTERISTIC
/begin CHARACTERISTIC CalRegn02Cmn.FordCmdArbnPullDriftCmpDeniedActvnReq.Ary1D "MICROSAR RTE" VAL_BLK 0x0 RTE_RL_BOOLEAN 0 RTE_CM_BOOLEAN 0 255 MATRIX_DIM 13 1 1 SYMBOL_LINK "Rte_CalprmRom_CalRegn02Cmn_DEFAULT_RTE_CALPRM_GROUP.FordCmdArbnPullDriftCmpDeniedActvnReq_Ary1D" 0 DISPLAY_IDENTIFIER CalRegn02Cmn.CalibrationPorts.FordCmdArbnPullDriftCmpDeniedActvnReq.Ary1D /end CHARACTERISTIC
/begin CHARACTERISTIC CalRegn02Cmn.FordCmdArbnPullDriftCmpLrngDeactvn.Ary1D "MICROSAR RTE" VAL_BLK 0x0 RTE_RL_BOOLEAN 0 RTE_CM_BOOLEAN 0 255 MATRIX_DIM 13 1 1 SYMBOL_LINK "Rte_CalprmRom_CalRegn02Cmn_DEFAULT_RTE_CALPRM_GROUP.FordCmdArbnPullDriftCmpLrngDeactvn_Ary1D" 0 DISPLAY_IDENTIFIER CalRegn02Cmn.CalibrationPorts.FordCmdArbnPullDriftCmpLrngDeactvn.Ary1D /end CHARACTERISTIC
/begin CHARACTERISTIC CalRegn02Cmn.FordCmdArbnPullDriftCmpLrngDeniedActvnReq.Ary1D "MICROSAR RTE" VAL_BLK 0x0 RTE_RL_BOOLEAN 0 RTE_CM_BOOLEAN 0 255 MATRIX_DIM 13 1 1 SYMBOL_LINK "Rte_CalprmRom_CalRegn02Cmn_DEFAULT_RTE_CALPRM_GROUP.FordCmdArbnPullDriftCmpLrngDeniedActvnReq_Ary1D" 0 DISPLAY_IDENTIFIER CalRegn02Cmn.CalibrationPorts.FordCmdArbnPullDriftCmpLrngDeniedActvnReq.Ary1D /end CHARACTERISTIC
/begin CHARACTERISTIC CalRegn02Cmn.FordCmdArbnSpare1Deactvn.Ary1D "MICROSAR RTE" VAL_BLK 0x0 RTE_RL_BOOLEAN 0 RTE_CM_BOOLEAN 0 255 MATRIX_DIM 13 1 1 SYMBOL_LINK "Rte_CalprmRom_CalRegn02Cmn_DEFAULT_RTE_CALPRM_GROUP.FordCmdArbnSpare1Deactvn_Ary1D" 0 DISPLAY_IDENTIFIER CalRegn02Cmn.CalibrationPorts.FordCmdArbnSpare1Deactvn.Ary1D /end CHARACTERISTIC
/begin CHARACTERISTIC CalRegn02Cmn.FordCmdArbnSpare1DeniedActvnReq.Ary1D "MICROSAR RTE" VAL_BLK 0x0 RTE_RL_BOOLEAN 0 RTE_CM_BOOLEAN 0 255 MATRIX_DIM 13 1 1 SYMBOL_LINK "Rte_CalprmRom_CalRegn02Cmn_DEFAULT_RTE_CALPRM_GROUP.FordCmdArbnSpare1DeniedActvnReq_Ary1D" 0 DISPLAY_IDENTIFIER CalRegn02Cmn.CalibrationPorts.FordCmdArbnSpare1DeniedActvnReq.Ary1D /end CHARACTERISTIC
/begin CHARACTERISTIC CalRegn02Cmn.FordCmdArbnSpare2Deactvn.Ary1D "MICROSAR RTE" VAL_BLK 0x0 RTE_RL_BOOLEAN 0 RTE_CM_BOOLEAN 0 255 MATRIX_DIM 13 1 1 SYMBOL_LINK "Rte_CalprmRom_CalRegn02Cmn_DEFAULT_RTE_CALPRM_GROUP.FordCmdArbnSpare2Deactvn_Ary1D" 0 DISPLAY_IDENTIFIER CalRegn02Cmn.CalibrationPorts.FordCmdArbnSpare2Deactvn.Ary1D /end CHARACTERISTIC
/begin CHARACTERISTIC CalRegn02Cmn.FordCmdArbnSpare2DeniedActvnReq.Ary1D "MICROSAR RTE" VAL_BLK 0x0 RTE_RL_BOOLEAN 0 RTE_CM_BOOLEAN 0 255 MATRIX_DIM 13 1 1 SYMBOL_LINK "Rte_CalprmRom_CalRegn02Cmn_DEFAULT_RTE_CALPRM_GROUP.FordCmdArbnSpare2DeniedActvnReq_Ary1D" 0 DISPLAY_IDENTIFIER CalRegn02Cmn.CalibrationPorts.FordCmdArbnSpare2DeniedActvnReq.Ary1D /end CHARACTERISTIC
/begin CHARACTERISTIC CalRegn02Cmn.FordCmdArbnSpare3Deactvn.Ary1D "MICROSAR RTE" VAL_BLK 0x0 RTE_RL_BOOLEAN 0 RTE_CM_BOOLEAN 0 255 MATRIX_DIM 13 1 1 SYMBOL_LINK "Rte_CalprmRom_CalRegn02Cmn_DEFAULT_RTE_CALPRM_GROUP.FordCmdArbnSpare3Deactvn_Ary1D" 0 DISPLAY_IDENTIFIER CalRegn02Cmn.CalibrationPorts.FordCmdArbnSpare3Deactvn.Ary1D /end CHARACTERISTIC
/begin CHARACTERISTIC CalRegn02Cmn.FordCmdArbnSpare3DeniedActvnReq.Ary1D "MICROSAR RTE" VAL_BLK 0x0 RTE_RL_BOOLEAN 0 RTE_CM_BOOLEAN 0 255 MATRIX_DIM 13 1 1 SYMBOL_LINK "Rte_CalprmRom_CalRegn02Cmn_DEFAULT_RTE_CALPRM_GROUP.FordCmdArbnSpare3DeniedActvnReq_Ary1D" 0 DISPLAY_IDENTIFIER CalRegn02Cmn.CalibrationPorts.FordCmdArbnSpare3DeniedActvnReq.Ary1D /end CHARACTERISTIC
/begin CHARACTERISTIC CalRegn02Cmn.FordCmdArbnSteerDstbcDeactvn.Ary1D "MICROSAR RTE" VAL_BLK 0x0 RTE_RL_BOOLEAN 0 RTE_CM_BOOLEAN 0 255 MATRIX_DIM 13 1 1 SYMBOL_LINK "Rte_CalprmRom_CalRegn02Cmn_DEFAULT_RTE_CALPRM_GROUP.FordCmdArbnSteerDstbcDeactvn_Ary1D" 0 DISPLAY_IDENTIFIER CalRegn02Cmn.CalibrationPorts.FordCmdArbnSteerDstbcDeactvn.Ary1D /end CHARACTERISTIC
/begin CHARACTERISTIC CalRegn02Cmn.FordCmdArbnSteerDstbcDeniedActvnReq.Ary1D "MICROSAR RTE" VAL_BLK 0x0 RTE_RL_BOOLEAN 0 RTE_CM_BOOLEAN 0 255 MATRIX_DIM 13 1 1 SYMBOL_LINK "Rte_CalprmRom_CalRegn02Cmn_DEFAULT_RTE_CALPRM_GROUP.FordCmdArbnSteerDstbcDeniedActvnReq_Ary1D" 0 DISPLAY_IDENTIFIER CalRegn02Cmn.CalibrationPorts.FordCmdArbnSteerDstbcDeniedActvnReq.Ary1D /end CHARACTERISTIC
/begin CHARACTERISTIC CalRegn02Cmn.FordHwAgArbnMotVelVldFlgRcvrTiThd.Val "MICROSAR RTE" VALUE 0x0 RTE_RL_UWORD 0 NO_COMPU_METHOD 0 65535 SYMBOL_LINK "Rte_CalprmRom_CalRegn02Cmn_DEFAULT_RTE_CALPRM_GROUP.FordHwAgArbnMotVelVldFlgRcvrTiThd_Val" 0 DISPLAY_IDENTIFIER CalRegn02Cmn.CalibrationPorts.FordHwAgArbnMotVelVldFlgRcvrTiThd.Val /end CHARACTERISTIC
/begin CHARACTERISTIC CalRegn02Cmn.FordHwAgArbnNonAbsCentrNotDetdTiThd.Val "MICROSAR RTE" VALUE 0x0 RTE_RL_UWORD 0 NO_COMPU_METHOD 0 65535 SYMBOL_LINK "Rte_CalprmRom_CalRegn02Cmn_DEFAULT_RTE_CALPRM_GROUP.FordHwAgArbnNonAbsCentrNotDetdTiThd_Val" 0 DISPLAY_IDENTIFIER CalRegn02Cmn.CalibrationPorts.FordHwAgArbnNonAbsCentrNotDetdTiThd.Val /end CHARACTERISTIC
/begin CHARACTERISTIC CalRegn02Cmn.FordHwAgArbnPhyRackTrvlThd.Val "MICROSAR RTE" VALUE 0x0 RTE_RL_FLOAT32_IEEE 0 NO_COMPU_METHOD -3.402823466e+38 3.402823466e+38 SYMBOL_LINK "Rte_CalprmRom_CalRegn02Cmn_DEFAULT_RTE_CALPRM_GROUP.FordHwAgArbnPhyRackTrvlThd_Val" 0 DISPLAY_IDENTIFIER CalRegn02Cmn.CalibrationPorts.FordHwAgArbnPhyRackTrvlThd.Val /end CHARACTERISTIC
/begin CHARACTERISTIC CalRegn02Cmn.FordHwAgArbnRelPosnVldFlgRcvryTiThd.Val "MICROSAR RTE" VALUE 0x0 RTE_RL_UWORD 0 NO_COMPU_METHOD 0 65535 SYMBOL_LINK "Rte_CalprmRom_CalRegn02Cmn_DEFAULT_RTE_CALPRM_GROUP.FordHwAgArbnRelPosnVldFlgRcvryTiThd_Val" 0 DISPLAY_IDENTIFIER CalRegn02Cmn.CalibrationPorts.FordHwAgArbnRelPosnVldFlgRcvryTiThd.Val /end CHARACTERISTIC
/begin CHARACTERISTIC CalRegn02Cmn.FordHwTqCdngAppldFinalMotTqVldTiThd.Val "MICROSAR RTE" VALUE 0x0 RTE_RL_UWORD 0 NO_COMPU_METHOD 0 65535 SYMBOL_LINK "Rte_CalprmRom_CalRegn02Cmn_DEFAULT_RTE_CALPRM_GROUP.FordHwTqCdngAppldFinalMotTqVldTiThd_Val" 0 DISPLAY_IDENTIFIER CalRegn02Cmn.CalibrationPorts.FordHwTqCdngAppldFinalMotTqVldTiThd.Val /end CHARACTERISTIC
/begin CHARACTERISTIC CalRegn02Cmn.FordHwTqCdngInpTqRawVldTiThd.Val "MICROSAR RTE" VALUE 0x0 RTE_RL_UWORD 0 NO_COMPU_METHOD 0 65535 SYMBOL_LINK "Rte_CalprmRom_CalRegn02Cmn_DEFAULT_RTE_CALPRM_GROUP.FordHwTqCdngInpTqRawVldTiThd_Val" 0 DISPLAY_IDENTIFIER CalRegn02Cmn.CalibrationPorts.FordHwTqCdngInpTqRawVldTiThd.Val /end CHARACTERISTIC
/begin CHARACTERISTIC CalRegn02Cmn.FordHwTqCmdOvrlLimrCombdBwY.Ary1D "MICROSAR RTE" VAL_BLK 0x0 RTE_RL_UWORD 0 NO_COMPU_METHOD 0 65535 MATRIX_DIM 8 1 1 SYMBOL_LINK "Rte_CalprmRom_CalRegn02Cmn_DEFAULT_RTE_CALPRM_GROUP.FordHwTqCmdOvrlLimrCombdBwY_Ary1D" 0 DISPLAY_IDENTIFIER CalRegn02Cmn.CalibrationPorts.FordHwTqCmdOvrlLimrCombdBwY.Ary1D /end CHARACTERISTIC
/begin CHARACTERISTIC CalRegn02Cmn.FordHwTqCmdOvrlLimrCombdTqRateY.Ary1D "MICROSAR RTE" VAL_BLK 0x0 RTE_RL_UWORD 0 NO_COMPU_METHOD 0 65535 MATRIX_DIM 8 1 1 SYMBOL_LINK "Rte_CalprmRom_CalRegn02Cmn_DEFAULT_RTE_CALPRM_GROUP.FordHwTqCmdOvrlLimrCombdTqRateY_Ary1D" 0 DISPLAY_IDENTIFIER CalRegn02Cmn.CalibrationPorts.FordHwTqCmdOvrlLimrCombdTqRateY.Ary1D /end CHARACTERISTIC
/begin CHARACTERISTIC CalRegn02Cmn.FordHwTqCmdOvrlLimrCombdTqSatnY.Ary1D "MICROSAR RTE" VAL_BLK 0x0 RTE_RL_UWORD 0 NO_COMPU_METHOD 0 65535 MATRIX_DIM 8 1 1 SYMBOL_LINK "Rte_CalprmRom_CalRegn02Cmn_DEFAULT_RTE_CALPRM_GROUP.FordHwTqCmdOvrlLimrCombdTqSatnY_Ary1D" 0 DISPLAY_IDENTIFIER CalRegn02Cmn.CalibrationPorts.FordHwTqCmdOvrlLimrCombdTqSatnY.Ary1D /end CHARACTERISTIC
/begin CHARACTERISTIC CalRegn02Cmn.FordHwTqCmdOvrlLimrCombdVehSpdBreakPtX.Ary1D "MICROSAR RTE" VAL_BLK 0x0 RTE_RL_UWORD 0 NO_COMPU_METHOD 0 65535 MATRIX_DIM 8 1 1 SYMBOL_LINK "Rte_CalprmRom_CalRegn02Cmn_DEFAULT_RTE_CALPRM_GROUP.FordHwTqCmdOvrlLimrCombdVehSpdBreakPtX_Ary1D" 0 DISPLAY_IDENTIFIER CalRegn02Cmn.CalibrationPorts.FordHwTqCmdOvrlLimrCombdVehSpdBreakPtX.Ary1D /end CHARACTERISTIC
/begin CHARACTERISTIC CalRegn02Cmn.FordHwTqCmdOvrlLimrDftSpdRate.Val "MICROSAR RTE" VALUE 0x0 RTE_RL_FLOAT32_IEEE 0 NO_COMPU_METHOD -3.402823466e+38 3.402823466e+38 SYMBOL_LINK "Rte_CalprmRom_CalRegn02Cmn_DEFAULT_RTE_CALPRM_GROUP.FordHwTqCmdOvrlLimrDftSpdRate_Val" 0 DISPLAY_IDENTIFIER CalRegn02Cmn.CalibrationPorts.FordHwTqCmdOvrlLimrDftSpdRate.Val /end CHARACTERISTIC
/begin CHARACTERISTIC CalRegn02Cmn.FordHwTqCmdOvrlLimrDftSpdRcvrRate.Val "MICROSAR RTE" VALUE 0x0 RTE_RL_FLOAT32_IEEE 0 NO_COMPU_METHOD -3.402823466e+38 3.402823466e+38 SYMBOL_LINK "Rte_CalprmRom_CalRegn02Cmn_DEFAULT_RTE_CALPRM_GROUP.FordHwTqCmdOvrlLimrDftSpdRcvrRate_Val" 0 DISPLAY_IDENTIFIER CalRegn02Cmn.CalibrationPorts.FordHwTqCmdOvrlLimrDftSpdRcvrRate.Val /end CHARACTERISTIC
/begin CHARACTERISTIC CalRegn02Cmn.FordHwTqCmdOvrlLimrLkaBwY.Ary1D "MICROSAR RTE" VAL_BLK 0x0 RTE_RL_UWORD 0 NO_COMPU_METHOD 0 65535 MATRIX_DIM 8 1 1 SYMBOL_LINK "Rte_CalprmRom_CalRegn02Cmn_DEFAULT_RTE_CALPRM_GROUP.FordHwTqCmdOvrlLimrLkaBwY_Ary1D" 0 DISPLAY_IDENTIFIER CalRegn02Cmn.CalibrationPorts.FordHwTqCmdOvrlLimrLkaBwY.Ary1D /end CHARACTERISTIC
/begin CHARACTERISTIC CalRegn02Cmn.FordHwTqCmdOvrlLimrLkaTqRateY.Ary1D "MICROSAR RTE" VAL_BLK 0x0 RTE_RL_UWORD 0 NO_COMPU_METHOD 0 65535 MATRIX_DIM 8 1 1 SYMBOL_LINK "Rte_CalprmRom_CalRegn02Cmn_DEFAULT_RTE_CALPRM_GROUP.FordHwTqCmdOvrlLimrLkaTqRateY_Ary1D" 0 DISPLAY_IDENTIFIER CalRegn02Cmn.CalibrationPorts.FordHwTqCmdOvrlLimrLkaTqRateY.Ary1D /end CHARACTERISTIC
/begin CHARACTERISTIC CalRegn02Cmn.FordHwTqCmdOvrlLimrLkaTqSatnY.Ary1D "MICROSAR RTE" VAL_BLK 0x0 RTE_RL_UWORD 0 NO_COMPU_METHOD 0 65535 MATRIX_DIM 8 1 1 SYMBOL_LINK "Rte_CalprmRom_CalRegn02Cmn_DEFAULT_RTE_CALPRM_GROUP.FordHwTqCmdOvrlLimrLkaTqSatnY_Ary1D" 0 DISPLAY_IDENTIFIER CalRegn02Cmn.CalibrationPorts.FordHwTqCmdOvrlLimrLkaTqSatnY.Ary1D /end CHARACTERISTIC
/begin CHARACTERISTIC CalRegn02Cmn.FordHwTqCmdOvrlLimrVehSpdBreakPtX.Ary1D "MICROSAR RTE" VAL_BLK 0x0 RTE_RL_UWORD 0 NO_COMPU_METHOD 0 65535 MATRIX_DIM 8 1 1 SYMBOL_LINK "Rte_CalprmRom_CalRegn02Cmn_DEFAULT_RTE_CALPRM_GROUP.FordHwTqCmdOvrlLimrVehSpdBreakPtX_Ary1D" 0 DISPLAY_IDENTIFIER CalRegn02Cmn.CalibrationPorts.FordHwTqCmdOvrlLimrVehSpdBreakPtX.Ary1D /end CHARACTERISTIC
/begin CHARACTERISTIC CalRegn02Cmn.FordMotTqCmdOvrlLimrDftSpdRate.Val "MICROSAR RTE" VALUE 0x0 RTE_RL_FLOAT32_IEEE 0 NO_COMPU_METHOD -3.402823466e+38 3.402823466e+38 SYMBOL_LINK "Rte_CalprmRom_CalRegn02Cmn_DEFAULT_RTE_CALPRM_GROUP.FordMotTqCmdOvrlLimrDftSpdRate_Val" 0 DISPLAY_IDENTIFIER CalRegn02Cmn.CalibrationPorts.FordMotTqCmdOvrlLimrDftSpdRate.Val /end CHARACTERISTIC
/begin CHARACTERISTIC CalRegn02Cmn.FordMotTqCmdOvrlLimrDftSpdRcvrRate.Val "MICROSAR RTE" VALUE 0x0 RTE_RL_FLOAT32_IEEE 0 NO_COMPU_METHOD -3.402823466e+38 3.402823466e+38 SYMBOL_LINK "Rte_CalprmRom_CalRegn02Cmn_DEFAULT_RTE_CALPRM_GROUP.FordMotTqCmdOvrlLimrDftSpdRcvrRate_Val" 0 DISPLAY_IDENTIFIER CalRegn02Cmn.CalibrationPorts.FordMotTqCmdOvrlLimrDftSpdRcvrRate.Val /end CHARACTERISTIC
/begin CHARACTERISTIC CalRegn02Cmn.FordMotTqCmdOvrlLimrHiFrqMonrActvNiblCtrlDcTqTrendThd.Val "MICROSAR RTE" VALUE 0x0 RTE_RL_FLOAT32_IEEE 0 NO_COMPU_METHOD -3.402823466e+38 3.402823466e+38 SYMBOL_LINK "Rte_CalprmRom_CalRegn02Cmn_DEFAULT_RTE_CALPRM_GROUP.FordMotTqCmdOvrlLimrHiFrqMonrActvNiblCtrlDcTqTrendThd_Val" 0 DISPLAY_IDENTIFIER CalRegn02Cmn.CalibrationPorts.FordMotTqCmdOvrlLimrHiFrqMonrActvNiblCtrlDcTqTrendThd.Val /end CHARACTERISTIC
/begin CHARACTERISTIC CalRegn02Cmn.FordMotTqCmdOvrlLimrHiFrqMonrActvNiblCtrlLoFrqTiThd.Val "MICROSAR RTE" VALUE 0x0 RTE_RL_FLOAT32_IEEE 0 NO_COMPU_METHOD -3.402823466e+38 3.402823466e+38 SYMBOL_LINK "Rte_CalprmRom_CalRegn02Cmn_DEFAULT_RTE_CALPRM_GROUP.FordMotTqCmdOvrlLimrHiFrqMonrActvNiblCtrlLoFrqTiThd_Val" 0 DISPLAY_IDENTIFIER CalRegn02Cmn.CalibrationPorts.FordMotTqCmdOvrlLimrHiFrqMonrActvNiblCtrlLoFrqTiThd.Val /end CHARACTERISTIC
/begin CHARACTERISTIC CalRegn02Cmn.FordMotTqCmdOvrlLimrHiFrqMonrActvNiblCtrlMaxMotTq.Val "MICROSAR RTE" VALUE 0x0 RTE_RL_FLOAT32_IEEE 0 NO_COMPU_METHOD -3.402823466e+38 3.402823466e+38 SYMBOL_LINK "Rte_CalprmRom_CalRegn02Cmn_DEFAULT_RTE_CALPRM_GROUP.FordMotTqCmdOvrlLimrHiFrqMonrActvNiblCtrlMaxMotTq_Val" 0 DISPLAY_IDENTIFIER CalRegn02Cmn.CalibrationPorts.FordMotTqCmdOvrlLimrHiFrqMonrActvNiblCtrlMaxMotTq.Val /end CHARACTERISTIC
/begin CHARACTERISTIC CalRegn02Cmn.FordMotTqCmdOvrlLimrHiFrqMonrLaneDprtrWarnDcTqTrendThd.Val "MICROSAR RTE" VALUE 0x0 RTE_RL_FLOAT32_IEEE 0 NO_COMPU_METHOD -3.402823466e+38 3.402823466e+38 SYMBOL_LINK "Rte_CalprmRom_CalRegn02Cmn_DEFAULT_RTE_CALPRM_GROUP.FordMotTqCmdOvrlLimrHiFrqMonrLaneDprtrWarnDcTqTrendThd_Val" 0 DISPLAY_IDENTIFIER CalRegn02Cmn.CalibrationPorts.FordMotTqCmdOvrlLimrHiFrqMonrLaneDprtrWarnDcTqTrendThd.Val /end CHARACTERISTIC
/begin CHARACTERISTIC CalRegn02Cmn.FordMotTqCmdOvrlLimrHiFrqMonrLaneDprtrWarnLoFrqTiThd.Val "MICROSAR RTE" VALUE 0x0 RTE_RL_FLOAT32_IEEE 0 NO_COMPU_METHOD -3.402823466e+38 3.402823466e+38 SYMBOL_LINK "Rte_CalprmRom_CalRegn02Cmn_DEFAULT_RTE_CALPRM_GROUP.FordMotTqCmdOvrlLimrHiFrqMonrLaneDprtrWarnLoFrqTiThd_Val" 0 DISPLAY_IDENTIFIER CalRegn02Cmn.CalibrationPorts.FordMotTqCmdOvrlLimrHiFrqMonrLaneDprtrWarnLoFrqTiThd.Val /end CHARACTERISTIC
/begin CHARACTERISTIC CalRegn02Cmn.FordMotTqCmdOvrlLimrHiFrqMonrLaneDprtrWarnMaxMotTq.Val "MICROSAR RTE" VALUE 0x0 RTE_RL_FLOAT32_IEEE 0 NO_COMPU_METHOD -3.402823466e+38 3.402823466e+38 SYMBOL_LINK "Rte_CalprmRom_CalRegn02Cmn_DEFAULT_RTE_CALPRM_GROUP.FordMotTqCmdOvrlLimrHiFrqMonrLaneDprtrWarnMaxMotTq_Val" 0 DISPLAY_IDENTIFIER CalRegn02Cmn.CalibrationPorts.FordMotTqCmdOvrlLimrHiFrqMonrLaneDprtrWarnMaxMotTq.Val /end CHARACTERISTIC
/begin CHARACTERISTIC CalRegn02Cmn.FordMotTqCmdOvrlLimrHiFrqMonrTqTrendAlpha.Val "MICROSAR RTE" VALUE 0x0 RTE_RL_FLOAT32_IEEE 0 NO_COMPU_METHOD -3.402823466e+38 3.402823466e+38 SYMBOL_LINK "Rte_CalprmRom_CalRegn02Cmn_DEFAULT_RTE_CALPRM_GROUP.FordMotTqCmdOvrlLimrHiFrqMonrTqTrendAlpha_Val" 0 DISPLAY_IDENTIFIER CalRegn02Cmn.CalibrationPorts.FordMotTqCmdOvrlLimrHiFrqMonrTqTrendAlpha.Val /end CHARACTERISTIC
/begin CHARACTERISTIC CalRegn02Cmn.FordMotTqCmdOvrlLimrHiFrqMonrZeroBandTq.Val "MICROSAR RTE" VALUE 0x0 RTE_RL_FLOAT32_IEEE 0 NO_COMPU_METHOD -3.402823466e+38 3.402823466e+38 SYMBOL_LINK "Rte_CalprmRom_CalRegn02Cmn_DEFAULT_RTE_CALPRM_GROUP.FordMotTqCmdOvrlLimrHiFrqMonrZeroBandTq_Val" 0 DISPLAY_IDENTIFIER CalRegn02Cmn.CalibrationPorts.FordMotTqCmdOvrlLimrHiFrqMonrZeroBandTq.Val /end CHARACTERISTIC
/begin CHARACTERISTIC CalRegn02Cmn.FordMotTqCmdOvrlLimrHwVelLoPassFrq.Val "MICROSAR RTE" VALUE 0x0 RTE_RL_FLOAT32_IEEE 0 NO_COMPU_METHOD -3.402823466e+38 3.402823466e+38 SYMBOL_LINK "Rte_CalprmRom_CalRegn02Cmn_DEFAULT_RTE_CALPRM_GROUP.FordMotTqCmdOvrlLimrHwVelLoPassFrq_Val" 0 DISPLAY_IDENTIFIER CalRegn02Cmn.CalibrationPorts.FordMotTqCmdOvrlLimrHwVelLoPassFrq.Val /end CHARACTERISTIC
/begin CHARACTERISTIC CalRegn02Cmn.FordMotTqCmdOvrlLimrLatCtrlBwY.Val "MICROSAR RTE" VAL_BLK 0x0 RTE_RL_SWORD 0 NO_COMPU_METHOD -32768 32767 MATRIX_DIM 8 1 1 SYMBOL_LINK "Rte_CalprmRom_CalRegn02Cmn_DEFAULT_RTE_CALPRM_GROUP.FordMotTqCmdOvrlLimrLatCtrlBwY_Val" 0 DISPLAY_IDENTIFIER CalRegn02Cmn.CalibrationPorts.FordMotTqCmdOvrlLimrLatCtrlBwY.Val /end CHARACTERISTIC
/begin CHARACTERISTIC CalRegn02Cmn.FordMotTqCmdOvrlLimrLatCtrlTqRateY.Ary1D "MICROSAR RTE" VAL_BLK 0x0 RTE_RL_SWORD 0 NO_COMPU_METHOD -32768 32767 MATRIX_DIM 8 1 1 SYMBOL_LINK "Rte_CalprmRom_CalRegn02Cmn_DEFAULT_RTE_CALPRM_GROUP.FordMotTqCmdOvrlLimrLatCtrlTqRateY_Ary1D" 0 DISPLAY_IDENTIFIER CalRegn02Cmn.CalibrationPorts.FordMotTqCmdOvrlLimrLatCtrlTqRateY.Ary1D /end CHARACTERISTIC
/begin CHARACTERISTIC CalRegn02Cmn.FordMotTqCmdOvrlLimrLatCtrlTqSatnY.Ary1D "MICROSAR RTE" VAL_BLK 0x0 RTE_RL_SWORD 0 NO_COMPU_METHOD -32768 32767 MATRIX_DIM 8 1 1 SYMBOL_LINK "Rte_CalprmRom_CalRegn02Cmn_DEFAULT_RTE_CALPRM_GROUP.FordMotTqCmdOvrlLimrLatCtrlTqSatnY_Ary1D" 0 DISPLAY_IDENTIFIER CalRegn02Cmn.CalibrationPorts.FordMotTqCmdOvrlLimrLatCtrlTqSatnY.Ary1D /end CHARACTERISTIC
/begin CHARACTERISTIC CalRegn02Cmn.FordMotTqCmdOvrlLimrLatCtrlVehSpdBreakPtX.Ary1D "MICROSAR RTE" VAL_BLK 0x0 RTE_RL_UWORD 0 NO_COMPU_METHOD 0 65535 MATRIX_DIM 8 1 1 SYMBOL_LINK "Rte_CalprmRom_CalRegn02Cmn_DEFAULT_RTE_CALPRM_GROUP.FordMotTqCmdOvrlLimrLatCtrlVehSpdBreakPtX_Ary1D" 0 DISPLAY_IDENTIFIER CalRegn02Cmn.CalibrationPorts.FordMotTqCmdOvrlLimrLatCtrlVehSpdBreakPtX.Ary1D /end CHARACTERISTIC
/begin CHARACTERISTIC CalRegn02Cmn.FordMotTqCmdOvrlLimrPullDriftCmpTqRateY.Ary1D "MICROSAR RTE" VAL_BLK 0x0 RTE_RL_SWORD 0 NO_COMPU_METHOD -32768 32767 MATRIX_DIM 8 1 1 SYMBOL_LINK "Rte_CalprmRom_CalRegn02Cmn_DEFAULT_RTE_CALPRM_GROUP.FordMotTqCmdOvrlLimrPullDriftCmpTqRateY_Ary1D" 0 DISPLAY_IDENTIFIER CalRegn02Cmn.CalibrationPorts.FordMotTqCmdOvrlLimrPullDriftCmpTqRateY.Ary1D /end CHARACTERISTIC
/begin CHARACTERISTIC CalRegn02Cmn.FordMotTqCmdOvrlLimrPullDriftCmpTqSatnY.Ary1D "MICROSAR RTE" VAL_BLK 0x0 RTE_RL_SWORD 0 NO_COMPU_METHOD -32768 32767 MATRIX_DIM 8 1 1 SYMBOL_LINK "Rte_CalprmRom_CalRegn02Cmn_DEFAULT_RTE_CALPRM_GROUP.FordMotTqCmdOvrlLimrPullDriftCmpTqSatnY_Ary1D" 0 DISPLAY_IDENTIFIER CalRegn02Cmn.CalibrationPorts.FordMotTqCmdOvrlLimrPullDriftCmpTqSatnY.Ary1D /end CHARACTERISTIC
/begin CHARACTERISTIC CalRegn02Cmn.FordMotTqCmdOvrlLimrPullDriftCmpVehSpdBreakPtX.Ary1D "MICROSAR RTE" VAL_BLK 0x0 RTE_RL_UWORD 0 NO_COMPU_METHOD 0 65535 MATRIX_DIM 8 1 1 SYMBOL_LINK "Rte_CalprmRom_CalRegn02Cmn_DEFAULT_RTE_CALPRM_GROUP.FordMotTqCmdOvrlLimrPullDriftCmpVehSpdBreakPtX_Ary1D" 0 DISPLAY_IDENTIFIER CalRegn02Cmn.CalibrationPorts.FordMotTqCmdOvrlLimrPullDriftCmpVehSpdBreakPtX.Ary1D /end CHARACTERISTIC
/begin CHARACTERISTIC CalRegn02Cmn.FordMotTqCmdOvrlLimrSteerReactnLimrCombAmpVehSpdLimX.Ary1D "MICROSAR RTE" VAL_BLK 0x0 RTE_RL_UWORD 0 NO_COMPU_METHOD 0 65535 MATRIX_DIM 8 1 1 SYMBOL_LINK "Rte_CalprmRom_CalRegn02Cmn_DEFAULT_RTE_CALPRM_GROUP.FordMotTqCmdOvrlLimrSteerReactnLimrCombAmpVehSpdLimX_Ary1D" 0 DISPLAY_IDENTIFIER CalRegn02Cmn.CalibrationPorts.FordMotTqCmdOvrlLimrSteerReactnLimrCombAmpVehSpdLimX.Ary1D /end CHARACTERISTIC
/begin CHARACTERISTIC CalRegn02Cmn.FordMotTqCmdOvrlLimrSteerReactnLimrCombAmpVehSpdLimY.Ary1D "MICROSAR RTE" VAL_BLK 0x0 RTE_RL_UWORD 0 NO_COMPU_METHOD 0 65535 MATRIX_DIM 8 1 1 SYMBOL_LINK "Rte_CalprmRom_CalRegn02Cmn_DEFAULT_RTE_CALPRM_GROUP.FordMotTqCmdOvrlLimrSteerReactnLimrCombAmpVehSpdLimY_Ary1D" 0 DISPLAY_IDENTIFIER CalRegn02Cmn.CalibrationPorts.FordMotTqCmdOvrlLimrSteerReactnLimrCombAmpVehSpdLimY.Ary1D /end CHARACTERISTIC
/begin CHARACTERISTIC CalRegn02Cmn.FordMotTqCmdOvrlLimrSteerReactnLimrCombOvrrunRampRateHwVelErrX.Ary1D "MICROSAR RTE" VAL_BLK 0x0 RTE_RL_UWORD 0 NO_COMPU_METHOD 0 65535 MATRIX_DIM 6 1 1 SYMBOL_LINK "Rte_CalprmRom_CalRegn02Cmn_DEFAULT_RTE_CALPRM_GROUP.FordMotTqCmdOvrlLimrSteerReactnLimrCombOvrrunRampRateHwVelErrX_Ary1D" 0 DISPLAY_IDENTIFIER CalRegn02Cmn.CalibrationPorts.FordMotTqCmdOvrlLimrSteerReactnLimrCombOvrrunRampRateHwVelErrX.Ary1D /end CHARACTERISTIC
/begin CHARACTERISTIC CalRegn02Cmn.FordMotTqCmdOvrlLimrSteerReactnLimrCombOvrrunRampRateOutY.Ary1D "MICROSAR RTE" VAL_BLK 0x0 RTE_RL_UWORD 0 NO_COMPU_METHOD 0 65535 MATRIX_DIM 6 1 1 SYMBOL_LINK "Rte_CalprmRom_CalRegn02Cmn_DEFAULT_RTE_CALPRM_GROUP.FordMotTqCmdOvrlLimrSteerReactnLimrCombOvrrunRampRateOutY_Ary1D" 0 DISPLAY_IDENTIFIER CalRegn02Cmn.CalibrationPorts.FordMotTqCmdOvrlLimrSteerReactnLimrCombOvrrunRampRateOutY.Ary1D /end CHARACTERISTIC
/begin CHARACTERISTIC CalRegn02Cmn.FordMotTqCmdOvrlLimrSteerReactnLimrCombdAmpOvrrun.Val "MICROSAR RTE" VALUE 0x0 RTE_RL_FLOAT32_IEEE 0 NO_COMPU_METHOD -3.402823466e+38 3.402823466e+38 SYMBOL_LINK "Rte_CalprmRom_CalRegn02Cmn_DEFAULT_RTE_CALPRM_GROUP.FordMotTqCmdOvrlLimrSteerReactnLimrCombdAmpOvrrun_Val" 0 DISPLAY_IDENTIFIER CalRegn02Cmn.CalibrationPorts.FordMotTqCmdOvrlLimrSteerReactnLimrCombdAmpOvrrun.Val /end CHARACTERISTIC
/begin CHARACTERISTIC CalRegn02Cmn.FordMotTqCmdOvrlLimrSteerReactnLimrCombdAmpRcvry.Val "MICROSAR RTE" VALUE 0x0 RTE_RL_FLOAT32_IEEE 0 NO_COMPU_METHOD -3.402823466e+38 3.402823466e+38 SYMBOL_LINK "Rte_CalprmRom_CalRegn02Cmn_DEFAULT_RTE_CALPRM_GROUP.FordMotTqCmdOvrlLimrSteerReactnLimrCombdAmpRcvry_Val" 0 DISPLAY_IDENTIFIER CalRegn02Cmn.CalibrationPorts.FordMotTqCmdOvrlLimrSteerReactnLimrCombdAmpRcvry.Val /end CHARACTERISTIC
/begin CHARACTERISTIC CalRegn02Cmn.FordMotTqCmdOvrlLimrSteerReactnLimrCombdFixdOvrrunRampRate.Val "MICROSAR RTE" VALUE 0x0 RTE_RL_FLOAT32_IEEE 0 NO_COMPU_METHOD -3.402823466e+38 3.402823466e+38 SYMBOL_LINK "Rte_CalprmRom_CalRegn02Cmn_DEFAULT_RTE_CALPRM_GROUP.FordMotTqCmdOvrlLimrSteerReactnLimrCombdFixdOvrrunRampRate_Val" 0 DISPLAY_IDENTIFIER CalRegn02Cmn.CalibrationPorts.FordMotTqCmdOvrlLimrSteerReactnLimrCombdFixdOvrrunRampRate.Val /end CHARACTERISTIC
/begin CHARACTERISTIC CalRegn02Cmn.FordMotTqCmdOvrlLimrSteerReactnLimrCombdLimHys.Val "MICROSAR RTE" VALUE 0x0 RTE_RL_FLOAT32_IEEE 0 NO_COMPU_METHOD -3.402823466e+38 3.402823466e+38 SYMBOL_LINK "Rte_CalprmRom_CalRegn02Cmn_DEFAULT_RTE_CALPRM_GROUP.FordMotTqCmdOvrlLimrSteerReactnLimrCombdLimHys_Val" 0 DISPLAY_IDENTIFIER CalRegn02Cmn.CalibrationPorts.FordMotTqCmdOvrlLimrSteerReactnLimrCombdLimHys.Val /end CHARACTERISTIC
/begin CHARACTERISTIC CalRegn02Cmn.FordMotTqCmdOvrlLimrSteerReactnLimrCombdLimTqX.Ary2D "MICROSAR RTE" VAL_BLK 0x0 RTE_RL_SWORD 0 NO_COMPU_METHOD -32768 32767 MATRIX_DIM 9 8 1 SYMBOL_LINK "Rte_CalprmRom_CalRegn02Cmn_DEFAULT_RTE_CALPRM_GROUP.FordMotTqCmdOvrlLimrSteerReactnLimrCombdLimTqX_Ary2D" 0 DISPLAY_IDENTIFIER CalRegn02Cmn.CalibrationPorts.FordMotTqCmdOvrlLimrSteerReactnLimrCombdLimTqX.Ary2D /end CHARACTERISTIC
/begin CHARACTERISTIC CalRegn02Cmn.FordMotTqCmdOvrlLimrSteerReactnLimrCombdLimrHwVelY.Ary2D "MICROSAR RTE" VAL_BLK 0x0 RTE_RL_SWORD 0 NO_COMPU_METHOD -32768 32767 MATRIX_DIM 9 8 1 SYMBOL_LINK "Rte_CalprmRom_CalRegn02Cmn_DEFAULT_RTE_CALPRM_GROUP.FordMotTqCmdOvrlLimrSteerReactnLimrCombdLimrHwVelY_Ary2D" 0 DISPLAY_IDENTIFIER CalRegn02Cmn.CalibrationPorts.FordMotTqCmdOvrlLimrSteerReactnLimrCombdLimrHwVelY.Ary2D /end CHARACTERISTIC
/begin CHARACTERISTIC CalRegn02Cmn.FordMotTqCmdOvrlLimrSteerReactnLimrCombdLimrVehSpd.Ary1D "MICROSAR RTE" VAL_BLK 0x0 RTE_RL_UWORD 0 NO_COMPU_METHOD 0 65535 MATRIX_DIM 8 1 1 SYMBOL_LINK "Rte_CalprmRom_CalRegn02Cmn_DEFAULT_RTE_CALPRM_GROUP.FordMotTqCmdOvrlLimrSteerReactnLimrCombdLimrVehSpd_Ary1D" 0 DISPLAY_IDENTIFIER CalRegn02Cmn.CalibrationPorts.FordMotTqCmdOvrlLimrSteerReactnLimrCombdLimrVehSpd.Ary1D /end CHARACTERISTIC
/begin CHARACTERISTIC CalRegn02Cmn.FordMotTqCmdOvrlLimrSteerReactnLimrCombdRcvryIdealRampRate.Val "MICROSAR RTE" VALUE 0x0 RTE_RL_FLOAT32_IEEE 0 NO_COMPU_METHOD -3.402823466e+38 3.402823466e+38 SYMBOL_LINK "Rte_CalprmRom_CalRegn02Cmn_DEFAULT_RTE_CALPRM_GROUP.FordMotTqCmdOvrlLimrSteerReactnLimrCombdRcvryIdealRampRate_Val" 0 DISPLAY_IDENTIFIER CalRegn02Cmn.CalibrationPorts.FordMotTqCmdOvrlLimrSteerReactnLimrCombdRcvryIdealRampRate.Val /end CHARACTERISTIC
/begin CHARACTERISTIC CalRegn02Cmn.FordMotTqCmdOvrlLimrSteerReactnLimrCombdRcvryRampRateStg1.Val "MICROSAR RTE" VALUE 0x0 RTE_RL_FLOAT32_IEEE 0 NO_COMPU_METHOD -3.402823466e+38 3.402823466e+38 SYMBOL_LINK "Rte_CalprmRom_CalRegn02Cmn_DEFAULT_RTE_CALPRM_GROUP.FordMotTqCmdOvrlLimrSteerReactnLimrCombdRcvryRampRateStg1_Val" 0 DISPLAY_IDENTIFIER CalRegn02Cmn.CalibrationPorts.FordMotTqCmdOvrlLimrSteerReactnLimrCombdRcvryRampRateStg1.Val /end CHARACTERISTIC
/begin CHARACTERISTIC CalRegn02Cmn.FordMotTqCmdOvrlLimrSteerReactnLimrCombdRcvryRampRateStg2.Val "MICROSAR RTE" VALUE 0x0 RTE_RL_FLOAT32_IEEE 0 NO_COMPU_METHOD -3.402823466e+38 3.402823466e+38 SYMBOL_LINK "Rte_CalprmRom_CalRegn02Cmn_DEFAULT_RTE_CALPRM_GROUP.FordMotTqCmdOvrlLimrSteerReactnLimrCombdRcvryRampRateStg2_Val" 0 DISPLAY_IDENTIFIER CalRegn02Cmn.CalibrationPorts.FordMotTqCmdOvrlLimrSteerReactnLimrCombdRcvryRampRateStg2.Val /end CHARACTERISTIC
/begin CHARACTERISTIC CalRegn02Cmn.FordVehSpdArbnDrvnWhl.Logl "MICROSAR RTE" VALUE 0x0 RTE_RL_BOOLEAN 0 RTE_CM_BOOLEAN 0 255 SYMBOL_LINK "Rte_CalprmRom_CalRegn02Cmn_DEFAULT_RTE_CALPRM_GROUP.FordVehSpdArbnDrvnWhl_Logl" 0 DISPLAY_IDENTIFIER CalRegn02Cmn.CalibrationPorts.FordVehSpdArbnDrvnWhl.Logl /end CHARACTERISTIC
/begin CHARACTERISTIC CalRegn02Cmn.FordVehSpdArbnTireCircumMax.Val "MICROSAR RTE" VALUE 0x0 RTE_RL_UWORD 0 NO_COMPU_METHOD 0 65535 SYMBOL_LINK "Rte_CalprmRom_CalRegn02Cmn_DEFAULT_RTE_CALPRM_GROUP.FordVehSpdArbnTireCircumMax_Val" 0 DISPLAY_IDENTIFIER CalRegn02Cmn.CalibrationPorts.FordVehSpdArbnTireCircumMax.Val /end CHARACTERISTIC
/begin CHARACTERISTIC CalRegn02Cmn.FordVehSpdArbnTireCircumMin.Val "MICROSAR RTE" VALUE 0x0 RTE_RL_UWORD 0 NO_COMPU_METHOD 0 65535 SYMBOL_LINK "Rte_CalprmRom_CalRegn02Cmn_DEFAULT_RTE_CALPRM_GROUP.FordVehSpdArbnTireCircumMin_Val" 0 DISPLAY_IDENTIFIER CalRegn02Cmn.CalibrationPorts.FordVehSpdArbnTireCircumMin.Val /end CHARACTERISTIC
/begin CHARACTERISTIC CalRegn02Cmn.FordVltgIfActvParkAssiAsscTqMin.Val "MICROSAR RTE" VALUE 0x0 RTE_RL_FLOAT32_IEEE 0 NO_COMPU_METHOD -3.402823466e+38 3.402823466e+38 SYMBOL_LINK "Rte_CalprmRom_CalRegn02Cmn_DEFAULT_RTE_CALPRM_GROUP.FordVltgIfActvParkAssiAsscTqMin_Val" 0 DISPLAY_IDENTIFIER CalRegn02Cmn.CalibrationPorts.FordVltgIfActvParkAssiAsscTqMin.Val /end CHARACTERISTIC
/begin CHARACTERISTIC CalRegn02Cmn.FordVltgIfEPSBattVltgDifThd.Val "MICROSAR RTE" VALUE 0x0 RTE_RL_FLOAT32_IEEE 0 NO_COMPU_METHOD -3.402823466e+38 3.402823466e+38 SYMBOL_LINK "Rte_CalprmRom_CalRegn02Cmn_DEFAULT_RTE_CALPRM_GROUP.FordVltgIfEPSBattVltgDifThd_Val" 0 DISPLAY_IDENTIFIER CalRegn02Cmn.CalibrationPorts.FordVltgIfEPSBattVltgDifThd.Val /end CHARACTERISTIC
/begin CHARACTERISTIC CalRegn02Cmn.FordVltgIfEpsBattCurrLim.Val "MICROSAR RTE" VALUE 0x0 RTE_RL_FLOAT32_IEEE 0 NO_COMPU_METHOD -3.402823466e+38 3.402823466e+38 SYMBOL_LINK "Rte_CalprmRom_CalRegn02Cmn_DEFAULT_RTE_CALPRM_GROUP.FordVltgIfEpsBattCurrLim_Val" 0 DISPLAY_IDENTIFIER CalRegn02Cmn.CalibrationPorts.FordVltgIfEpsBattCurrLim.Val /end CHARACTERISTIC
/begin CHARACTERISTIC CalRegn02Cmn.FordVltgIfEpsCurrLim.Val "MICROSAR RTE" VALUE 0x0 RTE_RL_FLOAT32_IEEE 0 NO_COMPU_METHOD -3.402823466e+38 3.402823466e+38 SYMBOL_LINK "Rte_CalprmRom_CalRegn02Cmn_DEFAULT_RTE_CALPRM_GROUP.FordVltgIfEpsCurrLim_Val" 0 DISPLAY_IDENTIFIER CalRegn02Cmn.CalibrationPorts.FordVltgIfEpsCurrLim.Val /end CHARACTERISTIC
/begin CHARACTERISTIC CalRegn02Cmn.FordVltgIfEvasSteerAssiTqMin.Val "MICROSAR RTE" VALUE 0x0 RTE_RL_FLOAT32_IEEE 0 NO_COMPU_METHOD -3.402823466e+38 3.402823466e+38 SYMBOL_LINK "Rte_CalprmRom_CalRegn02Cmn_DEFAULT_RTE_CALPRM_GROUP.FordVltgIfEvasSteerAssiTqMin_Val" 0 DISPLAY_IDENTIFIER CalRegn02Cmn.CalibrationPorts.FordVltgIfEvasSteerAssiTqMin.Val /end CHARACTERISTIC
/begin CHARACTERISTIC CalRegn02Cmn.FordVltgIfFeatThdStsTiThd.Val "MICROSAR RTE" VALUE 0x0 RTE_RL_UWORD 0 NO_COMPU_METHOD 0 65535 SYMBOL_LINK "Rte_CalprmRom_CalRegn02Cmn_DEFAULT_RTE_CALPRM_GROUP.FordVltgIfFeatThdStsTiThd_Val" 0 DISPLAY_IDENTIFIER CalRegn02Cmn.CalibrationPorts.FordVltgIfFeatThdStsTiThd.Val /end CHARACTERISTIC
/begin CHARACTERISTIC CalRegn02Cmn.FordVltgIfHiVltgAssiRampDwnRate.Val "MICROSAR RTE" VALUE 0x0 RTE_RL_FLOAT32_IEEE 0 NO_COMPU_METHOD -3.402823466e+38 3.402823466e+38 SYMBOL_LINK "Rte_CalprmRom_CalRegn02Cmn_DEFAULT_RTE_CALPRM_GROUP.FordVltgIfHiVltgAssiRampDwnRate_Val" 0 DISPLAY_IDENTIFIER CalRegn02Cmn.CalibrationPorts.FordVltgIfHiVltgAssiRampDwnRate.Val /end CHARACTERISTIC
/begin CHARACTERISTIC CalRegn02Cmn.FordVltgIfHiVltgAssiRampUpRate.Val "MICROSAR RTE" VALUE 0x0 RTE_RL_FLOAT32_IEEE 0 NO_COMPU_METHOD -3.402823466e+38 3.402823466e+38 SYMBOL_LINK "Rte_CalprmRom_CalRegn02Cmn_DEFAULT_RTE_CALPRM_GROUP.FordVltgIfHiVltgAssiRampUpRate_Val" 0 DISPLAY_IDENTIFIER CalRegn02Cmn.CalibrationPorts.FordVltgIfHiVltgAssiRampUpRate.Val /end CHARACTERISTIC
/begin CHARACTERISTIC CalRegn02Cmn.FordVltgIfHiVltgInhbTiMax.Val "MICROSAR RTE" VALUE 0x0 RTE_RL_UWORD 0 NO_COMPU_METHOD 0 65535 SYMBOL_LINK "Rte_CalprmRom_CalRegn02Cmn_DEFAULT_RTE_CALPRM_GROUP.FordVltgIfHiVltgInhbTiMax_Val" 0 DISPLAY_IDENTIFIER CalRegn02Cmn.CalibrationPorts.FordVltgIfHiVltgInhbTiMax.Val /end CHARACTERISTIC
/begin CHARACTERISTIC CalRegn02Cmn.FordVltgIfHiVltgNoAssiRampDwnRate.Val "MICROSAR RTE" VALUE 0x0 RTE_RL_FLOAT32_IEEE 0 NO_COMPU_METHOD -3.402823466e+38 3.402823466e+38 SYMBOL_LINK "Rte_CalprmRom_CalRegn02Cmn_DEFAULT_RTE_CALPRM_GROUP.FordVltgIfHiVltgNoAssiRampDwnRate_Val" 0 DISPLAY_IDENTIFIER CalRegn02Cmn.CalibrationPorts.FordVltgIfHiVltgNoAssiRampDwnRate.Val /end CHARACTERISTIC
/begin CHARACTERISTIC CalRegn02Cmn.FordVltgIfHiVltgNoAssiRcvrTiMax.Val "MICROSAR RTE" VALUE 0x0 RTE_RL_ULONG 0 NO_COMPU_METHOD 0 4294967295 SYMBOL_LINK "Rte_CalprmRom_CalRegn02Cmn_DEFAULT_RTE_CALPRM_GROUP.FordVltgIfHiVltgNoAssiRcvrTiMax_Val" 0 DISPLAY_IDENTIFIER CalRegn02Cmn.CalibrationPorts.FordVltgIfHiVltgNoAssiRcvrTiMax.Val /end CHARACTERISTIC
/begin CHARACTERISTIC CalRegn02Cmn.FordVltgIfHiVltgRcvrTiMax.Val "MICROSAR RTE" VALUE 0x0 RTE_RL_ULONG 0 NO_COMPU_METHOD 0 4294967295 SYMBOL_LINK "Rte_CalprmRom_CalRegn02Cmn_DEFAULT_RTE_CALPRM_GROUP.FordVltgIfHiVltgRcvrTiMax_Val" 0 DISPLAY_IDENTIFIER CalRegn02Cmn.CalibrationPorts.FordVltgIfHiVltgRcvrTiMax.Val /end CHARACTERISTIC
/begin CHARACTERISTIC CalRegn02Cmn.FordVltgIfHiVltgThdHi.Val "MICROSAR RTE" VALUE 0x0 RTE_RL_FLOAT32_IEEE 0 NO_COMPU_METHOD -3.402823466e+38 3.402823466e+38 SYMBOL_LINK "Rte_CalprmRom_CalRegn02Cmn_DEFAULT_RTE_CALPRM_GROUP.FordVltgIfHiVltgThdHi_Val" 0 DISPLAY_IDENTIFIER CalRegn02Cmn.CalibrationPorts.FordVltgIfHiVltgThdHi.Val /end CHARACTERISTIC
/begin CHARACTERISTIC CalRegn02Cmn.FordVltgIfHiVltgThdLo.Val "MICROSAR RTE" VALUE 0x0 RTE_RL_FLOAT32_IEEE 0 NO_COMPU_METHOD -3.402823466e+38 3.402823466e+38 SYMBOL_LINK "Rte_CalprmRom_CalRegn02Cmn_DEFAULT_RTE_CALPRM_GROUP.FordVltgIfHiVltgThdLo_Val" 0 DISPLAY_IDENTIFIER CalRegn02Cmn.CalibrationPorts.FordVltgIfHiVltgThdLo.Val /end CHARACTERISTIC
/begin CHARACTERISTIC CalRegn02Cmn.FordVltgIfInhbBattVltgDiagcTiThd.Val "MICROSAR RTE" VALUE 0x0 RTE_RL_UWORD 0 NO_COMPU_METHOD 0 65535 SYMBOL_LINK "Rte_CalprmRom_CalRegn02Cmn_DEFAULT_RTE_CALPRM_GROUP.FordVltgIfInhbBattVltgDiagcTiThd_Val" 0 DISPLAY_IDENTIFIER CalRegn02Cmn.CalibrationPorts.FordVltgIfInhbBattVltgDiagcTiThd.Val /end CHARACTERISTIC
/begin CHARACTERISTIC CalRegn02Cmn.FordVltgIfLaneCentrAssiTqMin.Val "MICROSAR RTE" VALUE 0x0 RTE_RL_FLOAT32_IEEE 0 NO_COMPU_METHOD -3.402823466e+38 3.402823466e+38 SYMBOL_LINK "Rte_CalprmRom_CalRegn02Cmn_DEFAULT_RTE_CALPRM_GROUP.FordVltgIfLaneCentrAssiTqMin_Val" 0 DISPLAY_IDENTIFIER CalRegn02Cmn.CalibrationPorts.FordVltgIfLaneCentrAssiTqMin.Val /end CHARACTERISTIC
/begin CHARACTERISTIC CalRegn02Cmn.FordVltgIfLaneDprtrWarnAsscTqMin.Val "MICROSAR RTE" VALUE 0x0 RTE_RL_FLOAT32_IEEE 0 NO_COMPU_METHOD -3.402823466e+38 3.402823466e+38 SYMBOL_LINK "Rte_CalprmRom_CalRegn02Cmn_DEFAULT_RTE_CALPRM_GROUP.FordVltgIfLaneDprtrWarnAsscTqMin_Val" 0 DISPLAY_IDENTIFIER CalRegn02Cmn.CalibrationPorts.FordVltgIfLaneDprtrWarnAsscTqMin.Val /end CHARACTERISTIC
/begin CHARACTERISTIC CalRegn02Cmn.FordVltgIfLkaAsscTqMin.Val "MICROSAR RTE" VALUE 0x0 RTE_RL_FLOAT32_IEEE 0 NO_COMPU_METHOD -3.402823466e+38 3.402823466e+38 SYMBOL_LINK "Rte_CalprmRom_CalRegn02Cmn_DEFAULT_RTE_CALPRM_GROUP.FordVltgIfLkaAsscTqMin_Val" 0 DISPLAY_IDENTIFIER CalRegn02Cmn.CalibrationPorts.FordVltgIfLkaAsscTqMin.Val /end CHARACTERISTIC
/begin CHARACTERISTIC CalRegn02Cmn.FordVltgIfLoVltgAssiRampDwnRate.Val "MICROSAR RTE" VALUE 0x0 RTE_RL_FLOAT32_IEEE 0 NO_COMPU_METHOD -3.402823466e+38 3.402823466e+38 SYMBOL_LINK "Rte_CalprmRom_CalRegn02Cmn_DEFAULT_RTE_CALPRM_GROUP.FordVltgIfLoVltgAssiRampDwnRate_Val" 0 DISPLAY_IDENTIFIER CalRegn02Cmn.CalibrationPorts.FordVltgIfLoVltgAssiRampDwnRate.Val /end CHARACTERISTIC
/begin CHARACTERISTIC CalRegn02Cmn.FordVltgIfLoVltgAssiRampUpRate.Val "MICROSAR RTE" VALUE 0x0 RTE_RL_FLOAT32_IEEE 0 NO_COMPU_METHOD -3.402823466e+38 3.402823466e+38 SYMBOL_LINK "Rte_CalprmRom_CalRegn02Cmn_DEFAULT_RTE_CALPRM_GROUP.FordVltgIfLoVltgAssiRampUpRate_Val" 0 DISPLAY_IDENTIFIER CalRegn02Cmn.CalibrationPorts.FordVltgIfLoVltgAssiRampUpRate.Val /end CHARACTERISTIC
/begin CHARACTERISTIC CalRegn02Cmn.FordVltgIfLoVltgAssiScar.Val "MICROSAR RTE" VALUE 0x0 RTE_RL_FLOAT32_IEEE 0 NO_COMPU_METHOD -3.402823466e+38 3.402823466e+38 SYMBOL_LINK "Rte_CalprmRom_CalRegn02Cmn_DEFAULT_RTE_CALPRM_GROUP.FordVltgIfLoVltgAssiScar_Val" 0 DISPLAY_IDENTIFIER CalRegn02Cmn.CalibrationPorts.FordVltgIfLoVltgAssiScar.Val /end CHARACTERISTIC
/begin CHARACTERISTIC CalRegn02Cmn.FordVltgIfLoVltgInhbTiMax.Val "MICROSAR RTE" VALUE 0x0 RTE_RL_ULONG 0 NO_COMPU_METHOD 0 4294967295 SYMBOL_LINK "Rte_CalprmRom_CalRegn02Cmn_DEFAULT_RTE_CALPRM_GROUP.FordVltgIfLoVltgInhbTiMax_Val" 0 DISPLAY_IDENTIFIER CalRegn02Cmn.CalibrationPorts.FordVltgIfLoVltgInhbTiMax.Val /end CHARACTERISTIC
/begin CHARACTERISTIC CalRegn02Cmn.FordVltgIfLoVltgNoAssiRampDwnRate.Val "MICROSAR RTE" VALUE 0x0 RTE_RL_FLOAT32_IEEE 0 NO_COMPU_METHOD -3.402823466e+38 3.402823466e+38 SYMBOL_LINK "Rte_CalprmRom_CalRegn02Cmn_DEFAULT_RTE_CALPRM_GROUP.FordVltgIfLoVltgNoAssiRampDwnRate_Val" 0 DISPLAY_IDENTIFIER CalRegn02Cmn.CalibrationPorts.FordVltgIfLoVltgNoAssiRampDwnRate.Val /end CHARACTERISTIC
/begin CHARACTERISTIC CalRegn02Cmn.FordVltgIfLoVltgNoAssiRcvrTiMax.Val "MICROSAR RTE" VALUE 0x0 RTE_RL_UWORD 0 NO_COMPU_METHOD 0 65535 SYMBOL_LINK "Rte_CalprmRom_CalRegn02Cmn_DEFAULT_RTE_CALPRM_GROUP.FordVltgIfLoVltgNoAssiRcvrTiMax_Val" 0 DISPLAY_IDENTIFIER CalRegn02Cmn.CalibrationPorts.FordVltgIfLoVltgNoAssiRcvrTiMax.Val /end CHARACTERISTIC
/begin CHARACTERISTIC CalRegn02Cmn.FordVltgIfLoVltgRcvrTiMax.Val "MICROSAR RTE" VALUE 0x0 RTE_RL_ULONG 0 NO_COMPU_METHOD 0 4294967295 SYMBOL_LINK "Rte_CalprmRom_CalRegn02Cmn_DEFAULT_RTE_CALPRM_GROUP.FordVltgIfLoVltgRcvrTiMax_Val" 0 DISPLAY_IDENTIFIER CalRegn02Cmn.CalibrationPorts.FordVltgIfLoVltgRcvrTiMax.Val /end CHARACTERISTIC
/begin CHARACTERISTIC CalRegn02Cmn.FordVltgIfLoVltgThdHi.Val "MICROSAR RTE" VALUE 0x0 RTE_RL_FLOAT32_IEEE 0 NO_COMPU_METHOD -3.402823466e+38 3.402823466e+38 SYMBOL_LINK "Rte_CalprmRom_CalRegn02Cmn_DEFAULT_RTE_CALPRM_GROUP.FordVltgIfLoVltgThdHi_Val" 0 DISPLAY_IDENTIFIER CalRegn02Cmn.CalibrationPorts.FordVltgIfLoVltgThdHi.Val /end CHARACTERISTIC
/begin CHARACTERISTIC CalRegn02Cmn.FordVltgIfLoVltgThdLo.Val "MICROSAR RTE" VALUE 0x0 RTE_RL_FLOAT32_IEEE 0 NO_COMPU_METHOD -3.402823466e+38 3.402823466e+38 SYMBOL_LINK "Rte_CalprmRom_CalRegn02Cmn_DEFAULT_RTE_CALPRM_GROUP.FordVltgIfLoVltgThdLo_Val" 0 DISPLAY_IDENTIFIER CalRegn02Cmn.CalibrationPorts.FordVltgIfLoVltgThdLo.Val /end CHARACTERISTIC
/begin CHARACTERISTIC CalRegn02Cmn.FordVltgIfLoVltgThdMid.Val "MICROSAR RTE" VALUE 0x0 RTE_RL_FLOAT32_IEEE 0 NO_COMPU_METHOD -3.402823466e+38 3.402823466e+38 SYMBOL_LINK "Rte_CalprmRom_CalRegn02Cmn_DEFAULT_RTE_CALPRM_GROUP.FordVltgIfLoVltgThdMid_Val" 0 DISPLAY_IDENTIFIER CalRegn02Cmn.CalibrationPorts.FordVltgIfLoVltgThdMid.Val /end CHARACTERISTIC
/begin CHARACTERISTIC CalRegn02Cmn.FordVltgIfLoVltgThdMidToLoTiMax.Val "MICROSAR RTE" VALUE 0x0 RTE_RL_ULONG 0 NO_COMPU_METHOD 0 4294967295 SYMBOL_LINK "Rte_CalprmRom_CalRegn02Cmn_DEFAULT_RTE_CALPRM_GROUP.FordVltgIfLoVltgThdMidToLoTiMax_Val" 0 DISPLAY_IDENTIFIER CalRegn02Cmn.CalibrationPorts.FordVltgIfLoVltgThdMidToLoTiMax.Val /end CHARACTERISTIC
/begin CHARACTERISTIC CalRegn02Cmn.FordVltgIfLoVltgTqScaDwnRate.Val "MICROSAR RTE" VALUE 0x0 RTE_RL_FLOAT32_IEEE 0 NO_COMPU_METHOD -3.402823466e+38 3.402823466e+38 SYMBOL_LINK "Rte_CalprmRom_CalRegn02Cmn_DEFAULT_RTE_CALPRM_GROUP.FordVltgIfLoVltgTqScaDwnRate_Val" 0 DISPLAY_IDENTIFIER CalRegn02Cmn.CalibrationPorts.FordVltgIfLoVltgTqScaDwnRate.Val /end CHARACTERISTIC
/begin CHARACTERISTIC CalRegn02Cmn.FordVltgIfLoVltgTqScaUpRate.Val "MICROSAR RTE" VALUE 0x0 RTE_RL_FLOAT32_IEEE 0 NO_COMPU_METHOD -3.402823466e+38 3.402823466e+38 SYMBOL_LINK "Rte_CalprmRom_CalRegn02Cmn_DEFAULT_RTE_CALPRM_GROUP.FordVltgIfLoVltgTqScaUpRate_Val" 0 DISPLAY_IDENTIFIER CalRegn02Cmn.CalibrationPorts.FordVltgIfLoVltgTqScaUpRate.Val /end CHARACTERISTIC
/begin CHARACTERISTIC CalRegn02Cmn.FordVltgIfLoVltgTqScagFac.Val "MICROSAR RTE" VALUE 0x0 RTE_RL_FLOAT32_IEEE 0 NO_COMPU_METHOD -3.402823466e+38 3.402823466e+38 SYMBOL_LINK "Rte_CalprmRom_CalRegn02Cmn_DEFAULT_RTE_CALPRM_GROUP.FordVltgIfLoVltgTqScagFac_Val" 0 DISPLAY_IDENTIFIER CalRegn02Cmn.CalibrationPorts.FordVltgIfLoVltgTqScagFac.Val /end CHARACTERISTIC
/begin CHARACTERISTIC CalRegn02Cmn.FordVltgIfTrfcJamAsscTqMin.Val "MICROSAR RTE" VALUE 0x0 RTE_RL_FLOAT32_IEEE 0 NO_COMPU_METHOD -3.402823466e+38 3.402823466e+38 SYMBOL_LINK "Rte_CalprmRom_CalRegn02Cmn_DEFAULT_RTE_CALPRM_GROUP.FordVltgIfTrfcJamAsscTqMin_Val" 0 DISPLAY_IDENTIFIER CalRegn02Cmn.CalibrationPorts.FordVltgIfTrfcJamAsscTqMin.Val /end CHARACTERISTIC
/begin CHARACTERISTIC CalRegn02Cmn.FordVltgIfTrlrBackupAssiTqMin.Val "MICROSAR RTE" VALUE 0x0 RTE_RL_FLOAT32_IEEE 0 NO_COMPU_METHOD -3.402823466e+38 3.402823466e+38 SYMBOL_LINK "Rte_CalprmRom_CalRegn02Cmn_DEFAULT_RTE_CALPRM_GROUP.FordVltgIfTrlrBackupAssiTqMin_Val" 0 DISPLAY_IDENTIFIER CalRegn02Cmn.CalibrationPorts.FordVltgIfTrlrBackupAssiTqMin.Val /end CHARACTERISTIC
/begin CHARACTERISTIC CalRegn02Cmn.FordVltgIfVehBattCircR.Val "MICROSAR RTE" VALUE 0x0 RTE_RL_FLOAT32_IEEE 0 NO_COMPU_METHOD -3.402823466e+38 3.402823466e+38 SYMBOL_LINK "Rte_CalprmRom_CalRegn02Cmn_DEFAULT_RTE_CALPRM_GROUP.FordVltgIfVehBattCircR_Val" 0 DISPLAY_IDENTIFIER CalRegn02Cmn.CalibrationPorts.FordVltgIfVehBattCircR.Val /end CHARACTERISTIC
/begin CHARACTERISTIC CalRegn02Cmn.FullAssiRampUpRate.Val "MICROSAR RTE" VALUE 0x0 RTE_RL_FLOAT32_IEEE 0 NO_COMPU_METHOD -3.402823466e+38 3.402823466e+38 SYMBOL_LINK "Rte_CalprmRom_CalRegn02Cmn_DEFAULT_RTE_CALPRM_GROUP.FullAssiRampUpRate_Val" 0 DISPLAY_IDENTIFIER CalRegn02Cmn.CalibrationPorts.FullAssiRampUpRate.Val /end CHARACTERISTIC
/begin CHARACTERISTIC CalRegn02Cmn.InitLimpHomeRamp.Val "MICROSAR RTE" VALUE 0x0 RTE_RL_FLOAT32_IEEE 0 NO_COMPU_METHOD -3.402823466e+38 3.402823466e+38 SYMBOL_LINK "Rte_CalprmRom_CalRegn02Cmn_DEFAULT_RTE_CALPRM_GROUP.InitLimpHomeRamp_Val" 0 DISPLAY_IDENTIFIER CalRegn02Cmn.CalibrationPorts.InitLimpHomeRamp.Val /end CHARACTERISTIC
/begin CHARACTERISTIC CalRegn02Cmn.InitLimpHomeScar.Val "MICROSAR RTE" VALUE 0x0 RTE_RL_FLOAT32_IEEE 0 NO_COMPU_METHOD -3.402823466e+38 3.402823466e+38 SYMBOL_LINK "Rte_CalprmRom_CalRegn02Cmn_DEFAULT_RTE_CALPRM_GROUP.InitLimpHomeScar_Val" 0 DISPLAY_IDENTIFIER CalRegn02Cmn.CalibrationPorts.InitLimpHomeScar.Val /end CHARACTERISTIC
/begin CHARACTERISTIC CalRegn02Cmn.LimdAssiRamp.Val "MICROSAR RTE" VALUE 0x0 RTE_RL_FLOAT32_IEEE 0 NO_COMPU_METHOD -3.402823466e+38 3.402823466e+38 SYMBOL_LINK "Rte_CalprmRom_CalRegn02Cmn_DEFAULT_RTE_CALPRM_GROUP.LimdAssiRamp_Val" 0 DISPLAY_IDENTIFIER CalRegn02Cmn.CalibrationPorts.LimdAssiRamp.Val /end CHARACTERISTIC
/begin CHARACTERISTIC CalRegn02Cmn.LimdAssiRampUpRate.Val "MICROSAR RTE" VALUE 0x0 RTE_RL_FLOAT32_IEEE 0 NO_COMPU_METHOD -3.402823466e+38 3.402823466e+38 SYMBOL_LINK "Rte_CalprmRom_CalRegn02Cmn_DEFAULT_RTE_CALPRM_GROUP.LimdAssiRampUpRate_Val" 0 DISPLAY_IDENTIFIER CalRegn02Cmn.CalibrationPorts.LimdAssiRampUpRate.Val /end CHARACTERISTIC
/begin CHARACTERISTIC CalRegn02Cmn.LimdAssiRampUpRateFaild.Val "MICROSAR RTE" VALUE 0x0 RTE_RL_FLOAT32_IEEE 0 NO_COMPU_METHOD -3.402823466e+38 3.402823466e+38 SYMBOL_LINK "Rte_CalprmRom_CalRegn02Cmn_DEFAULT_RTE_CALPRM_GROUP.LimdAssiRampUpRateFaild_Val" 0 DISPLAY_IDENTIFIER CalRegn02Cmn.CalibrationPorts.LimdAssiRampUpRateFaild.Val /end CHARACTERISTIC
/begin CHARACTERISTIC CalRegn02Cmn.LimdAssiScar.Val "MICROSAR RTE" VALUE 0x0 RTE_RL_FLOAT32_IEEE 0 NO_COMPU_METHOD -3.402823466e+38 3.402823466e+38 SYMBOL_LINK "Rte_CalprmRom_CalRegn02Cmn_DEFAULT_RTE_CALPRM_GROUP.LimdAssiScar_Val" 0 DISPLAY_IDENTIFIER CalRegn02Cmn.CalibrationPorts.LimdAssiScar.Val /end CHARACTERISTIC
/begin CHARACTERISTIC CalRegn02Cmn.LoaMgrCurrIvtrMtgtnRate.Val "MICROSAR RTE" VALUE 0x0 RTE_RL_FLOAT32_IEEE 0 NO_COMPU_METHOD -3.402823466e+38 3.402823466e+38 SYMBOL_LINK "Rte_CalprmRom_CalRegn02Cmn_DEFAULT_RTE_CALPRM_GROUP.LoaMgrCurrIvtrMtgtnRate_Val" 0 DISPLAY_IDENTIFIER CalRegn02Cmn.CalibrationPorts.LoaMgrCurrIvtrMtgtnRate.Val /end CHARACTERISTIC
/begin CHARACTERISTIC CalRegn02Cmn.LoaMgrCurrIvtrMtgtnSca.Val "MICROSAR RTE" VALUE 0x0 RTE_RL_FLOAT32_IEEE 0 NO_COMPU_METHOD -3.402823466e+38 3.402823466e+38 SYMBOL_LINK "Rte_CalprmRom_CalRegn02Cmn_DEFAULT_RTE_CALPRM_GROUP.LoaMgrCurrIvtrMtgtnSca_Val" 0 DISPLAY_IDENTIFIER CalRegn02Cmn.CalibrationPorts.LoaMgrCurrIvtrMtgtnSca.Val /end CHARACTERISTIC
/begin CHARACTERISTIC CalRegn02Cmn.LoaMgrCurrMeasMtgtnRate.Val "MICROSAR RTE" VALUE 0x0 RTE_RL_FLOAT32_IEEE 0 NO_COMPU_METHOD -3.402823466e+38 3.402823466e+38 SYMBOL_LINK "Rte_CalprmRom_CalRegn02Cmn_DEFAULT_RTE_CALPRM_GROUP.LoaMgrCurrMeasMtgtnRate_Val" 0 DISPLAY_IDENTIFIER CalRegn02Cmn.CalibrationPorts.LoaMgrCurrMeasMtgtnRate.Val /end CHARACTERISTIC
/begin CHARACTERISTIC CalRegn02Cmn.LoaMgrCurrMeasMtgtnSca.Val "MICROSAR RTE" VALUE 0x0 RTE_RL_FLOAT32_IEEE 0 NO_COMPU_METHOD -3.402823466e+38 3.402823466e+38 SYMBOL_LINK "Rte_CalprmRom_CalRegn02Cmn_DEFAULT_RTE_CALPRM_GROUP.LoaMgrCurrMeasMtgtnSca_Val" 0 DISPLAY_IDENTIFIER CalRegn02Cmn.CalibrationPorts.LoaMgrCurrMeasMtgtnSca.Val /end CHARACTERISTIC
/begin CHARACTERISTIC CalRegn02Cmn.LoaMgrIvtrMtgtnRate.Val "MICROSAR RTE" VALUE 0x0 RTE_RL_FLOAT32_IEEE 0 NO_COMPU_METHOD -3.402823466e+38 3.402823466e+38 SYMBOL_LINK "Rte_CalprmRom_CalRegn02Cmn_DEFAULT_RTE_CALPRM_GROUP.LoaMgrIvtrMtgtnRate_Val" 0 DISPLAY_IDENTIFIER CalRegn02Cmn.CalibrationPorts.LoaMgrIvtrMtgtnRate.Val /end CHARACTERISTIC
/begin CHARACTERISTIC CalRegn02Cmn.LoaMgrIvtrMtgtnSca.Val "MICROSAR RTE" VALUE 0x0 RTE_RL_FLOAT32_IEEE 0 NO_COMPU_METHOD -3.402823466e+38 3.402823466e+38 SYMBOL_LINK "Rte_CalprmRom_CalRegn02Cmn_DEFAULT_RTE_CALPRM_GROUP.LoaMgrIvtrMtgtnSca_Val" 0 DISPLAY_IDENTIFIER CalRegn02Cmn.CalibrationPorts.LoaMgrIvtrMtgtnSca.Val /end CHARACTERISTIC
/begin CHARACTERISTIC CalRegn02Cmn.LoaMgrLimdStRate.Val "MICROSAR RTE" VALUE 0x0 RTE_RL_FLOAT32_IEEE 0 NO_COMPU_METHOD -3.402823466e+38 3.402823466e+38 SYMBOL_LINK "Rte_CalprmRom_CalRegn02Cmn_DEFAULT_RTE_CALPRM_GROUP.LoaMgrLimdStRate_Val" 0 DISPLAY_IDENTIFIER CalRegn02Cmn.CalibrationPorts.LoaMgrLimdStRate.Val /end CHARACTERISTIC
/begin CHARACTERISTIC CalRegn02Cmn.LoaMgrLimdStSca.Val "MICROSAR RTE" VALUE 0x0 RTE_RL_FLOAT32_IEEE 0 NO_COMPU_METHOD -3.402823466e+38 3.402823466e+38 SYMBOL_LINK "Rte_CalprmRom_CalRegn02Cmn_DEFAULT_RTE_CALPRM_GROUP.LoaMgrLimdStSca_Val" 0 DISPLAY_IDENTIFIER CalRegn02Cmn.CalibrationPorts.LoaMgrLimdStSca.Val /end CHARACTERISTIC
/begin CHARACTERISTIC CalRegn02Cmn.LoaMgrMotAgMtgtnRate.Val "MICROSAR RTE" VALUE 0x0 RTE_RL_FLOAT32_IEEE 0 NO_COMPU_METHOD -3.402823466e+38 3.402823466e+38 SYMBOL_LINK "Rte_CalprmRom_CalRegn02Cmn_DEFAULT_RTE_CALPRM_GROUP.LoaMgrMotAgMtgtnRate_Val" 0 DISPLAY_IDENTIFIER CalRegn02Cmn.CalibrationPorts.LoaMgrMotAgMtgtnRate.Val /end CHARACTERISTIC
/begin CHARACTERISTIC CalRegn02Cmn.LoaMgrMotAgMtgtnSca.Val "MICROSAR RTE" VALUE 0x0 RTE_RL_FLOAT32_IEEE 0 NO_COMPU_METHOD -3.402823466e+38 3.402823466e+38 SYMBOL_LINK "Rte_CalprmRom_CalRegn02Cmn_DEFAULT_RTE_CALPRM_GROUP.LoaMgrMotAgMtgtnSca_Val" 0 DISPLAY_IDENTIFIER CalRegn02Cmn.CalibrationPorts.LoaMgrMotAgMtgtnSca.Val /end CHARACTERISTIC
/begin CHARACTERISTIC CalRegn02Cmn.MotRplCoggCfgMotAgTiDly.Val "MICROSAR RTE" VALUE 0x0 RTE_RL_FLOAT32_IEEE 0 NO_COMPU_METHOD -3.402823466e+38 3.402823466e+38 SYMBOL_LINK "Rte_CalprmRom_CalRegn02Cmn_DEFAULT_RTE_CALPRM_GROUP.MotRplCoggCfgMotAgTiDly_Val" 0 DISPLAY_IDENTIFIER CalRegn02Cmn.CalibrationPorts.MotRplCoggCfgMotAgTiDly.Val /end CHARACTERISTIC
/begin CHARACTERISTIC CalRegn02Cmn.MotRplCoggCfgMotCurrDaxRplBilnrSeln.Ary1D "MICROSAR RTE" VAL_BLK 0x0 RTE_RL_UWORD 0 NO_COMPU_METHOD 0 65535 MATRIX_DIM 10 1 1 SYMBOL_LINK "Rte_CalprmRom_CalRegn02Cmn_DEFAULT_RTE_CALPRM_GROUP.MotRplCoggCfgMotCurrDaxRplBilnrSeln_Ary1D" 0 DISPLAY_IDENTIFIER CalRegn02Cmn.CalibrationPorts.MotRplCoggCfgMotCurrDaxRplBilnrSeln.Ary1D /end CHARACTERISTIC
/begin CHARACTERISTIC CalRegn02Cmn.MotRplCoggCfgMotCurrQaxRpl.Ary1D "MICROSAR RTE" VAL_BLK 0x0 RTE_RL_UWORD 0 NO_COMPU_METHOD 0 65535 MATRIX_DIM 12 1 1 SYMBOL_LINK "Rte_CalprmRom_CalRegn02Cmn_DEFAULT_RTE_CALPRM_GROUP.MotRplCoggCfgMotCurrQaxRpl_Ary1D" 0 DISPLAY_IDENTIFIER CalRegn02Cmn.CalibrationPorts.MotRplCoggCfgMotCurrQaxRpl.Ary1D /end CHARACTERISTIC
/begin CHARACTERISTIC CalRegn02Cmn.MotRplCoggCfgMotTqCmdCurrRgltrBwCmpMgnY.Ary2D "MICROSAR RTE" VAL_BLK 0x0 RTE_RL_UWORD 0 NO_COMPU_METHOD 0 65535 MATRIX_DIM 8 20 1 SYMBOL_LINK "Rte_CalprmRom_CalRegn02Cmn_DEFAULT_RTE_CALPRM_GROUP.MotRplCoggCfgMotTqCmdCurrRgltrBwCmpMgnY_Ary2D" 0 DISPLAY_IDENTIFIER CalRegn02Cmn.CalibrationPorts.MotRplCoggCfgMotTqCmdCurrRgltrBwCmpMgnY.Ary2D /end CHARACTERISTIC
/begin CHARACTERISTIC CalRegn02Cmn.MotRplCoggCfgMotTqCmdCurrRgltrBwCmpPhaY.Ary2D "MICROSAR RTE" VAL_BLK 0x0 RTE_RL_UWORD 0 NO_COMPU_METHOD 0 65535 MATRIX_DIM 8 20 1 SYMBOL_LINK "Rte_CalprmRom_CalRegn02Cmn_DEFAULT_RTE_CALPRM_GROUP.MotRplCoggCfgMotTqCmdCurrRgltrBwCmpPhaY_Ary2D" 0 DISPLAY_IDENTIFIER CalRegn02Cmn.CalibrationPorts.MotRplCoggCfgMotTqCmdCurrRgltrBwCmpPhaY.Ary2D /end CHARACTERISTIC
/begin CHARACTERISTIC CalRegn02Cmn.MotRplCoggCfgMotTqCmdCurrRgltrBwCmpX.Ary1D "MICROSAR RTE" VAL_BLK 0x0 RTE_RL_UWORD 0 NO_COMPU_METHOD 0 65535 MATRIX_DIM 8 1 1 SYMBOL_LINK "Rte_CalprmRom_CalRegn02Cmn_DEFAULT_RTE_CALPRM_GROUP.MotRplCoggCfgMotTqCmdCurrRgltrBwCmpX_Ary1D" 0 DISPLAY_IDENTIFIER CalRegn02Cmn.CalibrationPorts.MotRplCoggCfgMotTqCmdCurrRgltrBwCmpX.Ary1D /end CHARACTERISTIC
/begin CHARACTERISTIC CalRegn02Cmn.MotRplCoggCfgMotTqRplOrder1X.Ary2D "MICROSAR RTE" VAL_BLK 0x0 RTE_RL_SWORD 0 NO_COMPU_METHOD -32768 32767 MATRIX_DIM 12 10 1 SYMBOL_LINK "Rte_CalprmRom_CalRegn02Cmn_DEFAULT_RTE_CALPRM_GROUP.MotRplCoggCfgMotTqRplOrder1X_Ary2D" 0 DISPLAY_IDENTIFIER CalRegn02Cmn.CalibrationPorts.MotRplCoggCfgMotTqRplOrder1X.Ary2D /end CHARACTERISTIC
/begin CHARACTERISTIC CalRegn02Cmn.MotRplCoggCfgMotTqRplOrder1Y.Ary2D "MICROSAR RTE" VAL_BLK 0x0 RTE_RL_SWORD 0 NO_COMPU_METHOD -32768 32767 MATRIX_DIM 12 10 1 SYMBOL_LINK "Rte_CalprmRom_CalRegn02Cmn_DEFAULT_RTE_CALPRM_GROUP.MotRplCoggCfgMotTqRplOrder1Y_Ary2D" 0 DISPLAY_IDENTIFIER CalRegn02Cmn.CalibrationPorts.MotRplCoggCfgMotTqRplOrder1Y.Ary2D /end CHARACTERISTIC
/begin CHARACTERISTIC CalRegn02Cmn.MotRplCoggCfgMotTqRplOrder2X.Ary2D "MICROSAR RTE" VAL_BLK 0x0 RTE_RL_SWORD 0 NO_COMPU_METHOD -32768 32767 MATRIX_DIM 12 10 1 SYMBOL_LINK "Rte_CalprmRom_CalRegn02Cmn_DEFAULT_RTE_CALPRM_GROUP.MotRplCoggCfgMotTqRplOrder2X_Ary2D" 0 DISPLAY_IDENTIFIER CalRegn02Cmn.CalibrationPorts.MotRplCoggCfgMotTqRplOrder2X.Ary2D /end CHARACTERISTIC
/begin CHARACTERISTIC CalRegn02Cmn.MotRplCoggCfgMotTqRplOrder2Y.Ary2D "MICROSAR RTE" VAL_BLK 0x0 RTE_RL_SWORD 0 NO_COMPU_METHOD -32768 32767 MATRIX_DIM 12 10 1 SYMBOL_LINK "Rte_CalprmRom_CalRegn02Cmn_DEFAULT_RTE_CALPRM_GROUP.MotRplCoggCfgMotTqRplOrder2Y_Ary2D" 0 DISPLAY_IDENTIFIER CalRegn02Cmn.CalibrationPorts.MotRplCoggCfgMotTqRplOrder2Y.Ary2D /end CHARACTERISTIC
/begin CHARACTERISTIC CalRegn02Cmn.MotRplCoggCfgMotTqRplOrder3X.Ary2D "MICROSAR RTE" VAL_BLK 0x0 RTE_RL_SWORD 0 NO_COMPU_METHOD -32768 32767 MATRIX_DIM 12 10 1 SYMBOL_LINK "Rte_CalprmRom_CalRegn02Cmn_DEFAULT_RTE_CALPRM_GROUP.MotRplCoggCfgMotTqRplOrder3X_Ary2D" 0 DISPLAY_IDENTIFIER CalRegn02Cmn.CalibrationPorts.MotRplCoggCfgMotTqRplOrder3X.Ary2D /end CHARACTERISTIC
/begin CHARACTERISTIC CalRegn02Cmn.MotRplCoggCfgMotTqRplOrder3Y.Ary2D "MICROSAR RTE" VAL_BLK 0x0 RTE_RL_SWORD 0 NO_COMPU_METHOD -32768 32767 MATRIX_DIM 12 10 1 SYMBOL_LINK "Rte_CalprmRom_CalRegn02Cmn_DEFAULT_RTE_CALPRM_GROUP.MotRplCoggCfgMotTqRplOrder3Y_Ary2D" 0 DISPLAY_IDENTIFIER CalRegn02Cmn.CalibrationPorts.MotRplCoggCfgMotTqRplOrder3Y.Ary2D /end CHARACTERISTIC
/begin CHARACTERISTIC CalRegn02Cmn.MotRplCoggCfgMotVelBilnrSeln.Ary1D "MICROSAR RTE" VAL_BLK 0x0 RTE_RL_UWORD 0 NO_COMPU_METHOD 0 65535 MATRIX_DIM 20 1 1 SYMBOL_LINK "Rte_CalprmRom_CalRegn02Cmn_DEFAULT_RTE_CALPRM_GROUP.MotRplCoggCfgMotVelBilnrSeln_Ary1D" 0 DISPLAY_IDENTIFIER CalRegn02Cmn.CalibrationPorts.MotRplCoggCfgMotVelBilnrSeln.Ary1D /end CHARACTERISTIC
/begin CHARACTERISTIC CalRegn02Cmn.MotRplCoggCmdHrmncOrder1Elec.Val "MICROSAR RTE" VALUE 0x0 RTE_RL_UBYTE 0 NO_COMPU_METHOD 0 255 SYMBOL_LINK "Rte_CalprmRom_CalRegn02Cmn_DEFAULT_RTE_CALPRM_GROUP.MotRplCoggCmdHrmncOrder1Elec_Val" 0 DISPLAY_IDENTIFIER CalRegn02Cmn.CalibrationPorts.MotRplCoggCmdHrmncOrder1Elec.Val /end CHARACTERISTIC
/begin CHARACTERISTIC CalRegn02Cmn.MotRplCoggCmdHrmncOrder2Elec.Val "MICROSAR RTE" VALUE 0x0 RTE_RL_UBYTE 0 NO_COMPU_METHOD 0 255 SYMBOL_LINK "Rte_CalprmRom_CalRegn02Cmn_DEFAULT_RTE_CALPRM_GROUP.MotRplCoggCmdHrmncOrder2Elec_Val" 0 DISPLAY_IDENTIFIER CalRegn02Cmn.CalibrationPorts.MotRplCoggCmdHrmncOrder2Elec.Val /end CHARACTERISTIC
/begin CHARACTERISTIC CalRegn02Cmn.MotRplCoggCmdHrmncOrder3Elec.Val "MICROSAR RTE" VALUE 0x0 RTE_RL_UBYTE 0 NO_COMPU_METHOD 0 255 SYMBOL_LINK "Rte_CalprmRom_CalRegn02Cmn_DEFAULT_RTE_CALPRM_GROUP.MotRplCoggCmdHrmncOrder3Elec_Val" 0 DISPLAY_IDENTIFIER CalRegn02Cmn.CalibrationPorts.MotRplCoggCmdHrmncOrder3Elec.Val /end CHARACTERISTIC
/begin CHARACTERISTIC CalRegn02Cmn.NormLimpHomeRamp.Val "MICROSAR RTE" VALUE 0x0 RTE_RL_FLOAT32_IEEE 0 NO_COMPU_METHOD -3.402823466e+38 3.402823466e+38 SYMBOL_LINK "Rte_CalprmRom_CalRegn02Cmn_DEFAULT_RTE_CALPRM_GROUP.NormLimpHomeRamp_Val" 0 DISPLAY_IDENTIFIER CalRegn02Cmn.CalibrationPorts.NormLimpHomeRamp.Val /end CHARACTERISTIC
/begin CHARACTERISTIC CalRegn02Cmn.NormLimpHomeScar.Val "MICROSAR RTE" VALUE 0x0 RTE_RL_FLOAT32_IEEE 0 NO_COMPU_METHOD -3.402823466e+38 3.402823466e+38 SYMBOL_LINK "Rte_CalprmRom_CalRegn02Cmn_DEFAULT_RTE_CALPRM_GROUP.NormLimpHomeScar_Val" 0 DISPLAY_IDENTIFIER CalRegn02Cmn.CalibrationPorts.NormLimpHomeScar.Val /end CHARACTERISTIC
/begin CHARACTERISTIC CalRegn02Cmn.NxtrCalIdsCal1DevlpAuthor.Ary1D "MICROSAR RTE" VAL_BLK 0x0 RTE_RL_UBYTE 0 NO_COMPU_METHOD 0 255 MATRIX_DIM 6 1 1 SYMBOL_LINK "Rte_CalprmRom_CalRegn02Cmn_DEFAULT_RTE_CALPRM_GROUP.NxtrCalIdsCal1DevlpAuthor_Ary1D" 0 DISPLAY_IDENTIFIER CalRegn02Cmn.CalibrationPorts.NxtrCalIdsCal1DevlpAuthor.Ary1D /end CHARACTERISTIC
/begin CHARACTERISTIC CalRegn02Cmn.NxtrCalIdsCal1DevlpDesc.Ary1D "MICROSAR RTE" VAL_BLK 0x0 RTE_RL_UBYTE 0 NO_COMPU_METHOD 0 255 MATRIX_DIM 48 1 1 SYMBOL_LINK "Rte_CalprmRom_CalRegn02Cmn_DEFAULT_RTE_CALPRM_GROUP.NxtrCalIdsCal1DevlpDesc_Ary1D" 0 DISPLAY_IDENTIFIER CalRegn02Cmn.CalibrationPorts.NxtrCalIdsCal1DevlpDesc.Ary1D /end CHARACTERISTIC
/begin CHARACTERISTIC CalRegn02Cmn.NxtrCalIdsCal1DevlpRelNr.Val "MICROSAR RTE" VALUE 0x0 RTE_RL_ULONG 0 NO_COMPU_METHOD 0 4294967295 SYMBOL_LINK "Rte_CalprmRom_CalRegn02Cmn_DEFAULT_RTE_CALPRM_GROUP.NxtrCalIdsCal1DevlpRelNr_Val" 0 DISPLAY_IDENTIFIER CalRegn02Cmn.CalibrationPorts.NxtrCalIdsCal1DevlpRelNr.Val /end CHARACTERISTIC
/begin CHARACTERISTIC CalRegn02Cmn.NxtrCalIdsCal1DevlpRelSt.Val "MICROSAR RTE" VALUE 0x0 RTE_RL_UBYTE 0 NO_COMPU_METHOD 0 255 SYMBOL_LINK "Rte_CalprmRom_CalRegn02Cmn_DEFAULT_RTE_CALPRM_GROUP.NxtrCalIdsCal1DevlpRelSt_Val" 0 DISPLAY_IDENTIFIER CalRegn02Cmn.CalibrationPorts.NxtrCalIdsCal1DevlpRelSt.Val /end CHARACTERISTIC
/begin CHARACTERISTIC CalRegn02Cmn.NxtrCalIdsCal1DevlpTiStamp.Val "MICROSAR RTE" VALUE 0x0 RTE_RL_ULONG 0 NO_COMPU_METHOD 0 4294967295 SYMBOL_LINK "Rte_CalprmRom_CalRegn02Cmn_DEFAULT_RTE_CALPRM_GROUP.NxtrCalIdsCal1DevlpTiStamp_Val" 0 DISPLAY_IDENTIFIER CalRegn02Cmn.CalibrationPorts.NxtrCalIdsCal1DevlpTiStamp.Val /end CHARACTERISTIC
/begin CHARACTERISTIC CalRegn02Cmn.NxtrCalIdsCal1DevlpVers.Val "MICROSAR RTE" VALUE 0x0 RTE_RL_UBYTE 0 NO_COMPU_METHOD 0 255 SYMBOL_LINK "Rte_CalprmRom_CalRegn02Cmn_DEFAULT_RTE_CALPRM_GROUP.NxtrCalIdsCal1DevlpVers_Val" 0 DISPLAY_IDENTIFIER CalRegn02Cmn.CalibrationPorts.NxtrCalIdsCal1DevlpVers.Val /end CHARACTERISTIC
/begin CHARACTERISTIC CalRegn02Cmn.ShtdwnRamp.Val "MICROSAR RTE" VALUE 0x0 RTE_RL_FLOAT32_IEEE 0 NO_COMPU_METHOD -3.402823466e+38 3.402823466e+38 SYMBOL_LINK "Rte_CalprmRom_CalRegn02Cmn_DEFAULT_RTE_CALPRM_GROUP.ShtdwnRamp_Val" 0 DISPLAY_IDENTIFIER CalRegn02Cmn.CalibrationPorts.ShtdwnRamp.Val /end CHARACTERISTIC
/begin CHARACTERISTIC CalRegn02CmnGroupA.AssiThermScaX.Ary1D "MICROSAR RTE" VAL_BLK 0x0 RTE_RL_UWORD 0 NO_COMPU_METHOD 0 65535 MATRIX_DIM 2 1 1 SYMBOL_LINK "Rte_CalprmRom_CalRegn02CmnGroupA_DEFAULT_RTE_CALPRM_GROUP.AssiThermScaX_Ary1D" 0 DISPLAY_IDENTIFIER CalRegn02CmnGroupA.CalibrationPorts.AssiThermScaX.Ary1D /end CHARACTERISTIC
/begin CHARACTERISTIC CalRegn02CmnGroupA.AssiThermScaY.Ary1D "MICROSAR RTE" VAL_BLK 0x0 RTE_RL_UWORD 0 NO_COMPU_METHOD 0 65535 MATRIX_DIM 2 1 1 SYMBOL_LINK "Rte_CalprmRom_CalRegn02CmnGroupA_DEFAULT_RTE_CALPRM_GROUP.AssiThermScaY_Ary1D" 0 DISPLAY_IDENTIFIER CalRegn02CmnGroupA.CalibrationPorts.AssiThermScaY.Ary1D /end CHARACTERISTIC
/begin CHARACTERISTIC CalRegn02CmnGroupB.EotLrngHwAgOverTrvlCntThd.Val "MICROSAR RTE" VALUE 0x0 RTE_RL_UBYTE 0 NO_COMPU_METHOD 0 255 SYMBOL_LINK "Rte_CalprmRom_CalRegn02CmnGroupB_DEFAULT_RTE_CALPRM_GROUP.EotLrngHwAgOverTrvlCntThd_Val" 0 DISPLAY_IDENTIFIER CalRegn02CmnGroupB.CalibrationPorts.EotLrngHwAgOverTrvlCntThd.Val /end CHARACTERISTIC
/begin CHARACTERISTIC CalRegn02CmnGroupB.EotProtnActvRegnBypMaxThd.Val "MICROSAR RTE" VALUE 0x0 RTE_RL_FLOAT32_IEEE 0 NO_COMPU_METHOD -3.402823466e+38 3.402823466e+38 SYMBOL_LINK "Rte_CalprmRom_CalRegn02CmnGroupB_DEFAULT_RTE_CALPRM_GROUP.EotProtnActvRegnBypMaxThd_Val" 0 DISPLAY_IDENTIFIER CalRegn02CmnGroupB.CalibrationPorts.EotProtnActvRegnBypMaxThd.Val /end CHARACTERISTIC
/begin CHARACTERISTIC CalRegn02CmnGroupB.EotProtnFwlEotDampgActvBndX.Ary1D "MICROSAR RTE" VAL_BLK 0x0 RTE_RL_SWORD 0 NO_COMPU_METHOD -32768 32767 MATRIX_DIM 5 1 1 SYMBOL_LINK "Rte_CalprmRom_CalRegn02CmnGroupB_DEFAULT_RTE_CALPRM_GROUP.EotProtnFwlEotDampgActvBndX_Ary1D" 0 DISPLAY_IDENTIFIER CalRegn02CmnGroupB.CalibrationPorts.EotProtnFwlEotDampgActvBndX.Ary1D /end CHARACTERISTIC
/begin CHARACTERISTIC CalRegn02CmnGroupB.EotProtnFwlInactvLim.Val "MICROSAR RTE" VALUE 0x0 RTE_RL_FLOAT32_IEEE 0 NO_COMPU_METHOD -3.402823466e+38 3.402823466e+38 SYMBOL_LINK "Rte_CalprmRom_CalRegn02CmnGroupB_DEFAULT_RTE_CALPRM_GROUP.EotProtnFwlInactvLim_Val" 0 DISPLAY_IDENTIFIER CalRegn02CmnGroupB.CalibrationPorts.EotProtnFwlInactvLim.Val /end CHARACTERISTIC
/begin CHARACTERISTIC CalRegn02CmnGroupB.EotProtnFwlVehSpd.Ary1D "MICROSAR RTE" VAL_BLK 0x0 RTE_RL_UWORD 0 NO_COMPU_METHOD 0 65535 MATRIX_DIM 4 1 1 SYMBOL_LINK "Rte_CalprmRom_CalRegn02CmnGroupB_DEFAULT_RTE_CALPRM_GROUP.EotProtnFwlVehSpd_Ary1D" 0 DISPLAY_IDENTIFIER CalRegn02CmnGroupB.CalibrationPorts.EotProtnFwlVehSpd.Ary1D /end CHARACTERISTIC
/begin CHARACTERISTIC CalRegn02Inin00.HiLoadStallLimrMotTqCmdFetMtgtnEnaFilFrq.Val "MICROSAR RTE" VALUE 0x0 RTE_RL_FLOAT32_IEEE 0 NO_COMPU_METHOD -3.402823466e+38 3.402823466e+38 SYMBOL_LINK "Rte_CalprmRom_CalRegn02Inin00_DEFAULT_RTE_CALPRM_GROUP.HiLoadStallLimrMotTqCmdFetMtgtnEnaFilFrq_Val" 0 DISPLAY_IDENTIFIER CalRegn02Inin00.CalibrationPorts.HiLoadStallLimrMotTqCmdFetMtgtnEnaFilFrq.Val /end CHARACTERISTIC
/begin CHARACTERISTIC CalRegn02Inin00.HiLoadStallLimrMotTqCmdFilFrq.Val "MICROSAR RTE" VALUE 0x0 RTE_RL_FLOAT32_IEEE 0 NO_COMPU_METHOD -3.402823466e+38 3.402823466e+38 SYMBOL_LINK "Rte_CalprmRom_CalRegn02Inin00_DEFAULT_RTE_CALPRM_GROUP.HiLoadStallLimrMotTqCmdFilFrq_Val" 0 DISPLAY_IDENTIFIER CalRegn02Inin00.CalibrationPorts.HiLoadStallLimrMotTqCmdFilFrq.Val /end CHARACTERISTIC
/begin CHARACTERISTIC CalRegn02Inin00.HiLoadStallLimrMotVelMgnThd.Ary1D "MICROSAR RTE" VAL_BLK 0x0 RTE_RL_FLOAT32_IEEE 0 NO_COMPU_METHOD -3.402823466e+38 3.402823466e+38 MATRIX_DIM 2 1 1 SYMBOL_LINK "Rte_CalprmRom_CalRegn02Inin00_DEFAULT_RTE_CALPRM_GROUP.HiLoadStallLimrMotVelMgnThd_Ary1D" 0 DISPLAY_IDENTIFIER CalRegn02Inin00.CalibrationPorts.HiLoadStallLimrMotVelMgnThd.Ary1D /end CHARACTERISTIC
/begin CHARACTERISTIC CalRegn02Inin00.HiLoadStallLimrStallMotTqCmdFetMtgtnLimX.Ary1D "MICROSAR RTE" VAL_BLK 0x0 RTE_RL_UWORD 0 NO_COMPU_METHOD 0 65535 MATRIX_DIM 6 1 1 SYMBOL_LINK "Rte_CalprmRom_CalRegn02Inin00_DEFAULT_RTE_CALPRM_GROUP.HiLoadStallLimrStallMotTqCmdFetMtgtnLimX_Ary1D" 0 DISPLAY_IDENTIFIER CalRegn02Inin00.CalibrationPorts.HiLoadStallLimrStallMotTqCmdFetMtgtnLimX.Ary1D /end CHARACTERISTIC
/begin CHARACTERISTIC CalRegn02Inin00.HiLoadStallLimrStallMotTqCmdFetMtgtnLimY.Ary1D "MICROSAR RTE" VAL_BLK 0x0 RTE_RL_UWORD 0 NO_COMPU_METHOD 0 65535 MATRIX_DIM 6 1 1 SYMBOL_LINK "Rte_CalprmRom_CalRegn02Inin00_DEFAULT_RTE_CALPRM_GROUP.HiLoadStallLimrStallMotTqCmdFetMtgtnLimY_Ary1D" 0 DISPLAY_IDENTIFIER CalRegn02Inin00.CalibrationPorts.HiLoadStallLimrStallMotTqCmdFetMtgtnLimY.Ary1D /end CHARACTERISTIC
/begin CHARACTERISTIC CalRegn02Inin00.HiLoadStallLimrStallMotTqCmdLimX.Ary1D "MICROSAR RTE" VAL_BLK 0x0 RTE_RL_UWORD 0 NO_COMPU_METHOD 0 65535 MATRIX_DIM 6 1 1 SYMBOL_LINK "Rte_CalprmRom_CalRegn02Inin00_DEFAULT_RTE_CALPRM_GROUP.HiLoadStallLimrStallMotTqCmdLimX_Ary1D" 0 DISPLAY_IDENTIFIER CalRegn02Inin00.CalibrationPorts.HiLoadStallLimrStallMotTqCmdLimX.Ary1D /end CHARACTERISTIC
/begin CHARACTERISTIC CalRegn02Inin00.HiLoadStallLimrStallMotTqCmdLimY.Ary1D "MICROSAR RTE" VAL_BLK 0x0 RTE_RL_UWORD 0 NO_COMPU_METHOD 0 65535 MATRIX_DIM 6 1 1 SYMBOL_LINK "Rte_CalprmRom_CalRegn02Inin00_DEFAULT_RTE_CALPRM_GROUP.HiLoadStallLimrStallMotTqCmdLimY_Ary1D" 0 DISPLAY_IDENTIFIER CalRegn02Inin00.CalibrationPorts.HiLoadStallLimrStallMotTqCmdLimY.Ary1D /end CHARACTERISTIC
/begin CHARACTERISTIC CalRegn02Inin00.HiLoadStallLimrStallMotTqLimSlewRate.Ary1D "MICROSAR RTE" VAL_BLK 0x0 RTE_RL_FLOAT32_IEEE 0 NO_COMPU_METHOD -3.402823466e+38 3.402823466e+38 MATRIX_DIM 2 1 1 SYMBOL_LINK "Rte_CalprmRom_CalRegn02Inin00_DEFAULT_RTE_CALPRM_GROUP.HiLoadStallLimrStallMotTqLimSlewRate_Ary1D" 0 DISPLAY_IDENTIFIER CalRegn02Inin00.CalibrationPorts.HiLoadStallLimrStallMotTqLimSlewRate.Ary1D /end CHARACTERISTIC
/begin CHARACTERISTIC CalRegn02Inin00.HiLoadStallLimrStallThermLimSca.Val "MICROSAR RTE" VALUE 0x0 RTE_RL_FLOAT32_IEEE 0 NO_COMPU_METHOD -3.402823466e+38 3.402823466e+38 SYMBOL_LINK "Rte_CalprmRom_CalRegn02Inin00_DEFAULT_RTE_CALPRM_GROUP.HiLoadStallLimrStallThermLimSca_Val" 0 DISPLAY_IDENTIFIER CalRegn02Inin00.CalibrationPorts.HiLoadStallLimrStallThermLimSca.Val /end CHARACTERISTIC
/begin CHARACTERISTIC CalRegn02Inin00.SysGlbPrmSysKineRat.Val "MICROSAR RTE" VALUE 0x0 RTE_RL_FLOAT32_IEEE 0 NO_COMPU_METHOD -3.402823466e+38 3.402823466e+38 SYMBOL_LINK "Rte_CalprmRom_CalRegn02Inin00_DEFAULT_RTE_CALPRM_GROUP.SysGlbPrmSysKineRat_Val" 0 DISPLAY_IDENTIFIER CalRegn02Inin00.CalibrationPorts.SysGlbPrmSysKineRat.Val /end CHARACTERISTIC
/begin CHARACTERISTIC CalRegn02Inin00.VehSigCdngVehSpdSlewRate.Val "MICROSAR RTE" VALUE 0x0 RTE_RL_FLOAT32_IEEE 0 NO_COMPU_METHOD -3.402823466e+38 3.402823466e+38 SYMBOL_LINK "Rte_CalprmRom_CalRegn02Inin00_DEFAULT_RTE_CALPRM_GROUP.VehSigCdngVehSpdSlewRate_Val" 0 DISPLAY_IDENTIFIER CalRegn02Inin00.CalibrationPorts.VehSigCdngVehSpdSlewRate.Val /end CHARACTERISTIC
/begin CHARACTERISTIC CalRegn02Inin00GroupA.AssiHiFrqHpFilFrq.Val "MICROSAR RTE" VALUE 0x0 RTE_RL_FLOAT32_IEEE 0 NO_COMPU_METHOD -3.402823466e+38 3.402823466e+38 SYMBOL_LINK "Rte_CalprmRom_CalRegn02Inin00GroupA_DEFAULT_RTE_CALPRM_GROUP.AssiHiFrqHpFilFrq_Val" 0 DISPLAY_IDENTIFIER CalRegn02Inin00GroupA.CalibrationPorts.AssiHiFrqHpFilFrq.Val /end CHARACTERISTIC
/begin CHARACTERISTIC CalRegn02Inin00GroupA.DampgHydAssiLim.Ary1D "MICROSAR RTE" VAL_BLK 0x0 RTE_RL_UWORD 0 NO_COMPU_METHOD 0 65535 MATRIX_DIM 12 1 1 SYMBOL_LINK "Rte_CalprmRom_CalRegn02Inin00GroupA_DEFAULT_RTE_CALPRM_GROUP.DampgHydAssiLim_Ary1D" 0 DISPLAY_IDENTIFIER CalRegn02Inin00GroupA.CalibrationPorts.DampgHydAssiLim.Ary1D /end CHARACTERISTIC
/begin CHARACTERISTIC CalRegn02Inin00GroupA.HysCmpAssiCmdLpFilFrq.Val "MICROSAR RTE" VALUE 0x0 RTE_RL_FLOAT32_IEEE 0 NO_COMPU_METHOD -3.402823466e+38 3.402823466e+38 SYMBOL_LINK "Rte_CalprmRom_CalRegn02Inin00GroupA_DEFAULT_RTE_CALPRM_GROUP.HysCmpAssiCmdLpFilFrq_Val" 0 DISPLAY_IDENTIFIER CalRegn02Inin00GroupA.CalibrationPorts.HysCmpAssiCmdLpFilFrq.Val /end CHARACTERISTIC
/begin CHARACTERISTIC CalRegn02Inin00GroupA.HysCmpAssiInpLim.Val "MICROSAR RTE" VALUE 0x0 RTE_RL_UWORD 0 NO_COMPU_METHOD 0 65535 SYMBOL_LINK "Rte_CalprmRom_CalRegn02Inin00GroupA_DEFAULT_RTE_CALPRM_GROUP.HysCmpAssiInpLim_Val" 0 DISPLAY_IDENTIFIER CalRegn02Inin00GroupA.CalibrationPorts.HysCmpAssiInpLim.Val /end CHARACTERISTIC
/begin CHARACTERISTIC CalRegn02Inin00GroupA.HysCmpFinalOutpLpFilFrq.Val "MICROSAR RTE" VALUE 0x0 RTE_RL_FLOAT32_IEEE 0 NO_COMPU_METHOD -3.402823466e+38 3.402823466e+38 SYMBOL_LINK "Rte_CalprmRom_CalRegn02Inin00GroupA_DEFAULT_RTE_CALPRM_GROUP.HysCmpFinalOutpLpFilFrq_Val" 0 DISPLAY_IDENTIFIER CalRegn02Inin00GroupA.CalibrationPorts.HysCmpFinalOutpLpFilFrq.Val /end CHARACTERISTIC
/begin CHARACTERISTIC CalRegn02Inin00GroupA.HysCmpFricTScaX.Ary1D "MICROSAR RTE" VAL_BLK 0x0 RTE_RL_SWORD 0 NO_COMPU_METHOD -32768 32767 MATRIX_DIM 8 1 1 SYMBOL_LINK "Rte_CalprmRom_CalRegn02Inin00GroupA_DEFAULT_RTE_CALPRM_GROUP.HysCmpFricTScaX_Ary1D" 0 DISPLAY_IDENTIFIER CalRegn02Inin00GroupA.CalibrationPorts.HysCmpFricTScaX.Ary1D /end CHARACTERISTIC
/begin CHARACTERISTIC CalRegn02Inin00GroupA.HysCmpFricTScaY.Ary1D "MICROSAR RTE" VAL_BLK 0x0 RTE_RL_UWORD 0 NO_COMPU_METHOD 0 65535 MATRIX_DIM 8 1 1 SYMBOL_LINK "Rte_CalprmRom_CalRegn02Inin00GroupA_DEFAULT_RTE_CALPRM_GROUP.HysCmpFricTScaY_Ary1D" 0 DISPLAY_IDENTIFIER CalRegn02Inin00GroupA.CalibrationPorts.HysCmpFricTScaY.Ary1D /end CHARACTERISTIC
/begin CHARACTERISTIC CalRegn02Inin00GroupA.HysCmpHwTqLpFilFrq.Val "MICROSAR RTE" VALUE 0x0 RTE_RL_FLOAT32_IEEE 0 NO_COMPU_METHOD -3.402823466e+38 3.402823466e+38 SYMBOL_LINK "Rte_CalprmRom_CalRegn02Inin00GroupA_DEFAULT_RTE_CALPRM_GROUP.HysCmpHwTqLpFilFrq_Val" 0 DISPLAY_IDENTIFIER CalRegn02Inin00GroupA.CalibrationPorts.HysCmpHwTqLpFilFrq.Val /end CHARACTERISTIC
/begin CHARACTERISTIC CalRegn02Inin00GroupA.InertiaCmpVelAssiBasdDampgCoeffX.Ary1D "MICROSAR RTE" VAL_BLK 0x0 RTE_RL_UWORD 0 NO_COMPU_METHOD 0 65535 MATRIX_DIM 10 1 1 SYMBOL_LINK "Rte_CalprmRom_CalRegn02Inin00GroupA_DEFAULT_RTE_CALPRM_GROUP.InertiaCmpVelAssiBasdDampgCoeffX_Ary1D" 0 DISPLAY_IDENTIFIER CalRegn02Inin00GroupA.CalibrationPorts.InertiaCmpVelAssiBasdDampgCoeffX.Ary1D /end CHARACTERISTIC
/begin CHARACTERISTIC CalRegn02Inin00GroupA.InertiaCmpVelAssiBasdDampgRollgWhlImbRejctnOnY.Ary1D "MICROSAR RTE" VAL_BLK 0x0 RTE_RL_UWORD 0 NO_COMPU_METHOD 0 65535 MATRIX_DIM 10 1 1 SYMBOL_LINK "Rte_CalprmRom_CalRegn02Inin00GroupA_DEFAULT_RTE_CALPRM_GROUP.InertiaCmpVelAssiBasdDampgRollgWhlImbRejctnOnY_Ary1D" 0 DISPLAY_IDENTIFIER CalRegn02Inin00GroupA.CalibrationPorts.InertiaCmpVelAssiBasdDampgRollgWhlImbRejctnOnY.Ary1D /end CHARACTERISTIC
/begin CHARACTERISTIC CalRegn02Inin00GroupA.InertiaCmpVelAssiBasdDampgRollgY.Ary1D "MICROSAR RTE" VAL_BLK 0x0 RTE_RL_UWORD 0 NO_COMPU_METHOD 0 65535 MATRIX_DIM 10 1 1 SYMBOL_LINK "Rte_CalprmRom_CalRegn02Inin00GroupA_DEFAULT_RTE_CALPRM_GROUP.InertiaCmpVelAssiBasdDampgRollgY_Ary1D" 0 DISPLAY_IDENTIFIER CalRegn02Inin00GroupA.CalibrationPorts.InertiaCmpVelAssiBasdDampgRollgY.Ary1D /end CHARACTERISTIC
/begin CHARACTERISTIC CalRegn02Inin00GroupA.InertiaCmpVelAssiBasdDampgStatWhlImbRejctnOnY.Ary1D "MICROSAR RTE" VAL_BLK 0x0 RTE_RL_UWORD 0 NO_COMPU_METHOD 0 65535 MATRIX_DIM 10 1 1 SYMBOL_LINK "Rte_CalprmRom_CalRegn02Inin00GroupA_DEFAULT_RTE_CALPRM_GROUP.InertiaCmpVelAssiBasdDampgStatWhlImbRejctnOnY_Ary1D" 0 DISPLAY_IDENTIFIER CalRegn02Inin00GroupA.CalibrationPorts.InertiaCmpVelAssiBasdDampgStatWhlImbRejctnOnY.Ary1D /end CHARACTERISTIC
/begin CHARACTERISTIC CalRegn02Inin00GroupA.InertiaCmpVelCmdScaY.Ary1D "MICROSAR RTE" VAL_BLK 0x0 RTE_RL_UWORD 0 NO_COMPU_METHOD 0 65535 MATRIX_DIM 12 1 1 SYMBOL_LINK "Rte_CalprmRom_CalRegn02Inin00GroupA_DEFAULT_RTE_CALPRM_GROUP.InertiaCmpVelCmdScaY_Ary1D" 0 DISPLAY_IDENTIFIER CalRegn02Inin00GroupA.CalibrationPorts.InertiaCmpVelCmdScaY.Ary1D /end CHARACTERISTIC
/begin CHARACTERISTIC CalRegn02Inin00GroupA.InertiaCmpVelDampgDecelGain.Val "MICROSAR RTE" VALUE 0x0 RTE_RL_FLOAT32_IEEE 0 NO_COMPU_METHOD -3.402823466e+38 3.402823466e+38 SYMBOL_LINK "Rte_CalprmRom_CalRegn02Inin00GroupA_DEFAULT_RTE_CALPRM_GROUP.InertiaCmpVelDampgDecelGain_Val" 0 DISPLAY_IDENTIFIER CalRegn02Inin00GroupA.CalibrationPorts.InertiaCmpVelDampgDecelGain.Val /end CHARACTERISTIC
/begin CHARACTERISTIC CalRegn02Inin00GroupA.InertiaCmpVelDampgDecelGainFallSlew.Val "MICROSAR RTE" VALUE 0x0 RTE_RL_FLOAT32_IEEE 0 NO_COMPU_METHOD -3.402823466e+38 3.402823466e+38 SYMBOL_LINK "Rte_CalprmRom_CalRegn02Inin00GroupA_DEFAULT_RTE_CALPRM_GROUP.InertiaCmpVelDampgDecelGainFallSlew_Val" 0 DISPLAY_IDENTIFIER CalRegn02Inin00GroupA.CalibrationPorts.InertiaCmpVelDampgDecelGainFallSlew.Val /end CHARACTERISTIC
/begin CHARACTERISTIC CalRegn02Inin00GroupA.InertiaCmpVelDampgDecelGainRisngSlewX.Ary1D "MICROSAR RTE" VAL_BLK 0x0 RTE_RL_UWORD 0 NO_COMPU_METHOD 0 65535 MATRIX_DIM 6 1 1 SYMBOL_LINK "Rte_CalprmRom_CalRegn02Inin00GroupA_DEFAULT_RTE_CALPRM_GROUP.InertiaCmpVelDampgDecelGainRisngSlewX_Ary1D" 0 DISPLAY_IDENTIFIER CalRegn02Inin00GroupA.CalibrationPorts.InertiaCmpVelDampgDecelGainRisngSlewX.Ary1D /end CHARACTERISTIC
/begin CHARACTERISTIC CalRegn02Inin00GroupA.InertiaCmpVelDampgDecelGainRisngSlewY.Ary1D "MICROSAR RTE" VAL_BLK 0x0 RTE_RL_UWORD 0 NO_COMPU_METHOD 0 65535 MATRIX_DIM 6 1 1 SYMBOL_LINK "Rte_CalprmRom_CalRegn02Inin00GroupA_DEFAULT_RTE_CALPRM_GROUP.InertiaCmpVelDampgDecelGainRisngSlewY_Ary1D" 0 DISPLAY_IDENTIFIER CalRegn02Inin00GroupA.CalibrationPorts.InertiaCmpVelDampgDecelGainRisngSlewY.Ary1D /end CHARACTERISTIC
/begin CHARACTERISTIC CalRegn02Inin00GroupA.InertiaCmpVelDampgGainOffThd.Val "MICROSAR RTE" VALUE 0x0 RTE_RL_FLOAT32_IEEE 0 NO_COMPU_METHOD -3.402823466e+38 3.402823466e+38 SYMBOL_LINK "Rte_CalprmRom_CalRegn02Inin00GroupA_DEFAULT_RTE_CALPRM_GROUP.InertiaCmpVelDampgGainOffThd_Val" 0 DISPLAY_IDENTIFIER CalRegn02Inin00GroupA.CalibrationPorts.InertiaCmpVelDampgGainOffThd.Val /end CHARACTERISTIC
/begin CHARACTERISTIC CalRegn02Inin00GroupA.InertiaCmpVelDampgGainOnThd.Val "MICROSAR RTE" VALUE 0x0 RTE_RL_FLOAT32_IEEE 0 NO_COMPU_METHOD -3.402823466e+38 3.402823466e+38 SYMBOL_LINK "Rte_CalprmRom_CalRegn02Inin00GroupA_DEFAULT_RTE_CALPRM_GROUP.InertiaCmpVelDampgGainOnThd_Val" 0 DISPLAY_IDENTIFIER CalRegn02Inin00GroupA.CalibrationPorts.InertiaCmpVelDampgGainOnThd.Val /end CHARACTERISTIC
/begin CHARACTERISTIC CalRegn02Inin00GroupA.InertiaCmpVelDecelGainEnaCal.Logl "MICROSAR RTE" VALUE 0x0 RTE_RL_BOOLEAN 0 RTE_CM_BOOLEAN 0 255 SYMBOL_LINK "Rte_CalprmRom_CalRegn02Inin00GroupA_DEFAULT_RTE_CALPRM_GROUP.InertiaCmpVelDecelGainEnaCal_Logl" 0 DISPLAY_IDENTIFIER CalRegn02Inin00GroupA.CalibrationPorts.InertiaCmpVelDecelGainEnaCal.Logl /end CHARACTERISTIC
/begin CHARACTERISTIC CalRegn02Inin00GroupA.InertiaCmpVelModWhlImbRejctnBlndX.Ary1D "MICROSAR RTE" VAL_BLK 0x0 RTE_RL_UWORD 0 NO_COMPU_METHOD 0 65535 MATRIX_DIM 2 1 1 SYMBOL_LINK "Rte_CalprmRom_CalRegn02Inin00GroupA_DEFAULT_RTE_CALPRM_GROUP.InertiaCmpVelModWhlImbRejctnBlndX_Ary1D" 0 DISPLAY_IDENTIFIER CalRegn02Inin00GroupA.CalibrationPorts.InertiaCmpVelModWhlImbRejctnBlndX.Ary1D /end CHARACTERISTIC
/begin CHARACTERISTIC CalRegn02Inin00GroupA.InertiaCmpVelModWhlImbRejctnBlndY.Ary1D "MICROSAR RTE" VAL_BLK 0x0 RTE_RL_UWORD 0 NO_COMPU_METHOD 0 65535 MATRIX_DIM 2 1 1 SYMBOL_LINK "Rte_CalprmRom_CalRegn02Inin00GroupA_DEFAULT_RTE_CALPRM_GROUP.InertiaCmpVelModWhlImbRejctnBlndY_Ary1D" 0 DISPLAY_IDENTIFIER CalRegn02Inin00GroupA.CalibrationPorts.InertiaCmpVelModWhlImbRejctnBlndY.Ary1D /end CHARACTERISTIC
/begin CHARACTERISTIC CalRegn02Inin00GroupA.InertiaCmpVelMotInertia.Val "MICROSAR RTE" VALUE 0x0 RTE_RL_FLOAT32_IEEE 0 NO_COMPU_METHOD -3.402823466e+38 3.402823466e+38 SYMBOL_LINK "Rte_CalprmRom_CalRegn02Inin00GroupA_DEFAULT_RTE_CALPRM_GROUP.InertiaCmpVelMotInertia_Val" 0 DISPLAY_IDENTIFIER CalRegn02Inin00GroupA.CalibrationPorts.InertiaCmpVelMotInertia.Val /end CHARACTERISTIC
/begin CHARACTERISTIC CalRegn02Inin00GroupA.InertiaCmpVelMotVelBasdOutpScagX.Ary1D "MICROSAR RTE" VAL_BLK 0x0 RTE_RL_UWORD 0 NO_COMPU_METHOD 0 65535 MATRIX_DIM 2 1 1 SYMBOL_LINK "Rte_CalprmRom_CalRegn02Inin00GroupA_DEFAULT_RTE_CALPRM_GROUP.InertiaCmpVelMotVelBasdOutpScagX_Ary1D" 0 DISPLAY_IDENTIFIER CalRegn02Inin00GroupA.CalibrationPorts.InertiaCmpVelMotVelBasdOutpScagX.Ary1D /end CHARACTERISTIC
/begin CHARACTERISTIC CalRegn02Inin00GroupA.InertiaCmpVelMotVelBasdOutpScagY.Ary1D "MICROSAR RTE" VAL_BLK 0x0 RTE_RL_UWORD 0 NO_COMPU_METHOD 0 65535 MATRIX_DIM 2 1 1 SYMBOL_LINK "Rte_CalprmRom_CalRegn02Inin00GroupA_DEFAULT_RTE_CALPRM_GROUP.InertiaCmpVelMotVelBasdOutpScagY_Ary1D" 0 DISPLAY_IDENTIFIER CalRegn02Inin00GroupA.CalibrationPorts.InertiaCmpVelMotVelBasdOutpScagY.Ary1D /end CHARACTERISTIC
/begin CHARACTERISTIC CalRegn02Inin00GroupA.InertiaCmpVelNotchBlndY.Ary1D "MICROSAR RTE" VAL_BLK 0x0 RTE_RL_UWORD 0 NO_COMPU_METHOD 0 65535 MATRIX_DIM 12 1 1 SYMBOL_LINK "Rte_CalprmRom_CalRegn02Inin00GroupA_DEFAULT_RTE_CALPRM_GROUP.InertiaCmpVelNotchBlndY_Ary1D" 0 DISPLAY_IDENTIFIER CalRegn02Inin00GroupA.CalibrationPorts.InertiaCmpVelNotchBlndY.Ary1D /end CHARACTERISTIC
/begin CHARACTERISTIC CalRegn02Inin00GroupA.InertiaCmpVelNotchFilStruct.Rec.FilGainA1 "MICROSAR RTE" VALUE 0x0 RTE_RL_FLOAT32_IEEE 0 NO_COMPU_METHOD -3.402823466e+38 3.402823466e+38 SYMBOL_LINK "Rte_CalprmRom_CalRegn02Inin00GroupA_DEFAULT_RTE_CALPRM_GROUP.InertiaCmpVelNotchFilStruct_Rec.FilGainA1" 0 DISPLAY_IDENTIFIER CalRegn02Inin00GroupA.CalibrationPorts.InertiaCmpVelNotchFilStruct.Rec.FilGainA1 /end CHARACTERISTIC
/begin CHARACTERISTIC CalRegn02Inin00GroupA.InertiaCmpVelNotchFilStruct.Rec.FilGainA2 "MICROSAR RTE" VALUE 0x0 RTE_RL_FLOAT32_IEEE 0 NO_COMPU_METHOD -3.402823466e+38 3.402823466e+38 SYMBOL_LINK "Rte_CalprmRom_CalRegn02Inin00GroupA_DEFAULT_RTE_CALPRM_GROUP.InertiaCmpVelNotchFilStruct_Rec.FilGainA2" 0 DISPLAY_IDENTIFIER CalRegn02Inin00GroupA.CalibrationPorts.InertiaCmpVelNotchFilStruct.Rec.FilGainA2 /end CHARACTERISTIC
/begin CHARACTERISTIC CalRegn02Inin00GroupA.InertiaCmpVelNotchFilStruct.Rec.FilGainB0 "MICROSAR RTE" VALUE 0x0 RTE_RL_FLOAT32_IEEE 0 NO_COMPU_METHOD -3.402823466e+38 3.402823466e+38 SYMBOL_LINK "Rte_CalprmRom_CalRegn02Inin00GroupA_DEFAULT_RTE_CALPRM_GROUP.InertiaCmpVelNotchFilStruct_Rec.FilGainB0" 0 DISPLAY_IDENTIFIER CalRegn02Inin00GroupA.CalibrationPorts.InertiaCmpVelNotchFilStruct.Rec.FilGainB0 /end CHARACTERISTIC
/begin CHARACTERISTIC CalRegn02Inin00GroupA.InertiaCmpVelNotchFilStruct.Rec.FilGainB1 "MICROSAR RTE" VALUE 0x0 RTE_RL_FLOAT32_IEEE 0 NO_COMPU_METHOD -3.402823466e+38 3.402823466e+38 SYMBOL_LINK "Rte_CalprmRom_CalRegn02Inin00GroupA_DEFAULT_RTE_CALPRM_GROUP.InertiaCmpVelNotchFilStruct_Rec.FilGainB1" 0 DISPLAY_IDENTIFIER CalRegn02Inin00GroupA.CalibrationPorts.InertiaCmpVelNotchFilStruct.Rec.FilGainB1 /end CHARACTERISTIC
/begin CHARACTERISTIC CalRegn02Inin00GroupA.InertiaCmpVelNotchFilStruct.Rec.FilGainB2 "MICROSAR RTE" VALUE 0x0 RTE_RL_FLOAT32_IEEE 0 NO_COMPU_METHOD -3.402823466e+38 3.402823466e+38 SYMBOL_LINK "Rte_CalprmRom_CalRegn02Inin00GroupA_DEFAULT_RTE_CALPRM_GROUP.InertiaCmpVelNotchFilStruct_Rec.FilGainB2" 0 DISPLAY_IDENTIFIER CalRegn02Inin00GroupA.CalibrationPorts.InertiaCmpVelNotchFilStruct.Rec.FilGainB2 /end CHARACTERISTIC
/begin CHARACTERISTIC CalRegn02Inin00GroupA.InertiaCmpVelTqSnsrVelFilFrq.Val "MICROSAR RTE" VALUE 0x0 RTE_RL_FLOAT32_IEEE 0 NO_COMPU_METHOD -3.402823466e+38 3.402823466e+38 SYMBOL_LINK "Rte_CalprmRom_CalRegn02Inin00GroupA_DEFAULT_RTE_CALPRM_GROUP.InertiaCmpVelTqSnsrVelFilFrq_Val" 0 DISPLAY_IDENTIFIER CalRegn02Inin00GroupA.CalibrationPorts.InertiaCmpVelTqSnsrVelFilFrq.Val /end CHARACTERISTIC
/begin CHARACTERISTIC CalRegn02Inin00GroupA.InertiaCmpVelTqSnsrVelSca.Ary1D "MICROSAR RTE" VAL_BLK 0x0 RTE_RL_UWORD 0 NO_COMPU_METHOD 0 65535 MATRIX_DIM 12 1 1 SYMBOL_LINK "Rte_CalprmRom_CalRegn02Inin00GroupA_DEFAULT_RTE_CALPRM_GROUP.InertiaCmpVelTqSnsrVelSca_Ary1D" 0 DISPLAY_IDENTIFIER CalRegn02Inin00GroupA.CalibrationPorts.InertiaCmpVelTqSnsrVelSca.Ary1D /end CHARACTERISTIC
/begin CHARACTERISTIC CalRegn02Inin00GroupB.EotLrngAuthyStrtLrn.Val "MICROSAR RTE" VALUE 0x0 RTE_RL_FLOAT32_IEEE 0 NO_COMPU_METHOD -3.402823466e+38 3.402823466e+38 SYMBOL_LINK "Rte_CalprmRom_CalRegn02Inin00GroupB_DEFAULT_RTE_CALPRM_GROUP.EotLrngAuthyStrtLrn_Val" 0 DISPLAY_IDENTIFIER CalRegn02Inin00GroupB.CalibrationPorts.EotLrngAuthyStrtLrn.Val /end CHARACTERISTIC
/begin CHARACTERISTIC CalRegn02Inin00GroupB.EotLrngEntrAndExitHysRngLimr.Val "MICROSAR RTE" VALUE 0x0 RTE_RL_FLOAT32_IEEE 0 NO_COMPU_METHOD -3.402823466e+38 3.402823466e+38 SYMBOL_LINK "Rte_CalprmRom_CalRegn02Inin00GroupB_DEFAULT_RTE_CALPRM_GROUP.EotLrngEntrAndExitHysRngLimr_Val" 0 DISPLAY_IDENTIFIER CalRegn02Inin00GroupB.CalibrationPorts.EotLrngEntrAndExitHysRngLimr.Val /end CHARACTERISTIC
/begin CHARACTERISTIC CalRegn02Inin00GroupB.EotLrngEotLrnTmr.Val "MICROSAR RTE" VALUE 0x0 RTE_RL_UWORD 0 NO_COMPU_METHOD 0 65535 SYMBOL_LINK "Rte_CalprmRom_CalRegn02Inin00GroupB_DEFAULT_RTE_CALPRM_GROUP.EotLrngEotLrnTmr_Val" 0 DISPLAY_IDENTIFIER CalRegn02Inin00GroupB.CalibrationPorts.EotLrngEotLrnTmr.Val /end CHARACTERISTIC
/begin CHARACTERISTIC CalRegn02Inin00GroupB.EotLrngHwTqEotLrn.Val "MICROSAR RTE" VALUE 0x0 RTE_RL_FLOAT32_IEEE 0 NO_COMPU_METHOD -3.402823466e+38 3.402823466e+38 SYMBOL_LINK "Rte_CalprmRom_CalRegn02Inin00GroupB_DEFAULT_RTE_CALPRM_GROUP.EotLrngHwTqEotLrn_Val" 0 DISPLAY_IDENTIFIER CalRegn02Inin00GroupB.CalibrationPorts.EotLrngHwTqEotLrn.Val /end CHARACTERISTIC
/begin CHARACTERISTIC CalRegn02Inin00GroupB.EotLrngMotVelEotLrn.Val "MICROSAR RTE" VALUE 0x0 RTE_RL_FLOAT32_IEEE 0 NO_COMPU_METHOD -3.402823466e+38 3.402823466e+38 SYMBOL_LINK "Rte_CalprmRom_CalRegn02Inin00GroupB_DEFAULT_RTE_CALPRM_GROUP.EotLrngMotVelEotLrn_Val" 0 DISPLAY_IDENTIFIER CalRegn02Inin00GroupB.CalibrationPorts.EotLrngMotVelEotLrn.Val /end CHARACTERISTIC
/begin GROUP CalRegn01Inin00GroupD.StabyCmpNotchFil1Struct.Rec "MICROSAR RTE" /begin SUB_GROUP /end SUB_GROUP /begin FUNCTION_LIST /end FUNCTION_LIST
 /begin REF_CHARACTERISTIC CalRegn01Inin00GroupD.StabyCmpNotchFil1Struct.Rec.FilGainA1 CalRegn01Inin00GroupD.StabyCmpNotchFil1Struct.Rec.FilGainA2 CalRegn01Inin00GroupD.StabyCmpNotchFil1Struct.Rec.FilGainB0 CalRegn01Inin00GroupD.StabyCmpNotchFil1Struct.Rec.FilGainB1 CalRegn01Inin00GroupD.StabyCmpNotchFil1Struct.Rec.FilGainB2 /end REF_CHARACTERISTIC
 /begin REF_MEASUREMENT /end REF_MEASUREMENT
/end GROUP
/begin GROUP CalRegn01Inin00GroupD.StabyCmpNotchFil2Struct.Rec "MICROSAR RTE" /begin SUB_GROUP /end SUB_GROUP /begin FUNCTION_LIST /end FUNCTION_LIST
 /begin REF_CHARACTERISTIC CalRegn01Inin00GroupD.StabyCmpNotchFil2Struct.Rec.FilGainA1 CalRegn01Inin00GroupD.StabyCmpNotchFil2Struct.Rec.FilGainA2 CalRegn01Inin00GroupD.StabyCmpNotchFil2Struct.Rec.FilGainB0 CalRegn01Inin00GroupD.StabyCmpNotchFil2Struct.Rec.FilGainB1 CalRegn01Inin00GroupD.StabyCmpNotchFil2Struct.Rec.FilGainB2 /end REF_CHARACTERISTIC
 /begin REF_MEASUREMENT /end REF_MEASUREMENT
/end GROUP
/begin GROUP CalRegn01Inin00GroupD.StabyCmpNotchFil3Struct.Rec "MICROSAR RTE" /begin SUB_GROUP /end SUB_GROUP /begin FUNCTION_LIST /end FUNCTION_LIST
 /begin REF_CHARACTERISTIC CalRegn01Inin00GroupD.StabyCmpNotchFil3Struct.Rec.FilGainA1 CalRegn01Inin00GroupD.StabyCmpNotchFil3Struct.Rec.FilGainA2 CalRegn01Inin00GroupD.StabyCmpNotchFil3Struct.Rec.FilGainB0 CalRegn01Inin00GroupD.StabyCmpNotchFil3Struct.Rec.FilGainB1 CalRegn01Inin00GroupD.StabyCmpNotchFil3Struct.Rec.FilGainB2 /end REF_CHARACTERISTIC
 /begin REF_MEASUREMENT /end REF_MEASUREMENT
/end GROUP
/begin GROUP CalRegn01Inin00GroupD.StabyCmpNotchFil4Struct.Rec "MICROSAR RTE" /begin SUB_GROUP /end SUB_GROUP /begin FUNCTION_LIST /end FUNCTION_LIST
 /begin REF_CHARACTERISTIC CalRegn01Inin00GroupD.StabyCmpNotchFil4Struct.Rec.FilGainA1 CalRegn01Inin00GroupD.StabyCmpNotchFil4Struct.Rec.FilGainA2 CalRegn01Inin00GroupD.StabyCmpNotchFil4Struct.Rec.FilGainB0 CalRegn01Inin00GroupD.StabyCmpNotchFil4Struct.Rec.FilGainB1 CalRegn01Inin00GroupD.StabyCmpNotchFil4Struct.Rec.FilGainB2 /end REF_CHARACTERISTIC
 /begin REF_MEASUREMENT /end REF_MEASUREMENT
/end GROUP
/begin GROUP CalRegn01Inin00GroupD.StabyCmpNotchFilBilnrBlndVehSpd.Ary1D "MICROSAR RTE" /begin SUB_GROUP /end SUB_GROUP /begin FUNCTION_LIST /end FUNCTION_LIST
 /begin REF_CHARACTERISTIC CalRegn01Inin00GroupD.StabyCmpNotchFilBilnrBlndVehSpd.Ary1D /end REF_CHARACTERISTIC
 /begin REF_MEASUREMENT /end REF_MEASUREMENT
/end GROUP
/begin GROUP CalRegn01Inin00GroupD.StabyCmpNotchFilBlnd02Y.Ary2D "MICROSAR RTE" /begin SUB_GROUP /end SUB_GROUP /begin FUNCTION_LIST /end FUNCTION_LIST /begin REF_CHARACTERISTIC CalRegn01Inin00GroupD.StabyCmpNotchFilBlnd02Y.Ary2D /end REF_CHARACTERISTIC /begin REF_MEASUREMENT /end REF_MEASUREMENT /end GROUP
/begin GROUP CalRegn01Inin00GroupD.StabyCmpNotchFilBlnd04Y.Ary2D "MICROSAR RTE" /begin SUB_GROUP /end SUB_GROUP /begin FUNCTION_LIST /end FUNCTION_LIST /begin REF_CHARACTERISTIC CalRegn01Inin00GroupD.StabyCmpNotchFilBlnd04Y.Ary2D /end REF_CHARACTERISTIC /begin REF_MEASUREMENT /end REF_MEASUREMENT /end GROUP
/begin GROUP CalRegn01Inin00GroupD.StabyCmpNotchFilBlnd12TqX.Ary2D "MICROSAR RTE" /begin SUB_GROUP /end SUB_GROUP /begin FUNCTION_LIST /end FUNCTION_LIST /begin REF_CHARACTERISTIC CalRegn01Inin00GroupD.StabyCmpNotchFilBlnd12TqX.Ary2D /end REF_CHARACTERISTIC /begin REF_MEASUREMENT /end REF_MEASUREMENT /end GROUP
/begin GROUP CalRegn01Inin00GroupD.StabyCmpNotchFilBlnd12Y.Ary2D "MICROSAR RTE" /begin SUB_GROUP /end SUB_GROUP /begin FUNCTION_LIST /end FUNCTION_LIST /begin REF_CHARACTERISTIC CalRegn01Inin00GroupD.StabyCmpNotchFilBlnd12Y.Ary2D /end REF_CHARACTERISTIC /begin REF_MEASUREMENT /end REF_MEASUREMENT /end GROUP
/begin GROUP CalRegn01Inin00GroupD.StabyCmpNotchFilBlnd34TqX.Ary2D "MICROSAR RTE" /begin SUB_GROUP /end SUB_GROUP /begin FUNCTION_LIST /end FUNCTION_LIST /begin REF_CHARACTERISTIC CalRegn01Inin00GroupD.StabyCmpNotchFilBlnd34TqX.Ary2D /end REF_CHARACTERISTIC /begin REF_MEASUREMENT /end REF_MEASUREMENT /end GROUP
/begin GROUP CalRegn01Inin00GroupD.StabyCmpNotchFilBlnd34Y.Ary2D "MICROSAR RTE" /begin SUB_GROUP /end SUB_GROUP /begin FUNCTION_LIST /end FUNCTION_LIST /begin REF_CHARACTERISTIC CalRegn01Inin00GroupD.StabyCmpNotchFilBlnd34Y.Ary2D /end REF_CHARACTERISTIC /begin REF_MEASUREMENT /end REF_MEASUREMENT /end GROUP
/begin GROUP CalRegn01Rt00 "MICROSAR RTE" /begin SUB_GROUP CalRegn01Rt00.CalibrationPorts /end SUB_GROUP /begin FUNCTION_LIST /end FUNCTION_LIST /begin REF_CHARACTERISTIC /end REF_CHARACTERISTIC /begin REF_MEASUREMENT /end REF_MEASUREMENT /end GROUP
/begin GROUP CalRegn01Rt00.CalibrationPorts "MICROSAR RTE" /begin SUB_GROUP CalRegn01Rt00.TEstimnMagAmbMplr.Ary1D /end SUB_GROUP /begin FUNCTION_LIST /end FUNCTION_LIST /begin REF_CHARACTERISTIC /end REF_CHARACTERISTIC /begin REF_MEASUREMENT /end REF_MEASUREMENT /end GROUP
/begin GROUP CalRegn01Rt00.TEstimnMagAmbMplr.Ary1D "MICROSAR RTE" /begin SUB_GROUP /end SUB_GROUP /begin FUNCTION_LIST /end FUNCTION_LIST /begin REF_CHARACTERISTIC CalRegn01Rt00.TEstimnMagAmbMplr.Ary1D /end REF_CHARACTERISTIC /begin REF_MEASUREMENT /end REF_MEASUREMENT /end GROUP
/begin GROUP CalRegn01Rt01 "MICROSAR RTE" /begin SUB_GROUP CalRegn01Rt01.CalibrationPorts /end SUB_GROUP /begin FUNCTION_LIST /end FUNCTION_LIST /begin REF_CHARACTERISTIC /end REF_CHARACTERISTIC /begin REF_MEASUREMENT /end REF_MEASUREMENT /end GROUP
/begin GROUP CalRegn01Rt01.CalibrationPorts "MICROSAR RTE" /begin SUB_GROUP CalRegn01Rt01.TEstimnMagAmbMplr.Ary1D /end SUB_GROUP /begin FUNCTION_LIST /end FUNCTION_LIST /begin REF_CHARACTERISTIC /end REF_CHARACTERISTIC /begin REF_MEASUREMENT /end REF_MEASUREMENT /end GROUP
/begin GROUP CalRegn01Rt01.TEstimnMagAmbMplr.Ary1D "MICROSAR RTE" /begin SUB_GROUP /end SUB_GROUP /begin FUNCTION_LIST /end FUNCTION_LIST /begin REF_CHARACTERISTIC CalRegn01Rt01.TEstimnMagAmbMplr.Ary1D /end REF_CHARACTERISTIC /begin REF_MEASUREMENT /end REF_MEASUREMENT /end GROUP
/begin GROUP CalRegn01Rt02 "MICROSAR RTE" /begin SUB_GROUP CalRegn01Rt02.CalibrationPorts /end SUB_GROUP /begin FUNCTION_LIST /end FUNCTION_LIST /begin REF_CHARACTERISTIC /end REF_CHARACTERISTIC /begin REF_MEASUREMENT /end REF_MEASUREMENT /end GROUP
/begin GROUP CalRegn01Rt02.CalibrationPorts "MICROSAR RTE" /begin SUB_GROUP CalRegn01Rt02.TEstimnMagAmbMplr.Ary1D /end SUB_GROUP /begin FUNCTION_LIST /end FUNCTION_LIST /begin REF_CHARACTERISTIC /end REF_CHARACTERISTIC /begin REF_MEASUREMENT /end REF_MEASUREMENT /end GROUP
/begin GROUP CalRegn01Rt02.TEstimnMagAmbMplr.Ary1D "MICROSAR RTE" /begin SUB_GROUP /end SUB_GROUP /begin FUNCTION_LIST /end FUNCTION_LIST /begin REF_CHARACTERISTIC CalRegn01Rt02.TEstimnMagAmbMplr.Ary1D /end REF_CHARACTERISTIC /begin REF_MEASUREMENT /end REF_MEASUREMENT /end GROUP
/begin GROUP CalRegn01Rt03 "MICROSAR RTE" /begin SUB_GROUP CalRegn01Rt03.CalibrationPorts /end SUB_GROUP /begin FUNCTION_LIST /end FUNCTION_LIST /begin REF_CHARACTERISTIC /end REF_CHARACTERISTIC /begin REF_MEASUREMENT /end REF_MEASUREMENT /end GROUP
/begin GROUP CalRegn01Rt03.CalibrationPorts "MICROSAR RTE" /begin SUB_GROUP CalRegn01Rt03.TEstimnMagAmbMplr.Ary1D /end SUB_GROUP /begin FUNCTION_LIST /end FUNCTION_LIST /begin REF_CHARACTERISTIC /end REF_CHARACTERISTIC /begin REF_MEASUREMENT /end REF_MEASUREMENT /end GROUP
/begin GROUP CalRegn01Rt03.TEstimnMagAmbMplr.Ary1D "MICROSAR RTE" /begin SUB_GROUP /end SUB_GROUP /begin FUNCTION_LIST /end FUNCTION_LIST /begin REF_CHARACTERISTIC CalRegn01Rt03.TEstimnMagAmbMplr.Ary1D /end REF_CHARACTERISTIC /begin REF_MEASUREMENT /end REF_MEASUREMENT /end GROUP
/begin GROUP CalRegn01Rt04 "MICROSAR RTE" /begin SUB_GROUP CalRegn01Rt04.CalibrationPorts /end SUB_GROUP /begin FUNCTION_LIST /end FUNCTION_LIST /begin REF_CHARACTERISTIC /end REF_CHARACTERISTIC /begin REF_MEASUREMENT /end REF_MEASUREMENT /end GROUP
/begin GROUP CalRegn01Rt04.CalibrationPorts "MICROSAR RTE" /begin SUB_GROUP CalRegn01Rt04.TEstimnMagAmbMplr.Ary1D /end SUB_GROUP /begin FUNCTION_LIST /end FUNCTION_LIST /begin REF_CHARACTERISTIC /end REF_CHARACTERISTIC /begin REF_MEASUREMENT /end REF_MEASUREMENT /end GROUP
/begin GROUP CalRegn01Rt04.TEstimnMagAmbMplr.Ary1D "MICROSAR RTE" /begin SUB_GROUP /end SUB_GROUP /begin FUNCTION_LIST /end FUNCTION_LIST /begin REF_CHARACTERISTIC CalRegn01Rt04.TEstimnMagAmbMplr.Ary1D /end REF_CHARACTERISTIC /begin REF_MEASUREMENT /end REF_MEASUREMENT /end GROUP
/begin GROUP CalRegn01Rt05 "MICROSAR RTE" /begin SUB_GROUP CalRegn01Rt05.CalibrationPorts /end SUB_GROUP /begin FUNCTION_LIST /end FUNCTION_LIST /begin REF_CHARACTERISTIC /end REF_CHARACTERISTIC /begin REF_MEASUREMENT /end REF_MEASUREMENT /end GROUP
/begin GROUP CalRegn01Rt05.CalibrationPorts "MICROSAR RTE" /begin SUB_GROUP CalRegn01Rt05.TEstimnMagAmbMplr.Ary1D /end SUB_GROUP /begin FUNCTION_LIST /end FUNCTION_LIST /begin REF_CHARACTERISTIC /end REF_CHARACTERISTIC /begin REF_MEASUREMENT /end REF_MEASUREMENT /end GROUP
/begin GROUP CalRegn01Rt05.TEstimnMagAmbMplr.Ary1D "MICROSAR RTE" /begin SUB_GROUP /end SUB_GROUP /begin FUNCTION_LIST /end FUNCTION_LIST /begin REF_CHARACTERISTIC CalRegn01Rt05.TEstimnMagAmbMplr.Ary1D /end REF_CHARACTERISTIC /begin REF_MEASUREMENT /end REF_MEASUREMENT /end GROUP
/begin GROUP CalRegn02Cmn "MICROSAR RTE" /begin SUB_GROUP CalRegn02Cmn.CalibrationPorts /end SUB_GROUP /begin FUNCTION_LIST /end FUNCTION_LIST /begin REF_CHARACTERISTIC /end REF_CHARACTERISTIC /begin REF_MEASUREMENT /end REF_MEASUREMENT /end GROUP
/begin GROUP CalRegn02Cmn.CalibrationPorts "MICROSAR RTE"
 /begin SUB_GROUP CalRegn02Cmn.FordBlaBoxIfCmnVehSteerRat.Val CalRegn02Cmn.FordBlaBoxIfCmnVehWhlBas.Val CalRegn02Cmn.FordCanDtcInhbFactryModThd.Val CalRegn02Cmn.FordCanDtcInhbTransptModThd.Val CalRegn02Cmn.FordCmdArbnActvNiblCtrlDeactvn.Ary1D CalRegn02Cmn.FordCmdArbnActvNiblCtrlDeniedActvnReq.Ary1D CalRegn02Cmn.FordCmdArbnDrvrSteerDeniedActvnReq.Ary1D CalRegn02Cmn.FordCmdArbnDrvrSteerRcmdnDeactvn.Ary1D CalRegn02Cmn.FordCmdArbnEvasSteerAssiDeactvn.Ary1D CalRegn02Cmn.FordCmdArbnEvasSteerDeniedActvnReq.Ary1D CalRegn02Cmn.FordCmdArbnExtAgCtrlDeactvn.Ary1D CalRegn02Cmn.FordCmdArbnExtAgDeniedActvnReq.Ary1D CalRegn02Cmn.FordCmdArbnLaneDprtrWarnDeactvn.Ary1D CalRegn02Cmn.FordCmdArbnLaneDprtrWarnDeniedActvnReq.Ary1D CalRegn02Cmn.FordCmdArbnLaneKeepAssiDeactvn.Ary1D CalRegn02Cmn.FordCmdArbnLaneKeepAssiDeniedActvnReq.Ary1D CalRegn02Cmn.FordCmdArbnLatCtrlDeactvn.Ary1D CalRegn02Cmn.FordCmdArbnLatCtrlDeniedActvnReq.Ary1D CalRegn02Cmn.FordCmdArbnNonStMask.Ary1D CalRegn02Cmn.FordCmdArbnNormAssiTqThd.Val CalRegn02Cmn.FordCmdArbnPullDriftCmpDeactvn.Ary1D CalRegn02Cmn.FordCmdArbnPullDriftCmpDeniedActvnReq.Ary1D CalRegn02Cmn.FordCmdArbnPullDriftCmpLrngDeactvn.Ary1D CalRegn02Cmn.FordCmdArbnPullDriftCmpLrngDeniedActvnReq.Ary1D CalRegn02Cmn.FordCmdArbnSpare1Deactvn.Ary1D CalRegn02Cmn.FordCmdArbnSpare1DeniedActvnReq.Ary1D CalRegn02Cmn.FordCmdArbnSpare2Deactvn.Ary1D CalRegn02Cmn.FordCmdArbnSpare2DeniedActvnReq.Ary1D CalRegn02Cmn.FordCmdArbnSpare3Deactvn.Ary1D CalRegn02Cmn.FordCmdArbnSpare3DeniedActvnReq.Ary1D CalRegn02Cmn.FordCmdArbnSteerDstbcDeactvn.Ary1D CalRegn02Cmn.FordCmdArbnSteerDstbcDeniedActvnReq.Ary1D CalRegn02Cmn.FordHwAgArbnMotVelVldFlgRcvrTiThd.Val CalRegn02Cmn.FordHwAgArbnNonAbsCentrNotDetdTiThd.Val CalRegn02Cmn.FordHwAgArbnPhyRackTrvlThd.Val CalRegn02Cmn.FordHwAgArbnRelPosnVldFlgRcvryTiThd.Val CalRegn02Cmn.FordHwTqCdngAppldFinalMotTqVldTiThd.Val CalRegn02Cmn.FordHwTqCdngInpTqRawVldTiThd.Val CalRegn02Cmn.FordHwTqCmdOvrlLimrCombdBwY.Ary1D CalRegn02Cmn.FordHwTqCmdOvrlLimrCombdTqRateY.Ary1D CalRegn02Cmn.FordHwTqCmdOvrlLimrCombdTqSatnY.Ary1D CalRegn02Cmn.FordHwTqCmdOvrlLimrCombdVehSpdBreakPtX.Ary1D CalRegn02Cmn.FordHwTqCmdOvrlLimrDftSpdRate.Val CalRegn02Cmn.FordHwTqCmdOvrlLimrDftSpdRcvrRate.Val CalRegn02Cmn.FordHwTqCmdOvrlLimrLkaBwY.Ary1D CalRegn02Cmn.FordHwTqCmdOvrlLimrLkaTqRateY.Ary1D CalRegn02Cmn.FordHwTqCmdOvrlLimrLkaTqSatnY.Ary1D CalRegn02Cmn.FordHwTqCmdOvrlLimrVehSpdBreakPtX.Ary1D CalRegn02Cmn.FordMotTqCmdOvrlLimrDftSpdRate.Val CalRegn02Cmn.FordMotTqCmdOvrlLimrDftSpdRcvrRate.Val CalRegn02Cmn.FordMotTqCmdOvrlLimrHiFrqMonrActvNiblCtrlDcTqTrendThd.Val CalRegn02Cmn.FordMotTqCmdOvrlLimrHiFrqMonrActvNiblCtrlLoFrqTiThd.Val CalRegn02Cmn.FordMotTqCmdOvrlLimrHiFrqMonrActvNiblCtrlMaxMotTq.Val CalRegn02Cmn.FordMotTqCmdOvrlLimrHiFrqMonrLaneDprtrWarnDcTqTrendThd.Val CalRegn02Cmn.FordMotTqCmdOvrlLimrHiFrqMonrLaneDprtrWarnLoFrqTiThd.Val CalRegn02Cmn.FordMotTqCmdOvrlLimrHiFrqMonrLaneDprtrWarnMaxMotTq.Val CalRegn02Cmn.FordMotTqCmdOvrlLimrHiFrqMonrTqTrendAlpha.Val CalRegn02Cmn.FordMotTqCmdOvrlLimrHiFrqMonrZeroBandTq.Val CalRegn02Cmn.FordMotTqCmdOvrlLimrHwVelLoPassFrq.Val CalRegn02Cmn.FordMotTqCmdOvrlLimrLatCtrlBwY.Val CalRegn02Cmn.FordMotTqCmdOvrlLimrLatCtrlTqRateY.Ary1D CalRegn02Cmn.FordMotTqCmdOvrlLimrLatCtrlTqSatnY.Ary1D CalRegn02Cmn.FordMotTqCmdOvrlLimrLatCtrlVehSpdBreakPtX.Ary1D CalRegn02Cmn.FordMotTqCmdOvrlLimrPullDriftCmpTqRateY.Ary1D CalRegn02Cmn.FordMotTqCmdOvrlLimrPullDriftCmpTqSatnY.Ary1D CalRegn02Cmn.FordMotTqCmdOvrlLimrPullDriftCmpVehSpdBreakPtX.Ary1D CalRegn02Cmn.FordMotTqCmdOvrlLimrSteerReactnLimrCombAmpVehSpdLimX.Ary1D CalRegn02Cmn.FordMotTqCmdOvrlLimrSteerReactnLimrCombAmpVehSpdLimY.Ary1D CalRegn02Cmn.FordMotTqCmdOvrlLimrSteerReactnLimrCombOvrrunRampRateHwVelErrX.Ary1D CalRegn02Cmn.FordMotTqCmdOvrlLimrSteerReactnLimrCombOvrrunRampRateOutY.Ary1D CalRegn02Cmn.FordMotTqCmdOvrlLimrSteerReactnLimrCombdAmpOvrrun.Val CalRegn02Cmn.FordMotTqCmdOvrlLimrSteerReactnLimrCombdAmpRcvry.Val CalRegn02Cmn.FordMotTqCmdOvrlLimrSteerReactnLimrCombdFixdOvrrunRampRate.Val CalRegn02Cmn.FordMotTqCmdOvrlLimrSteerReactnLimrCombdLimHys.Val CalRegn02Cmn.FordMotTqCmdOvrlLimrSteerReactnLimrCombdLimTqX.Ary2D CalRegn02Cmn.FordMotTqCmdOvrlLimrSteerReactnLimrCombdLimrHwVelY.Ary2D CalRegn02Cmn.FordMotTqCmdOvrlLimrSteerReactnLimrCombdLimrVehSpd.Ary1D CalRegn02Cmn.FordMotTqCmdOvrlLimrSteerReactnLimrCombdRcvryIdealRampRate.Val CalRegn02Cmn.FordMotTqCmdOvrlLimrSteerReactnLimrCombdRcvryRampRateStg1.Val CalRegn02Cmn.FordMotTqCmdOvrlLimrSteerReactnLimrCombdRcvryRampRateStg2.Val CalRegn02Cmn.FordVehSpdArbnDrvnWhl.Logl CalRegn02Cmn.FordVehSpdArbnTireCircumMax.Val CalRegn02Cmn.FordVehSpdArbnTireCircumMin.Val CalRegn02Cmn.FordVltgIfActvParkAssiAsscTqMin.Val CalRegn02Cmn.FordVltgIfEPSBattVltgDifThd.Val CalRegn02Cmn.FordVltgIfEpsBattCurrLim.Val CalRegn02Cmn.FordVltgIfEpsCurrLim.Val CalRegn02Cmn.FordVltgIfEvasSteerAssiTqMin.Val CalRegn02Cmn.FordVltgIfFeatThdStsTiThd.Val CalRegn02Cmn.FordVltgIfHiVltgAssiRampDwnRate.Val CalRegn02Cmn.FordVltgIfHiVltgAssiRampUpRate.Val CalRegn02Cmn.FordVltgIfHiVltgInhbTiMax.Val CalRegn02Cmn.FordVltgIfHiVltgNoAssiRampDwnRate.Val CalRegn02Cmn.FordVltgIfHiVltgNoAssiRcvrTiMax.Val CalRegn02Cmn.FordVltgIfHiVltgRcvrTiMax.Val CalRegn02Cmn.FordVltgIfHiVltgThdHi.Val CalRegn02Cmn.FordVltgIfHiVltgThdLo.Val CalRegn02Cmn.FordVltgIfInhbBattVltgDiagcTiThd.Val CalRegn02Cmn.FordVltgIfLaneCentrAssiTqMin.Val CalRegn02Cmn.FordVltgIfLaneDprtrWarnAsscTqMin.Val CalRegn02Cmn.FordVltgIfLkaAsscTqMin.Val CalRegn02Cmn.FordVltgIfLoVltgAssiRampDwnRate.Val CalRegn02Cmn.FordVltgIfLoVltgAssiRampUpRate.Val CalRegn02Cmn.FordVltgIfLoVltgAssiScar.Val CalRegn02Cmn.FordVltgIfLoVltgInhbTiMax.Val CalRegn02Cmn.FordVltgIfLoVltgNoAssiRampDwnRate.Val CalRegn02Cmn.FordVltgIfLoVltgNoAssiRcvrTiMax.Val CalRegn02Cmn.FordVltgIfLoVltgRcvrTiMax.Val CalRegn02Cmn.FordVltgIfLoVltgThdHi.Val CalRegn02Cmn.FordVltgIfLoVltgThdLo.Val CalRegn02Cmn.FordVltgIfLoVltgThdMid.Val CalRegn02Cmn.FordVltgIfLoVltgThdMidToLoTiMax.Val CalRegn02Cmn.FordVltgIfLoVltgTqScaDwnRate.Val CalRegn02Cmn.FordVltgIfLoVltgTqScaUpRate.Val CalRegn02Cmn.FordVltgIfLoVltgTqScagFac.Val CalRegn02Cmn.FordVltgIfTrfcJamAsscTqMin.Val CalRegn02Cmn.FordVltgIfTrlrBackupAssiTqMin.Val CalRegn02Cmn.FordVltgIfVehBattCircR.Val CalRegn02Cmn.FullAssiRampUpRate.Val CalRegn02Cmn.InitLimpHomeRamp.Val CalRegn02Cmn.InitLimpHomeScar.Val CalRegn02Cmn.LimdAssiRamp.Val CalRegn02Cmn.LimdAssiRampUpRate.Val CalRegn02Cmn.LimdAssiRampUpRateFaild.Val CalRegn02Cmn.LimdAssiScar.Val CalRegn02Cmn.LoaMgrCurrIvtrMtgtnRate.Val CalRegn02Cmn.LoaMgrCurrIvtrMtgtnSca.Val CalRegn02Cmn.LoaMgrCurrMeasMtgtnRate.Val CalRegn02Cmn.LoaMgrCurrMeasMtgtnSca.Val CalRegn02Cmn.LoaMgrIvtrMtgtnRate.Val CalRegn02Cmn.LoaMgrIvtrMtgtnSca.Val CalRegn02Cmn.LoaMgrLimdStRate.Val CalRegn02Cmn.LoaMgrLimdStSca.Val CalRegn02Cmn.LoaMgrMotAgMtgtnRate.Val CalRegn02Cmn.LoaMgrMotAgMtgtnSca.Val CalRegn02Cmn.MotRplCoggCfgMotAgTiDly.Val CalRegn02Cmn.MotRplCoggCfgMotCurrDaxRplBilnrSeln.Ary1D CalRegn02Cmn.MotRplCoggCfgMotCurrQaxRpl.Ary1D CalRegn02Cmn.MotRplCoggCfgMotTqCmdCurrRgltrBwCmpMgnY.Ary2D CalRegn02Cmn.MotRplCoggCfgMotTqCmdCurrRgltrBwCmpPhaY.Ary2D CalRegn02Cmn.MotRplCoggCfgMotTqCmdCurrRgltrBwCmpX.Ary1D CalRegn02Cmn.MotRplCoggCfgMotTqRplOrder1X.Ary2D CalRegn02Cmn.MotRplCoggCfgMotTqRplOrder1Y.Ary2D CalRegn02Cmn.MotRplCoggCfgMotTqRplOrder2X.Ary2D CalRegn02Cmn.MotRplCoggCfgMotTqRplOrder2Y.Ary2D CalRegn02Cmn.MotRplCoggCfgMotTqRplOrder3X.Ary2D CalRegn02Cmn.MotRplCoggCfgMotTqRplOrder3Y.Ary2D CalRegn02Cmn.MotRplCoggCfgMotVelBilnrSeln.Ary1D CalRegn02Cmn.MotRplCoggCmdHrmncOrder1Elec.Val CalRegn02Cmn.MotRplCoggCmdHrmncOrder2Elec.Val CalRegn02Cmn.MotRplCoggCmdHrmncOrder3Elec.Val CalRegn02Cmn.NormLimpHomeRamp.Val CalRegn02Cmn.NormLimpHomeScar.Val CalRegn02Cmn.NxtrCalIdsCal1DevlpAuthor.Ary1D CalRegn02Cmn.NxtrCalIdsCal1DevlpDesc.Ary1D CalRegn02Cmn.NxtrCalIdsCal1DevlpRelNr.Val CalRegn02Cmn.NxtrCalIdsCal1DevlpRelSt.Val CalRegn02Cmn.NxtrCalIdsCal1DevlpTiStamp.Val CalRegn02Cmn.NxtrCalIdsCal1DevlpVers.Val CalRegn02Cmn.ShtdwnRamp.Val /end SUB_GROUP
 /begin FUNCTION_LIST /end FUNCTION_LIST
 /begin REF_CHARACTERISTIC /end REF_CHARACTERISTIC
 /begin REF_MEASUREMENT /end REF_MEASUREMENT
/end GROUP
/begin GROUP CalRegn02Cmn.FordBlaBoxIfCmnVehSteerRat.Val "MICROSAR RTE" /begin SUB_GROUP /end SUB_GROUP /begin FUNCTION_LIST /end FUNCTION_LIST /begin REF_CHARACTERISTIC CalRegn02Cmn.FordBlaBoxIfCmnVehSteerRat.Val /end REF_CHARACTERISTIC /begin REF_MEASUREMENT /end REF_MEASUREMENT /end GROUP
/begin GROUP CalRegn02Cmn.FordBlaBoxIfCmnVehWhlBas.Val "MICROSAR RTE" /begin SUB_GROUP /end SUB_GROUP /begin FUNCTION_LIST /end FUNCTION_LIST /begin REF_CHARACTERISTIC CalRegn02Cmn.FordBlaBoxIfCmnVehWhlBas.Val /end REF_CHARACTERISTIC /begin REF_MEASUREMENT /end REF_MEASUREMENT /end GROUP
/begin GROUP CalRegn02Cmn.FordCanDtcInhbFactryModThd.Val "MICROSAR RTE" /begin SUB_GROUP /end SUB_GROUP /begin FUNCTION_LIST /end FUNCTION_LIST /begin REF_CHARACTERISTIC CalRegn02Cmn.FordCanDtcInhbFactryModThd.Val /end REF_CHARACTERISTIC /begin REF_MEASUREMENT /end REF_MEASUREMENT /end GROUP
/begin GROUP CalRegn02Cmn.FordCanDtcInhbTransptModThd.Val "MICROSAR RTE" /begin SUB_GROUP /end SUB_GROUP /begin FUNCTION_LIST /end FUNCTION_LIST /begin REF_CHARACTERISTIC CalRegn02Cmn.FordCanDtcInhbTransptModThd.Val /end REF_CHARACTERISTIC /begin REF_MEASUREMENT /end REF_MEASUREMENT /end GROUP
/begin GROUP CalRegn02Cmn.FordCmdArbnActvNiblCtrlDeactvn.Ary1D "MICROSAR RTE" /begin SUB_GROUP /end SUB_GROUP /begin FUNCTION_LIST /end FUNCTION_LIST /begin REF_CHARACTERISTIC CalRegn02Cmn.FordCmdArbnActvNiblCtrlDeactvn.Ary1D /end REF_CHARACTERISTIC /begin REF_MEASUREMENT /end REF_MEASUREMENT /end GROUP
/begin GROUP CalRegn02Cmn.FordCmdArbnActvNiblCtrlDeniedActvnReq.Ary1D "MICROSAR RTE" /begin SUB_GROUP /end SUB_GROUP /begin FUNCTION_LIST /end FUNCTION_LIST /begin REF_CHARACTERISTIC CalRegn02Cmn.FordCmdArbnActvNiblCtrlDeniedActvnReq.Ary1D /end REF_CHARACTERISTIC /begin REF_MEASUREMENT /end REF_MEASUREMENT /end GROUP
/begin GROUP CalRegn02Cmn.FordCmdArbnDrvrSteerDeniedActvnReq.Ary1D "MICROSAR RTE" /begin SUB_GROUP /end SUB_GROUP /begin FUNCTION_LIST /end FUNCTION_LIST /begin REF_CHARACTERISTIC CalRegn02Cmn.FordCmdArbnDrvrSteerDeniedActvnReq.Ary1D /end REF_CHARACTERISTIC /begin REF_MEASUREMENT /end REF_MEASUREMENT /end GROUP
/begin GROUP CalRegn02Cmn.FordCmdArbnDrvrSteerRcmdnDeactvn.Ary1D "MICROSAR RTE" /begin SUB_GROUP /end SUB_GROUP /begin FUNCTION_LIST /end FUNCTION_LIST /begin REF_CHARACTERISTIC CalRegn02Cmn.FordCmdArbnDrvrSteerRcmdnDeactvn.Ary1D /end REF_CHARACTERISTIC /begin REF_MEASUREMENT /end REF_MEASUREMENT /end GROUP
/begin GROUP CalRegn02Cmn.FordCmdArbnEvasSteerAssiDeactvn.Ary1D "MICROSAR RTE" /begin SUB_GROUP /end SUB_GROUP /begin FUNCTION_LIST /end FUNCTION_LIST /begin REF_CHARACTERISTIC CalRegn02Cmn.FordCmdArbnEvasSteerAssiDeactvn.Ary1D /end REF_CHARACTERISTIC /begin REF_MEASUREMENT /end REF_MEASUREMENT /end GROUP
/begin GROUP CalRegn02Cmn.FordCmdArbnEvasSteerDeniedActvnReq.Ary1D "MICROSAR RTE" /begin SUB_GROUP /end SUB_GROUP /begin FUNCTION_LIST /end FUNCTION_LIST /begin REF_CHARACTERISTIC CalRegn02Cmn.FordCmdArbnEvasSteerDeniedActvnReq.Ary1D /end REF_CHARACTERISTIC /begin REF_MEASUREMENT /end REF_MEASUREMENT /end GROUP
/begin GROUP CalRegn02Cmn.FordCmdArbnExtAgCtrlDeactvn.Ary1D "MICROSAR RTE" /begin SUB_GROUP /end SUB_GROUP /begin FUNCTION_LIST /end FUNCTION_LIST /begin REF_CHARACTERISTIC CalRegn02Cmn.FordCmdArbnExtAgCtrlDeactvn.Ary1D /end REF_CHARACTERISTIC /begin REF_MEASUREMENT /end REF_MEASUREMENT /end GROUP
/begin GROUP CalRegn02Cmn.FordCmdArbnExtAgDeniedActvnReq.Ary1D "MICROSAR RTE" /begin SUB_GROUP /end SUB_GROUP /begin FUNCTION_LIST /end FUNCTION_LIST /begin REF_CHARACTERISTIC CalRegn02Cmn.FordCmdArbnExtAgDeniedActvnReq.Ary1D /end REF_CHARACTERISTIC /begin REF_MEASUREMENT /end REF_MEASUREMENT /end GROUP
/begin GROUP CalRegn02Cmn.FordCmdArbnLaneDprtrWarnDeactvn.Ary1D "MICROSAR RTE" /begin SUB_GROUP /end SUB_GROUP /begin FUNCTION_LIST /end FUNCTION_LIST /begin REF_CHARACTERISTIC CalRegn02Cmn.FordCmdArbnLaneDprtrWarnDeactvn.Ary1D /end REF_CHARACTERISTIC /begin REF_MEASUREMENT /end REF_MEASUREMENT /end GROUP
/begin GROUP CalRegn02Cmn.FordCmdArbnLaneDprtrWarnDeniedActvnReq.Ary1D "MICROSAR RTE" /begin SUB_GROUP /end SUB_GROUP /begin FUNCTION_LIST /end FUNCTION_LIST /begin REF_CHARACTERISTIC CalRegn02Cmn.FordCmdArbnLaneDprtrWarnDeniedActvnReq.Ary1D /end REF_CHARACTERISTIC /begin REF_MEASUREMENT /end REF_MEASUREMENT /end GROUP
/begin GROUP CalRegn02Cmn.FordCmdArbnLaneKeepAssiDeactvn.Ary1D "MICROSAR RTE" /begin SUB_GROUP /end SUB_GROUP /begin FUNCTION_LIST /end FUNCTION_LIST /begin REF_CHARACTERISTIC CalRegn02Cmn.FordCmdArbnLaneKeepAssiDeactvn.Ary1D /end REF_CHARACTERISTIC /begin REF_MEASUREMENT /end REF_MEASUREMENT /end GROUP
/begin GROUP CalRegn02Cmn.FordCmdArbnLaneKeepAssiDeniedActvnReq.Ary1D "MICROSAR RTE" /begin SUB_GROUP /end SUB_GROUP /begin FUNCTION_LIST /end FUNCTION_LIST /begin REF_CHARACTERISTIC CalRegn02Cmn.FordCmdArbnLaneKeepAssiDeniedActvnReq.Ary1D /end REF_CHARACTERISTIC /begin REF_MEASUREMENT /end REF_MEASUREMENT /end GROUP
/begin GROUP CalRegn02Cmn.FordCmdArbnLatCtrlDeactvn.Ary1D "MICROSAR RTE" /begin SUB_GROUP /end SUB_GROUP /begin FUNCTION_LIST /end FUNCTION_LIST /begin REF_CHARACTERISTIC CalRegn02Cmn.FordCmdArbnLatCtrlDeactvn.Ary1D /end REF_CHARACTERISTIC /begin REF_MEASUREMENT /end REF_MEASUREMENT /end GROUP
/begin GROUP CalRegn02Cmn.FordCmdArbnLatCtrlDeniedActvnReq.Ary1D "MICROSAR RTE" /begin SUB_GROUP /end SUB_GROUP /begin FUNCTION_LIST /end FUNCTION_LIST /begin REF_CHARACTERISTIC CalRegn02Cmn.FordCmdArbnLatCtrlDeniedActvnReq.Ary1D /end REF_CHARACTERISTIC /begin REF_MEASUREMENT /end REF_MEASUREMENT /end GROUP
/begin GROUP CalRegn02Cmn.FordCmdArbnNonStMask.Ary1D "MICROSAR RTE" /begin SUB_GROUP /end SUB_GROUP /begin FUNCTION_LIST /end FUNCTION_LIST /begin REF_CHARACTERISTIC CalRegn02Cmn.FordCmdArbnNonStMask.Ary1D /end REF_CHARACTERISTIC /begin REF_MEASUREMENT /end REF_MEASUREMENT /end GROUP
/begin GROUP CalRegn02Cmn.FordCmdArbnNormAssiTqThd.Val "MICROSAR RTE" /begin SUB_GROUP /end SUB_GROUP /begin FUNCTION_LIST /end FUNCTION_LIST /begin REF_CHARACTERISTIC CalRegn02Cmn.FordCmdArbnNormAssiTqThd.Val /end REF_CHARACTERISTIC /begin REF_MEASUREMENT /end REF_MEASUREMENT /end GROUP
/begin GROUP CalRegn02Cmn.FordCmdArbnPullDriftCmpDeactvn.Ary1D "MICROSAR RTE" /begin SUB_GROUP /end SUB_GROUP /begin FUNCTION_LIST /end FUNCTION_LIST /begin REF_CHARACTERISTIC CalRegn02Cmn.FordCmdArbnPullDriftCmpDeactvn.Ary1D /end REF_CHARACTERISTIC /begin REF_MEASUREMENT /end REF_MEASUREMENT /end GROUP
/begin GROUP CalRegn02Cmn.FordCmdArbnPullDriftCmpDeniedActvnReq.Ary1D "MICROSAR RTE" /begin SUB_GROUP /end SUB_GROUP /begin FUNCTION_LIST /end FUNCTION_LIST /begin REF_CHARACTERISTIC CalRegn02Cmn.FordCmdArbnPullDriftCmpDeniedActvnReq.Ary1D /end REF_CHARACTERISTIC /begin REF_MEASUREMENT /end REF_MEASUREMENT /end GROUP
/begin GROUP CalRegn02Cmn.FordCmdArbnPullDriftCmpLrngDeactvn.Ary1D "MICROSAR RTE" /begin SUB_GROUP /end SUB_GROUP /begin FUNCTION_LIST /end FUNCTION_LIST /begin REF_CHARACTERISTIC CalRegn02Cmn.FordCmdArbnPullDriftCmpLrngDeactvn.Ary1D /end REF_CHARACTERISTIC /begin REF_MEASUREMENT /end REF_MEASUREMENT /end GROUP
/begin GROUP CalRegn02Cmn.FordCmdArbnPullDriftCmpLrngDeniedActvnReq.Ary1D "MICROSAR RTE" /begin SUB_GROUP /end SUB_GROUP /begin FUNCTION_LIST /end FUNCTION_LIST
 /begin REF_CHARACTERISTIC CalRegn02Cmn.FordCmdArbnPullDriftCmpLrngDeniedActvnReq.Ary1D /end REF_CHARACTERISTIC
 /begin REF_MEASUREMENT /end REF_MEASUREMENT
/end GROUP
/begin GROUP CalRegn02Cmn.FordCmdArbnSpare1Deactvn.Ary1D "MICROSAR RTE" /begin SUB_GROUP /end SUB_GROUP /begin FUNCTION_LIST /end FUNCTION_LIST /begin REF_CHARACTERISTIC CalRegn02Cmn.FordCmdArbnSpare1Deactvn.Ary1D /end REF_CHARACTERISTIC /begin REF_MEASUREMENT /end REF_MEASUREMENT /end GROUP
/begin GROUP CalRegn02Cmn.FordCmdArbnSpare1DeniedActvnReq.Ary1D "MICROSAR RTE" /begin SUB_GROUP /end SUB_GROUP /begin FUNCTION_LIST /end FUNCTION_LIST /begin REF_CHARACTERISTIC CalRegn02Cmn.FordCmdArbnSpare1DeniedActvnReq.Ary1D /end REF_CHARACTERISTIC /begin REF_MEASUREMENT /end REF_MEASUREMENT /end GROUP
/begin GROUP CalRegn02Cmn.FordCmdArbnSpare2Deactvn.Ary1D "MICROSAR RTE" /begin SUB_GROUP /end SUB_GROUP /begin FUNCTION_LIST /end FUNCTION_LIST /begin REF_CHARACTERISTIC CalRegn02Cmn.FordCmdArbnSpare2Deactvn.Ary1D /end REF_CHARACTERISTIC /begin REF_MEASUREMENT /end REF_MEASUREMENT /end GROUP
/begin GROUP CalRegn02Cmn.FordCmdArbnSpare2DeniedActvnReq.Ary1D "MICROSAR RTE" /begin SUB_GROUP /end SUB_GROUP /begin FUNCTION_LIST /end FUNCTION_LIST /begin REF_CHARACTERISTIC CalRegn02Cmn.FordCmdArbnSpare2DeniedActvnReq.Ary1D /end REF_CHARACTERISTIC /begin REF_MEASUREMENT /end REF_MEASUREMENT /end GROUP
/begin GROUP CalRegn02Cmn.FordCmdArbnSpare3Deactvn.Ary1D "MICROSAR RTE" /begin SUB_GROUP /end SUB_GROUP /begin FUNCTION_LIST /end FUNCTION_LIST /begin REF_CHARACTERISTIC CalRegn02Cmn.FordCmdArbnSpare3Deactvn.Ary1D /end REF_CHARACTERISTIC /begin REF_MEASUREMENT /end REF_MEASUREMENT /end GROUP
/begin GROUP CalRegn02Cmn.FordCmdArbnSpare3DeniedActvnReq.Ary1D "MICROSAR RTE" /begin SUB_GROUP /end SUB_GROUP /begin FUNCTION_LIST /end FUNCTION_LIST /begin REF_CHARACTERISTIC CalRegn02Cmn.FordCmdArbnSpare3DeniedActvnReq.Ary1D /end REF_CHARACTERISTIC /begin REF_MEASUREMENT /end REF_MEASUREMENT /end GROUP
/begin GROUP CalRegn02Cmn.FordCmdArbnSteerDstbcDeactvn.Ary1D "MICROSAR RTE" /begin SUB_GROUP /end SUB_GROUP /begin FUNCTION_LIST /end FUNCTION_LIST /begin REF_CHARACTERISTIC CalRegn02Cmn.FordCmdArbnSteerDstbcDeactvn.Ary1D /end REF_CHARACTERISTIC /begin REF_MEASUREMENT /end REF_MEASUREMENT /end GROUP
/begin GROUP CalRegn02Cmn.FordCmdArbnSteerDstbcDeniedActvnReq.Ary1D "MICROSAR RTE" /begin SUB_GROUP /end SUB_GROUP /begin FUNCTION_LIST /end FUNCTION_LIST /begin REF_CHARACTERISTIC CalRegn02Cmn.FordCmdArbnSteerDstbcDeniedActvnReq.Ary1D /end REF_CHARACTERISTIC /begin REF_MEASUREMENT /end REF_MEASUREMENT /end GROUP
/begin GROUP CalRegn02Cmn.FordHwAgArbnMotVelVldFlgRcvrTiThd.Val "MICROSAR RTE" /begin SUB_GROUP /end SUB_GROUP /begin FUNCTION_LIST /end FUNCTION_LIST /begin REF_CHARACTERISTIC CalRegn02Cmn.FordHwAgArbnMotVelVldFlgRcvrTiThd.Val /end REF_CHARACTERISTIC /begin REF_MEASUREMENT /end REF_MEASUREMENT /end GROUP
/begin GROUP CalRegn02Cmn.FordHwAgArbnNonAbsCentrNotDetdTiThd.Val "MICROSAR RTE" /begin SUB_GROUP /end SUB_GROUP /begin FUNCTION_LIST /end FUNCTION_LIST /begin REF_CHARACTERISTIC CalRegn02Cmn.FordHwAgArbnNonAbsCentrNotDetdTiThd.Val /end REF_CHARACTERISTIC /begin REF_MEASUREMENT /end REF_MEASUREMENT /end GROUP
/begin GROUP CalRegn02Cmn.FordHwAgArbnPhyRackTrvlThd.Val "MICROSAR RTE" /begin SUB_GROUP /end SUB_GROUP /begin FUNCTION_LIST /end FUNCTION_LIST /begin REF_CHARACTERISTIC CalRegn02Cmn.FordHwAgArbnPhyRackTrvlThd.Val /end REF_CHARACTERISTIC /begin REF_MEASUREMENT /end REF_MEASUREMENT /end GROUP
/begin GROUP CalRegn02Cmn.FordHwAgArbnRelPosnVldFlgRcvryTiThd.Val "MICROSAR RTE" /begin SUB_GROUP /end SUB_GROUP /begin FUNCTION_LIST /end FUNCTION_LIST /begin REF_CHARACTERISTIC CalRegn02Cmn.FordHwAgArbnRelPosnVldFlgRcvryTiThd.Val /end REF_CHARACTERISTIC /begin REF_MEASUREMENT /end REF_MEASUREMENT /end GROUP
/begin GROUP CalRegn02Cmn.FordHwTqCdngAppldFinalMotTqVldTiThd.Val "MICROSAR RTE" /begin SUB_GROUP /end SUB_GROUP /begin FUNCTION_LIST /end FUNCTION_LIST /begin REF_CHARACTERISTIC CalRegn02Cmn.FordHwTqCdngAppldFinalMotTqVldTiThd.Val /end REF_CHARACTERISTIC /begin REF_MEASUREMENT /end REF_MEASUREMENT /end GROUP
/begin GROUP CalRegn02Cmn.FordHwTqCdngInpTqRawVldTiThd.Val "MICROSAR RTE" /begin SUB_GROUP /end SUB_GROUP /begin FUNCTION_LIST /end FUNCTION_LIST /begin REF_CHARACTERISTIC CalRegn02Cmn.FordHwTqCdngInpTqRawVldTiThd.Val /end REF_CHARACTERISTIC /begin REF_MEASUREMENT /end REF_MEASUREMENT /end GROUP
/begin GROUP CalRegn02Cmn.FordHwTqCmdOvrlLimrCombdBwY.Ary1D "MICROSAR RTE" /begin SUB_GROUP /end SUB_GROUP /begin FUNCTION_LIST /end FUNCTION_LIST /begin REF_CHARACTERISTIC CalRegn02Cmn.FordHwTqCmdOvrlLimrCombdBwY.Ary1D /end REF_CHARACTERISTIC /begin REF_MEASUREMENT /end REF_MEASUREMENT /end GROUP
/begin GROUP CalRegn02Cmn.FordHwTqCmdOvrlLimrCombdTqRateY.Ary1D "MICROSAR RTE" /begin SUB_GROUP /end SUB_GROUP /begin FUNCTION_LIST /end FUNCTION_LIST /begin REF_CHARACTERISTIC CalRegn02Cmn.FordHwTqCmdOvrlLimrCombdTqRateY.Ary1D /end REF_CHARACTERISTIC /begin REF_MEASUREMENT /end REF_MEASUREMENT /end GROUP
/begin GROUP CalRegn02Cmn.FordHwTqCmdOvrlLimrCombdTqSatnY.Ary1D "MICROSAR RTE" /begin SUB_GROUP /end SUB_GROUP /begin FUNCTION_LIST /end FUNCTION_LIST /begin REF_CHARACTERISTIC CalRegn02Cmn.FordHwTqCmdOvrlLimrCombdTqSatnY.Ary1D /end REF_CHARACTERISTIC /begin REF_MEASUREMENT /end REF_MEASUREMENT /end GROUP
/begin GROUP CalRegn02Cmn.FordHwTqCmdOvrlLimrCombdVehSpdBreakPtX.Ary1D "MICROSAR RTE" /begin SUB_GROUP /end SUB_GROUP /begin FUNCTION_LIST /end FUNCTION_LIST /begin REF_CHARACTERISTIC CalRegn02Cmn.FordHwTqCmdOvrlLimrCombdVehSpdBreakPtX.Ary1D /end REF_CHARACTERISTIC /begin REF_MEASUREMENT /end REF_MEASUREMENT /end GROUP
/begin GROUP CalRegn02Cmn.FordHwTqCmdOvrlLimrDftSpdRate.Val "MICROSAR RTE" /begin SUB_GROUP /end SUB_GROUP /begin FUNCTION_LIST /end FUNCTION_LIST /begin REF_CHARACTERISTIC CalRegn02Cmn.FordHwTqCmdOvrlLimrDftSpdRate.Val /end REF_CHARACTERISTIC /begin REF_MEASUREMENT /end REF_MEASUREMENT /end GROUP
/begin GROUP CalRegn02Cmn.FordHwTqCmdOvrlLimrDftSpdRcvrRate.Val "MICROSAR RTE" /begin SUB_GROUP /end SUB_GROUP /begin FUNCTION_LIST /end FUNCTION_LIST /begin REF_CHARACTERISTIC CalRegn02Cmn.FordHwTqCmdOvrlLimrDftSpdRcvrRate.Val /end REF_CHARACTERISTIC /begin REF_MEASUREMENT /end REF_MEASUREMENT /end GROUP
/begin GROUP CalRegn02Cmn.FordHwTqCmdOvrlLimrLkaBwY.Ary1D "MICROSAR RTE" /begin SUB_GROUP /end SUB_GROUP /begin FUNCTION_LIST /end FUNCTION_LIST /begin REF_CHARACTERISTIC CalRegn02Cmn.FordHwTqCmdOvrlLimrLkaBwY.Ary1D /end REF_CHARACTERISTIC /begin REF_MEASUREMENT /end REF_MEASUREMENT /end GROUP
/begin GROUP CalRegn02Cmn.FordHwTqCmdOvrlLimrLkaTqRateY.Ary1D "MICROSAR RTE" /begin SUB_GROUP /end SUB_GROUP /begin FUNCTION_LIST /end FUNCTION_LIST /begin REF_CHARACTERISTIC CalRegn02Cmn.FordHwTqCmdOvrlLimrLkaTqRateY.Ary1D /end REF_CHARACTERISTIC /begin REF_MEASUREMENT /end REF_MEASUREMENT /end GROUP
/begin GROUP CalRegn02Cmn.FordHwTqCmdOvrlLimrLkaTqSatnY.Ary1D "MICROSAR RTE" /begin SUB_GROUP /end SUB_GROUP /begin FUNCTION_LIST /end FUNCTION_LIST /begin REF_CHARACTERISTIC CalRegn02Cmn.FordHwTqCmdOvrlLimrLkaTqSatnY.Ary1D /end REF_CHARACTERISTIC /begin REF_MEASUREMENT /end REF_MEASUREMENT /end GROUP
/begin GROUP CalRegn02Cmn.FordHwTqCmdOvrlLimrVehSpdBreakPtX.Ary1D "MICROSAR RTE" /begin SUB_GROUP /end SUB_GROUP /begin FUNCTION_LIST /end FUNCTION_LIST /begin REF_CHARACTERISTIC CalRegn02Cmn.FordHwTqCmdOvrlLimrVehSpdBreakPtX.Ary1D /end REF_CHARACTERISTIC /begin REF_MEASUREMENT /end REF_MEASUREMENT /end GROUP
/begin GROUP CalRegn02Cmn.FordMotTqCmdOvrlLimrDftSpdRate.Val "MICROSAR RTE" /begin SUB_GROUP /end SUB_GROUP /begin FUNCTION_LIST /end FUNCTION_LIST /begin REF_CHARACTERISTIC CalRegn02Cmn.FordMotTqCmdOvrlLimrDftSpdRate.Val /end REF_CHARACTERISTIC /begin REF_MEASUREMENT /end REF_MEASUREMENT /end GROUP
/begin GROUP CalRegn02Cmn.FordMotTqCmdOvrlLimrDftSpdRcvrRate.Val "MICROSAR RTE" /begin SUB_GROUP /end SUB_GROUP /begin FUNCTION_LIST /end FUNCTION_LIST /begin REF_CHARACTERISTIC CalRegn02Cmn.FordMotTqCmdOvrlLimrDftSpdRcvrRate.Val /end REF_CHARACTERISTIC /begin REF_MEASUREMENT /end REF_MEASUREMENT /end GROUP
/begin GROUP CalRegn02Cmn.FordMotTqCmdOvrlLimrHiFrqMonrActvNiblCtrlDcTqTrendThd.Val "MICROSAR RTE" /begin SUB_GROUP /end SUB_GROUP /begin FUNCTION_LIST /end FUNCTION_LIST
 /begin REF_CHARACTERISTIC CalRegn02Cmn.FordMotTqCmdOvrlLimrHiFrqMonrActvNiblCtrlDcTqTrendThd.Val /end REF_CHARACTERISTIC
 /begin REF_MEASUREMENT /end REF_MEASUREMENT
/end GROUP
/begin GROUP CalRegn02Cmn.FordMotTqCmdOvrlLimrHiFrqMonrActvNiblCtrlLoFrqTiThd.Val "MICROSAR RTE" /begin SUB_GROUP /end SUB_GROUP /begin FUNCTION_LIST /end FUNCTION_LIST
 /begin REF_CHARACTERISTIC CalRegn02Cmn.FordMotTqCmdOvrlLimrHiFrqMonrActvNiblCtrlLoFrqTiThd.Val /end REF_CHARACTERISTIC
 /begin REF_MEASUREMENT /end REF_MEASUREMENT
/end GROUP
/begin GROUP CalRegn02Cmn.FordMotTqCmdOvrlLimrHiFrqMonrActvNiblCtrlMaxMotTq.Val "MICROSAR RTE" /begin SUB_GROUP /end SUB_GROUP /begin FUNCTION_LIST /end FUNCTION_LIST
 /begin REF_CHARACTERISTIC CalRegn02Cmn.FordMotTqCmdOvrlLimrHiFrqMonrActvNiblCtrlMaxMotTq.Val /end REF_CHARACTERISTIC
 /begin REF_MEASUREMENT /end REF_MEASUREMENT
/end GROUP
/begin GROUP CalRegn02Cmn.FordMotTqCmdOvrlLimrHiFrqMonrLaneDprtrWarnDcTqTrendThd.Val "MICROSAR RTE" /begin SUB_GROUP /end SUB_GROUP /begin FUNCTION_LIST /end FUNCTION_LIST
 /begin REF_CHARACTERISTIC CalRegn02Cmn.FordMotTqCmdOvrlLimrHiFrqMonrLaneDprtrWarnDcTqTrendThd.Val /end REF_CHARACTERISTIC
 /begin REF_MEASUREMENT /end REF_MEASUREMENT
/end GROUP
/begin GROUP CalRegn02Cmn.FordMotTqCmdOvrlLimrHiFrqMonrLaneDprtrWarnLoFrqTiThd.Val "MICROSAR RTE" /begin SUB_GROUP /end SUB_GROUP /begin FUNCTION_LIST /end FUNCTION_LIST
 /begin REF_CHARACTERISTIC CalRegn02Cmn.FordMotTqCmdOvrlLimrHiFrqMonrLaneDprtrWarnLoFrqTiThd.Val /end REF_CHARACTERISTIC
 /begin REF_MEASUREMENT /end REF_MEASUREMENT
/end GROUP
/begin GROUP CalRegn02Cmn.FordMotTqCmdOvrlLimrHiFrqMonrLaneDprtrWarnMaxMotTq.Val "MICROSAR RTE" /begin SUB_GROUP /end SUB_GROUP /begin FUNCTION_LIST /end FUNCTION_LIST
 /begin REF_CHARACTERISTIC CalRegn02Cmn.FordMotTqCmdOvrlLimrHiFrqMonrLaneDprtrWarnMaxMotTq.Val /end REF_CHARACTERISTIC
 /begin REF_MEASUREMENT /end REF_MEASUREMENT
/end GROUP
/begin GROUP CalRegn02Cmn.FordMotTqCmdOvrlLimrHiFrqMonrTqTrendAlpha.Val "MICROSAR RTE" /begin SUB_GROUP /end SUB_GROUP /begin FUNCTION_LIST /end FUNCTION_LIST /begin REF_CHARACTERISTIC CalRegn02Cmn.FordMotTqCmdOvrlLimrHiFrqMonrTqTrendAlpha.Val /end REF_CHARACTERISTIC /begin REF_MEASUREMENT /end REF_MEASUREMENT /end GROUP
/begin GROUP CalRegn02Cmn.FordMotTqCmdOvrlLimrHiFrqMonrZeroBandTq.Val "MICROSAR RTE" /begin SUB_GROUP /end SUB_GROUP /begin FUNCTION_LIST /end FUNCTION_LIST /begin REF_CHARACTERISTIC CalRegn02Cmn.FordMotTqCmdOvrlLimrHiFrqMonrZeroBandTq.Val /end REF_CHARACTERISTIC /begin REF_MEASUREMENT /end REF_MEASUREMENT /end GROUP
/begin GROUP CalRegn02Cmn.FordMotTqCmdOvrlLimrHwVelLoPassFrq.Val "MICROSAR RTE" /begin SUB_GROUP /end SUB_GROUP /begin FUNCTION_LIST /end FUNCTION_LIST /begin REF_CHARACTERISTIC CalRegn02Cmn.FordMotTqCmdOvrlLimrHwVelLoPassFrq.Val /end REF_CHARACTERISTIC /begin REF_MEASUREMENT /end REF_MEASUREMENT /end GROUP
/begin GROUP CalRegn02Cmn.FordMotTqCmdOvrlLimrLatCtrlBwY.Val "MICROSAR RTE" /begin SUB_GROUP /end SUB_GROUP /begin FUNCTION_LIST /end FUNCTION_LIST /begin REF_CHARACTERISTIC CalRegn02Cmn.FordMotTqCmdOvrlLimrLatCtrlBwY.Val /end REF_CHARACTERISTIC /begin REF_MEASUREMENT /end REF_MEASUREMENT /end GROUP
/begin GROUP CalRegn02Cmn.FordMotTqCmdOvrlLimrLatCtrlTqRateY.Ary1D "MICROSAR RTE" /begin SUB_GROUP /end SUB_GROUP /begin FUNCTION_LIST /end FUNCTION_LIST /begin REF_CHARACTERISTIC CalRegn02Cmn.FordMotTqCmdOvrlLimrLatCtrlTqRateY.Ary1D /end REF_CHARACTERISTIC /begin REF_MEASUREMENT /end REF_MEASUREMENT /end GROUP
/begin GROUP CalRegn02Cmn.FordMotTqCmdOvrlLimrLatCtrlTqSatnY.Ary1D "MICROSAR RTE" /begin SUB_GROUP /end SUB_GROUP /begin FUNCTION_LIST /end FUNCTION_LIST /begin REF_CHARACTERISTIC CalRegn02Cmn.FordMotTqCmdOvrlLimrLatCtrlTqSatnY.Ary1D /end REF_CHARACTERISTIC /begin REF_MEASUREMENT /end REF_MEASUREMENT /end GROUP
/begin GROUP CalRegn02Cmn.FordMotTqCmdOvrlLimrLatCtrlVehSpdBreakPtX.Ary1D "MICROSAR RTE" /begin SUB_GROUP /end SUB_GROUP /begin FUNCTION_LIST /end FUNCTION_LIST
 /begin REF_CHARACTERISTIC CalRegn02Cmn.FordMotTqCmdOvrlLimrLatCtrlVehSpdBreakPtX.Ary1D /end REF_CHARACTERISTIC
 /begin REF_MEASUREMENT /end REF_MEASUREMENT
/end GROUP
/begin GROUP CalRegn02Cmn.FordMotTqCmdOvrlLimrPullDriftCmpTqRateY.Ary1D "MICROSAR RTE" /begin SUB_GROUP /end SUB_GROUP /begin FUNCTION_LIST /end FUNCTION_LIST /begin REF_CHARACTERISTIC CalRegn02Cmn.FordMotTqCmdOvrlLimrPullDriftCmpTqRateY.Ary1D /end REF_CHARACTERISTIC /begin REF_MEASUREMENT /end REF_MEASUREMENT /end GROUP
/begin GROUP CalRegn02Cmn.FordMotTqCmdOvrlLimrPullDriftCmpTqSatnY.Ary1D "MICROSAR RTE" /begin SUB_GROUP /end SUB_GROUP /begin FUNCTION_LIST /end FUNCTION_LIST /begin REF_CHARACTERISTIC CalRegn02Cmn.FordMotTqCmdOvrlLimrPullDriftCmpTqSatnY.Ary1D /end REF_CHARACTERISTIC /begin REF_MEASUREMENT /end REF_MEASUREMENT /end GROUP
/begin GROUP CalRegn02Cmn.FordMotTqCmdOvrlLimrPullDriftCmpVehSpdBreakPtX.Ary1D "MICROSAR RTE" /begin SUB_GROUP /end SUB_GROUP /begin FUNCTION_LIST /end FUNCTION_LIST
 /begin REF_CHARACTERISTIC CalRegn02Cmn.FordMotTqCmdOvrlLimrPullDriftCmpVehSpdBreakPtX.Ary1D /end REF_CHARACTERISTIC
 /begin REF_MEASUREMENT /end REF_MEASUREMENT
/end GROUP
/begin GROUP CalRegn02Cmn.FordMotTqCmdOvrlLimrSteerReactnLimrCombAmpVehSpdLimX.Ary1D "MICROSAR RTE" /begin SUB_GROUP /end SUB_GROUP /begin FUNCTION_LIST /end FUNCTION_LIST
 /begin REF_CHARACTERISTIC CalRegn02Cmn.FordMotTqCmdOvrlLimrSteerReactnLimrCombAmpVehSpdLimX.Ary1D /end REF_CHARACTERISTIC
 /begin REF_MEASUREMENT /end REF_MEASUREMENT
/end GROUP
/begin GROUP CalRegn02Cmn.FordMotTqCmdOvrlLimrSteerReactnLimrCombAmpVehSpdLimY.Ary1D "MICROSAR RTE" /begin SUB_GROUP /end SUB_GROUP /begin FUNCTION_LIST /end FUNCTION_LIST
 /begin REF_CHARACTERISTIC CalRegn02Cmn.FordMotTqCmdOvrlLimrSteerReactnLimrCombAmpVehSpdLimY.Ary1D /end REF_CHARACTERISTIC
 /begin REF_MEASUREMENT /end REF_MEASUREMENT
/end GROUP
/begin GROUP CalRegn02Cmn.FordMotTqCmdOvrlLimrSteerReactnLimrCombOvrrunRampRateHwVelErrX.Ary1D "MICROSAR RTE" /begin SUB_GROUP /end SUB_GROUP /begin FUNCTION_LIST /end FUNCTION_LIST
 /begin REF_CHARACTERISTIC CalRegn02Cmn.FordMotTqCmdOvrlLimrSteerReactnLimrCombOvrrunRampRateHwVelErrX.Ary1D /end REF_CHARACTERISTIC
 /begin REF_MEASUREMENT /end REF_MEASUREMENT
/end GROUP
/begin GROUP CalRegn02Cmn.FordMotTqCmdOvrlLimrSteerReactnLimrCombOvrrunRampRateOutY.Ary1D "MICROSAR RTE" /begin SUB_GROUP /end SUB_GROUP /begin FUNCTION_LIST /end FUNCTION_LIST
 /begin REF_CHARACTERISTIC CalRegn02Cmn.FordMotTqCmdOvrlLimrSteerReactnLimrCombOvrrunRampRateOutY.Ary1D /end REF_CHARACTERISTIC
 /begin REF_MEASUREMENT /end REF_MEASUREMENT
/end GROUP
/begin GROUP CalRegn02Cmn.FordMotTqCmdOvrlLimrSteerReactnLimrCombdAmpOvrrun.Val "MICROSAR RTE" /begin SUB_GROUP /end SUB_GROUP /begin FUNCTION_LIST /end FUNCTION_LIST
 /begin REF_CHARACTERISTIC CalRegn02Cmn.FordMotTqCmdOvrlLimrSteerReactnLimrCombdAmpOvrrun.Val /end REF_CHARACTERISTIC
 /begin REF_MEASUREMENT /end REF_MEASUREMENT
/end GROUP
/begin GROUP CalRegn02Cmn.FordMotTqCmdOvrlLimrSteerReactnLimrCombdAmpRcvry.Val "MICROSAR RTE" /begin SUB_GROUP /end SUB_GROUP /begin FUNCTION_LIST /end FUNCTION_LIST
 /begin REF_CHARACTERISTIC CalRegn02Cmn.FordMotTqCmdOvrlLimrSteerReactnLimrCombdAmpRcvry.Val /end REF_CHARACTERISTIC
 /begin REF_MEASUREMENT /end REF_MEASUREMENT
/end GROUP
/begin GROUP CalRegn02Cmn.FordMotTqCmdOvrlLimrSteerReactnLimrCombdFixdOvrrunRampRate.Val "MICROSAR RTE" /begin SUB_GROUP /end SUB_GROUP /begin FUNCTION_LIST /end FUNCTION_LIST
 /begin REF_CHARACTERISTIC CalRegn02Cmn.FordMotTqCmdOvrlLimrSteerReactnLimrCombdFixdOvrrunRampRate.Val /end REF_CHARACTERISTIC
 /begin REF_MEASUREMENT /end REF_MEASUREMENT
/end GROUP
/begin GROUP CalRegn02Cmn.FordMotTqCmdOvrlLimrSteerReactnLimrCombdLimHys.Val "MICROSAR RTE" /begin SUB_GROUP /end SUB_GROUP /begin FUNCTION_LIST /end FUNCTION_LIST
 /begin REF_CHARACTERISTIC CalRegn02Cmn.FordMotTqCmdOvrlLimrSteerReactnLimrCombdLimHys.Val /end REF_CHARACTERISTIC
 /begin REF_MEASUREMENT /end REF_MEASUREMENT
/end GROUP
/begin GROUP CalRegn02Cmn.FordMotTqCmdOvrlLimrSteerReactnLimrCombdLimTqX.Ary2D "MICROSAR RTE" /begin SUB_GROUP /end SUB_GROUP /begin FUNCTION_LIST /end FUNCTION_LIST
 /begin REF_CHARACTERISTIC CalRegn02Cmn.FordMotTqCmdOvrlLimrSteerReactnLimrCombdLimTqX.Ary2D /end REF_CHARACTERISTIC
 /begin REF_MEASUREMENT /end REF_MEASUREMENT
/end GROUP
/begin GROUP CalRegn02Cmn.FordMotTqCmdOvrlLimrSteerReactnLimrCombdLimrHwVelY.Ary2D "MICROSAR RTE" /begin SUB_GROUP /end SUB_GROUP /begin FUNCTION_LIST /end FUNCTION_LIST
 /begin REF_CHARACTERISTIC CalRegn02Cmn.FordMotTqCmdOvrlLimrSteerReactnLimrCombdLimrHwVelY.Ary2D /end REF_CHARACTERISTIC
 /begin REF_MEASUREMENT /end REF_MEASUREMENT
/end GROUP
/begin GROUP CalRegn02Cmn.FordMotTqCmdOvrlLimrSteerReactnLimrCombdLimrVehSpd.Ary1D "MICROSAR RTE" /begin SUB_GROUP /end SUB_GROUP /begin FUNCTION_LIST /end FUNCTION_LIST
 /begin REF_CHARACTERISTIC CalRegn02Cmn.FordMotTqCmdOvrlLimrSteerReactnLimrCombdLimrVehSpd.Ary1D /end REF_CHARACTERISTIC
 /begin REF_MEASUREMENT /end REF_MEASUREMENT
/end GROUP
/begin GROUP CalRegn02Cmn.FordMotTqCmdOvrlLimrSteerReactnLimrCombdRcvryIdealRampRate.Val "MICROSAR RTE" /begin SUB_GROUP /end SUB_GROUP /begin FUNCTION_LIST /end FUNCTION_LIST
 /begin REF_CHARACTERISTIC CalRegn02Cmn.FordMotTqCmdOvrlLimrSteerReactnLimrCombdRcvryIdealRampRate.Val /end REF_CHARACTERISTIC
 /begin REF_MEASUREMENT /end REF_MEASUREMENT
/end GROUP
/begin GROUP CalRegn02Cmn.FordMotTqCmdOvrlLimrSteerReactnLimrCombdRcvryRampRateStg1.Val "MICROSAR RTE" /begin SUB_GROUP /end SUB_GROUP /begin FUNCTION_LIST /end FUNCTION_LIST
 /begin REF_CHARACTERISTIC CalRegn02Cmn.FordMotTqCmdOvrlLimrSteerReactnLimrCombdRcvryRampRateStg1.Val /end REF_CHARACTERISTIC
 /begin REF_MEASUREMENT /end REF_MEASUREMENT
/end GROUP
/begin GROUP CalRegn02Cmn.FordMotTqCmdOvrlLimrSteerReactnLimrCombdRcvryRampRateStg2.Val "MICROSAR RTE" /begin SUB_GROUP /end SUB_GROUP /begin FUNCTION_LIST /end FUNCTION_LIST
 /begin REF_CHARACTERISTIC CalRegn02Cmn.FordMotTqCmdOvrlLimrSteerReactnLimrCombdRcvryRampRateStg2.Val /end REF_CHARACTERISTIC
 /begin REF_MEASUREMENT /end REF_MEASUREMENT
/end GROUP
/begin GROUP CalRegn02Cmn.FordVehSpdArbnDrvnWhl.Logl "MICROSAR RTE" /begin SUB_GROUP /end SUB_GROUP /begin FUNCTION_LIST /end FUNCTION_LIST /begin REF_CHARACTERISTIC CalRegn02Cmn.FordVehSpdArbnDrvnWhl.Logl /end REF_CHARACTERISTIC /begin REF_MEASUREMENT /end REF_MEASUREMENT /end GROUP
/begin GROUP CalRegn02Cmn.FordVehSpdArbnTireCircumMax.Val "MICROSAR RTE" /begin SUB_GROUP /end SUB_GROUP /begin FUNCTION_LIST /end FUNCTION_LIST /begin REF_CHARACTERISTIC CalRegn02Cmn.FordVehSpdArbnTireCircumMax.Val /end REF_CHARACTERISTIC /begin REF_MEASUREMENT /end REF_MEASUREMENT /end GROUP
/begin GROUP CalRegn02Cmn.FordVehSpdArbnTireCircumMin.Val "MICROSAR RTE" /begin SUB_GROUP /end SUB_GROUP /begin FUNCTION_LIST /end FUNCTION_LIST /begin REF_CHARACTERISTIC CalRegn02Cmn.FordVehSpdArbnTireCircumMin.Val /end REF_CHARACTERISTIC /begin REF_MEASUREMENT /end REF_MEASUREMENT /end GROUP
/begin GROUP CalRegn02Cmn.FordVltgIfActvParkAssiAsscTqMin.Val "MICROSAR RTE" /begin SUB_GROUP /end SUB_GROUP /begin FUNCTION_LIST /end FUNCTION_LIST /begin REF_CHARACTERISTIC CalRegn02Cmn.FordVltgIfActvParkAssiAsscTqMin.Val /end REF_CHARACTERISTIC /begin REF_MEASUREMENT /end REF_MEASUREMENT /end GROUP
/begin GROUP CalRegn02Cmn.FordVltgIfEPSBattVltgDifThd.Val "MICROSAR RTE" /begin SUB_GROUP /end SUB_GROUP /begin FUNCTION_LIST /end FUNCTION_LIST /begin REF_CHARACTERISTIC CalRegn02Cmn.FordVltgIfEPSBattVltgDifThd.Val /end REF_CHARACTERISTIC /begin REF_MEASUREMENT /end REF_MEASUREMENT /end GROUP
/begin GROUP CalRegn02Cmn.FordVltgIfEpsBattCurrLim.Val "MICROSAR RTE" /begin SUB_GROUP /end SUB_GROUP /begin FUNCTION_LIST /end FUNCTION_LIST /begin REF_CHARACTERISTIC CalRegn02Cmn.FordVltgIfEpsBattCurrLim.Val /end REF_CHARACTERISTIC /begin REF_MEASUREMENT /end REF_MEASUREMENT /end GROUP
/begin GROUP CalRegn02Cmn.FordVltgIfEpsCurrLim.Val "MICROSAR RTE" /begin SUB_GROUP /end SUB_GROUP /begin FUNCTION_LIST /end FUNCTION_LIST /begin REF_CHARACTERISTIC CalRegn02Cmn.FordVltgIfEpsCurrLim.Val /end REF_CHARACTERISTIC /begin REF_MEASUREMENT /end REF_MEASUREMENT /end GROUP
/begin GROUP CalRegn02Cmn.FordVltgIfEvasSteerAssiTqMin.Val "MICROSAR RTE" /begin SUB_GROUP /end SUB_GROUP /begin FUNCTION_LIST /end FUNCTION_LIST /begin REF_CHARACTERISTIC CalRegn02Cmn.FordVltgIfEvasSteerAssiTqMin.Val /end REF_CHARACTERISTIC /begin REF_MEASUREMENT /end REF_MEASUREMENT /end GROUP
/begin GROUP CalRegn02Cmn.FordVltgIfFeatThdStsTiThd.Val "MICROSAR RTE" /begin SUB_GROUP /end SUB_GROUP /begin FUNCTION_LIST /end FUNCTION_LIST /begin REF_CHARACTERISTIC CalRegn02Cmn.FordVltgIfFeatThdStsTiThd.Val /end REF_CHARACTERISTIC /begin REF_MEASUREMENT /end REF_MEASUREMENT /end GROUP
/begin GROUP CalRegn02Cmn.FordVltgIfHiVltgAssiRampDwnRate.Val "MICROSAR RTE" /begin SUB_GROUP /end SUB_GROUP /begin FUNCTION_LIST /end FUNCTION_LIST /begin REF_CHARACTERISTIC CalRegn02Cmn.FordVltgIfHiVltgAssiRampDwnRate.Val /end REF_CHARACTERISTIC /begin REF_MEASUREMENT /end REF_MEASUREMENT /end GROUP
/begin GROUP CalRegn02Cmn.FordVltgIfHiVltgAssiRampUpRate.Val "MICROSAR RTE" /begin SUB_GROUP /end SUB_GROUP /begin FUNCTION_LIST /end FUNCTION_LIST /begin REF_CHARACTERISTIC CalRegn02Cmn.FordVltgIfHiVltgAssiRampUpRate.Val /end REF_CHARACTERISTIC /begin REF_MEASUREMENT /end REF_MEASUREMENT /end GROUP
/begin GROUP CalRegn02Cmn.FordVltgIfHiVltgInhbTiMax.Val "MICROSAR RTE" /begin SUB_GROUP /end SUB_GROUP /begin FUNCTION_LIST /end FUNCTION_LIST /begin REF_CHARACTERISTIC CalRegn02Cmn.FordVltgIfHiVltgInhbTiMax.Val /end REF_CHARACTERISTIC /begin REF_MEASUREMENT /end REF_MEASUREMENT /end GROUP
/begin GROUP CalRegn02Cmn.FordVltgIfHiVltgNoAssiRampDwnRate.Val "MICROSAR RTE" /begin SUB_GROUP /end SUB_GROUP /begin FUNCTION_LIST /end FUNCTION_LIST /begin REF_CHARACTERISTIC CalRegn02Cmn.FordVltgIfHiVltgNoAssiRampDwnRate.Val /end REF_CHARACTERISTIC /begin REF_MEASUREMENT /end REF_MEASUREMENT /end GROUP
/begin GROUP CalRegn02Cmn.FordVltgIfHiVltgNoAssiRcvrTiMax.Val "MICROSAR RTE" /begin SUB_GROUP /end SUB_GROUP /begin FUNCTION_LIST /end FUNCTION_LIST /begin REF_CHARACTERISTIC CalRegn02Cmn.FordVltgIfHiVltgNoAssiRcvrTiMax.Val /end REF_CHARACTERISTIC /begin REF_MEASUREMENT /end REF_MEASUREMENT /end GROUP
/begin GROUP CalRegn02Cmn.FordVltgIfHiVltgRcvrTiMax.Val "MICROSAR RTE" /begin SUB_GROUP /end SUB_GROUP /begin FUNCTION_LIST /end FUNCTION_LIST /begin REF_CHARACTERISTIC CalRegn02Cmn.FordVltgIfHiVltgRcvrTiMax.Val /end REF_CHARACTERISTIC /begin REF_MEASUREMENT /end REF_MEASUREMENT /end GROUP
/begin GROUP CalRegn02Cmn.FordVltgIfHiVltgThdHi.Val "MICROSAR RTE" /begin SUB_GROUP /end SUB_GROUP /begin FUNCTION_LIST /end FUNCTION_LIST /begin REF_CHARACTERISTIC CalRegn02Cmn.FordVltgIfHiVltgThdHi.Val /end REF_CHARACTERISTIC /begin REF_MEASUREMENT /end REF_MEASUREMENT /end GROUP
/begin GROUP CalRegn02Cmn.FordVltgIfHiVltgThdLo.Val "MICROSAR RTE" /begin SUB_GROUP /end SUB_GROUP /begin FUNCTION_LIST /end FUNCTION_LIST /begin REF_CHARACTERISTIC CalRegn02Cmn.FordVltgIfHiVltgThdLo.Val /end REF_CHARACTERISTIC /begin REF_MEASUREMENT /end REF_MEASUREMENT /end GROUP
/begin GROUP CalRegn02Cmn.FordVltgIfInhbBattVltgDiagcTiThd.Val "MICROSAR RTE" /begin SUB_GROUP /end SUB_GROUP /begin FUNCTION_LIST /end FUNCTION_LIST /begin REF_CHARACTERISTIC CalRegn02Cmn.FordVltgIfInhbBattVltgDiagcTiThd.Val /end REF_CHARACTERISTIC /begin REF_MEASUREMENT /end REF_MEASUREMENT /end GROUP
/begin GROUP CalRegn02Cmn.FordVltgIfLaneCentrAssiTqMin.Val "MICROSAR RTE" /begin SUB_GROUP /end SUB_GROUP /begin FUNCTION_LIST /end FUNCTION_LIST /begin REF_CHARACTERISTIC CalRegn02Cmn.FordVltgIfLaneCentrAssiTqMin.Val /end REF_CHARACTERISTIC /begin REF_MEASUREMENT /end REF_MEASUREMENT /end GROUP
/begin GROUP CalRegn02Cmn.FordVltgIfLaneDprtrWarnAsscTqMin.Val "MICROSAR RTE" /begin SUB_GROUP /end SUB_GROUP /begin FUNCTION_LIST /end FUNCTION_LIST /begin REF_CHARACTERISTIC CalRegn02Cmn.FordVltgIfLaneDprtrWarnAsscTqMin.Val /end REF_CHARACTERISTIC /begin REF_MEASUREMENT /end REF_MEASUREMENT /end GROUP
/begin GROUP CalRegn02Cmn.FordVltgIfLkaAsscTqMin.Val "MICROSAR RTE" /begin SUB_GROUP /end SUB_GROUP /begin FUNCTION_LIST /end FUNCTION_LIST /begin REF_CHARACTERISTIC CalRegn02Cmn.FordVltgIfLkaAsscTqMin.Val /end REF_CHARACTERISTIC /begin REF_MEASUREMENT /end REF_MEASUREMENT /end GROUP
/begin GROUP CalRegn02Cmn.FordVltgIfLoVltgAssiRampDwnRate.Val "MICROSAR RTE" /begin SUB_GROUP /end SUB_GROUP /begin FUNCTION_LIST /end FUNCTION_LIST /begin REF_CHARACTERISTIC CalRegn02Cmn.FordVltgIfLoVltgAssiRampDwnRate.Val /end REF_CHARACTERISTIC /begin REF_MEASUREMENT /end REF_MEASUREMENT /end GROUP
/begin GROUP CalRegn02Cmn.FordVltgIfLoVltgAssiRampUpRate.Val "MICROSAR RTE" /begin SUB_GROUP /end SUB_GROUP /begin FUNCTION_LIST /end FUNCTION_LIST /begin REF_CHARACTERISTIC CalRegn02Cmn.FordVltgIfLoVltgAssiRampUpRate.Val /end REF_CHARACTERISTIC /begin REF_MEASUREMENT /end REF_MEASUREMENT /end GROUP
/begin GROUP CalRegn02Cmn.FordVltgIfLoVltgAssiScar.Val "MICROSAR RTE" /begin SUB_GROUP /end SUB_GROUP /begin FUNCTION_LIST /end FUNCTION_LIST /begin REF_CHARACTERISTIC CalRegn02Cmn.FordVltgIfLoVltgAssiScar.Val /end REF_CHARACTERISTIC /begin REF_MEASUREMENT /end REF_MEASUREMENT /end GROUP
/begin GROUP CalRegn02Cmn.FordVltgIfLoVltgInhbTiMax.Val "MICROSAR RTE" /begin SUB_GROUP /end SUB_GROUP /begin FUNCTION_LIST /end FUNCTION_LIST /begin REF_CHARACTERISTIC CalRegn02Cmn.FordVltgIfLoVltgInhbTiMax.Val /end REF_CHARACTERISTIC /begin REF_MEASUREMENT /end REF_MEASUREMENT /end GROUP
/begin GROUP CalRegn02Cmn.FordVltgIfLoVltgNoAssiRampDwnRate.Val "MICROSAR RTE" /begin SUB_GROUP /end SUB_GROUP /begin FUNCTION_LIST /end FUNCTION_LIST /begin REF_CHARACTERISTIC CalRegn02Cmn.FordVltgIfLoVltgNoAssiRampDwnRate.Val /end REF_CHARACTERISTIC /begin REF_MEASUREMENT /end REF_MEASUREMENT /end GROUP
/begin GROUP CalRegn02Cmn.FordVltgIfLoVltgNoAssiRcvrTiMax.Val "MICROSAR RTE" /begin SUB_GROUP /end SUB_GROUP /begin FUNCTION_LIST /end FUNCTION_LIST /begin REF_CHARACTERISTIC CalRegn02Cmn.FordVltgIfLoVltgNoAssiRcvrTiMax.Val /end REF_CHARACTERISTIC /begin REF_MEASUREMENT /end REF_MEASUREMENT /end GROUP
/begin GROUP CalRegn02Cmn.FordVltgIfLoVltgRcvrTiMax.Val "MICROSAR RTE" /begin SUB_GROUP /end SUB_GROUP /begin FUNCTION_LIST /end FUNCTION_LIST /begin REF_CHARACTERISTIC CalRegn02Cmn.FordVltgIfLoVltgRcvrTiMax.Val /end REF_CHARACTERISTIC /begin REF_MEASUREMENT /end REF_MEASUREMENT /end GROUP
/begin GROUP CalRegn02Cmn.FordVltgIfLoVltgThdHi.Val "MICROSAR RTE" /begin SUB_GROUP /end SUB_GROUP /begin FUNCTION_LIST /end FUNCTION_LIST /begin REF_CHARACTERISTIC CalRegn02Cmn.FordVltgIfLoVltgThdHi.Val /end REF_CHARACTERISTIC /begin REF_MEASUREMENT /end REF_MEASUREMENT /end GROUP
/begin GROUP CalRegn02Cmn.FordVltgIfLoVltgThdLo.Val "MICROSAR RTE" /begin SUB_GROUP /end SUB_GROUP /begin FUNCTION_LIST /end FUNCTION_LIST /begin REF_CHARACTERISTIC CalRegn02Cmn.FordVltgIfLoVltgThdLo.Val /end REF_CHARACTERISTIC /begin REF_MEASUREMENT /end REF_MEASUREMENT /end GROUP
/begin GROUP CalRegn02Cmn.FordVltgIfLoVltgThdMid.Val "MICROSAR RTE" /begin SUB_GROUP /end SUB_GROUP /begin FUNCTION_LIST /end FUNCTION_LIST /begin REF_CHARACTERISTIC CalRegn02Cmn.FordVltgIfLoVltgThdMid.Val /end REF_CHARACTERISTIC /begin REF_MEASUREMENT /end REF_MEASUREMENT /end GROUP
/begin GROUP CalRegn02Cmn.FordVltgIfLoVltgThdMidToLoTiMax.Val "MICROSAR RTE" /begin SUB_GROUP /end SUB_GROUP /begin FUNCTION_LIST /end FUNCTION_LIST /begin REF_CHARACTERISTIC CalRegn02Cmn.FordVltgIfLoVltgThdMidToLoTiMax.Val /end REF_CHARACTERISTIC /begin REF_MEASUREMENT /end REF_MEASUREMENT /end GROUP
/begin GROUP CalRegn02Cmn.FordVltgIfLoVltgTqScaDwnRate.Val "MICROSAR RTE" /begin SUB_GROUP /end SUB_GROUP /begin FUNCTION_LIST /end FUNCTION_LIST /begin REF_CHARACTERISTIC CalRegn02Cmn.FordVltgIfLoVltgTqScaDwnRate.Val /end REF_CHARACTERISTIC /begin REF_MEASUREMENT /end REF_MEASUREMENT /end GROUP
/begin GROUP CalRegn02Cmn.FordVltgIfLoVltgTqScaUpRate.Val "MICROSAR RTE" /begin SUB_GROUP /end SUB_GROUP /begin FUNCTION_LIST /end FUNCTION_LIST /begin REF_CHARACTERISTIC CalRegn02Cmn.FordVltgIfLoVltgTqScaUpRate.Val /end REF_CHARACTERISTIC /begin REF_MEASUREMENT /end REF_MEASUREMENT /end GROUP
/begin GROUP CalRegn02Cmn.FordVltgIfLoVltgTqScagFac.Val "MICROSAR RTE" /begin SUB_GROUP /end SUB_GROUP /begin FUNCTION_LIST /end FUNCTION_LIST /begin REF_CHARACTERISTIC CalRegn02Cmn.FordVltgIfLoVltgTqScagFac.Val /end REF_CHARACTERISTIC /begin REF_MEASUREMENT /end REF_MEASUREMENT /end GROUP
/begin GROUP CalRegn02Cmn.FordVltgIfTrfcJamAsscTqMin.Val "MICROSAR RTE" /begin SUB_GROUP /end SUB_GROUP /begin FUNCTION_LIST /end FUNCTION_LIST /begin REF_CHARACTERISTIC CalRegn02Cmn.FordVltgIfTrfcJamAsscTqMin.Val /end REF_CHARACTERISTIC /begin REF_MEASUREMENT /end REF_MEASUREMENT /end GROUP
/begin GROUP CalRegn02Cmn.FordVltgIfTrlrBackupAssiTqMin.Val "MICROSAR RTE" /begin SUB_GROUP /end SUB_GROUP /begin FUNCTION_LIST /end FUNCTION_LIST /begin REF_CHARACTERISTIC CalRegn02Cmn.FordVltgIfTrlrBackupAssiTqMin.Val /end REF_CHARACTERISTIC /begin REF_MEASUREMENT /end REF_MEASUREMENT /end GROUP
/begin GROUP CalRegn02Cmn.FordVltgIfVehBattCircR.Val "MICROSAR RTE" /begin SUB_GROUP /end SUB_GROUP /begin FUNCTION_LIST /end FUNCTION_LIST /begin REF_CHARACTERISTIC CalRegn02Cmn.FordVltgIfVehBattCircR.Val /end REF_CHARACTERISTIC /begin REF_MEASUREMENT /end REF_MEASUREMENT /end GROUP
/begin GROUP CalRegn02Cmn.FullAssiRampUpRate.Val "MICROSAR RTE" /begin SUB_GROUP /end SUB_GROUP /begin FUNCTION_LIST /end FUNCTION_LIST /begin REF_CHARACTERISTIC CalRegn02Cmn.FullAssiRampUpRate.Val /end REF_CHARACTERISTIC /begin REF_MEASUREMENT /end REF_MEASUREMENT /end GROUP
/begin GROUP CalRegn02Cmn.InitLimpHomeRamp.Val "MICROSAR RTE" /begin SUB_GROUP /end SUB_GROUP /begin FUNCTION_LIST /end FUNCTION_LIST /begin REF_CHARACTERISTIC CalRegn02Cmn.InitLimpHomeRamp.Val /end REF_CHARACTERISTIC /begin REF_MEASUREMENT /end REF_MEASUREMENT /end GROUP
/begin GROUP CalRegn02Cmn.InitLimpHomeScar.Val "MICROSAR RTE" /begin SUB_GROUP /end SUB_GROUP /begin FUNCTION_LIST /end FUNCTION_LIST /begin REF_CHARACTERISTIC CalRegn02Cmn.InitLimpHomeScar.Val /end REF_CHARACTERISTIC /begin REF_MEASUREMENT /end REF_MEASUREMENT /end GROUP
/begin GROUP CalRegn02Cmn.LimdAssiRamp.Val "MICROSAR RTE" /begin SUB_GROUP /end SUB_GROUP /begin FUNCTION_LIST /end FUNCTION_LIST /begin REF_CHARACTERISTIC CalRegn02Cmn.LimdAssiRamp.Val /end REF_CHARACTERISTIC /begin REF_MEASUREMENT /end REF_MEASUREMENT /end GROUP
/begin GROUP CalRegn02Cmn.LimdAssiRampUpRate.Val "MICROSAR RTE" /begin SUB_GROUP /end SUB_GROUP /begin FUNCTION_LIST /end FUNCTION_LIST /begin REF_CHARACTERISTIC CalRegn02Cmn.LimdAssiRampUpRate.Val /end REF_CHARACTERISTIC /begin REF_MEASUREMENT /end REF_MEASUREMENT /end GROUP
/begin GROUP CalRegn02Cmn.LimdAssiRampUpRateFaild.Val "MICROSAR RTE" /begin SUB_GROUP /end SUB_GROUP /begin FUNCTION_LIST /end FUNCTION_LIST /begin REF_CHARACTERISTIC CalRegn02Cmn.LimdAssiRampUpRateFaild.Val /end REF_CHARACTERISTIC /begin REF_MEASUREMENT /end REF_MEASUREMENT /end GROUP
/begin GROUP CalRegn02Cmn.LimdAssiScar.Val "MICROSAR RTE" /begin SUB_GROUP /end SUB_GROUP /begin FUNCTION_LIST /end FUNCTION_LIST /begin REF_CHARACTERISTIC CalRegn02Cmn.LimdAssiScar.Val /end REF_CHARACTERISTIC /begin REF_MEASUREMENT /end REF_MEASUREMENT /end GROUP
/begin GROUP CalRegn02Cmn.LoaMgrCurrIvtrMtgtnRate.Val "MICROSAR RTE" /begin SUB_GROUP /end SUB_GROUP /begin FUNCTION_LIST /end FUNCTION_LIST /begin REF_CHARACTERISTIC CalRegn02Cmn.LoaMgrCurrIvtrMtgtnRate.Val /end REF_CHARACTERISTIC /begin REF_MEASUREMENT /end REF_MEASUREMENT /end GROUP
/begin GROUP CalRegn02Cmn.LoaMgrCurrIvtrMtgtnSca.Val "MICROSAR RTE" /begin SUB_GROUP /end SUB_GROUP /begin FUNCTION_LIST /end FUNCTION_LIST /begin REF_CHARACTERISTIC CalRegn02Cmn.LoaMgrCurrIvtrMtgtnSca.Val /end REF_CHARACTERISTIC /begin REF_MEASUREMENT /end REF_MEASUREMENT /end GROUP
/begin GROUP CalRegn02Cmn.LoaMgrCurrMeasMtgtnRate.Val "MICROSAR RTE" /begin SUB_GROUP /end SUB_GROUP /begin FUNCTION_LIST /end FUNCTION_LIST /begin REF_CHARACTERISTIC CalRegn02Cmn.LoaMgrCurrMeasMtgtnRate.Val /end REF_CHARACTERISTIC /begin REF_MEASUREMENT /end REF_MEASUREMENT /end GROUP
/begin GROUP CalRegn02Cmn.LoaMgrCurrMeasMtgtnSca.Val "MICROSAR RTE" /begin SUB_GROUP /end SUB_GROUP /begin FUNCTION_LIST /end FUNCTION_LIST /begin REF_CHARACTERISTIC CalRegn02Cmn.LoaMgrCurrMeasMtgtnSca.Val /end REF_CHARACTERISTIC /begin REF_MEASUREMENT /end REF_MEASUREMENT /end GROUP
/begin GROUP CalRegn02Cmn.LoaMgrIvtrMtgtnRate.Val "MICROSAR RTE" /begin SUB_GROUP /end SUB_GROUP /begin FUNCTION_LIST /end FUNCTION_LIST /begin REF_CHARACTERISTIC CalRegn02Cmn.LoaMgrIvtrMtgtnRate.Val /end REF_CHARACTERISTIC /begin REF_MEASUREMENT /end REF_MEASUREMENT /end GROUP
/begin GROUP CalRegn02Cmn.LoaMgrIvtrMtgtnSca.Val "MICROSAR RTE" /begin SUB_GROUP /end SUB_GROUP /begin FUNCTION_LIST /end FUNCTION_LIST /begin REF_CHARACTERISTIC CalRegn02Cmn.LoaMgrIvtrMtgtnSca.Val /end REF_CHARACTERISTIC /begin REF_MEASUREMENT /end REF_MEASUREMENT /end GROUP
/begin GROUP CalRegn02Cmn.LoaMgrLimdStRate.Val "MICROSAR RTE" /begin SUB_GROUP /end SUB_GROUP /begin FUNCTION_LIST /end FUNCTION_LIST /begin REF_CHARACTERISTIC CalRegn02Cmn.LoaMgrLimdStRate.Val /end REF_CHARACTERISTIC /begin REF_MEASUREMENT /end REF_MEASUREMENT /end GROUP
/begin GROUP CalRegn02Cmn.LoaMgrLimdStSca.Val "MICROSAR RTE" /begin SUB_GROUP /end SUB_GROUP /begin FUNCTION_LIST /end FUNCTION_LIST /begin REF_CHARACTERISTIC CalRegn02Cmn.LoaMgrLimdStSca.Val /end REF_CHARACTERISTIC /begin REF_MEASUREMENT /end REF_MEASUREMENT /end GROUP
/begin GROUP CalRegn02Cmn.LoaMgrMotAgMtgtnRate.Val "MICROSAR RTE" /begin SUB_GROUP /end SUB_GROUP /begin FUNCTION_LIST /end FUNCTION_LIST /begin REF_CHARACTERISTIC CalRegn02Cmn.LoaMgrMotAgMtgtnRate.Val /end REF_CHARACTERISTIC /begin REF_MEASUREMENT /end REF_MEASUREMENT /end GROUP
/begin GROUP CalRegn02Cmn.LoaMgrMotAgMtgtnSca.Val "MICROSAR RTE" /begin SUB_GROUP /end SUB_GROUP /begin FUNCTION_LIST /end FUNCTION_LIST /begin REF_CHARACTERISTIC CalRegn02Cmn.LoaMgrMotAgMtgtnSca.Val /end REF_CHARACTERISTIC /begin REF_MEASUREMENT /end REF_MEASUREMENT /end GROUP
/begin GROUP CalRegn02Cmn.MotRplCoggCfgMotAgTiDly.Val "MICROSAR RTE" /begin SUB_GROUP /end SUB_GROUP /begin FUNCTION_LIST /end FUNCTION_LIST /begin REF_CHARACTERISTIC CalRegn02Cmn.MotRplCoggCfgMotAgTiDly.Val /end REF_CHARACTERISTIC /begin REF_MEASUREMENT /end REF_MEASUREMENT /end GROUP
/begin GROUP CalRegn02Cmn.MotRplCoggCfgMotCurrDaxRplBilnrSeln.Ary1D "MICROSAR RTE" /begin SUB_GROUP /end SUB_GROUP /begin FUNCTION_LIST /end FUNCTION_LIST /begin REF_CHARACTERISTIC CalRegn02Cmn.MotRplCoggCfgMotCurrDaxRplBilnrSeln.Ary1D /end REF_CHARACTERISTIC /begin REF_MEASUREMENT /end REF_MEASUREMENT /end GROUP
/begin GROUP CalRegn02Cmn.MotRplCoggCfgMotCurrQaxRpl.Ary1D "MICROSAR RTE" /begin SUB_GROUP /end SUB_GROUP /begin FUNCTION_LIST /end FUNCTION_LIST /begin REF_CHARACTERISTIC CalRegn02Cmn.MotRplCoggCfgMotCurrQaxRpl.Ary1D /end REF_CHARACTERISTIC /begin REF_MEASUREMENT /end REF_MEASUREMENT /end GROUP
/begin GROUP CalRegn02Cmn.MotRplCoggCfgMotTqCmdCurrRgltrBwCmpMgnY.Ary2D "MICROSAR RTE" /begin SUB_GROUP /end SUB_GROUP /begin FUNCTION_LIST /end FUNCTION_LIST /begin REF_CHARACTERISTIC CalRegn02Cmn.MotRplCoggCfgMotTqCmdCurrRgltrBwCmpMgnY.Ary2D /end REF_CHARACTERISTIC /begin REF_MEASUREMENT /end REF_MEASUREMENT /end GROUP
/begin GROUP CalRegn02Cmn.MotRplCoggCfgMotTqCmdCurrRgltrBwCmpPhaY.Ary2D "MICROSAR RTE" /begin SUB_GROUP /end SUB_GROUP /begin FUNCTION_LIST /end FUNCTION_LIST /begin REF_CHARACTERISTIC CalRegn02Cmn.MotRplCoggCfgMotTqCmdCurrRgltrBwCmpPhaY.Ary2D /end REF_CHARACTERISTIC /begin REF_MEASUREMENT /end REF_MEASUREMENT /end GROUP
/begin GROUP CalRegn02Cmn.MotRplCoggCfgMotTqCmdCurrRgltrBwCmpX.Ary1D "MICROSAR RTE" /begin SUB_GROUP /end SUB_GROUP /begin FUNCTION_LIST /end FUNCTION_LIST /begin REF_CHARACTERISTIC CalRegn02Cmn.MotRplCoggCfgMotTqCmdCurrRgltrBwCmpX.Ary1D /end REF_CHARACTERISTIC /begin REF_MEASUREMENT /end REF_MEASUREMENT /end GROUP
/begin GROUP CalRegn02Cmn.MotRplCoggCfgMotTqRplOrder1X.Ary2D "MICROSAR RTE" /begin SUB_GROUP /end SUB_GROUP /begin FUNCTION_LIST /end FUNCTION_LIST /begin REF_CHARACTERISTIC CalRegn02Cmn.MotRplCoggCfgMotTqRplOrder1X.Ary2D /end REF_CHARACTERISTIC /begin REF_MEASUREMENT /end REF_MEASUREMENT /end GROUP
/begin GROUP CalRegn02Cmn.MotRplCoggCfgMotTqRplOrder1Y.Ary2D "MICROSAR RTE" /begin SUB_GROUP /end SUB_GROUP /begin FUNCTION_LIST /end FUNCTION_LIST /begin REF_CHARACTERISTIC CalRegn02Cmn.MotRplCoggCfgMotTqRplOrder1Y.Ary2D /end REF_CHARACTERISTIC /begin REF_MEASUREMENT /end REF_MEASUREMENT /end GROUP
/begin GROUP CalRegn02Cmn.MotRplCoggCfgMotTqRplOrder2X.Ary2D "MICROSAR RTE" /begin SUB_GROUP /end SUB_GROUP /begin FUNCTION_LIST /end FUNCTION_LIST /begin REF_CHARACTERISTIC CalRegn02Cmn.MotRplCoggCfgMotTqRplOrder2X.Ary2D /end REF_CHARACTERISTIC /begin REF_MEASUREMENT /end REF_MEASUREMENT /end GROUP
/begin GROUP CalRegn02Cmn.MotRplCoggCfgMotTqRplOrder2Y.Ary2D "MICROSAR RTE" /begin SUB_GROUP /end SUB_GROUP /begin FUNCTION_LIST /end FUNCTION_LIST /begin REF_CHARACTERISTIC CalRegn02Cmn.MotRplCoggCfgMotTqRplOrder2Y.Ary2D /end REF_CHARACTERISTIC /begin REF_MEASUREMENT /end REF_MEASUREMENT /end GROUP
/begin GROUP CalRegn02Cmn.MotRplCoggCfgMotTqRplOrder3X.Ary2D "MICROSAR RTE" /begin SUB_GROUP /end SUB_GROUP /begin FUNCTION_LIST /end FUNCTION_LIST /begin REF_CHARACTERISTIC CalRegn02Cmn.MotRplCoggCfgMotTqRplOrder3X.Ary2D /end REF_CHARACTERISTIC /begin REF_MEASUREMENT /end REF_MEASUREMENT /end GROUP
/begin GROUP CalRegn02Cmn.MotRplCoggCfgMotTqRplOrder3Y.Ary2D "MICROSAR RTE" /begin SUB_GROUP /end SUB_GROUP /begin FUNCTION_LIST /end FUNCTION_LIST /begin REF_CHARACTERISTIC CalRegn02Cmn.MotRplCoggCfgMotTqRplOrder3Y.Ary2D /end REF_CHARACTERISTIC /begin REF_MEASUREMENT /end REF_MEASUREMENT /end GROUP
/begin GROUP CalRegn02Cmn.MotRplCoggCfgMotVelBilnrSeln.Ary1D "MICROSAR RTE" /begin SUB_GROUP /end SUB_GROUP /begin FUNCTION_LIST /end FUNCTION_LIST /begin REF_CHARACTERISTIC CalRegn02Cmn.MotRplCoggCfgMotVelBilnrSeln.Ary1D /end REF_CHARACTERISTIC /begin REF_MEASUREMENT /end REF_MEASUREMENT /end GROUP
/begin GROUP CalRegn02Cmn.MotRplCoggCmdHrmncOrder1Elec.Val "MICROSAR RTE" /begin SUB_GROUP /end SUB_GROUP /begin FUNCTION_LIST /end FUNCTION_LIST /begin REF_CHARACTERISTIC CalRegn02Cmn.MotRplCoggCmdHrmncOrder1Elec.Val /end REF_CHARACTERISTIC /begin REF_MEASUREMENT /end REF_MEASUREMENT /end GROUP
/begin GROUP CalRegn02Cmn.MotRplCoggCmdHrmncOrder2Elec.Val "MICROSAR RTE" /begin SUB_GROUP /end SUB_GROUP /begin FUNCTION_LIST /end FUNCTION_LIST /begin REF_CHARACTERISTIC CalRegn02Cmn.MotRplCoggCmdHrmncOrder2Elec.Val /end REF_CHARACTERISTIC /begin REF_MEASUREMENT /end REF_MEASUREMENT /end GROUP
/begin GROUP CalRegn02Cmn.MotRplCoggCmdHrmncOrder3Elec.Val "MICROSAR RTE" /begin SUB_GROUP /end SUB_GROUP /begin FUNCTION_LIST /end FUNCTION_LIST /begin REF_CHARACTERISTIC CalRegn02Cmn.MotRplCoggCmdHrmncOrder3Elec.Val /end REF_CHARACTERISTIC /begin REF_MEASUREMENT /end REF_MEASUREMENT /end GROUP
/begin GROUP CalRegn02Cmn.NormLimpHomeRamp.Val "MICROSAR RTE" /begin SUB_GROUP /end SUB_GROUP /begin FUNCTION_LIST /end FUNCTION_LIST /begin REF_CHARACTERISTIC CalRegn02Cmn.NormLimpHomeRamp.Val /end REF_CHARACTERISTIC /begin REF_MEASUREMENT /end REF_MEASUREMENT /end GROUP
/begin GROUP CalRegn02Cmn.NormLimpHomeScar.Val "MICROSAR RTE" /begin SUB_GROUP /end SUB_GROUP /begin FUNCTION_LIST /end FUNCTION_LIST /begin REF_CHARACTERISTIC CalRegn02Cmn.NormLimpHomeScar.Val /end REF_CHARACTERISTIC /begin REF_MEASUREMENT /end REF_MEASUREMENT /end GROUP
/begin GROUP CalRegn02Cmn.NxtrCalIdsCal1DevlpAuthor.Ary1D "MICROSAR RTE" /begin SUB_GROUP /end SUB_GROUP /begin FUNCTION_LIST /end FUNCTION_LIST /begin REF_CHARACTERISTIC CalRegn02Cmn.NxtrCalIdsCal1DevlpAuthor.Ary1D /end REF_CHARACTERISTIC /begin REF_MEASUREMENT /end REF_MEASUREMENT /end GROUP
/begin GROUP CalRegn02Cmn.NxtrCalIdsCal1DevlpDesc.Ary1D "MICROSAR RTE" /begin SUB_GROUP /end SUB_GROUP /begin FUNCTION_LIST /end FUNCTION_LIST /begin REF_CHARACTERISTIC CalRegn02Cmn.NxtrCalIdsCal1DevlpDesc.Ary1D /end REF_CHARACTERISTIC /begin REF_MEASUREMENT /end REF_MEASUREMENT /end GROUP
/begin GROUP CalRegn02Cmn.NxtrCalIdsCal1DevlpRelNr.Val "MICROSAR RTE" /begin SUB_GROUP /end SUB_GROUP /begin FUNCTION_LIST /end FUNCTION_LIST /begin REF_CHARACTERISTIC CalRegn02Cmn.NxtrCalIdsCal1DevlpRelNr.Val /end REF_CHARACTERISTIC /begin REF_MEASUREMENT /end REF_MEASUREMENT /end GROUP
/begin GROUP CalRegn02Cmn.NxtrCalIdsCal1DevlpRelSt.Val "MICROSAR RTE" /begin SUB_GROUP /end SUB_GROUP /begin FUNCTION_LIST /end FUNCTION_LIST /begin REF_CHARACTERISTIC CalRegn02Cmn.NxtrCalIdsCal1DevlpRelSt.Val /end REF_CHARACTERISTIC /begin REF_MEASUREMENT /end REF_MEASUREMENT /end GROUP
/begin GROUP CalRegn02Cmn.NxtrCalIdsCal1DevlpTiStamp.Val "MICROSAR RTE" /begin SUB_GROUP /end SUB_GROUP /begin FUNCTION_LIST /end FUNCTION_LIST /begin REF_CHARACTERISTIC CalRegn02Cmn.NxtrCalIdsCal1DevlpTiStamp.Val /end REF_CHARACTERISTIC /begin REF_MEASUREMENT /end REF_MEASUREMENT /end GROUP
/begin GROUP CalRegn02Cmn.NxtrCalIdsCal1DevlpVers.Val "MICROSAR RTE" /begin SUB_GROUP /end SUB_GROUP /begin FUNCTION_LIST /end FUNCTION_LIST /begin REF_CHARACTERISTIC CalRegn02Cmn.NxtrCalIdsCal1DevlpVers.Val /end REF_CHARACTERISTIC /begin REF_MEASUREMENT /end REF_MEASUREMENT /end GROUP
/begin GROUP CalRegn02Cmn.ShtdwnRamp.Val "MICROSAR RTE" /begin SUB_GROUP /end SUB_GROUP /begin FUNCTION_LIST /end FUNCTION_LIST /begin REF_CHARACTERISTIC CalRegn02Cmn.ShtdwnRamp.Val /end REF_CHARACTERISTIC /begin REF_MEASUREMENT /end REF_MEASUREMENT /end GROUP
/begin GROUP CalRegn02CmnGroupA "MICROSAR RTE" /begin SUB_GROUP CalRegn02CmnGroupA.CalibrationPorts /end SUB_GROUP /begin FUNCTION_LIST /end FUNCTION_LIST /begin REF_CHARACTERISTIC /end REF_CHARACTERISTIC /begin REF_MEASUREMENT /end REF_MEASUREMENT /end GROUP
/begin GROUP CalRegn02CmnGroupA.AssiThermScaX.Ary1D "MICROSAR RTE" /begin SUB_GROUP /end SUB_GROUP /begin FUNCTION_LIST /end FUNCTION_LIST /begin REF_CHARACTERISTIC CalRegn02CmnGroupA.AssiThermScaX.Ary1D /end REF_CHARACTERISTIC /begin REF_MEASUREMENT /end REF_MEASUREMENT /end GROUP
/begin GROUP CalRegn02CmnGroupA.AssiThermScaY.Ary1D "MICROSAR RTE" /begin SUB_GROUP /end SUB_GROUP /begin FUNCTION_LIST /end FUNCTION_LIST /begin REF_CHARACTERISTIC CalRegn02CmnGroupA.AssiThermScaY.Ary1D /end REF_CHARACTERISTIC /begin REF_MEASUREMENT /end REF_MEASUREMENT /end GROUP
/begin GROUP CalRegn02CmnGroupA.CalibrationPorts "MICROSAR RTE"
 /begin SUB_GROUP CalRegn02CmnGroupA.AssiThermScaX.Ary1D CalRegn02CmnGroupA.AssiThermScaY.Ary1D /end SUB_GROUP
 /begin FUNCTION_LIST /end FUNCTION_LIST
 /begin REF_CHARACTERISTIC /end REF_CHARACTERISTIC
 /begin REF_MEASUREMENT /end REF_MEASUREMENT
/end GROUP
/begin GROUP CalRegn02CmnGroupB "MICROSAR RTE" /begin SUB_GROUP CalRegn02CmnGroupB.CalibrationPorts /end SUB_GROUP /begin FUNCTION_LIST /end FUNCTION_LIST /begin REF_CHARACTERISTIC /end REF_CHARACTERISTIC /begin REF_MEASUREMENT /end REF_MEASUREMENT /end GROUP
/begin GROUP CalRegn02CmnGroupB.CalibrationPorts "MICROSAR RTE"
 /begin SUB_GROUP CalRegn02CmnGroupB.EotLrngHwAgOverTrvlCntThd.Val CalRegn02CmnGroupB.EotProtnActvRegnBypMaxThd.Val CalRegn02CmnGroupB.EotProtnFwlEotDampgActvBndX.Ary1D CalRegn02CmnGroupB.EotProtnFwlInactvLim.Val CalRegn02CmnGroupB.EotProtnFwlVehSpd.Ary1D /end SUB_GROUP
 /begin FUNCTION_LIST /end FUNCTION_LIST
 /begin REF_CHARACTERISTIC /end REF_CHARACTERISTIC
 /begin REF_MEASUREMENT /end REF_MEASUREMENT
/end GROUP
/begin GROUP CalRegn02CmnGroupB.EotLrngHwAgOverTrvlCntThd.Val "MICROSAR RTE" /begin SUB_GROUP /end SUB_GROUP /begin FUNCTION_LIST /end FUNCTION_LIST /begin REF_CHARACTERISTIC CalRegn02CmnGroupB.EotLrngHwAgOverTrvlCntThd.Val /end REF_CHARACTERISTIC /begin REF_MEASUREMENT /end REF_MEASUREMENT /end GROUP
/begin GROUP CalRegn02CmnGroupB.EotProtnActvRegnBypMaxThd.Val "MICROSAR RTE" /begin SUB_GROUP /end SUB_GROUP /begin FUNCTION_LIST /end FUNCTION_LIST /begin REF_CHARACTERISTIC CalRegn02CmnGroupB.EotProtnActvRegnBypMaxThd.Val /end REF_CHARACTERISTIC /begin REF_MEASUREMENT /end REF_MEASUREMENT /end GROUP
/begin GROUP CalRegn02CmnGroupB.EotProtnFwlEotDampgActvBndX.Ary1D "MICROSAR RTE" /begin SUB_GROUP /end SUB_GROUP /begin FUNCTION_LIST /end FUNCTION_LIST /begin REF_CHARACTERISTIC CalRegn02CmnGroupB.EotProtnFwlEotDampgActvBndX.Ary1D /end REF_CHARACTERISTIC /begin REF_MEASUREMENT /end REF_MEASUREMENT /end GROUP
/begin GROUP CalRegn02CmnGroupB.EotProtnFwlInactvLim.Val "MICROSAR RTE" /begin SUB_GROUP /end SUB_GROUP /begin FUNCTION_LIST /end FUNCTION_LIST /begin REF_CHARACTERISTIC CalRegn02CmnGroupB.EotProtnFwlInactvLim.Val /end REF_CHARACTERISTIC /begin REF_MEASUREMENT /end REF_MEASUREMENT /end GROUP
/begin GROUP CalRegn02CmnGroupB.EotProtnFwlVehSpd.Ary1D "MICROSAR RTE" /begin SUB_GROUP /end SUB_GROUP /begin FUNCTION_LIST /end FUNCTION_LIST /begin REF_CHARACTERISTIC CalRegn02CmnGroupB.EotProtnFwlVehSpd.Ary1D /end REF_CHARACTERISTIC /begin REF_MEASUREMENT /end REF_MEASUREMENT /end GROUP
/begin GROUP CalRegn02Inin00 "MICROSAR RTE" /begin SUB_GROUP CalRegn02Inin00.CalibrationPorts /end SUB_GROUP /begin FUNCTION_LIST /end FUNCTION_LIST /begin REF_CHARACTERISTIC /end REF_CHARACTERISTIC /begin REF_MEASUREMENT /end REF_MEASUREMENT /end GROUP
/begin GROUP CalRegn02Inin00.CalibrationPorts "MICROSAR RTE"
 /begin SUB_GROUP CalRegn02Inin00.HiLoadStallLimrMotTqCmdFetMtgtnEnaFilFrq.Val CalRegn02Inin00.HiLoadStallLimrMotTqCmdFilFrq.Val CalRegn02Inin00.HiLoadStallLimrMotVelMgnThd.Ary1D CalRegn02Inin00.HiLoadStallLimrStallMotTqCmdFetMtgtnLimX.Ary1D CalRegn02Inin00.HiLoadStallLimrStallMotTqCmdFetMtgtnLimY.Ary1D CalRegn02Inin00.HiLoadStallLimrStallMotTqCmdLimX.Ary1D CalRegn02Inin00.HiLoadStallLimrStallMotTqCmdLimY.Ary1D CalRegn02Inin00.HiLoadStallLimrStallMotTqLimSlewRate.Ary1D CalRegn02Inin00.HiLoadStallLimrStallThermLimSca.Val CalRegn02Inin00.SysGlbPrmSysKineRat.Val CalRegn02Inin00.VehSigCdngVehSpdSlewRate.Val /end SUB_GROUP
 /begin FUNCTION_LIST /end FUNCTION_LIST
 /begin REF_CHARACTERISTIC /end REF_CHARACTERISTIC
 /begin REF_MEASUREMENT /end REF_MEASUREMENT
/end GROUP
/begin GROUP CalRegn02Inin00.HiLoadStallLimrMotTqCmdFetMtgtnEnaFilFrq.Val "MICROSAR RTE" /begin SUB_GROUP /end SUB_GROUP /begin FUNCTION_LIST /end FUNCTION_LIST
 /begin REF_CHARACTERISTIC CalRegn02Inin00.HiLoadStallLimrMotTqCmdFetMtgtnEnaFilFrq.Val /end REF_CHARACTERISTIC
 /begin REF_MEASUREMENT /end REF_MEASUREMENT
/end GROUP
/begin GROUP CalRegn02Inin00.HiLoadStallLimrMotTqCmdFilFrq.Val "MICROSAR RTE" /begin SUB_GROUP /end SUB_GROUP /begin FUNCTION_LIST /end FUNCTION_LIST /begin REF_CHARACTERISTIC CalRegn02Inin00.HiLoadStallLimrMotTqCmdFilFrq.Val /end REF_CHARACTERISTIC /begin REF_MEASUREMENT /end REF_MEASUREMENT /end GROUP
/begin GROUP CalRegn02Inin00.HiLoadStallLimrMotVelMgnThd.Ary1D "MICROSAR RTE" /begin SUB_GROUP /end SUB_GROUP /begin FUNCTION_LIST /end FUNCTION_LIST /begin REF_CHARACTERISTIC CalRegn02Inin00.HiLoadStallLimrMotVelMgnThd.Ary1D /end REF_CHARACTERISTIC /begin REF_MEASUREMENT /end REF_MEASUREMENT /end GROUP
/begin GROUP CalRegn02Inin00.HiLoadStallLimrStallMotTqCmdFetMtgtnLimX.Ary1D "MICROSAR RTE" /begin SUB_GROUP /end SUB_GROUP /begin FUNCTION_LIST /end FUNCTION_LIST
 /begin REF_CHARACTERISTIC CalRegn02Inin00.HiLoadStallLimrStallMotTqCmdFetMtgtnLimX.Ary1D /end REF_CHARACTERISTIC
 /begin REF_MEASUREMENT /end REF_MEASUREMENT
/end GROUP
/begin GROUP CalRegn02Inin00.HiLoadStallLimrStallMotTqCmdFetMtgtnLimY.Ary1D "MICROSAR RTE" /begin SUB_GROUP /end SUB_GROUP /begin FUNCTION_LIST /end FUNCTION_LIST
 /begin REF_CHARACTERISTIC CalRegn02Inin00.HiLoadStallLimrStallMotTqCmdFetMtgtnLimY.Ary1D /end REF_CHARACTERISTIC
 /begin REF_MEASUREMENT /end REF_MEASUREMENT
/end GROUP
/begin GROUP CalRegn02Inin00.HiLoadStallLimrStallMotTqCmdLimX.Ary1D "MICROSAR RTE" /begin SUB_GROUP /end SUB_GROUP /begin FUNCTION_LIST /end FUNCTION_LIST /begin REF_CHARACTERISTIC CalRegn02Inin00.HiLoadStallLimrStallMotTqCmdLimX.Ary1D /end REF_CHARACTERISTIC /begin REF_MEASUREMENT /end REF_MEASUREMENT /end GROUP
/begin GROUP CalRegn02Inin00.HiLoadStallLimrStallMotTqCmdLimY.Ary1D "MICROSAR RTE" /begin SUB_GROUP /end SUB_GROUP /begin FUNCTION_LIST /end FUNCTION_LIST /begin REF_CHARACTERISTIC CalRegn02Inin00.HiLoadStallLimrStallMotTqCmdLimY.Ary1D /end REF_CHARACTERISTIC /begin REF_MEASUREMENT /end REF_MEASUREMENT /end GROUP
/begin GROUP CalRegn02Inin00.HiLoadStallLimrStallMotTqLimSlewRate.Ary1D "MICROSAR RTE" /begin SUB_GROUP /end SUB_GROUP /begin FUNCTION_LIST /end FUNCTION_LIST /begin REF_CHARACTERISTIC CalRegn02Inin00.HiLoadStallLimrStallMotTqLimSlewRate.Ary1D /end REF_CHARACTERISTIC /begin REF_MEASUREMENT /end REF_MEASUREMENT /end GROUP
/begin GROUP CalRegn02Inin00.HiLoadStallLimrStallThermLimSca.Val "MICROSAR RTE" /begin SUB_GROUP /end SUB_GROUP /begin FUNCTION_LIST /end FUNCTION_LIST /begin REF_CHARACTERISTIC CalRegn02Inin00.HiLoadStallLimrStallThermLimSca.Val /end REF_CHARACTERISTIC /begin REF_MEASUREMENT /end REF_MEASUREMENT /end GROUP
/begin GROUP CalRegn02Inin00.SysGlbPrmSysKineRat.Val "MICROSAR RTE" /begin SUB_GROUP /end SUB_GROUP /begin FUNCTION_LIST /end FUNCTION_LIST /begin REF_CHARACTERISTIC CalRegn02Inin00.SysGlbPrmSysKineRat.Val /end REF_CHARACTERISTIC /begin REF_MEASUREMENT /end REF_MEASUREMENT /end GROUP
/begin GROUP CalRegn02Inin00.VehSigCdngVehSpdSlewRate.Val "MICROSAR RTE" /begin SUB_GROUP /end SUB_GROUP /begin FUNCTION_LIST /end FUNCTION_LIST /begin REF_CHARACTERISTIC CalRegn02Inin00.VehSigCdngVehSpdSlewRate.Val /end REF_CHARACTERISTIC /begin REF_MEASUREMENT /end REF_MEASUREMENT /end GROUP
/begin GROUP CalRegn02Inin00GroupA "MICROSAR RTE" /begin SUB_GROUP CalRegn02Inin00GroupA.CalibrationPorts /end SUB_GROUP /begin FUNCTION_LIST /end FUNCTION_LIST /begin REF_CHARACTERISTIC /end REF_CHARACTERISTIC /begin REF_MEASUREMENT /end REF_MEASUREMENT /end GROUP
/begin GROUP CalRegn02Inin00GroupA.AssiHiFrqHpFilFrq.Val "MICROSAR RTE" /begin SUB_GROUP /end SUB_GROUP /begin FUNCTION_LIST /end FUNCTION_LIST /begin REF_CHARACTERISTIC CalRegn02Inin00GroupA.AssiHiFrqHpFilFrq.Val /end REF_CHARACTERISTIC /begin REF_MEASUREMENT /end REF_MEASUREMENT /end GROUP
/begin GROUP CalRegn02Inin00GroupA.CalibrationPorts "MICROSAR RTE"
 /begin SUB_GROUP CalRegn02Inin00GroupA.AssiHiFrqHpFilFrq.Val CalRegn02Inin00GroupA.DampgHydAssiLim.Ary1D CalRegn02Inin00GroupA.HysCmpAssiCmdLpFilFrq.Val CalRegn02Inin00GroupA.HysCmpAssiInpLim.Val CalRegn02Inin00GroupA.HysCmpFinalOutpLpFilFrq.Val CalRegn02Inin00GroupA.HysCmpFricTScaX.Ary1D CalRegn02Inin00GroupA.HysCmpFricTScaY.Ary1D CalRegn02Inin00GroupA.HysCmpHwTqLpFilFrq.Val CalRegn02Inin00GroupA.InertiaCmpVelAssiBasdDampgCoeffX.Ary1D CalRegn02Inin00GroupA.InertiaCmpVelAssiBasdDampgRollgWhlImbRejctnOnY.Ary1D CalRegn02Inin00GroupA.InertiaCmpVelAssiBasdDampgRollgY.Ary1D CalRegn02Inin00GroupA.InertiaCmpVelAssiBasdDampgStatWhlImbRejctnOnY.Ary1D CalRegn02Inin00GroupA.InertiaCmpVelCmdScaY.Ary1D CalRegn02Inin00GroupA.InertiaCmpVelDampgDecelGain.Val CalRegn02Inin00GroupA.InertiaCmpVelDampgDecelGainFallSlew.Val CalRegn02Inin00GroupA.InertiaCmpVelDampgDecelGainRisngSlewX.Ary1D CalRegn02Inin00GroupA.InertiaCmpVelDampgDecelGainRisngSlewY.Ary1D CalRegn02Inin00GroupA.InertiaCmpVelDampgGainOffThd.Val CalRegn02Inin00GroupA.InertiaCmpVelDampgGainOnThd.Val CalRegn02Inin00GroupA.InertiaCmpVelDecelGainEnaCal.Logl CalRegn02Inin00GroupA.InertiaCmpVelModWhlImbRejctnBlndX.Ary1D CalRegn02Inin00GroupA.InertiaCmpVelModWhlImbRejctnBlndY.Ary1D CalRegn02Inin00GroupA.InertiaCmpVelMotInertia.Val CalRegn02Inin00GroupA.InertiaCmpVelMotVelBasdOutpScagX.Ary1D CalRegn02Inin00GroupA.InertiaCmpVelMotVelBasdOutpScagY.Ary1D CalRegn02Inin00GroupA.InertiaCmpVelNotchBlndY.Ary1D CalRegn02Inin00GroupA.InertiaCmpVelNotchFilStruct.Rec CalRegn02Inin00GroupA.InertiaCmpVelTqSnsrVelFilFrq.Val CalRegn02Inin00GroupA.InertiaCmpVelTqSnsrVelSca.Ary1D /end SUB_GROUP
 /begin FUNCTION_LIST /end FUNCTION_LIST
 /begin REF_CHARACTERISTIC /end REF_CHARACTERISTIC
 /begin REF_MEASUREMENT /end REF_MEASUREMENT
/end GROUP
/begin GROUP CalRegn02Inin00GroupA.DampgHydAssiLim.Ary1D "MICROSAR RTE" /begin SUB_GROUP /end SUB_GROUP /begin FUNCTION_LIST /end FUNCTION_LIST /begin REF_CHARACTERISTIC CalRegn02Inin00GroupA.DampgHydAssiLim.Ary1D /end REF_CHARACTERISTIC /begin REF_MEASUREMENT /end REF_MEASUREMENT /end GROUP
/begin GROUP CalRegn02Inin00GroupA.HysCmpAssiCmdLpFilFrq.Val "MICROSAR RTE" /begin SUB_GROUP /end SUB_GROUP /begin FUNCTION_LIST /end FUNCTION_LIST /begin REF_CHARACTERISTIC CalRegn02Inin00GroupA.HysCmpAssiCmdLpFilFrq.Val /end REF_CHARACTERISTIC /begin REF_MEASUREMENT /end REF_MEASUREMENT /end GROUP
/begin GROUP CalRegn02Inin00GroupA.HysCmpAssiInpLim.Val "MICROSAR RTE" /begin SUB_GROUP /end SUB_GROUP /begin FUNCTION_LIST /end FUNCTION_LIST /begin REF_CHARACTERISTIC CalRegn02Inin00GroupA.HysCmpAssiInpLim.Val /end REF_CHARACTERISTIC /begin REF_MEASUREMENT /end REF_MEASUREMENT /end GROUP
/begin GROUP CalRegn02Inin00GroupA.HysCmpFinalOutpLpFilFrq.Val "MICROSAR RTE" /begin SUB_GROUP /end SUB_GROUP /begin FUNCTION_LIST /end FUNCTION_LIST /begin REF_CHARACTERISTIC CalRegn02Inin00GroupA.HysCmpFinalOutpLpFilFrq.Val /end REF_CHARACTERISTIC /begin REF_MEASUREMENT /end REF_MEASUREMENT /end GROUP
/begin GROUP CalRegn02Inin00GroupA.HysCmpFricTScaX.Ary1D "MICROSAR RTE" /begin SUB_GROUP /end SUB_GROUP /begin FUNCTION_LIST /end FUNCTION_LIST /begin REF_CHARACTERISTIC CalRegn02Inin00GroupA.HysCmpFricTScaX.Ary1D /end REF_CHARACTERISTIC /begin REF_MEASUREMENT /end REF_MEASUREMENT /end GROUP
/begin GROUP CalRegn02Inin00GroupA.HysCmpFricTScaY.Ary1D "MICROSAR RTE" /begin SUB_GROUP /end SUB_GROUP /begin FUNCTION_LIST /end FUNCTION_LIST /begin REF_CHARACTERISTIC CalRegn02Inin00GroupA.HysCmpFricTScaY.Ary1D /end REF_CHARACTERISTIC /begin REF_MEASUREMENT /end REF_MEASUREMENT /end GROUP
/begin GROUP CalRegn02Inin00GroupA.HysCmpHwTqLpFilFrq.Val "MICROSAR RTE" /begin SUB_GROUP /end SUB_GROUP /begin FUNCTION_LIST /end FUNCTION_LIST /begin REF_CHARACTERISTIC CalRegn02Inin00GroupA.HysCmpHwTqLpFilFrq.Val /end REF_CHARACTERISTIC /begin REF_MEASUREMENT /end REF_MEASUREMENT /end GROUP
/begin GROUP CalRegn02Inin00GroupA.InertiaCmpVelAssiBasdDampgCoeffX.Ary1D "MICROSAR RTE" /begin SUB_GROUP /end SUB_GROUP /begin FUNCTION_LIST /end FUNCTION_LIST
 /begin REF_CHARACTERISTIC CalRegn02Inin00GroupA.InertiaCmpVelAssiBasdDampgCoeffX.Ary1D /end REF_CHARACTERISTIC
 /begin REF_MEASUREMENT /end REF_MEASUREMENT
/end GROUP
/begin GROUP CalRegn02Inin00GroupA.InertiaCmpVelAssiBasdDampgRollgWhlImbRejctnOnY.Ary1D "MICROSAR RTE" /begin SUB_GROUP /end SUB_GROUP /begin FUNCTION_LIST /end FUNCTION_LIST
 /begin REF_CHARACTERISTIC CalRegn02Inin00GroupA.InertiaCmpVelAssiBasdDampgRollgWhlImbRejctnOnY.Ary1D /end REF_CHARACTERISTIC
 /begin REF_MEASUREMENT /end REF_MEASUREMENT
/end GROUP
/begin GROUP CalRegn02Inin00GroupA.InertiaCmpVelAssiBasdDampgRollgY.Ary1D "MICROSAR RTE" /begin SUB_GROUP /end SUB_GROUP /begin FUNCTION_LIST /end FUNCTION_LIST
 /begin REF_CHARACTERISTIC CalRegn02Inin00GroupA.InertiaCmpVelAssiBasdDampgRollgY.Ary1D /end REF_CHARACTERISTIC
 /begin REF_MEASUREMENT /end REF_MEASUREMENT
/end GROUP
/begin GROUP CalRegn02Inin00GroupA.InertiaCmpVelAssiBasdDampgStatWhlImbRejctnOnY.Ary1D "MICROSAR RTE" /begin SUB_GROUP /end SUB_GROUP /begin FUNCTION_LIST /end FUNCTION_LIST
 /begin REF_CHARACTERISTIC CalRegn02Inin00GroupA.InertiaCmpVelAssiBasdDampgStatWhlImbRejctnOnY.Ary1D /end REF_CHARACTERISTIC
 /begin REF_MEASUREMENT /end REF_MEASUREMENT
/end GROUP
/begin GROUP CalRegn02Inin00GroupA.InertiaCmpVelCmdScaY.Ary1D "MICROSAR RTE" /begin SUB_GROUP /end SUB_GROUP /begin FUNCTION_LIST /end FUNCTION_LIST /begin REF_CHARACTERISTIC CalRegn02Inin00GroupA.InertiaCmpVelCmdScaY.Ary1D /end REF_CHARACTERISTIC /begin REF_MEASUREMENT /end REF_MEASUREMENT /end GROUP
/begin GROUP CalRegn02Inin00GroupA.InertiaCmpVelDampgDecelGain.Val "MICROSAR RTE" /begin SUB_GROUP /end SUB_GROUP /begin FUNCTION_LIST /end FUNCTION_LIST /begin REF_CHARACTERISTIC CalRegn02Inin00GroupA.InertiaCmpVelDampgDecelGain.Val /end REF_CHARACTERISTIC /begin REF_MEASUREMENT /end REF_MEASUREMENT /end GROUP
/begin GROUP CalRegn02Inin00GroupA.InertiaCmpVelDampgDecelGainFallSlew.Val "MICROSAR RTE" /begin SUB_GROUP /end SUB_GROUP /begin FUNCTION_LIST /end FUNCTION_LIST
 /begin REF_CHARACTERISTIC CalRegn02Inin00GroupA.InertiaCmpVelDampgDecelGainFallSlew.Val /end REF_CHARACTERISTIC
 /begin REF_MEASUREMENT /end REF_MEASUREMENT
/end GROUP
/begin GROUP CalRegn02Inin00GroupA.InertiaCmpVelDampgDecelGainRisngSlewX.Ary1D "MICROSAR RTE" /begin SUB_GROUP /end SUB_GROUP /begin FUNCTION_LIST /end FUNCTION_LIST
 /begin REF_CHARACTERISTIC CalRegn02Inin00GroupA.InertiaCmpVelDampgDecelGainRisngSlewX.Ary1D /end REF_CHARACTERISTIC
 /begin REF_MEASUREMENT /end REF_MEASUREMENT
/end GROUP
/begin GROUP CalRegn02Inin00GroupA.InertiaCmpVelDampgDecelGainRisngSlewY.Ary1D "MICROSAR RTE" /begin SUB_GROUP /end SUB_GROUP /begin FUNCTION_LIST /end FUNCTION_LIST
 /begin REF_CHARACTERISTIC CalRegn02Inin00GroupA.InertiaCmpVelDampgDecelGainRisngSlewY.Ary1D /end REF_CHARACTERISTIC
 /begin REF_MEASUREMENT /end REF_MEASUREMENT
/end GROUP
/begin GROUP CalRegn02Inin00GroupA.InertiaCmpVelDampgGainOffThd.Val "MICROSAR RTE" /begin SUB_GROUP /end SUB_GROUP /begin FUNCTION_LIST /end FUNCTION_LIST /begin REF_CHARACTERISTIC CalRegn02Inin00GroupA.InertiaCmpVelDampgGainOffThd.Val /end REF_CHARACTERISTIC /begin REF_MEASUREMENT /end REF_MEASUREMENT /end GROUP
/begin GROUP CalRegn02Inin00GroupA.InertiaCmpVelDampgGainOnThd.Val "MICROSAR RTE" /begin SUB_GROUP /end SUB_GROUP /begin FUNCTION_LIST /end FUNCTION_LIST /begin REF_CHARACTERISTIC CalRegn02Inin00GroupA.InertiaCmpVelDampgGainOnThd.Val /end REF_CHARACTERISTIC /begin REF_MEASUREMENT /end REF_MEASUREMENT /end GROUP
/begin GROUP CalRegn02Inin00GroupA.InertiaCmpVelDecelGainEnaCal.Logl "MICROSAR RTE" /begin SUB_GROUP /end SUB_GROUP /begin FUNCTION_LIST /end FUNCTION_LIST /begin REF_CHARACTERISTIC CalRegn02Inin00GroupA.InertiaCmpVelDecelGainEnaCal.Logl /end REF_CHARACTERISTIC /begin REF_MEASUREMENT /end REF_MEASUREMENT /end GROUP
/begin GROUP CalRegn02Inin00GroupA.InertiaCmpVelModWhlImbRejctnBlndX.Ary1D "MICROSAR RTE" /begin SUB_GROUP /end SUB_GROUP /begin FUNCTION_LIST /end FUNCTION_LIST
 /begin REF_CHARACTERISTIC CalRegn02Inin00GroupA.InertiaCmpVelModWhlImbRejctnBlndX.Ary1D /end REF_CHARACTERISTIC
 /begin REF_MEASUREMENT /end REF_MEASUREMENT
/end GROUP
/begin GROUP CalRegn02Inin00GroupA.InertiaCmpVelModWhlImbRejctnBlndY.Ary1D "MICROSAR RTE" /begin SUB_GROUP /end SUB_GROUP /begin FUNCTION_LIST /end FUNCTION_LIST
 /begin REF_CHARACTERISTIC CalRegn02Inin00GroupA.InertiaCmpVelModWhlImbRejctnBlndY.Ary1D /end REF_CHARACTERISTIC
 /begin REF_MEASUREMENT /end REF_MEASUREMENT
/end GROUP
/begin GROUP CalRegn02Inin00GroupA.InertiaCmpVelMotInertia.Val "MICROSAR RTE" /begin SUB_GROUP /end SUB_GROUP /begin FUNCTION_LIST /end FUNCTION_LIST /begin REF_CHARACTERISTIC CalRegn02Inin00GroupA.InertiaCmpVelMotInertia.Val /end REF_CHARACTERISTIC /begin REF_MEASUREMENT /end REF_MEASUREMENT /end GROUP
/begin GROUP CalRegn02Inin00GroupA.InertiaCmpVelMotVelBasdOutpScagX.Ary1D "MICROSAR RTE" /begin SUB_GROUP /end SUB_GROUP /begin FUNCTION_LIST /end FUNCTION_LIST
 /begin REF_CHARACTERISTIC CalRegn02Inin00GroupA.InertiaCmpVelMotVelBasdOutpScagX.Ary1D /end REF_CHARACTERISTIC
 /begin REF_MEASUREMENT /end REF_MEASUREMENT
/end GROUP
/begin GROUP CalRegn02Inin00GroupA.InertiaCmpVelMotVelBasdOutpScagY.Ary1D "MICROSAR RTE" /begin SUB_GROUP /end SUB_GROUP /begin FUNCTION_LIST /end FUNCTION_LIST
 /begin REF_CHARACTERISTIC CalRegn02Inin00GroupA.InertiaCmpVelMotVelBasdOutpScagY.Ary1D /end REF_CHARACTERISTIC
 /begin REF_MEASUREMENT /end REF_MEASUREMENT
/end GROUP
/begin GROUP CalRegn02Inin00GroupA.InertiaCmpVelNotchBlndY.Ary1D "MICROSAR RTE" /begin SUB_GROUP /end SUB_GROUP /begin FUNCTION_LIST /end FUNCTION_LIST /begin REF_CHARACTERISTIC CalRegn02Inin00GroupA.InertiaCmpVelNotchBlndY.Ary1D /end REF_CHARACTERISTIC /begin REF_MEASUREMENT /end REF_MEASUREMENT /end GROUP
/begin GROUP CalRegn02Inin00GroupA.InertiaCmpVelNotchFilStruct.Rec "MICROSAR RTE" /begin SUB_GROUP /end SUB_GROUP /begin FUNCTION_LIST /end FUNCTION_LIST
 /begin REF_CHARACTERISTIC CalRegn02Inin00GroupA.InertiaCmpVelNotchFilStruct.Rec.FilGainA1 CalRegn02Inin00GroupA.InertiaCmpVelNotchFilStruct.Rec.FilGainA2 CalRegn02Inin00GroupA.InertiaCmpVelNotchFilStruct.Rec.FilGainB0 CalRegn02Inin00GroupA.InertiaCmpVelNotchFilStruct.Rec.FilGainB1 CalRegn02Inin00GroupA.InertiaCmpVelNotchFilStruct.Rec.FilGainB2 /end REF_CHARACTERISTIC
 /begin REF_MEASUREMENT /end REF_MEASUREMENT
/end GROUP
/begin GROUP CalRegn02Inin00GroupA.InertiaCmpVelTqSnsrVelFilFrq.Val "MICROSAR RTE" /begin SUB_GROUP /end SUB_GROUP /begin FUNCTION_LIST /end FUNCTION_LIST /begin REF_CHARACTERISTIC CalRegn02Inin00GroupA.InertiaCmpVelTqSnsrVelFilFrq.Val /end REF_CHARACTERISTIC /begin REF_MEASUREMENT /end REF_MEASUREMENT /end GROUP
/begin GROUP CalRegn02Inin00GroupA.InertiaCmpVelTqSnsrVelSca.Ary1D "MICROSAR RTE" /begin SUB_GROUP /end SUB_GROUP /begin FUNCTION_LIST /end FUNCTION_LIST /begin REF_CHARACTERISTIC CalRegn02Inin00GroupA.InertiaCmpVelTqSnsrVelSca.Ary1D /end REF_CHARACTERISTIC /begin REF_MEASUREMENT /end REF_MEASUREMENT /end GROUP
/begin GROUP CalRegn02Inin00GroupB "MICROSAR RTE" /begin SUB_GROUP CalRegn02Inin00GroupB.CalibrationPorts /end SUB_GROUP /begin FUNCTION_LIST /end FUNCTION_LIST /begin REF_CHARACTERISTIC /end REF_CHARACTERISTIC /begin REF_MEASUREMENT /end REF_MEASUREMENT /end GROUP
/begin GROUP CalRegn02Inin00GroupB.CalibrationPorts "MICROSAR RTE"
 /begin SUB_GROUP CalRegn02Inin00GroupB.EotLrngAuthyStrtLrn.Val CalRegn02Inin00GroupB.EotLrngEntrAndExitHysRngLimr.Val CalRegn02Inin00GroupB.EotLrngEotLrnTmr.Val CalRegn02Inin00GroupB.EotLrngHwTqEotLrn.Val CalRegn02Inin00GroupB.EotLrngMotVelEotLrn.Val CalRegn02Inin00GroupB.EotLrngRackTrvlMax.Val CalRegn02Inin00GroupB.EotLrngRackTrvlMin.Val CalRegn02Inin00GroupB.EotLrngRstAuthyMin.Val CalRegn02Inin00GroupB.EotProtnDampgSlew.Val CalRegn02Inin00GroupB.EotProtnDftPosn.Val CalRegn02Inin00GroupB.EotProtnEntrGainAuthyThd.Val CalRegn02Inin00GroupB.EotProtnEntrGainX.Ary2D CalRegn02Inin00GroupB.EotProtnEntrStLpFilFrq.Val CalRegn02Inin00GroupB.EotProtnExitDampgY.Ary2D CalRegn02Inin00GroupB.EotProtnExitStLpFilFrq.Val CalRegn02Inin00GroupB.EotProtnFwlActvCmdLowrBnd.Ary1D CalRegn02Inin00GroupB.EotProtnFwlActvCmdUpprBnd.Ary1D CalRegn02Inin00GroupB.EotProtnFwlEotDampgActvBndY.Ary2D CalRegn02Inin00GroupB.EotProtnHwAgGain.Val CalRegn02Inin00GroupB.EotProtnHwAgMax.Val CalRegn02Inin00GroupB.EotProtnHwAgMin.Val CalRegn02Inin00GroupB.EotProtnHwDegDampgX.Ary2D CalRegn02Inin00GroupB.EotProtnHwTqLpFilFrq.Val CalRegn02Inin00GroupB.EotProtnHwTqScaX.Ary1D CalRegn02Inin00GroupB.EotProtnMotSpdIncptSca.Val CalRegn02Inin00GroupB.EotProtnMotSpdIncptX.Ary1D CalRegn02Inin00GroupB.EotProtnMotVelGain.Val CalRegn02Inin00GroupB.EotProtnPosnRampStep.Val CalRegn02Inin00GroupB.EotProtnRackTrvlLimrAuthyThd.Val CalRegn02Inin00GroupB.EotProtnRackTrvlLimrAuthyThdLimd.Val CalRegn02Inin00GroupB.EotProtnRackTrvlLimrEna.Logl CalRegn02Inin00GroupB.EotProtnRackTrvlLimrRng.Val CalRegn02Inin00GroupB.EotProtnRackTrvlLimrRngLimd.Val CalRegn02Inin00GroupB.EotProtnRackTrvlLimrVehSpdThd.Val CalRegn02Inin00GroupB.EotProtnRunEotVelImpctAndSoftEndStop.Logl CalRegn02Inin00GroupB.EotProtnSoftEndStopEna.Logl CalRegn02Inin00GroupB.EotProtnSoftEndStopVehSpdThd.Val CalRegn02Inin00GroupB.RtnHwAuthyScaX.Ary1D CalRegn02Inin00GroupB.RtnHwAuthyScaY.Ary1D CalRegn02Inin00GroupB.RtnHwAuthySlew.Val CalRegn02Inin00GroupB.RtnOffsRng.Val CalRegn02Inin00GroupB.RtnOffsSlew.Val CalRegn02Inin00GroupB.RtnPahFwlUpprBndTblX.Ary1D CalRegn02Inin00GroupB.RtnPahFwlUpprBndTblY.Ary2D CalRegn02Inin00GroupB.RtnPahFwlVehSpd.Ary1D CalRegn02Inin00GroupB.RtnTScaX.Ary1D CalRegn02Inin00GroupB.RtnTScaY.Ary1D /end SUB_GROUP
 /begin FUNCTION_LIST /end FUNCTION_LIST
 /begin REF_CHARACTERISTIC /end REF_CHARACTERISTIC
 /begin REF_MEASUREMENT /end REF_MEASUREMENT
/end GROUP
/begin GROUP CalRegn02Inin00GroupB.EotLrngAuthyStrtLrn.Val "MICROSAR RTE" /begin SUB_GROUP /end SUB_GROUP /begin FUNCTION_LIST /end FUNCTION_LIST /begin REF_CHARACTERISTIC CalRegn02Inin00GroupB.EotLrngAuthyStrtLrn.Val /end REF_CHARACTERISTIC /begin REF_MEASUREMENT /end REF_MEASUREMENT /end GROUP
/begin GROUP CalRegn02Inin00GroupB.EotLrngEntrAndExitHysRngLimr.Val "MICROSAR RTE" /begin SUB_GROUP /end SUB_GROUP /begin FUNCTION_LIST /end FUNCTION_LIST /begin REF_CHARACTERISTIC CalRegn02Inin00GroupB.EotLrngEntrAndExitHysRngLimr.Val /end REF_CHARACTERISTIC /begin REF_MEASUREMENT /end REF_MEASUREMENT /end GROUP
/begin GROUP CalRegn02Inin00GroupB.EotLrngEotLrnTmr.Val "MICROSAR RTE" /begin SUB_GROUP /end SUB_GROUP /begin FUNCTION_LIST /end FUNCTION_LIST /begin REF_CHARACTERISTIC CalRegn02Inin00GroupB.EotLrngEotLrnTmr.Val /end REF_CHARACTERISTIC /begin REF_MEASUREMENT /end REF_MEASUREMENT /end GROUP
/begin GROUP CalRegn02Inin00GroupB.EotLrngHwTqEotLrn.Val "MICROSAR RTE" /begin SUB_GROUP /end SUB_GROUP /begin FUNCTION_LIST /end FUNCTION_LIST /begin REF_CHARACTERISTIC CalRegn02Inin00GroupB.EotLrngHwTqEotLrn.Val /end REF_CHARACTERISTIC /begin REF_MEASUREMENT /end REF_MEASUREMENT /end GROUP
/begin GROUP CalRegn02Inin00GroupB.EotLrngMotVelEotLrn.Val "MICROSAR RTE" /begin SUB_GROUP /end SUB_GROUP /begin FUNCTION_LIST /end FUNCTION_LIST /begin REF_CHARACTERISTIC CalRegn02Inin00GroupB.EotLrngMotVelEotLrn.Val /end REF_CHARACTERISTIC /begin REF_MEASUREMENT /end REF_MEASUREMENT /end GROUP
/**********************************************************************************************************************
* RECORD_LAYOUT
*********************************************************************************************************************/
/begin RECORD_LAYOUT RTE_RL_UBYTE FNC_VALUES 1 UBYTE ROW_DIR DIRECT /end RECORD_LAYOUT
/begin RECORD_LAYOUT RTE_RL_UWORD FNC_VALUES 1 UWORD ROW_DIR DIRECT /end RECORD_LAYOUT
/begin RECORD_LAYOUT RTE_RL_ULONG FNC_VALUES 1 ULONG ROW_DIR DIRECT /end RECORD_LAYOUT
/begin RECORD_LAYOUT RTE_RL_SWORD FNC_VALUES 1 SWORD ROW_DIR DIRECT /end RECORD_LAYOUT
/begin RECORD_LAYOUT RTE_RL_FLOAT32_IEEE FNC_VALUES 1 FLOAT32_IEEE ROW_DIR DIRECT /end RECORD_LAYOUT
/begin RECORD_LAYOUT RTE_RL_BOOLEAN FNC_VALUES 1 UBYTE ROW_DIR DIRECT /end RECORD_LAYOUT
/**********************************************************************************************************************
* COMPU_METHOD / COMPU_VTAB_RANGE
*********************************************************************************************************************/
/begin COMPU_METHOD RTE_CM_BOOLEAN "" TAB_VERB "%3.1" "" COMPU_TAB_REF RTE_CM_BOOLEAN /end COMPU_METHOD
/begin COMPU_VTAB_RANGE RTE_CM_BOOLEAN "" 2 0 0 "false" 1 255 "true" /end COMPU_VTAB_RANGE
