/begin CHARACTERISTIC CalRegn01Cmn.FordMsg47ABusHiSpdTrlrAidKnobBtnPassdTiThd.Val "MICROSAR RTE" VALUE 0x0 RTE_RL_UWORD 0 NO_COMPU_METHOD 0 65535 SYMBOL_LINK "Rte_CalprmRom_CalRegn01Cmn_DEFAULT_RTE_CALPRM_GROUP.FordMsg47ABusHiSpdTrlrAidKnobBtnPassdTiThd_Val" 0 DISPLAY_IDENTIFIER CalRegn01Cmn.CalibrationPorts.FordMsg47ABusHiSpdTrlrAidKnobBtnPassdTiThd.Val /end CHARACTERISTIC
/begin CHARACTERISTIC CalRegn01Cmn.FordMsg47ABusHiSpdTrlrAidKnobPosFaildTiThd.Val "MICROSAR RTE" VALUE 0x0 RTE_RL_UWORD 0 NO_COMPU_METHOD 0 65535 SYMBOL_LINK "Rte_CalprmRom_CalRegn01Cmn_DEFAULT_RTE_CALPRM_GROUP.FordMsg47ABusHiSpdTrlrAidKnobPosFaildTiThd_Val" 0 DISPLAY_IDENTIFIER CalRegn01Cmn.CalibrationPorts.FordMsg47ABusHiSpdTrlrAidKnobPosFaildTiThd.Val /end CHARACTERISTIC
/begin CHARACTERISTIC CalRegn01Cmn.FordMsg47ABusHiSpdTrlrAidKnobPosInvldPassdTiThd.Val "MICROSAR RTE" VALUE 0x0 RTE_RL_UWORD 0 NO_COMPU_METHOD 0 65535 SYMBOL_LINK "Rte_CalprmRom_CalRegn01Cmn_DEFAULT_RTE_CALPRM_GROUP.FordMsg47ABusHiSpdTrlrAidKnobPosInvldPassdTiThd_Val" 0 DISPLAY_IDENTIFIER CalRegn01Cmn.CalibrationPorts.FordMsg47ABusHiSpdTrlrAidKnobPosInvldPassdTiThd.Val /end CHARACTERISTIC
/begin CHARACTERISTIC CalRegn01Cmn.FordMsg47ABusHiSpdTrlrAidKnobPosMissTiThd.Val "MICROSAR RTE" VALUE 0x0 RTE_RL_UWORD 0 NO_COMPU_METHOD 0 65535 SYMBOL_LINK "Rte_CalprmRom_CalRegn01Cmn_DEFAULT_RTE_CALPRM_GROUP.FordMsg47ABusHiSpdTrlrAidKnobPosMissTiThd_Val" 0 DISPLAY_IDENTIFIER CalRegn01Cmn.CalibrationPorts.FordMsg47ABusHiSpdTrlrAidKnobPosMissTiThd.Val /end CHARACTERISTIC
/begin CHARACTERISTIC CalRegn01Cmn.FordMsg47ABusHiSpdTrlrAidKnobPosPassdTiThd.Val "MICROSAR RTE" VALUE 0x0 RTE_RL_UWORD 0 NO_COMPU_METHOD 0 65535 SYMBOL_LINK "Rte_CalprmRom_CalRegn01Cmn_DEFAULT_RTE_CALPRM_GROUP.FordMsg47ABusHiSpdTrlrAidKnobPosPassdTiThd_Val" 0 DISPLAY_IDENTIFIER CalRegn01Cmn.CalibrationPorts.FordMsg47ABusHiSpdTrlrAidKnobPosPassdTiThd.Val /end CHARACTERISTIC
/begin CHARACTERISTIC CalRegn01Cmn.FordMsg4B0BusHiSpdCanDtcInhbTiThd.Val "MICROSAR RTE" VALUE 0x0 RTE_RL_UWORD 0 NO_COMPU_METHOD 0 65535 SYMBOL_LINK "Rte_CalRegn01Cmn_FordMsg4B0BusHiSpdCanDtcInhbTiThd_Val" 0 DISPLAY_IDENTIFIER CalRegn01Cmn.CalibrationPorts.FordMsg4B0BusHiSpdCanDtcInhbTiThd.Val /end CHARACTERISTIC
/begin CHARACTERISTIC CalRegn01Cmn.FordMsg4B0BusHiSpdMsgFltNtcDiagcTiThd.Val "MICROSAR RTE" VALUE 0x0 RTE_RL_UWORD 0 NO_COMPU_METHOD 0 65535 SYMBOL_LINK "Rte_CalRegn01Cmn_FordMsg4B0BusHiSpdMsgFltNtcDiagcTiThd_Val" 0 DISPLAY_IDENTIFIER CalRegn01Cmn.CalibrationPorts.FordMsg4B0BusHiSpdMsgFltNtcDiagcTiThd.Val /end CHARACTERISTIC
/begin CHARACTERISTIC CalRegn01Cmn.FordMsg4B0BusHiSpdMsgFltTiThd.Val "MICROSAR RTE" VALUE 0x0 RTE_RL_UWORD 0 NO_COMPU_METHOD 0 65535 SYMBOL_LINK "Rte_CalRegn01Cmn_FordMsg4B0BusHiSpdMsgFltTiThd_Val" 0 DISPLAY_IDENTIFIER CalRegn01Cmn.CalibrationPorts.FordMsg4B0BusHiSpdMsgFltTiThd.Val /end CHARACTERISTIC
/begin CHARACTERISTIC CalRegn01Cmn.FordMsg4B0BusHiSpdMsgMissNtcDiagcTiThd.Val "MICROSAR RTE" VALUE 0x0 RTE_RL_UWORD 0 NO_COMPU_METHOD 0 65535 SYMBOL_LINK "Rte_CalRegn01Cmn_FordMsg4B0BusHiSpdMsgMissNtcDiagcTiThd_Val" 0 DISPLAY_IDENTIFIER CalRegn01Cmn.CalibrationPorts.FordMsg4B0BusHiSpdMsgMissNtcDiagcTiThd.Val /end CHARACTERISTIC
/begin CHARACTERISTIC CalRegn01Cmn.FordMsg4B0BusHiSpdMsgMissTiThd.Val "MICROSAR RTE" VALUE 0x0 RTE_RL_UWORD 0 NO_COMPU_METHOD 0 65535 SYMBOL_LINK "Rte_CalRegn01Cmn_FordMsg4B0BusHiSpdMsgMissTiThd_Val" 0 DISPLAY_IDENTIFIER CalRegn01Cmn.CalibrationPorts.FordMsg4B0BusHiSpdMsgMissTiThd.Val /end CHARACTERISTIC
/begin CHARACTERISTIC CalRegn01Cmn.FordMsg4B0BusHiSpdMsgRxdNtcDiagcTiThd.Val "MICROSAR RTE" VALUE 0x0 RTE_RL_UWORD 0 NO_COMPU_METHOD 0 65535 SYMBOL_LINK "Rte_CalRegn01Cmn_FordMsg4B0BusHiSpdMsgRxdNtcDiagcTiThd_Val" 0 DISPLAY_IDENTIFIER CalRegn01Cmn.CalibrationPorts.FordMsg4B0BusHiSpdMsgRxdNtcDiagcTiThd.Val /end CHARACTERISTIC
/begin CHARACTERISTIC CalRegn01Cmn.FordMsg4B0BusHiSpdMsgVldNtcDiagcTiThd.Val "MICROSAR RTE" VALUE 0x0 RTE_RL_UWORD 0 NO_COMPU_METHOD 0 65535 SYMBOL_LINK "Rte_CalRegn01Cmn_FordMsg4B0BusHiSpdMsgVldNtcDiagcTiThd_Val" 0 DISPLAY_IDENTIFIER CalRegn01Cmn.CalibrationPorts.FordMsg4B0BusHiSpdMsgVldNtcDiagcTiThd.Val /end CHARACTERISTIC
/begin CHARACTERISTIC CalRegn01Cmn.FordMsg4B0BusHiSpdMsgVldTiThd.Val "MICROSAR RTE" VALUE 0x0 RTE_RL_UWORD 0 NO_COMPU_METHOD 0 65535 SYMBOL_LINK "Rte_CalRegn01Cmn_FordMsg4B0BusHiSpdMsgVldTiThd_Val" 0 DISPLAY_IDENTIFIER CalRegn01Cmn.CalibrationPorts.FordMsg4B0BusHiSpdMsgVldTiThd.Val /end CHARACTERISTIC
/begin CHARACTERISTIC CalRegn01Cmn.GateDrv0CtrlErrFilFrq.Val "MICROSAR RTE" VALUE 0x0 RTE_RL_FLOAT32_IEEE 0 NO_COMPU_METHOD -3.402823466e+38 3.402823466e+38 SYMBOL_LINK "Rte_CalprmRom_CalRegn01Cmn_DEFAULT_RTE_CALPRM_GROUP.GateDrv0CtrlErrFilFrq_Val" 0 DISPLAY_IDENTIFIER CalRegn01Cmn.CalibrationPorts.GateDrv0CtrlErrFilFrq.Val /end CHARACTERISTIC
/begin CHARACTERISTIC CalRegn01Cmn.GateDrv0CtrlErrOffs.Val "MICROSAR RTE" VALUE 0x0 RTE_RL_ULONG 0 NO_COMPU_METHOD 0 4294967295 SYMBOL_LINK "Rte_CalprmRom_CalRegn01Cmn_DEFAULT_RTE_CALPRM_GROUP.GateDrv0CtrlErrOffs_Val" 0 DISPLAY_IDENTIFIER CalRegn01Cmn.CalibrationPorts.GateDrv0CtrlErrOffs.Val /end CHARACTERISTIC
/begin CHARACTERISTIC CalRegn01Cmn.GateDrv0CtrlErrThd.Val "MICROSAR RTE" VALUE 0x0 RTE_RL_ULONG 0 NO_COMPU_METHOD 0 4294967295 SYMBOL_LINK "Rte_CalprmRom_CalRegn01Cmn_DEFAULT_RTE_CALPRM_GROUP.GateDrv0CtrlErrThd_Val" 0 DISPLAY_IDENTIFIER CalRegn01Cmn.CalibrationPorts.GateDrv0CtrlErrThd.Val /end CHARACTERISTIC
/begin CHARACTERISTIC CalRegn01Cmn.GateDrv0CtrlNtcNr0x050FailStep.Val "MICROSAR RTE" VALUE 0x0 RTE_RL_UWORD 0 NO_COMPU_METHOD 0 65535 SYMBOL_LINK "Rte_CalprmRom_CalRegn01Cmn_DEFAULT_RTE_CALPRM_GROUP.GateDrv0CtrlNtcNr0x050FailStep_Val" 0 DISPLAY_IDENTIFIER CalRegn01Cmn.CalibrationPorts.GateDrv0CtrlNtcNr0x050FailStep.Val /end CHARACTERISTIC
/begin CHARACTERISTIC CalRegn01Cmn.GateDrv0CtrlNtcNr0x050PassStep.Val "MICROSAR RTE" VALUE 0x0 RTE_RL_UWORD 0 NO_COMPU_METHOD 0 65535 SYMBOL_LINK "Rte_CalprmRom_CalRegn01Cmn_DEFAULT_RTE_CALPRM_GROUP.GateDrv0CtrlNtcNr0x050PassStep_Val" 0 DISPLAY_IDENTIFIER CalRegn01Cmn.CalibrationPorts.GateDrv0CtrlNtcNr0x050PassStep.Val /end CHARACTERISTIC
/begin CHARACTERISTIC CalRegn01Cmn.GateDrv0CtrlNtcNr0x051FailStep.Val "MICROSAR RTE" VALUE 0x0 RTE_RL_UWORD 0 NO_COMPU_METHOD 0 65535 SYMBOL_LINK "Rte_CalprmRom_CalRegn01Cmn_DEFAULT_RTE_CALPRM_GROUP.GateDrv0CtrlNtcNr0x051FailStep_Val" 0 DISPLAY_IDENTIFIER CalRegn01Cmn.CalibrationPorts.GateDrv0CtrlNtcNr0x051FailStep.Val /end CHARACTERISTIC
/begin CHARACTERISTIC CalRegn01Cmn.GateDrv0CtrlNtcNr0x051PassStep.Val "MICROSAR RTE" VALUE 0x0 RTE_RL_UWORD 0 NO_COMPU_METHOD 0 65535 SYMBOL_LINK "Rte_CalprmRom_CalRegn01Cmn_DEFAULT_RTE_CALPRM_GROUP.GateDrv0CtrlNtcNr0x051PassStep_Val" 0 DISPLAY_IDENTIFIER CalRegn01Cmn.CalibrationPorts.GateDrv0CtrlNtcNr0x051PassStep.Val /end CHARACTERISTIC
/begin CHARACTERISTIC CalRegn01Cmn.GateDrv0CtrlNtcNr0x055FailStep.Val "MICROSAR RTE" VALUE 0x0 RTE_RL_UWORD 0 NO_COMPU_METHOD 0 65535 SYMBOL_LINK "Rte_CalprmRom_CalRegn01Cmn_DEFAULT_RTE_CALPRM_GROUP.GateDrv0CtrlNtcNr0x055FailStep_Val" 0 DISPLAY_IDENTIFIER CalRegn01Cmn.CalibrationPorts.GateDrv0CtrlNtcNr0x055FailStep.Val /end CHARACTERISTIC
/begin CHARACTERISTIC CalRegn01Cmn.GateDrv0CtrlNtcNr0x055PassStep.Val "MICROSAR RTE" VALUE 0x0 RTE_RL_UWORD 0 NO_COMPU_METHOD 0 65535 SYMBOL_LINK "Rte_CalprmRom_CalRegn01Cmn_DEFAULT_RTE_CALPRM_GROUP.GateDrv0CtrlNtcNr0x055PassStep_Val" 0 DISPLAY_IDENTIFIER CalRegn01Cmn.CalibrationPorts.GateDrv0CtrlNtcNr0x055PassStep.Val /end CHARACTERISTIC
/begin CHARACTERISTIC CalRegn01Cmn.GateDrv0CtrlUnit0Cfg2WrVal.Val "MICROSAR RTE" VALUE 0x0 RTE_RL_UWORD 0 NO_COMPU_METHOD 0 65535 SYMBOL_LINK "Rte_CalprmRom_CalRegn01Cmn_DEFAULT_RTE_CALPRM_GROUP.GateDrv0CtrlUnit0Cfg2WrVal_Val" 0 DISPLAY_IDENTIFIER CalRegn01Cmn.CalibrationPorts.GateDrv0CtrlUnit0Cfg2WrVal.Val /end CHARACTERISTIC
/begin CHARACTERISTIC CalRegn01Cmn.GateDrv0CtrlUnit0Cfg3WrVal.Val "MICROSAR RTE" VALUE 0x0 RTE_RL_UWORD 0 NO_COMPU_METHOD 0 65535 SYMBOL_LINK "Rte_CalprmRom_CalRegn01Cmn_DEFAULT_RTE_CALPRM_GROUP.GateDrv0CtrlUnit0Cfg3WrVal_Val" 0 DISPLAY_IDENTIFIER CalRegn01Cmn.CalibrationPorts.GateDrv0CtrlUnit0Cfg3WrVal.Val /end CHARACTERISTIC
/begin CHARACTERISTIC CalRegn01Cmn.GateDrv0CtrlUnit0Cfg4WrVal.Val "MICROSAR RTE" VALUE 0x0 RTE_RL_UWORD 0 NO_COMPU_METHOD 0 65535 SYMBOL_LINK "Rte_CalprmRom_CalRegn01Cmn_DEFAULT_RTE_CALPRM_GROUP.GateDrv0CtrlUnit0Cfg4WrVal_Val" 0 DISPLAY_IDENTIFIER CalRegn01Cmn.CalibrationPorts.GateDrv0CtrlUnit0Cfg4WrVal.Val /end CHARACTERISTIC
/begin CHARACTERISTIC CalRegn01Cmn.GateDrv0CtrlUnit0Cfg7WrVal.Val "MICROSAR RTE" VALUE 0x0 RTE_RL_UWORD 0 NO_COMPU_METHOD 0 65535 SYMBOL_LINK "Rte_CalprmRom_CalRegn01Cmn_DEFAULT_RTE_CALPRM_GROUP.GateDrv0CtrlUnit0Cfg7WrVal_Val" 0 DISPLAY_IDENTIFIER CalRegn01Cmn.CalibrationPorts.GateDrv0CtrlUnit0Cfg7WrVal.Val /end CHARACTERISTIC
/begin CHARACTERISTIC CalRegn01Cmn.GtmCfgAndUseAdcStrtOfCnvn2Offs.Val "MICROSAR RTE" VALUE 0x0 RTE_RL_ULONG 0 NO_COMPU_METHOD 0 4294967295 SYMBOL_LINK "Rte_CalprmRom_CalRegn01Cmn_DEFAULT_RTE_CALPRM_GROUP.GtmCfgAndUseAdcStrtOfCnvn2Offs_Val" 0 DISPLAY_IDENTIFIER CalRegn01Cmn.CalibrationPorts.GtmCfgAndUseAdcStrtOfCnvn2Offs.Val /end CHARACTERISTIC
/begin CHARACTERISTIC CalRegn01Cmn.GtmCfgAndUseAdcStrtOfCnvnPeakOffs.Val "MICROSAR RTE" VALUE 0x0 RTE_RL_ULONG 0 NO_COMPU_METHOD 0 4294967295 SYMBOL_LINK "Rte_CalprmRom_CalRegn01Cmn_DEFAULT_RTE_CALPRM_GROUP.GtmCfgAndUseAdcStrtOfCnvnPeakOffs_Val" 0 DISPLAY_IDENTIFIER CalRegn01Cmn.CalibrationPorts.GtmCfgAndUseAdcStrtOfCnvnPeakOffs.Val /end CHARACTERISTIC
/begin CHARACTERISTIC CalRegn01Cmn.GtmCfgAndUseDma2MilliSecToMotCtrlTrig.Val "MICROSAR RTE" VALUE 0x0 RTE_RL_ULONG 0 NO_COMPU_METHOD 0 4294967295 SYMBOL_LINK "Rte_CalprmRom_CalRegn01Cmn_DEFAULT_RTE_CALPRM_GROUP.GtmCfgAndUseDma2MilliSecToMotCtrlTrig_Val" 0 DISPLAY_IDENTIFIER CalRegn01Cmn.CalibrationPorts.GtmCfgAndUseDma2MilliSecToMotCtrlTrig.Val /end CHARACTERISTIC
/begin CHARACTERISTIC CalRegn01Cmn.GtmCfgAndUseDmaMotAgATrig.Val "MICROSAR RTE" VALUE 0x0 RTE_RL_ULONG 0 NO_COMPU_METHOD 0 4294967295 SYMBOL_LINK "Rte_CalprmRom_CalRegn01Cmn_DEFAULT_RTE_CALPRM_GROUP.GtmCfgAndUseDmaMotAgATrig_Val" 0 DISPLAY_IDENTIFIER CalRegn01Cmn.CalibrationPorts.GtmCfgAndUseDmaMotAgATrig.Val /end CHARACTERISTIC
/begin CHARACTERISTIC CalRegn01Cmn.GtmCfgAndUseDmaMotCtrlTo2MilliSecTrig.Val "MICROSAR RTE" VALUE 0x0 RTE_RL_ULONG 0 NO_COMPU_METHOD 0 4294967295 SYMBOL_LINK "Rte_CalprmRom_CalRegn01Cmn_DEFAULT_RTE_CALPRM_GROUP.GtmCfgAndUseDmaMotCtrlTo2MilliSecTrig_Val" 0 DISPLAY_IDENTIFIER CalRegn01Cmn.CalibrationPorts.GtmCfgAndUseDmaMotCtrlTo2MilliSecTrig.Val /end CHARACTERISTIC
/begin CHARACTERISTIC CalRegn01Cmn.GtmCfgAndUsePwmDbnd.Val "MICROSAR RTE" VALUE 0x0 RTE_RL_ULONG 0 NO_COMPU_METHOD 0 4294967295 SYMBOL_LINK "Rte_CalprmRom_CalRegn01Cmn_DEFAULT_RTE_CALPRM_GROUP.GtmCfgAndUsePwmDbnd_Val" 0 DISPLAY_IDENTIFIER CalRegn01Cmn.CalibrationPorts.GtmCfgAndUsePwmDbnd.Val /end CHARACTERISTIC
/begin CHARACTERISTIC CalRegn01Cmn.HwAgSnsrlsCorrdPinionAgConfThd.Val "MICROSAR RTE" VALUE 0x0 RTE_RL_FLOAT32_IEEE 0 NO_COMPU_METHOD -3.402823466e+38 3.402823466e+38 SYMBOL_LINK "Rte_CalprmRom_CalRegn01Cmn_DEFAULT_RTE_CALPRM_GROUP.HwAgSnsrlsCorrdPinionAgConfThd_Val" 0 DISPLAY_IDENTIFIER CalRegn01Cmn.CalibrationPorts.HwAgSnsrlsCorrdPinionAgConfThd.Val /end CHARACTERISTIC
/begin CHARACTERISTIC CalRegn01Cmn.HwAgSnsrlsCorrdPinionAgHwConf.Val "MICROSAR RTE" VALUE 0x0 RTE_RL_FLOAT32_IEEE 0 NO_COMPU_METHOD -3.402823466e+38 3.402823466e+38 SYMBOL_LINK "Rte_CalprmRom_CalRegn01Cmn_DEFAULT_RTE_CALPRM_GROUP.HwAgSnsrlsCorrdPinionAgHwConf_Val" 0 DISPLAY_IDENTIFIER CalRegn01Cmn.CalibrationPorts.HwAgSnsrlsCorrdPinionAgHwConf.Val /end CHARACTERISTIC
/begin CHARACTERISTIC CalRegn01Cmn.HwAgSnsrlsFCentrHwConf.Val "MICROSAR RTE" VALUE 0x0 RTE_RL_FLOAT32_IEEE 0 NO_COMPU_METHOD -3.402823466e+38 3.402823466e+38 SYMBOL_LINK "Rte_CalprmRom_CalRegn01Cmn_DEFAULT_RTE_CALPRM_GROUP.HwAgSnsrlsFCentrHwConf_Val" 0 DISPLAY_IDENTIFIER CalRegn01Cmn.CalibrationPorts.HwAgSnsrlsFCentrHwConf.Val /end CHARACTERISTIC
/begin CHARACTERISTIC CalRegn01Cmn.HwAgSnsrlsMotAgIdptSigThd.Val "MICROSAR RTE" VALUE 0x0 RTE_RL_UBYTE 0 NO_COMPU_METHOD 0 255 SYMBOL_LINK "Rte_CalprmRom_CalRegn01Cmn_DEFAULT_RTE_CALPRM_GROUP.HwAgSnsrlsMotAgIdptSigThd_Val" 0 DISPLAY_IDENTIFIER CalRegn01Cmn.CalibrationPorts.HwAgSnsrlsMotAgIdptSigThd.Val /end CHARACTERISTIC
/begin CHARACTERISTIC CalRegn01Cmn.HwAgSnsrlsPinionTqFilFrq.Val "MICROSAR RTE" VALUE 0x0 RTE_RL_FLOAT32_IEEE 0 NO_COMPU_METHOD -3.402823466e+38 3.402823466e+38 SYMBOL_LINK "Rte_CalprmRom_CalRegn01Cmn_DEFAULT_RTE_CALPRM_GROUP.HwAgSnsrlsPinionTqFilFrq_Val" 0 DISPLAY_IDENTIFIER CalRegn01Cmn.CalibrationPorts.HwAgSnsrlsPinionTqFilFrq.Val /end CHARACTERISTIC
/begin CHARACTERISTIC CalRegn01Cmn.HwAgSnsrlsRelHwAgFil1Frq.Val "MICROSAR RTE" VALUE 0x0 RTE_RL_FLOAT32_IEEE 0 NO_COMPU_METHOD -3.402823466e+38 3.402823466e+38 SYMBOL_LINK "Rte_CalprmRom_CalRegn01Cmn_DEFAULT_RTE_CALPRM_GROUP.HwAgSnsrlsRelHwAgFil1Frq_Val" 0 DISPLAY_IDENTIFIER CalRegn01Cmn.CalibrationPorts.HwAgSnsrlsRelHwAgFil1Frq.Val /end CHARACTERISTIC
/begin CHARACTERISTIC CalRegn01Cmn.HwAgSnsrlsRelHwAgFil2Frq.Val "MICROSAR RTE" VALUE 0x0 RTE_RL_FLOAT32_IEEE 0 NO_COMPU_METHOD -3.402823466e+38 3.402823466e+38 SYMBOL_LINK "Rte_CalprmRom_CalRegn01Cmn_DEFAULT_RTE_CALPRM_GROUP.HwAgSnsrlsRelHwAgFil2Frq_Val" 0 DISPLAY_IDENTIFIER CalRegn01Cmn.CalibrationPorts.HwAgSnsrlsRelHwAgFil2Frq.Val /end CHARACTERISTIC
/begin CHARACTERISTIC CalRegn01Cmn.HwAgSnsrlsSmotngCoeff.Val "MICROSAR RTE" VALUE 0x0 RTE_RL_FLOAT32_IEEE 0 NO_COMPU_METHOD -3.402823466e+38 3.402823466e+38 SYMBOL_LINK "Rte_CalprmRom_CalRegn01Cmn_DEFAULT_RTE_CALPRM_GROUP.HwAgSnsrlsSmotngCoeff_Val" 0 DISPLAY_IDENTIFIER CalRegn01Cmn.CalibrationPorts.HwAgSnsrlsSmotngCoeff.Val /end CHARACTERISTIC
/begin CHARACTERISTIC CalRegn01Cmn.HwAgSnsrlsSmotngStepThd.Val "MICROSAR RTE" VALUE 0x0 RTE_RL_FLOAT32_IEEE 0 NO_COMPU_METHOD -3.402823466e+38 3.402823466e+38 SYMBOL_LINK "Rte_CalprmRom_CalRegn01Cmn_DEFAULT_RTE_CALPRM_GROUP.HwAgSnsrlsSmotngStepThd_Val" 0 DISPLAY_IDENTIFIER CalRegn01Cmn.CalibrationPorts.HwAgSnsrlsSmotngStepThd.Val /end CHARACTERISTIC
/begin CHARACTERISTIC CalRegn01Cmn.HwAgSnsrlsStordPinionConf.Val "MICROSAR RTE" VALUE 0x0 RTE_RL_FLOAT32_IEEE 0 NO_COMPU_METHOD -3.402823466e+38 3.402823466e+38 SYMBOL_LINK "Rte_CalprmRom_CalRegn01Cmn_DEFAULT_RTE_CALPRM_GROUP.HwAgSnsrlsStordPinionConf_Val" 0 DISPLAY_IDENTIFIER CalRegn01Cmn.CalibrationPorts.HwAgSnsrlsStordPinionConf.Val /end CHARACTERISTIC
/begin CHARACTERISTIC CalRegn01Cmn.HwAgSnsrlsStordPinionConfThd.Val "MICROSAR RTE" VALUE 0x0 RTE_RL_FLOAT32_IEEE 0 NO_COMPU_METHOD -3.402823466e+38 3.402823466e+38 SYMBOL_LINK "Rte_CalprmRom_CalRegn01Cmn_DEFAULT_RTE_CALPRM_GROUP.HwAgSnsrlsStordPinionConfThd_Val" 0 DISPLAY_IDENTIFIER CalRegn01Cmn.CalibrationPorts.HwAgSnsrlsStordPinionConfThd.Val /end CHARACTERISTIC
/begin CHARACTERISTIC CalRegn01Cmn.HwAgSnsrlsVehDynDifThd.Val "MICROSAR RTE" VALUE 0x0 RTE_RL_FLOAT32_IEEE 0 NO_COMPU_METHOD -3.402823466e+38 3.402823466e+38 SYMBOL_LINK "Rte_CalprmRom_CalRegn01Cmn_DEFAULT_RTE_CALPRM_GROUP.HwAgSnsrlsVehDynDifThd_Val" 0 DISPLAY_IDENTIFIER CalRegn01Cmn.CalibrationPorts.HwAgSnsrlsVehDynDifThd.Val /end CHARACTERISTIC
/begin CHARACTERISTIC CalRegn01Cmn.HwAgSnsrlsVehDynHwConf.Val "MICROSAR RTE" VALUE 0x0 RTE_RL_FLOAT32_IEEE 0 NO_COMPU_METHOD -3.402823466e+38 3.402823466e+38 SYMBOL_LINK "Rte_CalprmRom_CalRegn01Cmn_DEFAULT_RTE_CALPRM_GROUP.HwAgSnsrlsVehDynHwConf_Val" 0 DISPLAY_IDENTIFIER CalRegn01Cmn.CalibrationPorts.HwAgSnsrlsVehDynHwConf.Val /end CHARACTERISTIC
/begin CHARACTERISTIC CalRegn01Cmn.HwAgSnsrlsVehDynMotVelThd.Val "MICROSAR RTE" VALUE 0x0 RTE_RL_FLOAT32_IEEE 0 NO_COMPU_METHOD -3.402823466e+38 3.402823466e+38 SYMBOL_LINK "Rte_CalprmRom_CalRegn01Cmn_DEFAULT_RTE_CALPRM_GROUP.HwAgSnsrlsVehDynMotVelThd_Val" 0 DISPLAY_IDENTIFIER CalRegn01Cmn.CalibrationPorts.HwAgSnsrlsVehDynMotVelThd.Val /end CHARACTERISTIC
/begin CHARACTERISTIC CalRegn01Cmn.HwAgSnsrlsVehDynPinionTqThd.Val "MICROSAR RTE" VALUE 0x0 RTE_RL_FLOAT32_IEEE 0 NO_COMPU_METHOD -3.402823466e+38 3.402823466e+38 SYMBOL_LINK "Rte_CalprmRom_CalRegn01Cmn_DEFAULT_RTE_CALPRM_GROUP.HwAgSnsrlsVehDynPinionTqThd_Val" 0 DISPLAY_IDENTIFIER CalRegn01Cmn.CalibrationPorts.HwAgSnsrlsVehDynPinionTqThd.Val /end CHARACTERISTIC
/begin CHARACTERISTIC CalRegn01Cmn.HwAgSnsrlsVehDynTmr1Thd.Val "MICROSAR RTE" VALUE 0x0 RTE_RL_ULONG 0 NO_COMPU_METHOD 0 4294967295 SYMBOL_LINK "Rte_CalprmRom_CalRegn01Cmn_DEFAULT_RTE_CALPRM_GROUP.HwAgSnsrlsVehDynTmr1Thd_Val" 0 DISPLAY_IDENTIFIER CalRegn01Cmn.CalibrationPorts.HwAgSnsrlsVehDynTmr1Thd.Val /end CHARACTERISTIC
/begin CHARACTERISTIC CalRegn01Cmn.HwAgSnsrlsVehDynTmr2Thd.Val "MICROSAR RTE" VALUE 0x0 RTE_RL_ULONG 0 NO_COMPU_METHOD 0 4294967295 SYMBOL_LINK "Rte_CalprmRom_CalRegn01Cmn_DEFAULT_RTE_CALPRM_GROUP.HwAgSnsrlsVehDynTmr2Thd_Val" 0 DISPLAY_IDENTIFIER CalRegn01Cmn.CalibrationPorts.HwAgSnsrlsVehDynTmr2Thd.Val /end CHARACTERISTIC
/begin CHARACTERISTIC CalRegn01Cmn.HwAgSnsrlsWhlFrqThd.Val "MICROSAR RTE" VALUE 0x0 RTE_RL_FLOAT32_IEEE 0 NO_COMPU_METHOD -3.402823466e+38 3.402823466e+38 SYMBOL_LINK "Rte_CalprmRom_CalRegn01Cmn_DEFAULT_RTE_CALPRM_GROUP.HwAgSnsrlsWhlFrqThd_Val" 0 DISPLAY_IDENTIFIER CalRegn01Cmn.CalibrationPorts.HwAgSnsrlsWhlFrqThd.Val /end CHARACTERISTIC
/begin CHARACTERISTIC CalRegn01Cmn.HwAgSnsrlsWhlSpdHwAgCoeff1.Val "MICROSAR RTE" VALUE 0x0 RTE_RL_FLOAT32_IEEE 0 NO_COMPU_METHOD -3.402823466e+38 3.402823466e+38 SYMBOL_LINK "Rte_CalprmRom_CalRegn01Cmn_DEFAULT_RTE_CALPRM_GROUP.HwAgSnsrlsWhlSpdHwAgCoeff1_Val" 0 DISPLAY_IDENTIFIER CalRegn01Cmn.CalibrationPorts.HwAgSnsrlsWhlSpdHwAgCoeff1.Val /end CHARACTERISTIC
/begin CHARACTERISTIC CalRegn01Cmn.HwAgSnsrlsWhlSpdHwAgCoeff2.Val "MICROSAR RTE" VALUE 0x0 RTE_RL_FLOAT32_IEEE 0 NO_COMPU_METHOD -3.402823466e+38 3.402823466e+38 SYMBOL_LINK "Rte_CalprmRom_CalRegn01Cmn_DEFAULT_RTE_CALPRM_GROUP.HwAgSnsrlsWhlSpdHwAgCoeff2_Val" 0 DISPLAY_IDENTIFIER CalRegn01Cmn.CalibrationPorts.HwAgSnsrlsWhlSpdHwAgCoeff2.Val /end CHARACTERISTIC
/begin CHARACTERISTIC CalRegn01Cmn.HwAgSnsrlsWhlSpdHwAgThd.Val "MICROSAR RTE" VALUE 0x0 RTE_RL_FLOAT32_IEEE 0 NO_COMPU_METHOD -3.402823466e+38 3.402823466e+38 SYMBOL_LINK "Rte_CalprmRom_CalRegn01Cmn_DEFAULT_RTE_CALPRM_GROUP.HwAgSnsrlsWhlSpdHwAgThd_Val" 0 DISPLAY_IDENTIFIER CalRegn01Cmn.CalibrationPorts.HwAgSnsrlsWhlSpdHwAgThd.Val /end CHARACTERISTIC
/begin CHARACTERISTIC CalRegn01Cmn.HwAgSnsrlsWhlSpdHwConf.Val "MICROSAR RTE" VALUE 0x0 RTE_RL_FLOAT32_IEEE 0 NO_COMPU_METHOD -3.402823466e+38 3.402823466e+38 SYMBOL_LINK "Rte_CalprmRom_CalRegn01Cmn_DEFAULT_RTE_CALPRM_GROUP.HwAgSnsrlsWhlSpdHwConf_Val" 0 DISPLAY_IDENTIFIER CalRegn01Cmn.CalibrationPorts.HwAgSnsrlsWhlSpdHwConf.Val /end CHARACTERISTIC
/begin CHARACTERISTIC CalRegn01Cmn.HwAgSnsrlsWhlSpdRatThd.Val "MICROSAR RTE" VALUE 0x0 RTE_RL_FLOAT32_IEEE 0 NO_COMPU_METHOD -3.402823466e+38 3.402823466e+38 SYMBOL_LINK "Rte_CalprmRom_CalRegn01Cmn_DEFAULT_RTE_CALPRM_GROUP.HwAgSnsrlsWhlSpdRatThd_Val" 0 DISPLAY_IDENTIFIER CalRegn01Cmn.CalibrationPorts.HwAgSnsrlsWhlSpdRatThd.Val /end CHARACTERISTIC
/begin CHARACTERISTIC CalRegn01Cmn.HwAgSnsrlsWhlSpdTmrThd.Val "MICROSAR RTE" VALUE 0x0 RTE_RL_ULONG 0 NO_COMPU_METHOD 0 4294967295 SYMBOL_LINK "Rte_CalprmRom_CalRegn01Cmn_DEFAULT_RTE_CALPRM_GROUP.HwAgSnsrlsWhlSpdTmrThd_Val" 0 DISPLAY_IDENTIFIER CalRegn01Cmn.CalibrationPorts.HwAgSnsrlsWhlSpdTmrThd.Val /end CHARACTERISTIC
/begin CHARACTERISTIC CalRegn01Cmn.HwAgSnsrlsWhlSpdVehSpdThd.Val "MICROSAR RTE" VALUE 0x0 RTE_RL_FLOAT32_IEEE 0 NO_COMPU_METHOD -3.402823466e+38 3.402823466e+38 SYMBOL_LINK "Rte_CalprmRom_CalRegn01Cmn_DEFAULT_RTE_CALPRM_GROUP.HwAgSnsrlsWhlSpdVehSpdThd_Val" 0 DISPLAY_IDENTIFIER CalRegn01Cmn.CalibrationPorts.HwAgSnsrlsWhlSpdVehSpdThd.Val /end CHARACTERISTIC
/begin CHARACTERISTIC CalRegn01Cmn.HwAgSysArbnHwAgConf1Snsr.Val "MICROSAR RTE" VALUE 0x0 RTE_RL_FLOAT32_IEEE 0 NO_COMPU_METHOD -3.402823466e+38 3.402823466e+38 SYMBOL_LINK "Rte_CalprmRom_CalRegn01Cmn_DEFAULT_RTE_CALPRM_GROUP.HwAgSysArbnHwAgConf1Snsr_Val" 0 DISPLAY_IDENTIFIER CalRegn01Cmn.CalibrationPorts.HwAgSysArbnHwAgConf1Snsr.Val /end CHARACTERISTIC
/begin CHARACTERISTIC CalRegn01Cmn.HwAgSysArbnHwAgConf1SnsrHwAgTrimNotPrfmd.Val "MICROSAR RTE" VALUE 0x0 RTE_RL_FLOAT32_IEEE 0 NO_COMPU_METHOD -3.402823466e+38 3.402823466e+38 SYMBOL_LINK "Rte_CalprmRom_CalRegn01Cmn_DEFAULT_RTE_CALPRM_GROUP.HwAgSysArbnHwAgConf1SnsrHwAgTrimNotPrfmd_Val" 0 DISPLAY_IDENTIFIER CalRegn01Cmn.CalibrationPorts.HwAgSysArbnHwAgConf1SnsrHwAgTrimNotPrfmd.Val /end CHARACTERISTIC
/begin CHARACTERISTIC CalRegn01Cmn.HwAgSysArbnHwAgConf2Snsr.Val "MICROSAR RTE" VALUE 0x0 RTE_RL_FLOAT32_IEEE 0 NO_COMPU_METHOD -3.402823466e+38 3.402823466e+38 SYMBOL_LINK "Rte_CalprmRom_CalRegn01Cmn_DEFAULT_RTE_CALPRM_GROUP.HwAgSysArbnHwAgConf2Snsr_Val" 0 DISPLAY_IDENTIFIER CalRegn01Cmn.CalibrationPorts.HwAgSysArbnHwAgConf2Snsr.Val /end CHARACTERISTIC
/begin CHARACTERISTIC CalRegn01Cmn.HwAgSysArbnHwAgConf2SnsrHwAgTrimNotPrfmd.Val "MICROSAR RTE" VALUE 0x0 RTE_RL_FLOAT32_IEEE 0 NO_COMPU_METHOD -3.402823466e+38 3.402823466e+38 SYMBOL_LINK "Rte_CalprmRom_CalRegn01Cmn_DEFAULT_RTE_CALPRM_GROUP.HwAgSysArbnHwAgConf2SnsrHwAgTrimNotPrfmd_Val" 0 DISPLAY_IDENTIFIER CalRegn01Cmn.CalibrationPorts.HwAgSysArbnHwAgConf2SnsrHwAgTrimNotPrfmd.Val /end CHARACTERISTIC
/begin CHARACTERISTIC CalRegn01Cmn.HwAgSysArbnHwAgConfNoSnsr.Val "MICROSAR RTE" VALUE 0x0 RTE_RL_FLOAT32_IEEE 0 NO_COMPU_METHOD -3.402823466e+38 3.402823466e+38 SYMBOL_LINK "Rte_CalprmRom_CalRegn01Cmn_DEFAULT_RTE_CALPRM_GROUP.HwAgSysArbnHwAgConfNoSnsr_Val" 0 DISPLAY_IDENTIFIER CalRegn01Cmn.CalibrationPorts.HwAgSysArbnHwAgConfNoSnsr.Val /end CHARACTERISTIC
/begin CHARACTERISTIC CalRegn01Cmn.HwAgSysArbnHwAgConfTiThd.Val "MICROSAR RTE" VALUE 0x0 RTE_RL_UWORD 0 NO_COMPU_METHOD 0 65535 SYMBOL_LINK "Rte_CalprmRom_CalRegn01Cmn_DEFAULT_RTE_CALPRM_GROUP.HwAgSysArbnHwAgConfTiThd_Val" 0 DISPLAY_IDENTIFIER CalRegn01Cmn.CalibrationPorts.HwAgSysArbnHwAgConfTiThd.Val /end CHARACTERISTIC
/begin CHARACTERISTIC CalRegn01Cmn.HwAgSysArbnHwAgCorrdCorrlnThd.Val "MICROSAR RTE" VALUE 0x0 RTE_RL_FLOAT32_IEEE 0 NO_COMPU_METHOD -3.402823466e+38 3.402823466e+38 SYMBOL_LINK "Rte_CalprmRom_CalRegn01Cmn_DEFAULT_RTE_CALPRM_GROUP.HwAgSysArbnHwAgCorrdCorrlnThd_Val" 0 DISPLAY_IDENTIFIER CalRegn01Cmn.CalibrationPorts.HwAgSysArbnHwAgCorrdCorrlnThd.Val /end CHARACTERISTIC
/begin CHARACTERISTIC CalRegn01Cmn.HwAgSysArbnHwAgCorrlnFailDebStep.Val "MICROSAR RTE" VALUE 0x0 RTE_RL_UWORD 0 NO_COMPU_METHOD 0 65535 SYMBOL_LINK "Rte_CalprmRom_CalRegn01Cmn_DEFAULT_RTE_CALPRM_GROUP.HwAgSysArbnHwAgCorrlnFailDebStep_Val" 0 DISPLAY_IDENTIFIER CalRegn01Cmn.CalibrationPorts.HwAgSysArbnHwAgCorrlnFailDebStep.Val /end CHARACTERISTIC
/begin CHARACTERISTIC CalRegn01Cmn.HwAgSysArbnHwAgCorrlnPassDebStep.Val "MICROSAR RTE" VALUE 0x0 RTE_RL_UWORD 0 NO_COMPU_METHOD 0 65535 SYMBOL_LINK "Rte_CalprmRom_CalRegn01Cmn_DEFAULT_RTE_CALPRM_GROUP.HwAgSysArbnHwAgCorrlnPassDebStep_Val" 0 DISPLAY_IDENTIFIER CalRegn01Cmn.CalibrationPorts.HwAgSysArbnHwAgCorrlnPassDebStep.Val /end CHARACTERISTIC
/begin CHARACTERISTIC CalRegn01Cmn.HwAgSysArbnHwAgCorrlnRng.Val "MICROSAR RTE" VALUE 0x0 RTE_RL_FLOAT32_IEEE 0 NO_COMPU_METHOD -3.402823466e+38 3.402823466e+38 SYMBOL_LINK "Rte_CalprmRom_CalRegn01Cmn_DEFAULT_RTE_CALPRM_GROUP.HwAgSysArbnHwAgCorrlnRng_Val" 0 DISPLAY_IDENTIFIER CalRegn01Cmn.CalibrationPorts.HwAgSysArbnHwAgCorrlnRng.Val /end CHARACTERISTIC
/begin CHARACTERISTIC CalRegn01Cmn.HwAgSysArbnHwAgIdptSigLim.Val "MICROSAR RTE" VALUE 0x0 RTE_RL_UBYTE 0 NO_COMPU_METHOD 0 255 SYMBOL_LINK "Rte_CalprmRom_CalRegn01Cmn_DEFAULT_RTE_CALPRM_GROUP.HwAgSysArbnHwAgIdptSigLim_Val" 0 DISPLAY_IDENTIFIER CalRegn01Cmn.CalibrationPorts.HwAgSysArbnHwAgIdptSigLim.Val /end CHARACTERISTIC
/begin CHARACTERISTIC CalRegn01Cmn.HwAgSysArbnHwAgSlewRate.Val "MICROSAR RTE" VALUE 0x0 RTE_RL_FLOAT32_IEEE 0 NO_COMPU_METHOD -3.402823466e+38 3.402823466e+38 SYMBOL_LINK "Rte_CalprmRom_CalRegn01Cmn_DEFAULT_RTE_CALPRM_GROUP.HwAgSysArbnHwAgSlewRate_Val" 0 DISPLAY_IDENTIFIER CalRegn01Cmn.CalibrationPorts.HwAgSysArbnHwAgSlewRate.Val /end CHARACTERISTIC
/begin CHARACTERISTIC CalRegn01Cmn.HwAgSysArbnHwAgSnsrlsCorrlnThd.Val "MICROSAR RTE" VALUE 0x0 RTE_RL_FLOAT32_IEEE 0 NO_COMPU_METHOD -3.402823466e+38 3.402823466e+38 SYMBOL_LINK "Rte_CalprmRom_CalRegn01Cmn_DEFAULT_RTE_CALPRM_GROUP.HwAgSysArbnHwAgSnsrlsCorrlnThd_Val" 0 DISPLAY_IDENTIFIER CalRegn01Cmn.CalibrationPorts.HwAgSysArbnHwAgSnsrlsCorrlnThd.Val /end CHARACTERISTIC
/begin CHARACTERISTIC CalRegn01Cmn.HwAgSysArbnHwAgSnsrlsKineThd.Val "MICROSAR RTE" VALUE 0x0 RTE_RL_FLOAT32_IEEE 0 NO_COMPU_METHOD -3.402823466e+38 3.402823466e+38 SYMBOL_LINK "Rte_CalprmRom_CalRegn01Cmn_DEFAULT_RTE_CALPRM_GROUP.HwAgSysArbnHwAgSnsrlsKineThd_Val" 0 DISPLAY_IDENTIFIER CalRegn01Cmn.CalibrationPorts.HwAgSysArbnHwAgSnsrlsKineThd.Val /end CHARACTERISTIC
/begin CHARACTERISTIC CalRegn01Cmn.HwAgSysArbnImcHwAgCorrlnRng.Val "MICROSAR RTE" VALUE 0x0 RTE_RL_FLOAT32_IEEE 0 NO_COMPU_METHOD -3.402823466e+38 3.402823466e+38 SYMBOL_LINK "Rte_CalprmRom_CalRegn01Cmn_DEFAULT_RTE_CALPRM_GROUP.HwAgSysArbnImcHwAgCorrlnRng_Val" 0 DISPLAY_IDENTIFIER CalRegn01Cmn.CalibrationPorts.HwAgSysArbnImcHwAgCorrlnRng.Val /end CHARACTERISTIC
/begin CHARACTERISTIC CalRegn01Cmn.HwAgSysArbnPinionAgConfThd.Val "MICROSAR RTE" VALUE 0x0 RTE_RL_FLOAT32_IEEE 0 NO_COMPU_METHOD -3.402823466e+38 3.402823466e+38 SYMBOL_LINK "Rte_CalprmRom_CalRegn01Cmn_DEFAULT_RTE_CALPRM_GROUP.HwAgSysArbnPinionAgConfThd_Val" 0 DISPLAY_IDENTIFIER CalRegn01Cmn.CalibrationPorts.HwAgSysArbnPinionAgConfThd.Val /end CHARACTERISTIC
/begin CHARACTERISTIC CalRegn01Cmn.HwAgSysArbnSerlComHwAgCorrdConf.Val "MICROSAR RTE" VALUE 0x0 RTE_RL_FLOAT32_IEEE 0 NO_COMPU_METHOD -3.402823466e+38 3.402823466e+38 SYMBOL_LINK "Rte_CalprmRom_CalRegn01Cmn_DEFAULT_RTE_CALPRM_GROUP.HwAgSysArbnSerlComHwAgCorrdConf_Val" 0 DISPLAY_IDENTIFIER CalRegn01Cmn.CalibrationPorts.HwAgSysArbnSerlComHwAgCorrdConf.Val /end CHARACTERISTIC
/begin CHARACTERISTIC CalRegn01Cmn.HwAgSysArbnSerlComHwAgSnsrlsConf.Val "MICROSAR RTE" VALUE 0x0 RTE_RL_FLOAT32_IEEE 0 NO_COMPU_METHOD -3.402823466e+38 3.402823466e+38 SYMBOL_LINK "Rte_CalprmRom_CalRegn01Cmn_DEFAULT_RTE_CALPRM_GROUP.HwAgSysArbnSerlComHwAgSnsrlsConf_Val" 0 DISPLAY_IDENTIFIER CalRegn01Cmn.CalibrationPorts.HwAgSysArbnSerlComHwAgSnsrlsConf.Val /end CHARACTERISTIC
/begin CHARACTERISTIC CalRegn01Cmn.HwAgSysArbnSlewRateTmr.Val "MICROSAR RTE" VALUE 0x0 RTE_RL_FLOAT32_IEEE 0 NO_COMPU_METHOD -3.402823466e+38 3.402823466e+38 SYMBOL_LINK "Rte_CalprmRom_CalRegn01Cmn_DEFAULT_RTE_CALPRM_GROUP.HwAgSysArbnSlewRateTmr_Val" 0 DISPLAY_IDENTIFIER CalRegn01Cmn.CalibrationPorts.HwAgSysArbnSlewRateTmr.Val /end CHARACTERISTIC
/begin CHARACTERISTIC CalRegn01Cmn.HwTqArbnHwTqMaxStallCnt.Val "MICROSAR RTE" VALUE 0x0 RTE_RL_UBYTE 0 NO_COMPU_METHOD 0 255 SYMBOL_LINK "Rte_CalprmRom_CalRegn01Cmn_DEFAULT_RTE_CALPRM_GROUP.HwTqArbnHwTqMaxStallCnt_Val" 0 DISPLAY_IDENTIFIER CalRegn01Cmn.CalibrationPorts.HwTqArbnHwTqMaxStallCnt.Val /end CHARACTERISTIC
/begin CHARACTERISTIC CalRegn01Cmn.HwTqCorrlnImdtCorrlnChkFailThd.Val "MICROSAR RTE" VALUE 0x0 RTE_RL_FLOAT32_IEEE 0 NO_COMPU_METHOD -3.402823466e+38 3.402823466e+38 SYMBOL_LINK "Rte_CalprmRom_CalRegn01Cmn_DEFAULT_RTE_CALPRM_GROUP.HwTqCorrlnImdtCorrlnChkFailThd_Val" 0 DISPLAY_IDENTIFIER CalRegn01Cmn.CalibrationPorts.HwTqCorrlnImdtCorrlnChkFailThd.Val /end CHARACTERISTIC
/begin CHARACTERISTIC CalRegn01Cmn.HwTqCorrlnNtcFailStep.Val "MICROSAR RTE" VALUE 0x0 RTE_RL_UWORD 0 NO_COMPU_METHOD 0 65535 SYMBOL_LINK "Rte_CalprmRom_CalRegn01Cmn_DEFAULT_RTE_CALPRM_GROUP.HwTqCorrlnNtcFailStep_Val" 0 DISPLAY_IDENTIFIER CalRegn01Cmn.CalibrationPorts.HwTqCorrlnNtcFailStep.Val /end CHARACTERISTIC
/begin CHARACTERISTIC CalRegn01Cmn.HwTqCorrlnNtcPassStep.Val "MICROSAR RTE" VALUE 0x0 RTE_RL_UWORD 0 NO_COMPU_METHOD 0 65535 SYMBOL_LINK "Rte_CalprmRom_CalRegn01Cmn_DEFAULT_RTE_CALPRM_GROUP.HwTqCorrlnNtcPassStep_Val" 0 DISPLAY_IDENTIFIER CalRegn01Cmn.CalibrationPorts.HwTqCorrlnNtcPassStep.Val /end CHARACTERISTIC
/begin CHARACTERISTIC CalRegn01Cmn.ImcArbnEcuIninTiOutThd.Val "MICROSAR RTE" VALUE 0x0 RTE_RL_ULONG 0 NO_COMPU_METHOD 0 4294967295 SYMBOL_LINK "Rte_CalprmRom_CalRegn01Cmn_DEFAULT_RTE_CALPRM_GROUP.ImcArbnEcuIninTiOutThd_Val" 0 DISPLAY_IDENTIFIER CalRegn01Cmn.CalibrationPorts.ImcArbnEcuIninTiOutThd.Val /end CHARACTERISTIC
/begin CHARACTERISTIC CalRegn01Cmn.ImcArbnFrmFltThd.Val "MICROSAR RTE" VALUE 0x0 RTE_RL_UBYTE 0 NO_COMPU_METHOD 0 255 SYMBOL_LINK "Rte_CalprmRom_CalRegn01Cmn_DEFAULT_RTE_CALPRM_GROUP.ImcArbnFrmFltThd_Val" 0 DISPLAY_IDENTIFIER CalRegn01Cmn.CalibrationPorts.ImcArbnFrmFltThd.Val /end CHARACTERISTIC
/begin CHARACTERISTIC CalRegn01Cmn.LoaMgrCurrIvtrMtgtnScaZeroEna.Logl "MICROSAR RTE" VALUE 0x0 RTE_RL_BOOLEAN 0 RTE_CM_BOOLEAN 0 255 SYMBOL_LINK "Rte_CalprmRom_CalRegn01Cmn_DEFAULT_RTE_CALPRM_GROUP.LoaMgrCurrIvtrMtgtnScaZeroEna_Logl" 0 DISPLAY_IDENTIFIER CalRegn01Cmn.CalibrationPorts.LoaMgrCurrIvtrMtgtnScaZeroEna.Logl /end CHARACTERISTIC
/begin CHARACTERISTIC CalRegn01Cmn.LoaMgrCurrMeasIdptSig0Resp.Val "MICROSAR RTE" VALUE 0x0 RTE_RL_UBYTE 0 NO_COMPU_METHOD 0 255 SYMBOL_LINK "Rte_CalprmRom_CalRegn01Cmn_DEFAULT_RTE_CALPRM_GROUP.LoaMgrCurrMeasIdptSig0Resp_Val" 0 DISPLAY_IDENTIFIER CalRegn01Cmn.CalibrationPorts.LoaMgrCurrMeasIdptSig0Resp.Val /end CHARACTERISTIC
/begin CHARACTERISTIC CalRegn01Cmn.LoaMgrCurrMeasIdptSig1Resp.Val "MICROSAR RTE" VALUE 0x0 RTE_RL_UBYTE 0 NO_COMPU_METHOD 0 255 SYMBOL_LINK "Rte_CalprmRom_CalRegn01Cmn_DEFAULT_RTE_CALPRM_GROUP.LoaMgrCurrMeasIdptSig1Resp_Val" 0 DISPLAY_IDENTIFIER CalRegn01Cmn.CalibrationPorts.LoaMgrCurrMeasIdptSig1Resp.Val /end CHARACTERISTIC
/begin CHARACTERISTIC CalRegn01Cmn.LoaMgrCurrMeasIdptSig2Resp.Val "MICROSAR RTE" VALUE 0x0 RTE_RL_UBYTE 0 NO_COMPU_METHOD 0 255 SYMBOL_LINK "Rte_CalprmRom_CalRegn01Cmn_DEFAULT_RTE_CALPRM_GROUP.LoaMgrCurrMeasIdptSig2Resp_Val" 0 DISPLAY_IDENTIFIER CalRegn01Cmn.CalibrationPorts.LoaMgrCurrMeasIdptSig2Resp.Val /end CHARACTERISTIC
/begin CHARACTERISTIC CalRegn01Cmn.LoaMgrCurrMeasIdptSigFltThd.Val "MICROSAR RTE" VALUE 0x0 RTE_RL_UBYTE 0 NO_COMPU_METHOD 0 255 SYMBOL_LINK "Rte_CalprmRom_CalRegn01Cmn_DEFAULT_RTE_CALPRM_GROUP.LoaMgrCurrMeasIdptSigFltThd_Val" 0 DISPLAY_IDENTIFIER CalRegn01Cmn.CalibrationPorts.LoaMgrCurrMeasIdptSigFltThd.Val /end CHARACTERISTIC
/begin CHARACTERISTIC CalRegn01Cmn.LoaMgrCurrMeasMtgtnScaZeroEna.Logl "MICROSAR RTE" VALUE 0x0 RTE_RL_BOOLEAN 0 RTE_CM_BOOLEAN 0 255 SYMBOL_LINK "Rte_CalprmRom_CalRegn01Cmn_DEFAULT_RTE_CALPRM_GROUP.LoaMgrCurrMeasMtgtnScaZeroEna_Logl" 0 DISPLAY_IDENTIFIER CalRegn01Cmn.CalibrationPorts.LoaMgrCurrMeasMtgtnScaZeroEna.Logl /end CHARACTERISTIC
/begin CHARACTERISTIC CalRegn01Cmn.LoaMgrFadeOutStRate.Val "MICROSAR RTE" VALUE 0x0 RTE_RL_FLOAT32_IEEE 0 NO_COMPU_METHOD -3.402823466e+38 3.402823466e+38 SYMBOL_LINK "Rte_CalprmRom_CalRegn01Cmn_DEFAULT_RTE_CALPRM_GROUP.LoaMgrFadeOutStRate_Val" 0 DISPLAY_IDENTIFIER CalRegn01Cmn.CalibrationPorts.LoaMgrFadeOutStRate.Val /end CHARACTERISTIC
/begin CHARACTERISTIC CalRegn01Cmn.LoaMgrHwTqIdptSig0NoTqLoaResp.Val "MICROSAR RTE" VALUE 0x0 RTE_RL_UBYTE 0 NO_COMPU_METHOD 0 255 SYMBOL_LINK "Rte_CalprmRom_CalRegn01Cmn_DEFAULT_RTE_CALPRM_GROUP.LoaMgrHwTqIdptSig0NoTqLoaResp_Val" 0 DISPLAY_IDENTIFIER CalRegn01Cmn.CalibrationPorts.LoaMgrHwTqIdptSig0NoTqLoaResp.Val /end CHARACTERISTIC
/begin CHARACTERISTIC CalRegn01Cmn.LoaMgrHwTqIdptSig1NoTqLoaResp.Val "MICROSAR RTE" VALUE 0x0 RTE_RL_UBYTE 0 NO_COMPU_METHOD 0 255 SYMBOL_LINK "Rte_CalprmRom_CalRegn01Cmn_DEFAULT_RTE_CALPRM_GROUP.LoaMgrHwTqIdptSig1NoTqLoaResp_Val" 0 DISPLAY_IDENTIFIER CalRegn01Cmn.CalibrationPorts.LoaMgrHwTqIdptSig1NoTqLoaResp.Val /end CHARACTERISTIC
/begin CHARACTERISTIC CalRegn01Cmn.LoaMgrHwTqIdptSig2Resp.Val "MICROSAR RTE" VALUE 0x0 RTE_RL_UBYTE 0 NO_COMPU_METHOD 0 255 SYMBOL_LINK "Rte_CalprmRom_CalRegn01Cmn_DEFAULT_RTE_CALPRM_GROUP.LoaMgrHwTqIdptSig2Resp_Val" 0 DISPLAY_IDENTIFIER CalRegn01Cmn.CalibrationPorts.LoaMgrHwTqIdptSig2Resp.Val /end CHARACTERISTIC
/begin CHARACTERISTIC CalRegn01Cmn.LoaMgrHwTqIdptSig3Resp.Val "MICROSAR RTE" VALUE 0x0 RTE_RL_UBYTE 0 NO_COMPU_METHOD 0 255 SYMBOL_LINK "Rte_CalprmRom_CalRegn01Cmn_DEFAULT_RTE_CALPRM_GROUP.LoaMgrHwTqIdptSig3Resp_Val" 0 DISPLAY_IDENTIFIER CalRegn01Cmn.CalibrationPorts.LoaMgrHwTqIdptSig3Resp.Val /end CHARACTERISTIC
/begin CHARACTERISTIC CalRegn01Cmn.LoaMgrHwTqIdptSig4Resp.Val "MICROSAR RTE" VALUE 0x0 RTE_RL_UBYTE 0 NO_COMPU_METHOD 0 255 SYMBOL_LINK "Rte_CalprmRom_CalRegn01Cmn_DEFAULT_RTE_CALPRM_GROUP.LoaMgrHwTqIdptSig4Resp_Val" 0 DISPLAY_IDENTIFIER CalRegn01Cmn.CalibrationPorts.LoaMgrHwTqIdptSig4Resp.Val /end CHARACTERISTIC
/begin CHARACTERISTIC CalRegn01Cmn.LoaMgrHwTqIdptSigFltThd.Val "MICROSAR RTE" VALUE 0x0 RTE_RL_UBYTE 0 NO_COMPU_METHOD 0 255 SYMBOL_LINK "Rte_CalprmRom_CalRegn01Cmn_DEFAULT_RTE_CALPRM_GROUP.LoaMgrHwTqIdptSigFltThd_Val" 0 DISPLAY_IDENTIFIER CalRegn01Cmn.CalibrationPorts.LoaMgrHwTqIdptSigFltThd.Val /end CHARACTERISTIC
/begin CHARACTERISTIC CalRegn01Cmn.LoaMgrHwTqLoaAvlResp.Val "MICROSAR RTE" VALUE 0x0 RTE_RL_UBYTE 0 NO_COMPU_METHOD 0 255 SYMBOL_LINK "Rte_CalprmRom_CalRegn01Cmn_DEFAULT_RTE_CALPRM_GROUP.LoaMgrHwTqLoaAvlResp_Val" 0 DISPLAY_IDENTIFIER CalRegn01Cmn.CalibrationPorts.LoaMgrHwTqLoaAvlResp.Val /end CHARACTERISTIC
/begin CHARACTERISTIC CalRegn01Cmn.LoaMgrIvtrIdptSig0Resp.Val "MICROSAR RTE" VALUE 0x0 RTE_RL_UBYTE 0 NO_COMPU_METHOD 0 255 SYMBOL_LINK "Rte_CalprmRom_CalRegn01Cmn_DEFAULT_RTE_CALPRM_GROUP.LoaMgrIvtrIdptSig0Resp_Val" 0 DISPLAY_IDENTIFIER CalRegn01Cmn.CalibrationPorts.LoaMgrIvtrIdptSig0Resp.Val /end CHARACTERISTIC
/begin CHARACTERISTIC CalRegn01Cmn.LoaMgrIvtrIdptSig1Resp.Val "MICROSAR RTE" VALUE 0x0 RTE_RL_UBYTE 0 NO_COMPU_METHOD 0 255 SYMBOL_LINK "Rte_CalprmRom_CalRegn01Cmn_DEFAULT_RTE_CALPRM_GROUP.LoaMgrIvtrIdptSig1Resp_Val" 0 DISPLAY_IDENTIFIER CalRegn01Cmn.CalibrationPorts.LoaMgrIvtrIdptSig1Resp.Val /end CHARACTERISTIC
/begin CHARACTERISTIC CalRegn01Cmn.LoaMgrIvtrIdptSig2Resp.Val "MICROSAR RTE" VALUE 0x0 RTE_RL_UBYTE 0 NO_COMPU_METHOD 0 255 SYMBOL_LINK "Rte_CalprmRom_CalRegn01Cmn_DEFAULT_RTE_CALPRM_GROUP.LoaMgrIvtrIdptSig2Resp_Val" 0 DISPLAY_IDENTIFIER CalRegn01Cmn.CalibrationPorts.LoaMgrIvtrIdptSig2Resp.Val /end CHARACTERISTIC
/begin CHARACTERISTIC CalRegn01Cmn.LoaMgrIvtrIdptSigFltThd.Val "MICROSAR RTE" VALUE 0x0 RTE_RL_UBYTE 0 NO_COMPU_METHOD 0 255 SYMBOL_LINK "Rte_CalprmRom_CalRegn01Cmn_DEFAULT_RTE_CALPRM_GROUP.LoaMgrIvtrIdptSigFltThd_Val" 0 DISPLAY_IDENTIFIER CalRegn01Cmn.CalibrationPorts.LoaMgrIvtrIdptSigFltThd.Val /end CHARACTERISTIC
/begin CHARACTERISTIC CalRegn01Cmn.LoaMgrIvtrMtgtnScaZeroEna.Logl "MICROSAR RTE" VALUE 0x0 RTE_RL_BOOLEAN 0 RTE_CM_BOOLEAN 0 255 SYMBOL_LINK "Rte_CalprmRom_CalRegn01Cmn_DEFAULT_RTE_CALPRM_GROUP.LoaMgrIvtrMtgtnScaZeroEna_Logl" 0 DISPLAY_IDENTIFIER CalRegn01Cmn.CalibrationPorts.LoaMgrIvtrMtgtnScaZeroEna.Logl /end CHARACTERISTIC
/begin CHARACTERISTIC CalRegn01Cmn.LoaMgrMotAgAvlSnsrlsResp.Val "MICROSAR RTE" VALUE 0x0 RTE_RL_UBYTE 0 NO_COMPU_METHOD 0 255 SYMBOL_LINK "Rte_CalprmRom_CalRegn01Cmn_DEFAULT_RTE_CALPRM_GROUP.LoaMgrMotAgAvlSnsrlsResp_Val" 0 DISPLAY_IDENTIFIER CalRegn01Cmn.CalibrationPorts.LoaMgrMotAgAvlSnsrlsResp.Val /end CHARACTERISTIC
/begin CHARACTERISTIC CalRegn01Cmn.LoaMgrMotAgIdptSig0NoSnsrlsResp.Val "MICROSAR RTE" VALUE 0x0 RTE_RL_UBYTE 0 NO_COMPU_METHOD 0 255 SYMBOL_LINK "Rte_CalprmRom_CalRegn01Cmn_DEFAULT_RTE_CALPRM_GROUP.LoaMgrMotAgIdptSig0NoSnsrlsResp_Val" 0 DISPLAY_IDENTIFIER CalRegn01Cmn.CalibrationPorts.LoaMgrMotAgIdptSig0NoSnsrlsResp.Val /end CHARACTERISTIC
/begin CHARACTERISTIC CalRegn01Cmn.LoaMgrMotAgIdptSig1NoSnsrlsResp.Val "MICROSAR RTE" VALUE 0x0 RTE_RL_UBYTE 0 NO_COMPU_METHOD 0 255 SYMBOL_LINK "Rte_CalprmRom_CalRegn01Cmn_DEFAULT_RTE_CALPRM_GROUP.LoaMgrMotAgIdptSig1NoSnsrlsResp_Val" 0 DISPLAY_IDENTIFIER CalRegn01Cmn.CalibrationPorts.LoaMgrMotAgIdptSig1NoSnsrlsResp.Val /end CHARACTERISTIC
/begin CHARACTERISTIC CalRegn01Cmn.LoaMgrMotAgIdptSig2Resp.Val "MICROSAR RTE" VALUE 0x0 RTE_RL_UBYTE 0 NO_COMPU_METHOD 0 255 SYMBOL_LINK "Rte_CalprmRom_CalRegn01Cmn_DEFAULT_RTE_CALPRM_GROUP.LoaMgrMotAgIdptSig2Resp_Val" 0 DISPLAY_IDENTIFIER CalRegn01Cmn.CalibrationPorts.LoaMgrMotAgIdptSig2Resp.Val /end CHARACTERISTIC
/begin CHARACTERISTIC CalRegn01Cmn.LoaMgrMotAgIdptSig3Resp.Val "MICROSAR RTE" VALUE 0x0 RTE_RL_UBYTE 0 NO_COMPU_METHOD 0 255 SYMBOL_LINK "Rte_CalprmRom_CalRegn01Cmn_DEFAULT_RTE_CALPRM_GROUP.LoaMgrMotAgIdptSig3Resp_Val" 0 DISPLAY_IDENTIFIER CalRegn01Cmn.CalibrationPorts.LoaMgrMotAgIdptSig3Resp.Val /end CHARACTERISTIC
/begin CHARACTERISTIC CalRegn01Cmn.LoaMgrMotAgIdptSigFltThd.Val "MICROSAR RTE" VALUE 0x0 RTE_RL_UBYTE 0 NO_COMPU_METHOD 0 255 SYMBOL_LINK "Rte_CalprmRom_CalRegn01Cmn_DEFAULT_RTE_CALPRM_GROUP.LoaMgrMotAgIdptSigFltThd_Val" 0 DISPLAY_IDENTIFIER CalRegn01Cmn.CalibrationPorts.LoaMgrMotAgIdptSigFltThd.Val /end CHARACTERISTIC
/begin CHARACTERISTIC CalRegn01Cmn.LoaMgrMotAgMtgtnScaZeroEna.Logl "MICROSAR RTE" VALUE 0x0 RTE_RL_BOOLEAN 0 RTE_CM_BOOLEAN 0 255 SYMBOL_LINK "Rte_CalprmRom_CalRegn01Cmn_DEFAULT_RTE_CALPRM_GROUP.LoaMgrMotAgMtgtnScaZeroEna_Logl" 0 DISPLAY_IDENTIFIER CalRegn01Cmn.CalibrationPorts.LoaMgrMotAgMtgtnScaZeroEna.Logl /end CHARACTERISTIC
/begin CHARACTERISTIC CalRegn01Cmn.MotAg2MeasOffs.Val "MICROSAR RTE" VALUE 0x0 RTE_RL_FLOAT32_IEEE 0 NO_COMPU_METHOD -3.402823466e+38 3.402823466e+38 SYMBOL_LINK "Rte_CalprmRom_CalRegn01Cmn_DEFAULT_RTE_CALPRM_GROUP.MotAg2MeasOffs_Val" 0 DISPLAY_IDENTIFIER CalRegn01Cmn.CalibrationPorts.MotAg2MeasOffs.Val /end CHARACTERISTIC
/begin CHARACTERISTIC CalRegn01Cmn.MotAg5MeasAmpSqdMaxThd.Val "MICROSAR RTE" VALUE 0x0 RTE_RL_FLOAT32_IEEE 0 NO_COMPU_METHOD -3.402823466e+38 3.402823466e+38 SYMBOL_LINK "Rte_CalprmRom_CalRegn01Cmn_DEFAULT_RTE_CALPRM_GROUP.MotAg5MeasAmpSqdMaxThd_Val" 0 DISPLAY_IDENTIFIER CalRegn01Cmn.CalibrationPorts.MotAg5MeasAmpSqdMaxThd.Val /end CHARACTERISTIC
/begin CHARACTERISTIC CalRegn01Cmn.MotAg5MeasAmpSqdMinThd.Val "MICROSAR RTE" VALUE 0x0 RTE_RL_FLOAT32_IEEE 0 NO_COMPU_METHOD -3.402823466e+38 3.402823466e+38 SYMBOL_LINK "Rte_CalprmRom_CalRegn01Cmn_DEFAULT_RTE_CALPRM_GROUP.MotAg5MeasAmpSqdMinThd_Val" 0 DISPLAY_IDENTIFIER CalRegn01Cmn.CalibrationPorts.MotAg5MeasAmpSqdMinThd.Val /end CHARACTERISTIC
/begin CHARACTERISTIC CalRegn01Cmn.MotAg5MeasLpFilFrq.Val "MICROSAR RTE" VALUE 0x0 RTE_RL_FLOAT32_IEEE 0 NO_COMPU_METHOD -3.402823466e+38 3.402823466e+38 SYMBOL_LINK "Rte_CalprmRom_CalRegn01Cmn_DEFAULT_RTE_CALPRM_GROUP.MotAg5MeasLpFilFrq_Val" 0 DISPLAY_IDENTIFIER CalRegn01Cmn.CalibrationPorts.MotAg5MeasLpFilFrq.Val /end CHARACTERISTIC
/begin CHARACTERISTIC CalRegn01Cmn.MotAg5MeasOffs.Val "MICROSAR RTE" VALUE 0x0 RTE_RL_UWORD 0 NO_COMPU_METHOD 0 65535 SYMBOL_LINK "Rte_CalprmRom_CalRegn01Cmn_DEFAULT_RTE_CALPRM_GROUP.MotAg5MeasOffs_Val" 0 DISPLAY_IDENTIFIER CalRegn01Cmn.CalibrationPorts.MotAg5MeasOffs.Val /end CHARACTERISTIC
/begin CHARACTERISTIC CalRegn01Cmn.MotAg5MeasRtAmpRecprLim.Val "MICROSAR RTE" VALUE 0x0 RTE_RL_FLOAT32_IEEE 0 NO_COMPU_METHOD -3.402823466e+38 3.402823466e+38 SYMBOL_LINK "Rte_CalprmRom_CalRegn01Cmn_DEFAULT_RTE_CALPRM_GROUP.MotAg5MeasRtAmpRecprLim_Val" 0 DISPLAY_IDENTIFIER CalRegn01Cmn.CalibrationPorts.MotAg5MeasRtAmpRecprLim.Val /end CHARACTERISTIC
/begin CHARACTERISTIC CalRegn01Cmn.MotAg5MeasRtFilEnaThd.Val "MICROSAR RTE" VALUE 0x0 RTE_RL_FLOAT32_IEEE 0 NO_COMPU_METHOD -3.402823466e+38 3.402823466e+38 SYMBOL_LINK "Rte_CalprmRom_CalRegn01Cmn_DEFAULT_RTE_CALPRM_GROUP.MotAg5MeasRtFilEnaThd_Val" 0 DISPLAY_IDENTIFIER CalRegn01Cmn.CalibrationPorts.MotAg5MeasRtFilEnaThd.Val /end CHARACTERISTIC
/begin CHARACTERISTIC CalRegn01Cmn.MotAg5MeasRtMotVelFilEnaThd.Val "MICROSAR RTE" VALUE 0x0 RTE_RL_FLOAT32_IEEE 0 NO_COMPU_METHOD -3.402823466e+38 3.402823466e+38 SYMBOL_LINK "Rte_CalprmRom_CalRegn01Cmn_DEFAULT_RTE_CALPRM_GROUP.MotAg5MeasRtMotVelFilEnaThd_Val" 0 DISPLAY_IDENTIFIER CalRegn01Cmn.CalibrationPorts.MotAg5MeasRtMotVelFilEnaThd.Val /end CHARACTERISTIC
/begin CHARACTERISTIC CalRegn01Cmn.MotAg5MeasRtOffsLim.Val "MICROSAR RTE" VALUE 0x0 RTE_RL_FLOAT32_IEEE 0 NO_COMPU_METHOD -3.402823466e+38 3.402823466e+38 SYMBOL_LINK "Rte_CalprmRom_CalRegn01Cmn_DEFAULT_RTE_CALPRM_GROUP.MotAg5MeasRtOffsLim_Val" 0 DISPLAY_IDENTIFIER CalRegn01Cmn.CalibrationPorts.MotAg5MeasRtOffsLim.Val /end CHARACTERISTIC
/begin CHARACTERISTIC CalRegn01Cmn.MotAg5MeasRtToNomRatLim.Val "MICROSAR RTE" VALUE 0x0 RTE_RL_FLOAT32_IEEE 0 NO_COMPU_METHOD -3.402823466e+38 3.402823466e+38 SYMBOL_LINK "Rte_CalprmRom_CalRegn01Cmn_DEFAULT_RTE_CALPRM_GROUP.MotAg5MeasRtToNomRatLim_Val" 0 DISPLAY_IDENTIFIER CalRegn01Cmn.CalibrationPorts.MotAg5MeasRtToNomRatLim.Val /end CHARACTERISTIC
/begin CHARACTERISTIC CalRegn01Cmn.MotAg6MeasAmpSqdMaxThd.Val "MICROSAR RTE" VALUE 0x0 RTE_RL_FLOAT32_IEEE 0 NO_COMPU_METHOD -3.402823466e+38 3.402823466e+38 SYMBOL_LINK "Rte_CalprmRom_CalRegn01Cmn_DEFAULT_RTE_CALPRM_GROUP.MotAg6MeasAmpSqdMaxThd_Val" 0 DISPLAY_IDENTIFIER CalRegn01Cmn.CalibrationPorts.MotAg6MeasAmpSqdMaxThd.Val /end CHARACTERISTIC
/begin CHARACTERISTIC CalRegn01Cmn.MotAg6MeasAmpSqdMinThd.Val "MICROSAR RTE" VALUE 0x0 RTE_RL_FLOAT32_IEEE 0 NO_COMPU_METHOD -3.402823466e+38 3.402823466e+38 SYMBOL_LINK "Rte_CalprmRom_CalRegn01Cmn_DEFAULT_RTE_CALPRM_GROUP.MotAg6MeasAmpSqdMinThd_Val" 0 DISPLAY_IDENTIFIER CalRegn01Cmn.CalibrationPorts.MotAg6MeasAmpSqdMinThd.Val /end CHARACTERISTIC
/begin CHARACTERISTIC CalRegn01Cmn.MotAg6MeasLpFilFrq.Val "MICROSAR RTE" VALUE 0x0 RTE_RL_FLOAT32_IEEE 0 NO_COMPU_METHOD -3.402823466e+38 3.402823466e+38 SYMBOL_LINK "Rte_CalprmRom_CalRegn01Cmn_DEFAULT_RTE_CALPRM_GROUP.MotAg6MeasLpFilFrq_Val" 0 DISPLAY_IDENTIFIER CalRegn01Cmn.CalibrationPorts.MotAg6MeasLpFilFrq.Val /end CHARACTERISTIC
/begin CHARACTERISTIC CalRegn01Cmn.MotAg6MeasOffs.Val "MICROSAR RTE" VALUE 0x0 RTE_RL_UWORD 0 NO_COMPU_METHOD 0 65535 SYMBOL_LINK "Rte_CalprmRom_CalRegn01Cmn_DEFAULT_RTE_CALPRM_GROUP.MotAg6MeasOffs_Val" 0 DISPLAY_IDENTIFIER CalRegn01Cmn.CalibrationPorts.MotAg6MeasOffs.Val /end CHARACTERISTIC
/begin CHARACTERISTIC CalRegn01Cmn.MotAg6MeasRtAmpRecprLim.Val "MICROSAR RTE" VALUE 0x0 RTE_RL_FLOAT32_IEEE 0 NO_COMPU_METHOD -3.402823466e+38 3.402823466e+38 SYMBOL_LINK "Rte_CalprmRom_CalRegn01Cmn_DEFAULT_RTE_CALPRM_GROUP.MotAg6MeasRtAmpRecprLim_Val" 0 DISPLAY_IDENTIFIER CalRegn01Cmn.CalibrationPorts.MotAg6MeasRtAmpRecprLim.Val /end CHARACTERISTIC
/begin CHARACTERISTIC CalRegn01Cmn.MotAg6MeasRtFilEnaThd.Val "MICROSAR RTE" VALUE 0x0 RTE_RL_FLOAT32_IEEE 0 NO_COMPU_METHOD -3.402823466e+38 3.402823466e+38 SYMBOL_LINK "Rte_CalprmRom_CalRegn01Cmn_DEFAULT_RTE_CALPRM_GROUP.MotAg6MeasRtFilEnaThd_Val" 0 DISPLAY_IDENTIFIER CalRegn01Cmn.CalibrationPorts.MotAg6MeasRtFilEnaThd.Val /end CHARACTERISTIC
/begin CHARACTERISTIC CalRegn01Cmn.MotAg6MeasRtMotVelFilEnaThd.Val "MICROSAR RTE" VALUE 0x0 RTE_RL_FLOAT32_IEEE 0 NO_COMPU_METHOD -3.402823466e+38 3.402823466e+38 SYMBOL_LINK "Rte_CalprmRom_CalRegn01Cmn_DEFAULT_RTE_CALPRM_GROUP.MotAg6MeasRtMotVelFilEnaThd_Val" 0 DISPLAY_IDENTIFIER CalRegn01Cmn.CalibrationPorts.MotAg6MeasRtMotVelFilEnaThd.Val /end CHARACTERISTIC
/begin CHARACTERISTIC CalRegn01Cmn.MotAg6MeasRtOffsLim.Val "MICROSAR RTE" VALUE 0x0 RTE_RL_FLOAT32_IEEE 0 NO_COMPU_METHOD -3.402823466e+38 3.402823466e+38 SYMBOL_LINK "Rte_CalprmRom_CalRegn01Cmn_DEFAULT_RTE_CALPRM_GROUP.MotAg6MeasRtOffsLim_Val" 0 DISPLAY_IDENTIFIER CalRegn01Cmn.CalibrationPorts.MotAg6MeasRtOffsLim.Val /end CHARACTERISTIC
/begin CHARACTERISTIC CalRegn01Cmn.MotAg6MeasRtToNomRatLim.Val "MICROSAR RTE" VALUE 0x0 RTE_RL_FLOAT32_IEEE 0 NO_COMPU_METHOD -3.402823466e+38 3.402823466e+38 SYMBOL_LINK "Rte_CalprmRom_CalRegn01Cmn_DEFAULT_RTE_CALPRM_GROUP.MotAg6MeasRtToNomRatLim_Val" 0 DISPLAY_IDENTIFIER CalRegn01Cmn.CalibrationPorts.MotAg6MeasRtToNomRatLim.Val /end CHARACTERISTIC
/begin CHARACTERISTIC CalRegn01Cmn.MotAgSwCalVehSpdThd.Val "MICROSAR RTE" VALUE 0x0 RTE_RL_FLOAT32_IEEE 0 NO_COMPU_METHOD -3.402823466e+38 3.402823466e+38 SYMBOL_LINK "Rte_CalprmRom_CalRegn01Cmn_DEFAULT_RTE_CALPRM_GROUP.MotAgSwCalVehSpdThd_Val" 0 DISPLAY_IDENTIFIER CalRegn01Cmn.CalibrationPorts.MotAgSwCalVehSpdThd.Val /end CHARACTERISTIC
/begin CHARACTERISTIC CalRegn01Cmn.MotCtrlPrmEstimnFetRNom.Val "MICROSAR RTE" VALUE 0x0 RTE_RL_FLOAT32_IEEE 0 NO_COMPU_METHOD 0.0 0.1 SYMBOL_LINK "Rte_CalprmRom_CalRegn01Cmn_DEFAULT_RTE_CALPRM_GROUP.MotCtrlPrmEstimnFetRNom_Val" 0 DISPLAY_IDENTIFIER CalRegn01Cmn.CalibrationPorts.MotCtrlPrmEstimnFetRNom.Val /end CHARACTERISTIC
/begin CHARACTERISTIC CalRegn01Cmn.MotCtrlPrmEstimnFetThermCoeff.Val "MICROSAR RTE" VALUE 0x0 RTE_RL_FLOAT32_IEEE 0 NO_COMPU_METHOD 0.0 0.006 SYMBOL_LINK "Rte_CalprmRom_CalRegn01Cmn_DEFAULT_RTE_CALPRM_GROUP.MotCtrlPrmEstimnFetThermCoeff_Val" 0 DISPLAY_IDENTIFIER CalRegn01Cmn.CalibrationPorts.MotCtrlPrmEstimnFetThermCoeff.Val /end CHARACTERISTIC
/begin CHARACTERISTIC CalRegn01Cmn.MotCtrlPrmEstimnMagThermCoeff.Val "MICROSAR RTE" VALUE 0x0 RTE_RL_FLOAT32_IEEE 0 NO_COMPU_METHOD -0.0015 0.0 SYMBOL_LINK "Rte_CalprmRom_CalRegn01Cmn_DEFAULT_RTE_CALPRM_GROUP.MotCtrlPrmEstimnMagThermCoeff_Val" 0 DISPLAY_IDENTIFIER CalRegn01Cmn.CalibrationPorts.MotCtrlPrmEstimnMagThermCoeff.Val /end CHARACTERISTIC
/begin CHARACTERISTIC CalRegn01Cmn.MotCtrlPrmEstimnMotBackEmfConHiLim.Val "MICROSAR RTE" VALUE 0x0 RTE_RL_FLOAT32_IEEE 0 NO_COMPU_METHOD 0.025 0.075 SYMBOL_LINK "Rte_CalprmRom_CalRegn01Cmn_DEFAULT_RTE_CALPRM_GROUP.MotCtrlPrmEstimnMotBackEmfConHiLim_Val" 0 DISPLAY_IDENTIFIER CalRegn01Cmn.CalibrationPorts.MotCtrlPrmEstimnMotBackEmfConHiLim.Val /end CHARACTERISTIC
/begin CHARACTERISTIC CalRegn01Cmn.MotCtrlPrmEstimnMotBackEmfConLoLim.Val "MICROSAR RTE" VALUE 0x0 RTE_RL_FLOAT32_IEEE 0 NO_COMPU_METHOD 0.025 0.075 SYMBOL_LINK "Rte_CalprmRom_CalRegn01Cmn_DEFAULT_RTE_CALPRM_GROUP.MotCtrlPrmEstimnMotBackEmfConLoLim_Val" 0 DISPLAY_IDENTIFIER CalRegn01Cmn.CalibrationPorts.MotCtrlPrmEstimnMotBackEmfConLoLim.Val /end CHARACTERISTIC
/begin CHARACTERISTIC CalRegn01Cmn.MotCtrlPrmEstimnMotBackEmfConNom.Val "MICROSAR RTE" VALUE 0x0 RTE_RL_FLOAT32_IEEE 0 NO_COMPU_METHOD 0.025 0.075 SYMBOL_LINK "Rte_CalprmRom_CalRegn01Cmn_DEFAULT_RTE_CALPRM_GROUP.MotCtrlPrmEstimnMotBackEmfConNom_Val" 0 DISPLAY_IDENTIFIER CalRegn01Cmn.CalibrationPorts.MotCtrlPrmEstimnMotBackEmfConNom.Val /end CHARACTERISTIC
/begin CHARACTERISTIC CalRegn01Cmn.MotCtrlPrmEstimnMotBackEmfConSatnScaIvtrLoaMtgtn.Val "MICROSAR RTE" VALUE 0x0 RTE_RL_FLOAT32_IEEE 0 NO_COMPU_METHOD -3.402823466e+38 3.402823466e+38 SYMBOL_LINK "Rte_CalprmRom_CalRegn01Cmn_DEFAULT_RTE_CALPRM_GROUP.MotCtrlPrmEstimnMotBackEmfConSatnScaIvtrLoaMtgtn_Val" 0 DISPLAY_IDENTIFIER CalRegn01Cmn.CalibrationPorts.MotCtrlPrmEstimnMotBackEmfConSatnScaIvtrLoaMtgtn.Val /end CHARACTERISTIC
/begin CHARACTERISTIC CalRegn01Cmn.MotCtrlPrmEstimnMotBackEmfConSatnX.Ary1D "MICROSAR RTE" VAL_BLK 0x0 RTE_RL_UWORD 0 RTE_CM_Curr8 0 200 MATRIX_DIM 16 1 1 SYMBOL_LINK "Rte_CalprmRom_CalRegn01Cmn_DEFAULT_RTE_CALPRM_GROUP.MotCtrlPrmEstimnMotBackEmfConSatnX_Ary1D" 0 DISPLAY_IDENTIFIER CalRegn01Cmn.CalibrationPorts.MotCtrlPrmEstimnMotBackEmfConSatnX.Ary1D /end CHARACTERISTIC
/begin CHARACTERISTIC CalRegn01Cmn.MotCtrlPrmEstimnMotBackEmfConSatnY.Ary1D "MICROSAR RTE" VAL_BLK 0x0 RTE_RL_UWORD 0 RTE_CM_Uls11 0 2 MATRIX_DIM 16 1 1 SYMBOL_LINK "Rte_CalprmRom_CalRegn01Cmn_DEFAULT_RTE_CALPRM_GROUP.MotCtrlPrmEstimnMotBackEmfConSatnY_Ary1D" 0 DISPLAY_IDENTIFIER CalRegn01Cmn.CalibrationPorts.MotCtrlPrmEstimnMotBackEmfConSatnY.Ary1D /end CHARACTERISTIC
/begin CHARACTERISTIC CalRegn01Cmn.MotCtrlPrmEstimnMotCurrDaxInduSatnBilnrSeln.Ary1D "MICROSAR RTE" VAL_BLK 0x0 RTE_RL_UWORD 0 RTE_CM_Curr8 0 200 MATRIX_DIM 6 1 1 SYMBOL_LINK "Rte_CalprmRom_CalRegn01Cmn_DEFAULT_RTE_CALPRM_GROUP.MotCtrlPrmEstimnMotCurrDaxInduSatnBilnrSeln_Ary1D" 0 DISPLAY_IDENTIFIER CalRegn01Cmn.CalibrationPorts.MotCtrlPrmEstimnMotCurrDaxInduSatnBilnrSeln.Ary1D /end CHARACTERISTIC
/begin CHARACTERISTIC CalRegn01Cmn.MotCtrlPrmEstimnMotCurrQaxInduSatnX.Ary1D "MICROSAR RTE" VAL_BLK 0x0 RTE_RL_UWORD 0 RTE_CM_Curr8 0 200 MATRIX_DIM 7 1 1 SYMBOL_LINK "Rte_CalprmRom_CalRegn01Cmn_DEFAULT_RTE_CALPRM_GROUP.MotCtrlPrmEstimnMotCurrQaxInduSatnX_Ary1D" 0 DISPLAY_IDENTIFIER CalRegn01Cmn.CalibrationPorts.MotCtrlPrmEstimnMotCurrQaxInduSatnX.Ary1D /end CHARACTERISTIC
/begin CHARACTERISTIC CalRegn01Cmn.MotCtrlPrmEstimnMotInduDaxHiLim.Val "MICROSAR RTE" VALUE 0x0 RTE_RL_FLOAT32_IEEE 0 NO_COMPU_METHOD 0.00003 0.00041 SYMBOL_LINK "Rte_CalprmRom_CalRegn01Cmn_DEFAULT_RTE_CALPRM_GROUP.MotCtrlPrmEstimnMotInduDaxHiLim_Val" 0 DISPLAY_IDENTIFIER CalRegn01Cmn.CalibrationPorts.MotCtrlPrmEstimnMotInduDaxHiLim.Val /end CHARACTERISTIC
/begin CHARACTERISTIC CalRegn01Cmn.MotCtrlPrmEstimnMotInduDaxIvtrLoaMtgtn.Val "MICROSAR RTE" VALUE 0x0 RTE_RL_FLOAT32_IEEE 0 NO_COMPU_METHOD -3.402823466e+38 3.402823466e+38 SYMBOL_LINK "Rte_CalprmRom_CalRegn01Cmn_DEFAULT_RTE_CALPRM_GROUP.MotCtrlPrmEstimnMotInduDaxIvtrLoaMtgtn_Val" 0 DISPLAY_IDENTIFIER CalRegn01Cmn.CalibrationPorts.MotCtrlPrmEstimnMotInduDaxIvtrLoaMtgtn.Val /end CHARACTERISTIC
/begin CHARACTERISTIC CalRegn01Cmn.MotCtrlPrmEstimnMotInduDaxLoLim.Val "MICROSAR RTE" VALUE 0x0 RTE_RL_FLOAT32_IEEE 0 NO_COMPU_METHOD 0.00003 0.00041 SYMBOL_LINK "Rte_CalprmRom_CalRegn01Cmn_DEFAULT_RTE_CALPRM_GROUP.MotCtrlPrmEstimnMotInduDaxLoLim_Val" 0 DISPLAY_IDENTIFIER CalRegn01Cmn.CalibrationPorts.MotCtrlPrmEstimnMotInduDaxLoLim.Val /end CHARACTERISTIC
/begin CHARACTERISTIC CalRegn01Cmn.MotCtrlPrmEstimnMotInduDaxNom.Val "MICROSAR RTE" VALUE 0x0 RTE_RL_FLOAT32_IEEE 0 NO_COMPU_METHOD 0.00003 0.00041 SYMBOL_LINK "Rte_CalprmRom_CalRegn01Cmn_DEFAULT_RTE_CALPRM_GROUP.MotCtrlPrmEstimnMotInduDaxNom_Val" 0 DISPLAY_IDENTIFIER CalRegn01Cmn.CalibrationPorts.MotCtrlPrmEstimnMotInduDaxNom.Val /end CHARACTERISTIC
/begin CHARACTERISTIC CalRegn01Cmn.MotCtrlPrmEstimnMotInduDaxSatnScaY.Ary2D "MICROSAR RTE" VAL_BLK 0x0 RTE_RL_UWORD 0 NO_COMPU_METHOD 0 65535 MATRIX_DIM 7 6 1 SYMBOL_LINK "Rte_CalprmRom_CalRegn01Cmn_DEFAULT_RTE_CALPRM_GROUP.MotCtrlPrmEstimnMotInduDaxSatnScaY_Ary2D" 0 DISPLAY_IDENTIFIER CalRegn01Cmn.CalibrationPorts.MotCtrlPrmEstimnMotInduDaxSatnScaY.Ary2D /end CHARACTERISTIC
/begin CHARACTERISTIC CalRegn01Cmn.MotCtrlPrmEstimnMotInduQaxHiLim.Val "MICROSAR RTE" VALUE 0x0 RTE_RL_FLOAT32_IEEE 0 NO_COMPU_METHOD 0.00003 0.00041 SYMBOL_LINK "Rte_CalprmRom_CalRegn01Cmn_DEFAULT_RTE_CALPRM_GROUP.MotCtrlPrmEstimnMotInduQaxHiLim_Val" 0 DISPLAY_IDENTIFIER CalRegn01Cmn.CalibrationPorts.MotCtrlPrmEstimnMotInduQaxHiLim.Val /end CHARACTERISTIC
/begin CHARACTERISTIC CalRegn01Cmn.MotCtrlPrmEstimnMotInduQaxIvtrLoaMtgtn.Val "MICROSAR RTE" VALUE 0x0 RTE_RL_FLOAT32_IEEE 0 NO_COMPU_METHOD -3.402823466e+38 3.402823466e+38 SYMBOL_LINK "Rte_CalprmRom_CalRegn01Cmn_DEFAULT_RTE_CALPRM_GROUP.MotCtrlPrmEstimnMotInduQaxIvtrLoaMtgtn_Val" 0 DISPLAY_IDENTIFIER CalRegn01Cmn.CalibrationPorts.MotCtrlPrmEstimnMotInduQaxIvtrLoaMtgtn.Val /end CHARACTERISTIC
/begin CHARACTERISTIC CalRegn01Cmn.MotCtrlPrmEstimnMotInduQaxLoLim.Val "MICROSAR RTE" VALUE 0x0 RTE_RL_FLOAT32_IEEE 0 NO_COMPU_METHOD 0.00003 0.00041 SYMBOL_LINK "Rte_CalprmRom_CalRegn01Cmn_DEFAULT_RTE_CALPRM_GROUP.MotCtrlPrmEstimnMotInduQaxLoLim_Val" 0 DISPLAY_IDENTIFIER CalRegn01Cmn.CalibrationPorts.MotCtrlPrmEstimnMotInduQaxLoLim.Val /end CHARACTERISTIC
/begin CHARACTERISTIC CalRegn01Cmn.MotCtrlPrmEstimnMotInduQaxNom.Val "MICROSAR RTE" VALUE 0x0 RTE_RL_FLOAT32_IEEE 0 NO_COMPU_METHOD 0.00003 0.00041 SYMBOL_LINK "Rte_CalprmRom_CalRegn01Cmn_DEFAULT_RTE_CALPRM_GROUP.MotCtrlPrmEstimnMotInduQaxNom_Val" 0 DISPLAY_IDENTIFIER CalRegn01Cmn.CalibrationPorts.MotCtrlPrmEstimnMotInduQaxNom.Val /end CHARACTERISTIC
/begin CHARACTERISTIC CalRegn01Cmn.MotCtrlPrmEstimnMotInduQaxSatnScaY.Ary2D "MICROSAR RTE" VAL_BLK 0x0 RTE_RL_UWORD 0 NO_COMPU_METHOD 0 65535 MATRIX_DIM 7 6 1 SYMBOL_LINK "Rte_CalprmRom_CalRegn01Cmn_DEFAULT_RTE_CALPRM_GROUP.MotCtrlPrmEstimnMotInduQaxSatnScaY_Ary2D" 0 DISPLAY_IDENTIFIER CalRegn01Cmn.CalibrationPorts.MotCtrlPrmEstimnMotInduQaxSatnScaY.Ary2D /end CHARACTERISTIC
/begin CHARACTERISTIC CalRegn01Cmn.MotCtrlPrmEstimnMotRHiLim.Val "MICROSAR RTE" VALUE 0x0 RTE_RL_FLOAT32_IEEE 0 NO_COMPU_METHOD 0.005 0.12565 SYMBOL_LINK "Rte_CalprmRom_CalRegn01Cmn_DEFAULT_RTE_CALPRM_GROUP.MotCtrlPrmEstimnMotRHiLim_Val" 0 DISPLAY_IDENTIFIER CalRegn01Cmn.CalibrationPorts.MotCtrlPrmEstimnMotRHiLim.Val /end CHARACTERISTIC
/begin CHARACTERISTIC CalRegn01Cmn.MotCtrlPrmEstimnMotRLoLim.Val "MICROSAR RTE" VALUE 0x0 RTE_RL_FLOAT32_IEEE 0 NO_COMPU_METHOD 0.005 0.12565 SYMBOL_LINK "Rte_CalprmRom_CalRegn01Cmn_DEFAULT_RTE_CALPRM_GROUP.MotCtrlPrmEstimnMotRLoLim_Val" 0 DISPLAY_IDENTIFIER CalRegn01Cmn.CalibrationPorts.MotCtrlPrmEstimnMotRLoLim.Val /end CHARACTERISTIC
/begin CHARACTERISTIC CalRegn01Cmn.MotCtrlPrmEstimnMotRNom.Val "MICROSAR RTE" VALUE 0x0 RTE_RL_FLOAT32_IEEE 0 NO_COMPU_METHOD 0.005 0.12565 SYMBOL_LINK "Rte_CalprmRom_CalRegn01Cmn_DEFAULT_RTE_CALPRM_GROUP.MotCtrlPrmEstimnMotRNom_Val" 0 DISPLAY_IDENTIFIER CalRegn01Cmn.CalibrationPorts.MotCtrlPrmEstimnMotRNom.Val /end CHARACTERISTIC
/begin CHARACTERISTIC CalRegn01Cmn.MotCtrlPrmEstimnMotWidgThermCoeff.Val "MICROSAR RTE" VALUE 0x0 RTE_RL_FLOAT32_IEEE 0 NO_COMPU_METHOD 0.0 0.0045 SYMBOL_LINK "Rte_CalprmRom_CalRegn01Cmn_DEFAULT_RTE_CALPRM_GROUP.MotCtrlPrmEstimnMotWidgThermCoeff_Val" 0 DISPLAY_IDENTIFIER CalRegn01Cmn.CalibrationPorts.MotCtrlPrmEstimnMotWidgThermCoeff.Val /end CHARACTERISTIC
/begin CHARACTERISTIC CalRegn01Cmn.MotCtrlPrmEstimnTNom.Val "MICROSAR RTE" VALUE 0x0 RTE_RL_FLOAT32_IEEE 0 NO_COMPU_METHOD -40.0 150.0 SYMBOL_LINK "Rte_CalprmRom_CalRegn01Cmn_DEFAULT_RTE_CALPRM_GROUP.MotCtrlPrmEstimnTNom_Val" 0 DISPLAY_IDENTIFIER CalRegn01Cmn.CalibrationPorts.MotCtrlPrmEstimnTNom.Val /end CHARACTERISTIC
/begin CHARACTERISTIC CalRegn01Cmn.MotCurrPeakEstimnCurrFilFrq.Val "MICROSAR RTE" VALUE 0x0 RTE_RL_FLOAT32_IEEE 0 NO_COMPU_METHOD -3.402823466e+38 3.402823466e+38 SYMBOL_LINK "Rte_CalprmRom_CalRegn01Cmn_DEFAULT_RTE_CALPRM_GROUP.MotCurrPeakEstimnCurrFilFrq_Val" 0 DISPLAY_IDENTIFIER CalRegn01Cmn.CalibrationPorts.MotCurrPeakEstimnCurrFilFrq.Val /end CHARACTERISTIC
/begin CHARACTERISTIC CalRegn01Cmn.MotCurrPeakEstimnCurrPeakEstimdFilFrq.Val "MICROSAR RTE" VALUE 0x0 RTE_RL_FLOAT32_IEEE 0 NO_COMPU_METHOD -3.402823466e+38 3.402823466e+38 SYMBOL_LINK "Rte_CalprmRom_CalRegn01Cmn_DEFAULT_RTE_CALPRM_GROUP.MotCurrPeakEstimnCurrPeakEstimdFilFrq_Val" 0 DISPLAY_IDENTIFIER CalRegn01Cmn.CalibrationPorts.MotCurrPeakEstimnCurrPeakEstimdFilFrq.Val /end CHARACTERISTIC
/begin CHARACTERISTIC CalRegn01Cmn.MotCurrRegCfgCtrlrDynGainVehSpdCutOff.Val "MICROSAR RTE" VALUE 0x0 RTE_RL_FLOAT32_IEEE 0 NO_COMPU_METHOD -3.402823466e+38 3.402823466e+38 SYMBOL_LINK "Rte_CalprmRom_CalRegn01Cmn_DEFAULT_RTE_CALPRM_GROUP.MotCurrRegCfgCtrlrDynGainVehSpdCutOff_Val" 0 DISPLAY_IDENTIFIER CalRegn01Cmn.CalibrationPorts.MotCurrRegCfgCtrlrDynGainVehSpdCutOff.Val /end CHARACTERISTIC
/begin CHARACTERISTIC CalRegn01Cmn.MotCurrRegCfgCurrLoopSecOrderTrfFctEna.Logl "MICROSAR RTE" VALUE 0x0 RTE_RL_BOOLEAN 0 RTE_CM_BOOLEAN 0 255 SYMBOL_LINK "Rte_CalprmRom_CalRegn01Cmn_DEFAULT_RTE_CALPRM_GROUP.MotCurrRegCfgCurrLoopSecOrderTrfFctEna_Logl" 0 DISPLAY_IDENTIFIER CalRegn01Cmn.CalibrationPorts.MotCurrRegCfgCurrLoopSecOrderTrfFctEna.Logl /end CHARACTERISTIC
/begin CHARACTERISTIC CalRegn01Cmn.MotCurrRegCfgIntglGainSampleTi.Val "MICROSAR RTE" VALUE 0x0 RTE_RL_FLOAT32_IEEE 0 NO_COMPU_METHOD -3.402823466e+38 3.402823466e+38 SYMBOL_LINK "Rte_CalprmRom_CalRegn01Cmn_DEFAULT_RTE_CALPRM_GROUP.MotCurrRegCfgIntglGainSampleTi_Val" 0 DISPLAY_IDENTIFIER CalRegn01Cmn.CalibrationPorts.MotCurrRegCfgIntglGainSampleTi.Val /end CHARACTERISTIC
/begin CHARACTERISTIC CalRegn01Cmn.MotCurrRegCfgMotAgCompuDly.Val "MICROSAR RTE" VALUE 0x0 RTE_RL_FLOAT32_IEEE 0 NO_COMPU_METHOD -3.402823466e+38 3.402823466e+38 SYMBOL_LINK "Rte_CalprmRom_CalRegn01Cmn_DEFAULT_RTE_CALPRM_GROUP.MotCurrRegCfgMotAgCompuDly_Val" 0 DISPLAY_IDENTIFIER CalRegn01Cmn.CalibrationPorts.MotCurrRegCfgMotAgCompuDly.Val /end CHARACTERISTIC
/begin CHARACTERISTIC CalRegn01Cmn.MotCurrRegCfgMotClsdLoopBwDaxY.Ary1D "MICROSAR RTE" VAL_BLK 0x0 RTE_RL_UWORD 0 NO_COMPU_METHOD 0 65535 MATRIX_DIM 4 1 1 SYMBOL_LINK "Rte_CalprmRom_CalRegn01Cmn_DEFAULT_RTE_CALPRM_GROUP.MotCurrRegCfgMotClsdLoopBwDaxY_Ary1D" 0 DISPLAY_IDENTIFIER CalRegn01Cmn.CalibrationPorts.MotCurrRegCfgMotClsdLoopBwDaxY.Ary1D /end CHARACTERISTIC
/begin CHARACTERISTIC CalRegn01Cmn.MotCurrRegCfgMotClsdLoopBwQaxY.Ary1D "MICROSAR RTE" VAL_BLK 0x0 RTE_RL_UWORD 0 NO_COMPU_METHOD 0 65535 MATRIX_DIM 4 1 1 SYMBOL_LINK "Rte_CalprmRom_CalRegn01Cmn_DEFAULT_RTE_CALPRM_GROUP.MotCurrRegCfgMotClsdLoopBwQaxY_Ary1D" 0 DISPLAY_IDENTIFIER CalRegn01Cmn.CalibrationPorts.MotCurrRegCfgMotClsdLoopBwQaxY.Ary1D /end CHARACTERISTIC
/begin CHARACTERISTIC CalRegn01Cmn.MotCurrRegCfgMotCtrlPrmSelnX.Ary1D "MICROSAR RTE" VAL_BLK 0x0 RTE_RL_UWORD 0 NO_COMPU_METHOD 0 65535 MATRIX_DIM 4 1 1 SYMBOL_LINK "Rte_CalprmRom_CalRegn01Cmn_DEFAULT_RTE_CALPRM_GROUP.MotCurrRegCfgMotCtrlPrmSelnX_Ary1D" 0 DISPLAY_IDENTIFIER CalRegn01Cmn.CalibrationPorts.MotCurrRegCfgMotCtrlPrmSelnX.Ary1D /end CHARACTERISTIC
/begin CHARACTERISTIC CalRegn01Cmn.MotCurrRegCfgMotDampgRatDax.Val "MICROSAR RTE" VALUE 0x0 RTE_RL_FLOAT32_IEEE 0 NO_COMPU_METHOD -3.402823466e+38 3.402823466e+38 SYMBOL_LINK "Rte_CalprmRom_CalRegn01Cmn_DEFAULT_RTE_CALPRM_GROUP.MotCurrRegCfgMotDampgRatDax_Val" 0 DISPLAY_IDENTIFIER CalRegn01Cmn.CalibrationPorts.MotCurrRegCfgMotDampgRatDax.Val /end CHARACTERISTIC
/begin CHARACTERISTIC CalRegn01Cmn.MotCurrRegCfgMotDampgRatQax.Val "MICROSAR RTE" VALUE 0x0 RTE_RL_FLOAT32_IEEE 0 NO_COMPU_METHOD -3.402823466e+38 3.402823466e+38 SYMBOL_LINK "Rte_CalprmRom_CalRegn01Cmn_DEFAULT_RTE_CALPRM_GROUP.MotCurrRegCfgMotDampgRatQax_Val" 0 DISPLAY_IDENTIFIER CalRegn01Cmn.CalibrationPorts.MotCurrRegCfgMotDampgRatQax.Val /end CHARACTERISTIC
/begin CHARACTERISTIC CalRegn01Cmn.MotCurrRegCfgMotNatFrqDaxY.Ary1D "MICROSAR RTE" VAL_BLK 0x0 RTE_RL_UWORD 0 NO_COMPU_METHOD 0 65535 MATRIX_DIM 4 1 1 SYMBOL_LINK "Rte_CalprmRom_CalRegn01Cmn_DEFAULT_RTE_CALPRM_GROUP.MotCurrRegCfgMotNatFrqDaxY_Ary1D" 0 DISPLAY_IDENTIFIER CalRegn01Cmn.CalibrationPorts.MotCurrRegCfgMotNatFrqDaxY.Ary1D /end CHARACTERISTIC
/begin CHARACTERISTIC CalRegn01Cmn.MotCurrRegCfgMotNatFrqQaxY.Ary1D "MICROSAR RTE" VAL_BLK 0x0 RTE_RL_UWORD 0 NO_COMPU_METHOD 0 65535 MATRIX_DIM 4 1 1 SYMBOL_LINK "Rte_CalprmRom_CalRegn01Cmn_DEFAULT_RTE_CALPRM_GROUP.MotCurrRegCfgMotNatFrqQaxY_Ary1D" 0 DISPLAY_IDENTIFIER CalRegn01Cmn.CalibrationPorts.MotCurrRegCfgMotNatFrqQaxY.Ary1D /end CHARACTERISTIC
/begin CHARACTERISTIC CalRegn01Cmn.MotCurrRegCfgMotRVirtDax.Val "MICROSAR RTE" VALUE 0x0 RTE_RL_FLOAT32_IEEE 0 NO_COMPU_METHOD 0.0 0.2 SYMBOL_LINK "Rte_CalprmRom_CalRegn01Cmn_DEFAULT_RTE_CALPRM_GROUP.MotCurrRegCfgMotRVirtDax_Val" 0 DISPLAY_IDENTIFIER CalRegn01Cmn.CalibrationPorts.MotCurrRegCfgMotRVirtDax.Val /end CHARACTERISTIC
/begin CHARACTERISTIC CalRegn01Cmn.MotCurrRegCfgMotRVirtQax.Val "MICROSAR RTE" VALUE 0x0 RTE_RL_FLOAT32_IEEE 0 NO_COMPU_METHOD 0.0 0.2 SYMBOL_LINK "Rte_CalprmRom_CalRegn01Cmn_DEFAULT_RTE_CALPRM_GROUP.MotCurrRegCfgMotRVirtQax_Val" 0 DISPLAY_IDENTIFIER CalRegn01Cmn.CalibrationPorts.MotCurrRegCfgMotRVirtQax.Val /end CHARACTERISTIC
/begin CHARACTERISTIC CalRegn01Cmn.MotCurrRegCfgMotVelFilFrq.Val "MICROSAR RTE" VALUE 0x0 RTE_RL_FLOAT32_IEEE 0 NO_COMPU_METHOD -3.402823466e+38 3.402823466e+38 SYMBOL_LINK "Rte_CalprmRom_CalRegn01Cmn_DEFAULT_RTE_CALPRM_GROUP.MotCurrRegCfgMotVelFilFrq_Val" 0 DISPLAY_IDENTIFIER CalRegn01Cmn.CalibrationPorts.MotCurrRegCfgMotVelFilFrq.Val /end CHARACTERISTIC
/begin CHARACTERISTIC CalRegn01Cmn.MotCurrRegVltgLimrCurrLoaScarSlewRate.Val "MICROSAR RTE" VALUE 0x0 RTE_RL_FLOAT32_IEEE 0 NO_COMPU_METHOD 0.0 1000.0 SYMBOL_LINK "Rte_CalprmRom_CalRegn01Cmn_DEFAULT_RTE_CALPRM_GROUP.MotCurrRegVltgLimrCurrLoaScarSlewRate_Val" 0 DISPLAY_IDENTIFIER CalRegn01Cmn.CalibrationPorts.MotCurrRegVltgLimrCurrLoaScarSlewRate.Val /end CHARACTERISTIC
/begin CHARACTERISTIC CalRegn01Cmn.MotCurrRegVltgLimrDaxAntiWdupCoeff.Val "MICROSAR RTE" VALUE 0x0 RTE_RL_FLOAT32_IEEE 0 NO_COMPU_METHOD -25 25 SYMBOL_LINK "Rte_CalprmRom_CalRegn01Cmn_DEFAULT_RTE_CALPRM_GROUP.MotCurrRegVltgLimrDaxAntiWdupCoeff_Val" 0 DISPLAY_IDENTIFIER CalRegn01Cmn.CalibrationPorts.MotCurrRegVltgLimrDaxAntiWdupCoeff.Val /end CHARACTERISTIC
/begin CHARACTERISTIC CalRegn01Cmn.MotCurrRegVltgLimrDualEcuLoaScarSlewRate.Val "MICROSAR RTE" VALUE 0x0 RTE_RL_FLOAT32_IEEE 0 NO_COMPU_METHOD -3.402823466e+38 3.402823466e+38 SYMBOL_LINK "Rte_CalprmRom_CalRegn01Cmn_DEFAULT_RTE_CALPRM_GROUP.MotCurrRegVltgLimrDualEcuLoaScarSlewRate_Val" 0 DISPLAY_IDENTIFIER CalRegn01Cmn.CalibrationPorts.MotCurrRegVltgLimrDualEcuLoaScarSlewRate.Val /end CHARACTERISTIC
/begin CHARACTERISTIC CalRegn01Cmn.MotCurrRegVltgLimrFETLoaScarSlewRate.Val "MICROSAR RTE" VALUE 0x0 RTE_RL_FLOAT32_IEEE 0 NO_COMPU_METHOD -3.402823466e+38 3.402823466e+38 SYMBOL_LINK "Rte_CalprmRom_CalRegn01Cmn_DEFAULT_RTE_CALPRM_GROUP.MotCurrRegVltgLimrFETLoaScarSlewRate_Val" 0 DISPLAY_IDENTIFIER CalRegn01Cmn.CalibrationPorts.MotCurrRegVltgLimrFETLoaScarSlewRate.Val /end CHARACTERISTIC
/begin CHARACTERISTIC CalRegn01Cmn.MotCurrRegVltgLimrIvtrLoaScarSlewRate.Val "MICROSAR RTE" VALUE 0x0 RTE_RL_FLOAT32_IEEE 0 NO_COMPU_METHOD 0.0 1000.0 SYMBOL_LINK "Rte_CalprmRom_CalRegn01Cmn_DEFAULT_RTE_CALPRM_GROUP.MotCurrRegVltgLimrIvtrLoaScarSlewRate_Val" 0 DISPLAY_IDENTIFIER CalRegn01Cmn.CalibrationPorts.MotCurrRegVltgLimrIvtrLoaScarSlewRate.Val /end CHARACTERISTIC
/begin CHARACTERISTIC CalRegn01Cmn.MotCurrRegVltgLimrMotCurrPredEna.Logl "MICROSAR RTE" VALUE 0x0 RTE_RL_BOOLEAN 0 RTE_CM_BOOLEAN 0 255 SYMBOL_LINK "Rte_CalprmRom_CalRegn01Cmn_DEFAULT_RTE_CALPRM_GROUP.MotCurrRegVltgLimrMotCurrPredEna_Logl" 0 DISPLAY_IDENTIFIER CalRegn01Cmn.CalibrationPorts.MotCurrRegVltgLimrMotCurrPredEna.Logl /end CHARACTERISTIC
/begin CHARACTERISTIC CalRegn01Cmn.MotCurrRegVltgLimrMotCurrPredTi.Val "MICROSAR RTE" VALUE 0x0 RTE_RL_FLOAT32_IEEE 0 NO_COMPU_METHOD -3.402823466e+38 3.402823466e+38 SYMBOL_LINK "Rte_CalprmRom_CalRegn01Cmn_DEFAULT_RTE_CALPRM_GROUP.MotCurrRegVltgLimrMotCurrPredTi_Val" 0 DISPLAY_IDENTIFIER CalRegn01Cmn.CalibrationPorts.MotCurrRegVltgLimrMotCurrPredTi.Val /end CHARACTERISTIC
/begin CHARACTERISTIC CalRegn01Cmn.MotCurrRegVltgLimrMotCurrQaxRefMdfnRplEna.Logl "MICROSAR RTE" VALUE 0x0 RTE_RL_BOOLEAN 0 RTE_CM_BOOLEAN 0 255 SYMBOL_LINK "Rte_CalprmRom_CalRegn01Cmn_DEFAULT_RTE_CALPRM_GROUP.MotCurrRegVltgLimrMotCurrQaxRefMdfnRplEna_Logl" 0 DISPLAY_IDENTIFIER CalRegn01Cmn.CalibrationPorts.MotCurrRegVltgLimrMotCurrQaxRefMdfnRplEna.Logl /end CHARACTERISTIC
/begin CHARACTERISTIC CalRegn01Cmn.MotCurrRegVltgLimrMotVltgBrdgFilEna.Logl "MICROSAR RTE" VALUE 0x0 RTE_RL_BOOLEAN 0 RTE_CM_BOOLEAN 0 255 SYMBOL_LINK "Rte_CalprmRom_CalRegn01Cmn_DEFAULT_RTE_CALPRM_GROUP.MotCurrRegVltgLimrMotVltgBrdgFilEna_Logl" 0 DISPLAY_IDENTIFIER CalRegn01Cmn.CalibrationPorts.MotCurrRegVltgLimrMotVltgBrdgFilEna.Logl /end CHARACTERISTIC
/begin CHARACTERISTIC CalRegn01Cmn.MotCurrRegVltgLimrMotVltgBrdgLpFilFrq.Val "MICROSAR RTE" VALUE 0x0 RTE_RL_FLOAT32_IEEE 0 NO_COMPU_METHOD -3.402823466e+38 3.402823466e+38 SYMBOL_LINK "Rte_CalprmRom_CalRegn01Cmn_DEFAULT_RTE_CALPRM_GROUP.MotCurrRegVltgLimrMotVltgBrdgLpFilFrq_Val" 0 DISPLAY_IDENTIFIER CalRegn01Cmn.CalibrationPorts.MotCurrRegVltgLimrMotVltgBrdgLpFilFrq.Val /end CHARACTERISTIC
/begin CHARACTERISTIC CalRegn01Cmn.MotCurrRegVltgLimrMotVltgDaxIntglHiLim.Val "MICROSAR RTE" VALUE 0x0 RTE_RL_FLOAT32_IEEE 0 NO_COMPU_METHOD -3.402823466e+38 3.402823466e+38 SYMBOL_LINK "Rte_CalprmRom_CalRegn01Cmn_DEFAULT_RTE_CALPRM_GROUP.MotCurrRegVltgLimrMotVltgDaxIntglHiLim_Val" 0 DISPLAY_IDENTIFIER CalRegn01Cmn.CalibrationPorts.MotCurrRegVltgLimrMotVltgDaxIntglHiLim.Val /end CHARACTERISTIC
/begin CHARACTERISTIC CalRegn01Cmn.MotCurrRegVltgLimrMotVltgDaxIntglLoLim.Val "MICROSAR RTE" VALUE 0x0 RTE_RL_FLOAT32_IEEE 0 NO_COMPU_METHOD -3.402823466e+38 3.402823466e+38 SYMBOL_LINK "Rte_CalprmRom_CalRegn01Cmn_DEFAULT_RTE_CALPRM_GROUP.MotCurrRegVltgLimrMotVltgDaxIntglLoLim_Val" 0 DISPLAY_IDENTIFIER CalRegn01Cmn.CalibrationPorts.MotCurrRegVltgLimrMotVltgDaxIntglLoLim.Val /end CHARACTERISTIC
/begin CHARACTERISTIC CalRegn01Cmn.MotCurrRegVltgLimrMotVltgQaxFfFilEna.Logl "MICROSAR RTE" VALUE 0x0 RTE_RL_BOOLEAN 0 RTE_CM_BOOLEAN 0 255 SYMBOL_LINK "Rte_CalprmRom_CalRegn01Cmn_DEFAULT_RTE_CALPRM_GROUP.MotCurrRegVltgLimrMotVltgQaxFfFilEna_Logl" 0 DISPLAY_IDENTIFIER CalRegn01Cmn.CalibrationPorts.MotCurrRegVltgLimrMotVltgQaxFfFilEna.Logl /end CHARACTERISTIC
/begin CHARACTERISTIC CalRegn01Cmn.MotCurrRegVltgLimrMotVltgQaxFfLpFilFrq.Val "MICROSAR RTE" VALUE 0x0 RTE_RL_FLOAT32_IEEE 0 NO_COMPU_METHOD -3.402823466e+38 3.402823466e+38 SYMBOL_LINK "Rte_CalprmRom_CalRegn01Cmn_DEFAULT_RTE_CALPRM_GROUP.MotCurrRegVltgLimrMotVltgQaxFfLpFilFrq_Val" 0 DISPLAY_IDENTIFIER CalRegn01Cmn.CalibrationPorts.MotCurrRegVltgLimrMotVltgQaxFfLpFilFrq.Val /end CHARACTERISTIC
/begin CHARACTERISTIC CalRegn01Cmn.MotCurrRegVltgLimrMotVltgQaxIntglHiLim.Val "MICROSAR RTE" VALUE 0x0 RTE_RL_FLOAT32_IEEE 0 NO_COMPU_METHOD -3.402823466e+38 3.402823466e+38 SYMBOL_LINK "Rte_CalprmRom_CalRegn01Cmn_DEFAULT_RTE_CALPRM_GROUP.MotCurrRegVltgLimrMotVltgQaxIntglHiLim_Val" 0 DISPLAY_IDENTIFIER CalRegn01Cmn.CalibrationPorts.MotCurrRegVltgLimrMotVltgQaxIntglHiLim.Val /end CHARACTERISTIC
/begin CHARACTERISTIC CalRegn01Cmn.MotCurrRegVltgLimrMotVltgQaxIntglLoLim.Val "MICROSAR RTE" VALUE 0x0 RTE_RL_FLOAT32_IEEE 0 NO_COMPU_METHOD -3.402823466e+38 3.402823466e+38 SYMBOL_LINK "Rte_CalprmRom_CalRegn01Cmn_DEFAULT_RTE_CALPRM_GROUP.MotCurrRegVltgLimrMotVltgQaxIntglLoLim_Val" 0 DISPLAY_IDENTIFIER CalRegn01Cmn.CalibrationPorts.MotCurrRegVltgLimrMotVltgQaxIntglLoLim.Val /end CHARACTERISTIC
/begin CHARACTERISTIC CalRegn01Cmn.MotCurrRegVltgLimrQaxAntiWdupCoeff.Val "MICROSAR RTE" VALUE 0x0 RTE_RL_FLOAT32_IEEE 0 NO_COMPU_METHOD -25 25 SYMBOL_LINK "Rte_CalprmRom_CalRegn01Cmn_DEFAULT_RTE_CALPRM_GROUP.MotCurrRegVltgLimrQaxAntiWdupCoeff_Val" 0 DISPLAY_IDENTIFIER CalRegn01Cmn.CalibrationPorts.MotCurrRegVltgLimrQaxAntiWdupCoeff.Val /end CHARACTERISTIC
/begin CHARACTERISTIC CalRegn01Cmn.MotCurrRegVltgLimrQaxAntiWdupScagDi.Logl "MICROSAR RTE" VALUE 0x0 RTE_RL_BOOLEAN 0 RTE_CM_BOOLEAN 0 255 SYMBOL_LINK "Rte_CalprmRom_CalRegn01Cmn_DEFAULT_RTE_CALPRM_GROUP.MotCurrRegVltgLimrQaxAntiWdupScagDi_Logl" 0 DISPLAY_IDENTIFIER CalRegn01Cmn.CalibrationPorts.MotCurrRegVltgLimrQaxAntiWdupScagDi.Logl /end CHARACTERISTIC
/begin CHARACTERISTIC CalRegn01Cmn.MotQuadDetnMotDirHysInsts.Val "MICROSAR RTE" VALUE 0x0 RTE_RL_SLONG 0 NO_COMPU_METHOD -2147483648 2147483647 SYMBOL_LINK "Rte_CalprmRom_CalRegn01Cmn_DEFAULT_RTE_CALPRM_GROUP.MotQuadDetnMotDirHysInsts_Val" 0 DISPLAY_IDENTIFIER CalRegn01Cmn.CalibrationPorts.MotQuadDetnMotDirHysInsts.Val /end CHARACTERISTIC
/begin CHARACTERISTIC CalRegn01Cmn.MotRefMdlCurrDaxBoostGain.Val "MICROSAR RTE" VALUE 0x0 RTE_RL_FLOAT32_IEEE 0 NO_COMPU_METHOD 0.0 1.0 SYMBOL_LINK "Rte_CalprmRom_CalRegn01Cmn_DEFAULT_RTE_CALPRM_GROUP.MotRefMdlCurrDaxBoostGain_Val" 0 DISPLAY_IDENTIFIER CalRegn01Cmn.CalibrationPorts.MotRefMdlCurrDaxBoostGain.Val /end CHARACTERISTIC
/begin CHARACTERISTIC CalRegn01Cmn.MotRefMdlCurrDaxBoostTqScaX.Ary1D "MICROSAR RTE" VAL_BLK 0x0 RTE_RL_UWORD 0 RTE_CM_Tq13 0 8.8 MATRIX_DIM 11 1 1 SYMBOL_LINK "Rte_CalprmRom_CalRegn01Cmn_DEFAULT_RTE_CALPRM_GROUP.MotRefMdlCurrDaxBoostTqScaX_Ary1D" 0 DISPLAY_IDENTIFIER CalRegn01Cmn.CalibrationPorts.MotRefMdlCurrDaxBoostTqScaX.Ary1D /end CHARACTERISTIC
/begin CHARACTERISTIC CalRegn01Cmn.MotRefMdlCurrDaxBoostTqScaY.Ary1D "MICROSAR RTE" VAL_BLK 0x0 RTE_RL_UWORD 0 RTE_CM_Uls15 0 1 MATRIX_DIM 11 1 1 SYMBOL_LINK "Rte_CalprmRom_CalRegn01Cmn_DEFAULT_RTE_CALPRM_GROUP.MotRefMdlCurrDaxBoostTqScaY_Ary1D" 0 DISPLAY_IDENTIFIER CalRegn01Cmn.CalibrationPorts.MotRefMdlCurrDaxBoostTqScaY.Ary1D /end CHARACTERISTIC
/begin CHARACTERISTIC CalRegn01Cmn.MotRefMdlCurrDaxQaxRefDelta.Ary1D "MICROSAR RTE" VAL_BLK 0x0 RTE_RL_FLOAT32_IEEE 0 NO_COMPU_METHOD -3.1415927 3.1415927 MATRIX_DIM 8 1 1 SYMBOL_LINK "Rte_CalprmRom_CalRegn01Cmn_DEFAULT_RTE_CALPRM_GROUP.MotRefMdlCurrDaxQaxRefDelta_Ary1D" 0 DISPLAY_IDENTIFIER CalRegn01Cmn.CalibrationPorts.MotRefMdlCurrDaxQaxRefDelta.Ary1D /end CHARACTERISTIC
/begin CHARACTERISTIC CalRegn01Cmn.MotRefMdlCurrItrnTolr.Val "MICROSAR RTE" VALUE 0x0 RTE_RL_FLOAT32_IEEE 0 NO_COMPU_METHOD 0.01 20.0 SYMBOL_LINK "Rte_CalprmRom_CalRegn01Cmn_DEFAULT_RTE_CALPRM_GROUP.MotRefMdlCurrItrnTolr_Val" 0 DISPLAY_IDENTIFIER CalRegn01Cmn.CalibrationPorts.MotRefMdlCurrItrnTolr.Val /end CHARACTERISTIC
/begin CHARACTERISTIC CalRegn01Cmn.MotRefMdlFbCtrlDi.Logl "MICROSAR RTE" VALUE 0x0 RTE_RL_BOOLEAN 0 RTE_CM_BOOLEAN 0 255 SYMBOL_LINK "Rte_CalprmRom_CalRegn01Cmn_DEFAULT_RTE_CALPRM_GROUP.MotRefMdlFbCtrlDi_Logl" 0 DISPLAY_IDENTIFIER CalRegn01Cmn.CalibrationPorts.MotRefMdlFbCtrlDi.Logl /end CHARACTERISTIC
/begin CHARACTERISTIC CalRegn01Cmn.MotRefMdlIvtrDeadTiBrdgVltgSca.Val "MICROSAR RTE" VALUE 0x0 RTE_RL_FLOAT32_IEEE 0 NO_COMPU_METHOD 0.98 1 SYMBOL_LINK "Rte_CalprmRom_CalRegn01Cmn_DEFAULT_RTE_CALPRM_GROUP.MotRefMdlIvtrDeadTiBrdgVltgSca_Val" 0 DISPLAY_IDENTIFIER CalRegn01Cmn.CalibrationPorts.MotRefMdlIvtrDeadTiBrdgVltgSca.Val /end CHARACTERISTIC
/begin CHARACTERISTIC CalRegn01Cmn.MotRefMdlMinCurrItrnLim.Val "MICROSAR RTE" VALUE 0x0 RTE_RL_UBYTE 0 NO_COMPU_METHOD 1.0 5.0 SYMBOL_LINK "Rte_CalprmRom_CalRegn01Cmn_DEFAULT_RTE_CALPRM_GROUP.MotRefMdlMinCurrItrnLim_Val" 0 DISPLAY_IDENTIFIER CalRegn01Cmn.CalibrationPorts.MotRefMdlMinCurrItrnLim.Val /end CHARACTERISTIC
/begin CHARACTERISTIC CalRegn01Cmn.MotRefMdlMotCurrDaxMaxSca.Val "MICROSAR RTE" VALUE 0x0 RTE_RL_FLOAT32_IEEE 0 NO_COMPU_METHOD 1.0 2.0 SYMBOL_LINK "Rte_CalprmRom_CalRegn01Cmn_DEFAULT_RTE_CALPRM_GROUP.MotRefMdlMotCurrDaxMaxSca_Val" 0 DISPLAY_IDENTIFIER CalRegn01Cmn.CalibrationPorts.MotRefMdlMotCurrDaxMaxSca.Val /end CHARACTERISTIC
/begin CHARACTERISTIC CalRegn01Cmn.MotRefMdlMotVelLpFilFrq.Val "MICROSAR RTE" VALUE 0x0 RTE_RL_FLOAT32_IEEE 0 NO_COMPU_METHOD 1.0 200.0 SYMBOL_LINK "Rte_CalprmRom_CalRegn01Cmn_DEFAULT_RTE_CALPRM_GROUP.MotRefMdlMotVelLpFilFrq_Val" 0 DISPLAY_IDENTIFIER CalRegn01Cmn.CalibrationPorts.MotRefMdlMotVelLpFilFrq.Val /end CHARACTERISTIC
/begin CHARACTERISTIC CalRegn01Cmn.MotRefMdlMotVltgDerivtvTiCon.Val "MICROSAR RTE" VALUE 0x0 RTE_RL_FLOAT32_IEEE 0 NO_COMPU_METHOD 0.0 0.05 SYMBOL_LINK "Rte_CalprmRom_CalRegn01Cmn_DEFAULT_RTE_CALPRM_GROUP.MotRefMdlMotVltgDerivtvTiCon_Val" 0 DISPLAY_IDENTIFIER CalRegn01Cmn.CalibrationPorts.MotRefMdlMotVltgDerivtvTiCon.Val /end CHARACTERISTIC
/begin CHARACTERISTIC CalRegn01Cmn.MotRefMdlQuad13VltgSdlX.Ary1D "MICROSAR RTE" VAL_BLK 0x0 RTE_RL_UWORD 0 RTE_CM_Vel4 0 1350 MATRIX_DIM 10 1 1 SYMBOL_LINK "Rte_CalprmRom_CalRegn01Cmn_DEFAULT_RTE_CALPRM_GROUP.MotRefMdlQuad13VltgSdlX_Ary1D" 0 DISPLAY_IDENTIFIER CalRegn01Cmn.CalibrationPorts.MotRefMdlQuad13VltgSdlX.Ary1D /end CHARACTERISTIC
/begin CHARACTERISTIC CalRegn01Cmn.MotRefMdlQuad13VltgSdlY.Ary1D "MICROSAR RTE" VAL_BLK 0x0 RTE_RL_UWORD 0 RTE_CM_Volt18 0 5 MATRIX_DIM 10 1 1 SYMBOL_LINK "Rte_CalprmRom_CalRegn01Cmn_DEFAULT_RTE_CALPRM_GROUP.MotRefMdlQuad13VltgSdlY_Ary1D" 0 DISPLAY_IDENTIFIER CalRegn01Cmn.CalibrationPorts.MotRefMdlQuad13VltgSdlY.Ary1D /end CHARACTERISTIC
/begin CHARACTERISTIC CalRegn01Cmn.MotRefMdlQuad24VltgSdlX.Ary1D "MICROSAR RTE" VAL_BLK 0x0 RTE_RL_UWORD 0 RTE_CM_Vel4 0 1350 MATRIX_DIM 10 1 1 SYMBOL_LINK "Rte_CalprmRom_CalRegn01Cmn_DEFAULT_RTE_CALPRM_GROUP.MotRefMdlQuad24VltgSdlX_Ary1D" 0 DISPLAY_IDENTIFIER CalRegn01Cmn.CalibrationPorts.MotRefMdlQuad24VltgSdlX.Ary1D /end CHARACTERISTIC
/begin CHARACTERISTIC CalRegn01Cmn.MotRefMdlQuad24VltgSdlY.Ary1D "MICROSAR RTE" VAL_BLK 0x0 RTE_RL_UWORD 0 RTE_CM_Volt18 0 5 MATRIX_DIM 10 1 1 SYMBOL_LINK "Rte_CalprmRom_CalRegn01Cmn_DEFAULT_RTE_CALPRM_GROUP.MotRefMdlQuad24VltgSdlY_Ary1D" 0 DISPLAY_IDENTIFIER CalRegn01Cmn.CalibrationPorts.MotRefMdlQuad24VltgSdlY.Ary1D /end CHARACTERISTIC
/begin CHARACTERISTIC CalRegn01Cmn.MotRefMdlRefLocnItrnLim.Val "MICROSAR RTE" VALUE 0x0 RTE_RL_UBYTE 0 NO_COMPU_METHOD 1.0 20.0 SYMBOL_LINK "Rte_CalprmRom_CalRegn01Cmn_DEFAULT_RTE_CALPRM_GROUP.MotRefMdlRefLocnItrnLim_Val" 0 DISPLAY_IDENTIFIER CalRegn01Cmn.CalibrationPorts.MotRefMdlRefLocnItrnLim.Val /end CHARACTERISTIC
/begin CHARACTERISTIC CalRegn01Cmn.MotRefMdlTqItrnLim.Val "MICROSAR RTE" VALUE 0x0 RTE_RL_UBYTE 0 NO_COMPU_METHOD 1.0 5.0 SYMBOL_LINK "Rte_CalprmRom_CalRegn01Cmn_DEFAULT_RTE_CALPRM_GROUP.MotRefMdlTqItrnLim_Val" 0 DISPLAY_IDENTIFIER CalRegn01Cmn.CalibrationPorts.MotRefMdlTqItrnLim.Val /end CHARACTERISTIC
/begin CHARACTERISTIC CalRegn01Cmn.MotRefMdlTqItrnTolr.Val "MICROSAR RTE" VALUE 0x0 RTE_RL_FLOAT32_IEEE 0 NO_COMPU_METHOD 0.001 0.1 SYMBOL_LINK "Rte_CalprmRom_CalRegn01Cmn_DEFAULT_RTE_CALPRM_GROUP.MotRefMdlTqItrnTolr_Val" 0 DISPLAY_IDENTIFIER CalRegn01Cmn.CalibrationPorts.MotRefMdlTqItrnTolr.Val /end CHARACTERISTIC
/begin CHARACTERISTIC CalRegn01Cmn.MotRefMdlVltgModDynCmpEna.Logl "MICROSAR RTE" VALUE 0x0 RTE_RL_BOOLEAN 0 RTE_CM_BOOLEAN 0 255 SYMBOL_LINK "Rte_CalprmRom_CalRegn01Cmn_DEFAULT_RTE_CALPRM_GROUP.MotRefMdlVltgModDynCmpEna_Logl" 0 DISPLAY_IDENTIFIER CalRegn01Cmn.CalibrationPorts.MotRefMdlVltgModDynCmpEna.Logl /end CHARACTERISTIC
/begin CHARACTERISTIC CalRegn01Cmn.MotRefMdlVltgOverRThdSca.Val "MICROSAR RTE" VALUE 0x0 RTE_RL_FLOAT32_IEEE 0 NO_COMPU_METHOD 0.0 1.0 SYMBOL_LINK "Rte_CalprmRom_CalRegn01Cmn_DEFAULT_RTE_CALPRM_GROUP.MotRefMdlVltgOverRThdSca_Val" 0 DISPLAY_IDENTIFIER CalRegn01Cmn.CalibrationPorts.MotRefMdlVltgOverRThdSca.Val /end CHARACTERISTIC
/begin CHARACTERISTIC CalRegn01Cmn.MotTqTranlDampgVehSpdBlndY.Ary1D "MICROSAR RTE" VAL_BLK 0x0 RTE_RL_UWORD 0 NO_COMPU_METHOD 0 65535 MATRIX_DIM 4 1 1 SYMBOL_LINK "Rte_CalprmRom_CalRegn01Cmn_DEFAULT_RTE_CALPRM_GROUP.MotTqTranlDampgVehSpdBlndY_Ary1D" 0 DISPLAY_IDENTIFIER CalRegn01Cmn.CalibrationPorts.MotTqTranlDampgVehSpdBlndY.Ary1D /end CHARACTERISTIC
/begin CHARACTERISTIC CalRegn01Cmn.NxtrCalIdsCal0DevlpAuthor.Ary1D "MICROSAR RTE" VAL_BLK 0x0 RTE_RL_UBYTE 0 NO_COMPU_METHOD 0 255 MATRIX_DIM 6 1 1 SYMBOL_LINK "Rte_CalprmRom_CalRegn01Cmn_DEFAULT_RTE_CALPRM_GROUP.NxtrCalIdsCal0DevlpAuthor_Ary1D" 0 DISPLAY_IDENTIFIER CalRegn01Cmn.CalibrationPorts.NxtrCalIdsCal0DevlpAuthor.Ary1D /end CHARACTERISTIC
/begin CHARACTERISTIC CalRegn01Cmn.NxtrCalIdsCal0DevlpDesc.Ary1D "MICROSAR RTE" VAL_BLK 0x0 RTE_RL_UBYTE 0 NO_COMPU_METHOD 0 255 MATRIX_DIM 48 1 1 SYMBOL_LINK "Rte_CalprmRom_CalRegn01Cmn_DEFAULT_RTE_CALPRM_GROUP.NxtrCalIdsCal0DevlpDesc_Ary1D" 0 DISPLAY_IDENTIFIER CalRegn01Cmn.CalibrationPorts.NxtrCalIdsCal0DevlpDesc.Ary1D /end CHARACTERISTIC
/begin CHARACTERISTIC CalRegn01Cmn.NxtrCalIdsCal0DevlpRelNr.Val "MICROSAR RTE" VALUE 0x0 RTE_RL_ULONG 0 NO_COMPU_METHOD 0 4294967295 SYMBOL_LINK "Rte_CalprmRom_CalRegn01Cmn_DEFAULT_RTE_CALPRM_GROUP.NxtrCalIdsCal0DevlpRelNr_Val" 0 DISPLAY_IDENTIFIER CalRegn01Cmn.CalibrationPorts.NxtrCalIdsCal0DevlpRelNr.Val /end CHARACTERISTIC
/begin CHARACTERISTIC CalRegn01Cmn.NxtrCalIdsCal0DevlpRelSt.Val "MICROSAR RTE" VALUE 0x0 RTE_RL_UBYTE 0 NO_COMPU_METHOD 0 255 SYMBOL_LINK "Rte_CalprmRom_CalRegn01Cmn_DEFAULT_RTE_CALPRM_GROUP.NxtrCalIdsCal0DevlpRelSt_Val" 0 DISPLAY_IDENTIFIER CalRegn01Cmn.CalibrationPorts.NxtrCalIdsCal0DevlpRelSt.Val /end CHARACTERISTIC
/begin CHARACTERISTIC CalRegn01Cmn.NxtrCalIdsCal0DevlpTiStamp.Val "MICROSAR RTE" VALUE 0x0 RTE_RL_ULONG 0 NO_COMPU_METHOD 0 4294967295 SYMBOL_LINK "Rte_CalprmRom_CalRegn01Cmn_DEFAULT_RTE_CALPRM_GROUP.NxtrCalIdsCal0DevlpTiStamp_Val" 0 DISPLAY_IDENTIFIER CalRegn01Cmn.CalibrationPorts.NxtrCalIdsCal0DevlpTiStamp.Val /end CHARACTERISTIC
/begin CHARACTERISTIC CalRegn01Cmn.NxtrCalIdsCal0DevlpVers.Val "MICROSAR RTE" VALUE 0x0 RTE_RL_UBYTE 0 NO_COMPU_METHOD 0 255 SYMBOL_LINK "Rte_CalprmRom_CalRegn01Cmn_DEFAULT_RTE_CALPRM_GROUP.NxtrCalIdsCal0DevlpVers_Val" 0 DISPLAY_IDENTIFIER CalRegn01Cmn.CalibrationPorts.NxtrCalIdsCal0DevlpVers.Val /end CHARACTERISTIC
/begin CHARACTERISTIC CalRegn01Cmn.NxtrCalIdsCal2DevlpAuthor.Ary1D "MICROSAR RTE" VAL_BLK 0x0 RTE_RL_UBYTE 0 NO_COMPU_METHOD 0 255 MATRIX_DIM 6 1 1 SYMBOL_LINK "Rte_CalprmRom_CalRegn01Cmn_DEFAULT_RTE_CALPRM_GROUP.NxtrCalIdsCal2DevlpAuthor_Ary1D" 0 DISPLAY_IDENTIFIER CalRegn01Cmn.CalibrationPorts.NxtrCalIdsCal2DevlpAuthor.Ary1D /end CHARACTERISTIC
/begin CHARACTERISTIC CalRegn01Cmn.NxtrCalIdsCal2DevlpDesc.Ary1D "MICROSAR RTE" VAL_BLK 0x0 RTE_RL_UBYTE 0 NO_COMPU_METHOD 0 255 MATRIX_DIM 48 1 1 SYMBOL_LINK "Rte_CalprmRom_CalRegn01Cmn_DEFAULT_RTE_CALPRM_GROUP.NxtrCalIdsCal2DevlpDesc_Ary1D" 0 DISPLAY_IDENTIFIER CalRegn01Cmn.CalibrationPorts.NxtrCalIdsCal2DevlpDesc.Ary1D /end CHARACTERISTIC
/begin CHARACTERISTIC CalRegn01Cmn.NxtrCalIdsCal2DevlpRelNr.Val "MICROSAR RTE" VALUE 0x0 RTE_RL_ULONG 0 NO_COMPU_METHOD 0 4294967295 SYMBOL_LINK "Rte_CalprmRom_CalRegn01Cmn_DEFAULT_RTE_CALPRM_GROUP.NxtrCalIdsCal2DevlpRelNr_Val" 0 DISPLAY_IDENTIFIER CalRegn01Cmn.CalibrationPorts.NxtrCalIdsCal2DevlpRelNr.Val /end CHARACTERISTIC
/begin CHARACTERISTIC CalRegn01Cmn.NxtrCalIdsCal2DevlpRelSt.Val "MICROSAR RTE" VALUE 0x0 RTE_RL_UBYTE 0 NO_COMPU_METHOD 0 255 SYMBOL_LINK "Rte_CalprmRom_CalRegn01Cmn_DEFAULT_RTE_CALPRM_GROUP.NxtrCalIdsCal2DevlpRelSt_Val" 0 DISPLAY_IDENTIFIER CalRegn01Cmn.CalibrationPorts.NxtrCalIdsCal2DevlpRelSt.Val /end CHARACTERISTIC
/begin CHARACTERISTIC CalRegn01Cmn.NxtrCalIdsCal2DevlpTiStamp.Val "MICROSAR RTE" VALUE 0x0 RTE_RL_ULONG 0 NO_COMPU_METHOD 0 4294967295 SYMBOL_LINK "Rte_CalprmRom_CalRegn01Cmn_DEFAULT_RTE_CALPRM_GROUP.NxtrCalIdsCal2DevlpTiStamp_Val" 0 DISPLAY_IDENTIFIER CalRegn01Cmn.CalibrationPorts.NxtrCalIdsCal2DevlpTiStamp.Val /end CHARACTERISTIC
/begin CHARACTERISTIC CalRegn01Cmn.NxtrCalIdsCal2DevlpVers.Val "MICROSAR RTE" VALUE 0x0 RTE_RL_UBYTE 0 NO_COMPU_METHOD 0 255 SYMBOL_LINK "Rte_CalprmRom_CalRegn01Cmn_DEFAULT_RTE_CALPRM_GROUP.NxtrCalIdsCal2DevlpVers_Val" 0 DISPLAY_IDENTIFIER CalRegn01Cmn.CalibrationPorts.NxtrCalIdsCal2DevlpVers.Val /end CHARACTERISTIC
/begin CHARACTERISTIC CalRegn01Cmn.PwrLimrAssiRednLpFilFrq.Val "MICROSAR RTE" VALUE 0x0 RTE_RL_FLOAT32_IEEE 0 NO_COMPU_METHOD -3.402823466e+38 3.402823466e+38 SYMBOL_LINK "Rte_CalprmRom_CalRegn01Cmn_DEFAULT_RTE_CALPRM_GROUP.PwrLimrAssiRednLpFilFrq_Val" 0 DISPLAY_IDENTIFIER CalRegn01Cmn.CalibrationPorts.PwrLimrAssiRednLpFilFrq.Val /end CHARACTERISTIC
/begin CHARACTERISTIC CalRegn01Cmn.PwrLimrBackEmfConStdT.Val "MICROSAR RTE" VALUE 0x0 RTE_RL_FLOAT32_IEEE 0 NO_COMPU_METHOD -3.402823466e+38 3.402823466e+38 SYMBOL_LINK "Rte_CalprmRom_CalRegn01Cmn_DEFAULT_RTE_CALPRM_GROUP.PwrLimrBackEmfConStdT_Val" 0 DISPLAY_IDENTIFIER CalRegn01Cmn.CalibrationPorts.PwrLimrBackEmfConStdT.Val /end CHARACTERISTIC
/begin CHARACTERISTIC CalRegn01Cmn.PwrLimrBrdgVltgAdjSlew.Val "MICROSAR RTE" VALUE 0x0 RTE_RL_FLOAT32_IEEE 0 NO_COMPU_METHOD -3.402823466e+38 3.402823466e+38 SYMBOL_LINK "Rte_CalprmRom_CalRegn01Cmn_DEFAULT_RTE_CALPRM_GROUP.PwrLimrBrdgVltgAdjSlew_Val" 0 DISPLAY_IDENTIFIER CalRegn01Cmn.CalibrationPorts.PwrLimrBrdgVltgAdjSlew.Val /end CHARACTERISTIC
/begin CHARACTERISTIC CalRegn01Cmn.PwrLimrBrdgVltgAltFltAdj.Val "MICROSAR RTE" VALUE 0x0 RTE_RL_FLOAT32_IEEE 0 NO_COMPU_METHOD -3.402823466e+38 3.402823466e+38 SYMBOL_LINK "Rte_CalprmRom_CalRegn01Cmn_DEFAULT_RTE_CALPRM_GROUP.PwrLimrBrdgVltgAltFltAdj_Val" 0 DISPLAY_IDENTIFIER CalRegn01Cmn.CalibrationPorts.PwrLimrBrdgVltgAltFltAdj.Val /end CHARACTERISTIC
/begin CHARACTERISTIC CalRegn01Cmn.PwrLimrFilAssiRednThd.Val "MICROSAR RTE" VALUE 0x0 RTE_RL_FLOAT32_IEEE 0 NO_COMPU_METHOD -3.402823466e+38 3.402823466e+38 SYMBOL_LINK "Rte_CalprmRom_CalRegn01Cmn_DEFAULT_RTE_CALPRM_GROUP.PwrLimrFilAssiRednThd_Val" 0 DISPLAY_IDENTIFIER CalRegn01Cmn.CalibrationPorts.PwrLimrFilAssiRednThd.Val /end CHARACTERISTIC
/begin CHARACTERISTIC CalRegn01Cmn.PwrLimrLoVoltAssiRcvrThd.Val "MICROSAR RTE" VALUE 0x0 RTE_RL_FLOAT32_IEEE 0 NO_COMPU_METHOD -3.402823466e+38 3.402823466e+38 SYMBOL_LINK "Rte_CalprmRom_CalRegn01Cmn_DEFAULT_RTE_CALPRM_GROUP.PwrLimrLoVoltAssiRcvrThd_Val" 0 DISPLAY_IDENTIFIER CalRegn01Cmn.CalibrationPorts.PwrLimrLoVoltAssiRcvrThd.Val /end CHARACTERISTIC
/begin CHARACTERISTIC CalRegn01Cmn.PwrLimrLoVoltAssiRcvrTi.Val "MICROSAR RTE" VALUE 0x0 RTE_RL_UWORD 0 NO_COMPU_METHOD 0 65535 SYMBOL_LINK "Rte_CalprmRom_CalRegn01Cmn_DEFAULT_RTE_CALPRM_GROUP.PwrLimrLoVoltAssiRcvrTi_Val" 0 DISPLAY_IDENTIFIER CalRegn01Cmn.CalibrationPorts.PwrLimrLoVoltAssiRcvrTi.Val /end CHARACTERISTIC
/begin CHARACTERISTIC CalRegn01Cmn.PwrLimrMotEnvlpX.Ary1D "MICROSAR RTE" VAL_BLK 0x0 RTE_RL_SWORD 0 NO_COMPU_METHOD -32768 32767 MATRIX_DIM 14 1 1 SYMBOL_LINK "Rte_CalprmRom_CalRegn01Cmn_DEFAULT_RTE_CALPRM_GROUP.PwrLimrMotEnvlpX_Ary1D" 0 DISPLAY_IDENTIFIER CalRegn01Cmn.CalibrationPorts.PwrLimrMotEnvlpX.Ary1D /end CHARACTERISTIC
/begin CHARACTERISTIC CalRegn01Cmn.PwrLimrMotEnvlpY.Ary1D "MICROSAR RTE" VAL_BLK 0x0 RTE_RL_UWORD 0 NO_COMPU_METHOD 0 65535 MATRIX_DIM 14 1 1 SYMBOL_LINK "Rte_CalprmRom_CalRegn01Cmn_DEFAULT_RTE_CALPRM_GROUP.PwrLimrMotEnvlpY_Ary1D" 0 DISPLAY_IDENTIFIER CalRegn01Cmn.CalibrationPorts.PwrLimrMotEnvlpY.Ary1D /end CHARACTERISTIC
/begin CHARACTERISTIC CalRegn01Cmn.PwrLimrMotVelLpFilFrq.Val "MICROSAR RTE" VALUE 0x0 RTE_RL_FLOAT32_IEEE 0 NO_COMPU_METHOD -3.402823466e+38 3.402823466e+38 SYMBOL_LINK "Rte_CalprmRom_CalRegn01Cmn_DEFAULT_RTE_CALPRM_GROUP.PwrLimrMotVelLpFilFrq_Val" 0 DISPLAY_IDENTIFIER CalRegn01Cmn.CalibrationPorts.PwrLimrMotVelLpFilFrq.Val /end CHARACTERISTIC
/begin CHARACTERISTIC CalRegn01Cmn.PwrLimrSpdAdjSlewDec.Val "MICROSAR RTE" VALUE 0x0 RTE_RL_FLOAT32_IEEE 0 NO_COMPU_METHOD -3.402823466e+38 3.402823466e+38 SYMBOL_LINK "Rte_CalprmRom_CalRegn01Cmn_DEFAULT_RTE_CALPRM_GROUP.PwrLimrSpdAdjSlewDec_Val" 0 DISPLAY_IDENTIFIER CalRegn01Cmn.CalibrationPorts.PwrLimrSpdAdjSlewDec.Val /end CHARACTERISTIC
/begin CHARACTERISTIC CalRegn01Cmn.PwrLimrSpdAdjSlewEna.Logl "MICROSAR RTE" VALUE 0x0 RTE_RL_BOOLEAN 0 RTE_CM_BOOLEAN 0 255 SYMBOL_LINK "Rte_CalprmRom_CalRegn01Cmn_DEFAULT_RTE_CALPRM_GROUP.PwrLimrSpdAdjSlewEna_Logl" 0 DISPLAY_IDENTIFIER CalRegn01Cmn.CalibrationPorts.PwrLimrSpdAdjSlewEna.Logl /end CHARACTERISTIC
/begin CHARACTERISTIC CalRegn01Cmn.PwrLimrSpdAdjSlewInc.Val "MICROSAR RTE" VALUE 0x0 RTE_RL_FLOAT32_IEEE 0 NO_COMPU_METHOD -3.402823466e+38 3.402823466e+38 SYMBOL_LINK "Rte_CalprmRom_CalRegn01Cmn_DEFAULT_RTE_CALPRM_GROUP.PwrLimrSpdAdjSlewInc_Val" 0 DISPLAY_IDENTIFIER CalRegn01Cmn.CalibrationPorts.PwrLimrSpdAdjSlewInc.Val /end CHARACTERISTIC
/begin CHARACTERISTIC CalRegn01Cmn.PwrLimrStdOperMotEnvlpX.Ary1D "MICROSAR RTE" VAL_BLK 0x0 RTE_RL_UWORD 0 NO_COMPU_METHOD 0 65535 MATRIX_DIM 6 1 1 SYMBOL_LINK "Rte_CalprmRom_CalRegn01Cmn_DEFAULT_RTE_CALPRM_GROUP.PwrLimrStdOperMotEnvlpX_Ary1D" 0 DISPLAY_IDENTIFIER CalRegn01Cmn.CalibrationPorts.PwrLimrStdOperMotEnvlpX.Ary1D /end CHARACTERISTIC
/begin CHARACTERISTIC CalRegn01Cmn.PwrLimrStdOperMotEnvlpY.Ary1D "MICROSAR RTE" VAL_BLK 0x0 RTE_RL_UWORD 0 NO_COMPU_METHOD 0 65535 MATRIX_DIM 6 1 1 SYMBOL_LINK "Rte_CalprmRom_CalRegn01Cmn_DEFAULT_RTE_CALPRM_GROUP.PwrLimrStdOperMotEnvlpY_Ary1D" 0 DISPLAY_IDENTIFIER CalRegn01Cmn.CalibrationPorts.PwrLimrStdOperMotEnvlpY.Ary1D /end CHARACTERISTIC
/begin CHARACTERISTIC CalRegn01Cmn.PwrLimrVltgDptMotVelOffsX.Ary1D "MICROSAR RTE" VAL_BLK 0x0 RTE_RL_UWORD 0 NO_COMPU_METHOD 0 65535 MATRIX_DIM 10 1 1 SYMBOL_LINK "Rte_CalprmRom_CalRegn01Cmn_DEFAULT_RTE_CALPRM_GROUP.PwrLimrVltgDptMotVelOffsX_Ary1D" 0 DISPLAY_IDENTIFIER CalRegn01Cmn.CalibrationPorts.PwrLimrVltgDptMotVelOffsX.Ary1D /end CHARACTERISTIC
/begin CHARACTERISTIC CalRegn01Cmn.PwrLimrVltgDptMotVelOffsY.Ary1D "MICROSAR RTE" VAL_BLK 0x0 RTE_RL_UWORD 0 NO_COMPU_METHOD 0 65535 MATRIX_DIM 10 1 1 SYMBOL_LINK "Rte_CalprmRom_CalRegn01Cmn_DEFAULT_RTE_CALPRM_GROUP.PwrLimrVltgDptMotVelOffsY_Ary1D" 0 DISPLAY_IDENTIFIER CalRegn01Cmn.CalibrationPorts.PwrLimrVltgDptMotVelOffsY.Ary1D /end CHARACTERISTIC
/begin CHARACTERISTIC CalRegn01Cmn.PwrSplyNtc0x07BFailStep.Val "MICROSAR RTE" VALUE 0x0 RTE_RL_UWORD 0 NO_COMPU_METHOD 0 65535 SYMBOL_LINK "Rte_CalprmRom_CalRegn01Cmn_DEFAULT_RTE_CALPRM_GROUP.PwrSplyNtc0x07BFailStep_Val" 0 DISPLAY_IDENTIFIER CalRegn01Cmn.CalibrationPorts.PwrSplyNtc0x07BFailStep.Val /end CHARACTERISTIC
/begin CHARACTERISTIC CalRegn01Cmn.PwrSplyNtc0x07BPassStep.Val "MICROSAR RTE" VALUE 0x0 RTE_RL_UWORD 0 NO_COMPU_METHOD 0 65535 SYMBOL_LINK "Rte_CalprmRom_CalRegn01Cmn_DEFAULT_RTE_CALPRM_GROUP.PwrSplyNtc0x07BPassStep_Val" 0 DISPLAY_IDENTIFIER CalRegn01Cmn.CalibrationPorts.PwrSplyNtc0x07BPassStep.Val /end CHARACTERISTIC
/begin CHARACTERISTIC CalRegn01Cmn.PwrSplyNtc0x07CFailStep.Val "MICROSAR RTE" VALUE 0x0 RTE_RL_UWORD 0 NO_COMPU_METHOD 0 65535 SYMBOL_LINK "Rte_CalprmRom_CalRegn01Cmn_DEFAULT_RTE_CALPRM_GROUP.PwrSplyNtc0x07CFailStep_Val" 0 DISPLAY_IDENTIFIER CalRegn01Cmn.CalibrationPorts.PwrSplyNtc0x07CFailStep.Val /end CHARACTERISTIC
/begin CHARACTERISTIC CalRegn01Cmn.PwrSplyNtc0x07CPassStep.Val "MICROSAR RTE" VALUE 0x0 RTE_RL_UWORD 0 NO_COMPU_METHOD 0 65535 SYMBOL_LINK "Rte_CalprmRom_CalRegn01Cmn_DEFAULT_RTE_CALPRM_GROUP.PwrSplyNtc0x07CPassStep_Val" 0 DISPLAY_IDENTIFIER CalRegn01Cmn.CalibrationPorts.PwrSplyNtc0x07CPassStep.Val /end CHARACTERISTIC
/begin CHARACTERISTIC CalRegn01Cmn.PwrSplyNtc0x07DFailStep.Val "MICROSAR RTE" VALUE 0x0 RTE_RL_UWORD 0 NO_COMPU_METHOD 0 65535 SYMBOL_LINK "Rte_CalprmRom_CalRegn01Cmn_DEFAULT_RTE_CALPRM_GROUP.PwrSplyNtc0x07DFailStep_Val" 0 DISPLAY_IDENTIFIER CalRegn01Cmn.CalibrationPorts.PwrSplyNtc0x07DFailStep.Val /end CHARACTERISTIC
/begin CHARACTERISTIC CalRegn01Cmn.PwrSplyNtc0x07DPassStep.Val "MICROSAR RTE" VALUE 0x0 RTE_RL_UWORD 0 NO_COMPU_METHOD 0 65535 SYMBOL_LINK "Rte_CalprmRom_CalRegn01Cmn_DEFAULT_RTE_CALPRM_GROUP.PwrSplyNtc0x07DPassStep_Val" 0 DISPLAY_IDENTIFIER CalRegn01Cmn.CalibrationPorts.PwrSplyNtc0x07DPassStep.Val /end CHARACTERISTIC
/begin CHARACTERISTIC CalRegn01Cmn.SinVltgGennDthrEna.Logl "MICROSAR RTE" VALUE 0x0 RTE_RL_BOOLEAN 0 RTE_CM_BOOLEAN 0 255 SYMBOL_LINK "Rte_CalprmRom_CalRegn01Cmn_DEFAULT_RTE_CALPRM_GROUP.SinVltgGennDthrEna_Logl" 0 DISPLAY_IDENTIFIER CalRegn01Cmn.CalibrationPorts.SinVltgGennDthrEna.Logl /end CHARACTERISTIC
/begin CHARACTERISTIC CalRegn01Cmn.SinVltgGennDthrLpFilCoeff.Val "MICROSAR RTE" VALUE 0x0 RTE_RL_FLOAT32_IEEE 0 NO_COMPU_METHOD -3.402823466e+38 3.402823466e+38 SYMBOL_LINK "Rte_CalprmRom_CalRegn01Cmn_DEFAULT_RTE_CALPRM_GROUP.SinVltgGennDthrLpFilCoeff_Val" 0 DISPLAY_IDENTIFIER CalRegn01Cmn.CalibrationPorts.SinVltgGennDthrLpFilCoeff.Val /end CHARACTERISTIC
/begin CHARACTERISTIC CalRegn01Cmn.SysPrfmncStsAbsltCtrlTFltThd.Val "MICROSAR RTE" VALUE 0x0 RTE_RL_FLOAT32_IEEE 0 NO_COMPU_METHOD -3.402823466e+38 3.402823466e+38 SYMBOL_LINK "Rte_CalprmRom_CalRegn01Cmn_DEFAULT_RTE_CALPRM_GROUP.SysPrfmncStsAbsltCtrlTFltThd_Val" 0 DISPLAY_IDENTIFIER CalRegn01Cmn.CalibrationPorts.SysPrfmncStsAbsltCtrlTFltThd.Val /end CHARACTERISTIC
/begin CHARACTERISTIC CalRegn01Cmn.SysPrfmncStsAssiStallLimDecThd.Val "MICROSAR RTE" VALUE 0x0 RTE_RL_FLOAT32_IEEE 0 NO_COMPU_METHOD -3.402823466e+38 3.402823466e+38 SYMBOL_LINK "Rte_CalprmRom_CalRegn01Cmn_DEFAULT_RTE_CALPRM_GROUP.SysPrfmncStsAssiStallLimDecThd_Val" 0 DISPLAY_IDENTIFIER CalRegn01Cmn.CalibrationPorts.SysPrfmncStsAssiStallLimDecThd.Val /end CHARACTERISTIC
/begin CHARACTERISTIC CalRegn01Cmn.SysPrfmncStsBattDiagcHiCrit.Val "MICROSAR RTE" VALUE 0x0 RTE_RL_FLOAT32_IEEE 0 NO_COMPU_METHOD -3.402823466e+38 3.402823466e+38 SYMBOL_LINK "Rte_CalprmRom_CalRegn01Cmn_DEFAULT_RTE_CALPRM_GROUP.SysPrfmncStsBattDiagcHiCrit_Val" 0 DISPLAY_IDENTIFIER CalRegn01Cmn.CalibrationPorts.SysPrfmncStsBattDiagcHiCrit.Val /end CHARACTERISTIC
/begin CHARACTERISTIC CalRegn01Cmn.SysPrfmncStsBattDiagcHiWarn.Val "MICROSAR RTE" VALUE 0x0 RTE_RL_FLOAT32_IEEE 0 NO_COMPU_METHOD -3.402823466e+38 3.402823466e+38 SYMBOL_LINK "Rte_CalprmRom_CalRegn01Cmn_DEFAULT_RTE_CALPRM_GROUP.SysPrfmncStsBattDiagcHiWarn_Val" 0 DISPLAY_IDENTIFIER CalRegn01Cmn.CalibrationPorts.SysPrfmncStsBattDiagcHiWarn.Val /end CHARACTERISTIC
/begin CHARACTERISTIC CalRegn01Cmn.SysPrfmncStsBattDiagcLoCrit.Val "MICROSAR RTE" VALUE 0x0 RTE_RL_FLOAT32_IEEE 0 NO_COMPU_METHOD -3.402823466e+38 3.402823466e+38 SYMBOL_LINK "Rte_CalprmRom_CalRegn01Cmn_DEFAULT_RTE_CALPRM_GROUP.SysPrfmncStsBattDiagcLoCrit_Val" 0 DISPLAY_IDENTIFIER CalRegn01Cmn.CalibrationPorts.SysPrfmncStsBattDiagcLoCrit.Val /end CHARACTERISTIC
/begin CHARACTERISTIC CalRegn01Cmn.SysPrfmncStsBattDiagcLoWarn.Val "MICROSAR RTE" VALUE 0x0 RTE_RL_FLOAT32_IEEE 0 NO_COMPU_METHOD -3.402823466e+38 3.402823466e+38 SYMBOL_LINK "Rte_CalprmRom_CalRegn01Cmn_DEFAULT_RTE_CALPRM_GROUP.SysPrfmncStsBattDiagcLoWarn_Val" 0 DISPLAY_IDENTIFIER CalRegn01Cmn.CalibrationPorts.SysPrfmncStsBattDiagcLoWarn.Val /end CHARACTERISTIC
/begin CHARACTERISTIC CalRegn01Cmn.SysPrfmncStsBattVltgFilFrq.Val "MICROSAR RTE" VALUE 0x0 RTE_RL_FLOAT32_IEEE 0 NO_COMPU_METHOD -3.402823466e+38 3.402823466e+38 SYMBOL_LINK "Rte_CalprmRom_CalRegn01Cmn_DEFAULT_RTE_CALPRM_GROUP.SysPrfmncStsBattVltgFilFrq_Val" 0 DISPLAY_IDENTIFIER CalRegn01Cmn.CalibrationPorts.SysPrfmncStsBattVltgFilFrq.Val /end CHARACTERISTIC
/begin CHARACTERISTIC CalRegn01Cmn.SysPrfmncStsDutyCycLvlFltThd.Val "MICROSAR RTE" VALUE 0x0 RTE_RL_UWORD 0 NO_COMPU_METHOD 0 65535 SYMBOL_LINK "Rte_CalprmRom_CalRegn01Cmn_DEFAULT_RTE_CALPRM_GROUP.SysPrfmncStsDutyCycLvlFltThd_Val" 0 DISPLAY_IDENTIFIER CalRegn01Cmn.CalibrationPorts.SysPrfmncStsDutyCycLvlFltThd.Val /end CHARACTERISTIC
/begin CHARACTERISTIC CalRegn01Cmn.SysPrfmncStsLoadDptLimDecThd.Val "MICROSAR RTE" VALUE 0x0 RTE_RL_FLOAT32_IEEE 0 NO_COMPU_METHOD -3.402823466e+38 3.402823466e+38 SYMBOL_LINK "Rte_CalprmRom_CalRegn01Cmn_DEFAULT_RTE_CALPRM_GROUP.SysPrfmncStsLoadDptLimDecThd_Val" 0 DISPLAY_IDENTIFIER CalRegn01Cmn.CalibrationPorts.SysPrfmncStsLoadDptLimDecThd.Val /end CHARACTERISTIC
/begin CHARACTERISTIC CalRegn01Cmn.SysPrfmncStsTDptLimThd.Val "MICROSAR RTE" VALUE 0x0 RTE_RL_FLOAT32_IEEE 0 NO_COMPU_METHOD -3.402823466e+38 3.402823466e+38 SYMBOL_LINK "Rte_CalprmRom_CalRegn01Cmn_DEFAULT_RTE_CALPRM_GROUP.SysPrfmncStsTDptLimThd_Val" 0 DISPLAY_IDENTIFIER CalRegn01Cmn.CalibrationPorts.SysPrfmncStsTDptLimThd.Val /end CHARACTERISTIC
/begin CHARACTERISTIC CalRegn01Cmn.TEstimnIgnOffCtrlEna.Logl "MICROSAR RTE" VALUE 0x0 RTE_RL_BOOLEAN 0 RTE_CM_BOOLEAN 0 255 SYMBOL_LINK "Rte_CalprmRom_CalRegn01Cmn_DEFAULT_RTE_CALPRM_GROUP.TEstimnIgnOffCtrlEna_Logl" 0 DISPLAY_IDENTIFIER CalRegn01Cmn.CalibrationPorts.TEstimnIgnOffCtrlEna.Logl /end CHARACTERISTIC
/begin CHARACTERISTIC CalRegn01Cmn.TEstimnIgnOffMsgWaitTi.Val "MICROSAR RTE" VALUE 0x0 RTE_RL_FLOAT32_IEEE 0 NO_COMPU_METHOD -3.402823466e+38 3.402823466e+38 SYMBOL_LINK "Rte_CalprmRom_CalRegn01Cmn_DEFAULT_RTE_CALPRM_GROUP.TEstimnIgnOffMsgWaitTi_Val" 0 DISPLAY_IDENTIFIER CalRegn01Cmn.CalibrationPorts.TEstimnIgnOffMsgWaitTi.Val /end CHARACTERISTIC
/begin CHARACTERISTIC CalRegn01Cmn.TqLoaDrvrTqNom.Val "MICROSAR RTE" VALUE 0x0 RTE_RL_FLOAT32_IEEE 0 NO_COMPU_METHOD -3.402823466e+38 3.402823466e+38 SYMBOL_LINK "Rte_CalprmRom_CalRegn01Cmn_DEFAULT_RTE_CALPRM_GROUP.TqLoaDrvrTqNom_Val" 0 DISPLAY_IDENTIFIER CalRegn01Cmn.CalibrationPorts.TqLoaDrvrTqNom.Val /end CHARACTERISTIC
/begin CHARACTERISTIC CalRegn01Cmn.TqLoaMotTqCmdLim.Val "MICROSAR RTE" VALUE 0x0 RTE_RL_FLOAT32_IEEE 0 NO_COMPU_METHOD -3.402823466e+38 3.402823466e+38 SYMBOL_LINK "Rte_CalprmRom_CalRegn01Cmn_DEFAULT_RTE_CALPRM_GROUP.TqLoaMotTqCmdLim_Val" 0 DISPLAY_IDENTIFIER CalRegn01Cmn.CalibrationPorts.TqLoaMotTqCmdLim.Val /end CHARACTERISTIC
/begin CHARACTERISTIC CalRegn01Cmn.TqLoaMotVelAndTqBasdScaFacFallRate.Val "MICROSAR RTE" VALUE 0x0 RTE_RL_FLOAT32_IEEE 0 NO_COMPU_METHOD -3.402823466e+38 3.402823466e+38 SYMBOL_LINK "Rte_CalprmRom_CalRegn01Cmn_DEFAULT_RTE_CALPRM_GROUP.TqLoaMotVelAndTqBasdScaFacFallRate_Val" 0 DISPLAY_IDENTIFIER CalRegn01Cmn.CalibrationPorts.TqLoaMotVelAndTqBasdScaFacFallRate.Val /end CHARACTERISTIC
/begin CHARACTERISTIC CalRegn01Cmn.TqLoaMotVelAndTqBasdScaFacMax.Val "MICROSAR RTE" VALUE 0x0 RTE_RL_FLOAT32_IEEE 0 NO_COMPU_METHOD -3.402823466e+38 3.402823466e+38 SYMBOL_LINK "Rte_CalprmRom_CalRegn01Cmn_DEFAULT_RTE_CALPRM_GROUP.TqLoaMotVelAndTqBasdScaFacMax_Val" 0 DISPLAY_IDENTIFIER CalRegn01Cmn.CalibrationPorts.TqLoaMotVelAndTqBasdScaFacMax.Val /end CHARACTERISTIC
/begin CHARACTERISTIC CalRegn01Cmn.TqLoaMotVelAndTqBasdScaFacMin.Val "MICROSAR RTE" VALUE 0x0 RTE_RL_FLOAT32_IEEE 0 NO_COMPU_METHOD -3.402823466e+38 3.402823466e+38 SYMBOL_LINK "Rte_CalprmRom_CalRegn01Cmn_DEFAULT_RTE_CALPRM_GROUP.TqLoaMotVelAndTqBasdScaFacMin_Val" 0 DISPLAY_IDENTIFIER CalRegn01Cmn.CalibrationPorts.TqLoaMotVelAndTqBasdScaFacMin.Val /end CHARACTERISTIC
/begin CHARACTERISTIC CalRegn01Cmn.TqLoaMotVelAndTqBasdScaFacRiseRate.Val "MICROSAR RTE" VALUE 0x0 RTE_RL_FLOAT32_IEEE 0 NO_COMPU_METHOD -3.402823466e+38 3.402823466e+38 SYMBOL_LINK "Rte_CalprmRom_CalRegn01Cmn_DEFAULT_RTE_CALPRM_GROUP.TqLoaMotVelAndTqBasdScaFacRiseRate_Val" 0 DISPLAY_IDENTIFIER CalRegn01Cmn.CalibrationPorts.TqLoaMotVelAndTqBasdScaFacRiseRate.Val /end CHARACTERISTIC
/begin CHARACTERISTIC CalRegn01Cmn.TqLoaMotVelMgnThd.Val "MICROSAR RTE" VALUE 0x0 RTE_RL_FLOAT32_IEEE 0 NO_COMPU_METHOD -3.402823466e+38 3.402823466e+38 SYMBOL_LINK "Rte_CalprmRom_CalRegn01Cmn_DEFAULT_RTE_CALPRM_GROUP.TqLoaMotVelMgnThd_Val" 0 DISPLAY_IDENTIFIER CalRegn01Cmn.CalibrationPorts.TqLoaMotVelMgnThd.Val /end CHARACTERISTIC
/begin CHARACTERISTIC CalRegn01Cmn.TqLoaTqCmdLimY.Ary1D "MICROSAR RTE" VAL_BLK 0x0 RTE_RL_UWORD 0 NO_COMPU_METHOD 0 65535 MATRIX_DIM 8 1 1 SYMBOL_LINK "Rte_CalprmRom_CalRegn01Cmn_DEFAULT_RTE_CALPRM_GROUP.TqLoaTqCmdLimY_Ary1D" 0 DISPLAY_IDENTIFIER CalRegn01Cmn.CalibrationPorts.TqLoaTqCmdLimY.Ary1D /end CHARACTERISTIC
/begin CHARACTERISTIC CalRegn01Cmn.TqLoaTqCmdMgnThd.Val "MICROSAR RTE" VALUE 0x0 RTE_RL_FLOAT32_IEEE 0 NO_COMPU_METHOD -3.402823466e+38 3.402823466e+38 SYMBOL_LINK "Rte_CalprmRom_CalRegn01Cmn_DEFAULT_RTE_CALPRM_GROUP.TqLoaTqCmdMgnThd_Val" 0 DISPLAY_IDENTIFIER CalRegn01Cmn.CalibrationPorts.TqLoaTqCmdMgnThd.Val /end CHARACTERISTIC
/begin CHARACTERISTIC CalRegn01Cmn.TqLoaVehLatADifScaFacFallRate.Val "MICROSAR RTE" VALUE 0x0 RTE_RL_FLOAT32_IEEE 0 NO_COMPU_METHOD -3.402823466e+38 3.402823466e+38 SYMBOL_LINK "Rte_CalprmRom_CalRegn01Cmn_DEFAULT_RTE_CALPRM_GROUP.TqLoaVehLatADifScaFacFallRate_Val" 0 DISPLAY_IDENTIFIER CalRegn01Cmn.CalibrationPorts.TqLoaVehLatADifScaFacFallRate.Val /end CHARACTERISTIC
/begin CHARACTERISTIC CalRegn01Cmn.TqLoaVehLatADifScaFacRiseRate.Val "MICROSAR RTE" VALUE 0x0 RTE_RL_FLOAT32_IEEE 0 NO_COMPU_METHOD -3.402823466e+38 3.402823466e+38 SYMBOL_LINK "Rte_CalprmRom_CalRegn01Cmn_DEFAULT_RTE_CALPRM_GROUP.TqLoaVehLatADifScaFacRiseRate_Val" 0 DISPLAY_IDENTIFIER CalRegn01Cmn.CalibrationPorts.TqLoaVehLatADifScaFacRiseRate.Val /end CHARACTERISTIC
/begin CHARACTERISTIC CalRegn01Cmn.TqLoaVehLatADifScaFacX.Ary1D "MICROSAR RTE" VAL_BLK 0x0 RTE_RL_UWORD 0 NO_COMPU_METHOD 0 65535 MATRIX_DIM 4 1 1 SYMBOL_LINK "Rte_CalprmRom_CalRegn01Cmn_DEFAULT_RTE_CALPRM_GROUP.TqLoaVehLatADifScaFacX_Ary1D" 0 DISPLAY_IDENTIFIER CalRegn01Cmn.CalibrationPorts.TqLoaVehLatADifScaFacX.Ary1D /end CHARACTERISTIC
/begin CHARACTERISTIC CalRegn01Cmn.TqLoaVehLatADifScaFacY.Ary2D "MICROSAR RTE" VAL_BLK 0x0 RTE_RL_UWORD 0 NO_COMPU_METHOD 0 65535 MATRIX_DIM 4 8 1 SYMBOL_LINK "Rte_CalprmRom_CalRegn01Cmn_DEFAULT_RTE_CALPRM_GROUP.TqLoaVehLatADifScaFacY_Ary2D" 0 DISPLAY_IDENTIFIER CalRegn01Cmn.CalibrationPorts.TqLoaVehLatADifScaFacY.Ary2D /end CHARACTERISTIC
/begin CHARACTERISTIC CalRegn01Cmn.TqLoaVehLatAEstimnFilFrq.Val "MICROSAR RTE" VALUE 0x0 RTE_RL_FLOAT32_IEEE 0 NO_COMPU_METHOD -3.402823466e+38 3.402823466e+38 SYMBOL_LINK "Rte_CalprmRom_CalRegn01Cmn_DEFAULT_RTE_CALPRM_GROUP.TqLoaVehLatAEstimnFilFrq_Val" 0 DISPLAY_IDENTIFIER CalRegn01Cmn.CalibrationPorts.TqLoaVehLatAEstimnFilFrq.Val /end CHARACTERISTIC
/begin CHARACTERISTIC CalRegn01Cmn.TqLoaVehLatAGainY.Ary1D "MICROSAR RTE" VAL_BLK 0x0 RTE_RL_UWORD 0 NO_COMPU_METHOD 0 65535 MATRIX_DIM 8 1 1 SYMBOL_LINK "Rte_CalprmRom_CalRegn01Cmn_DEFAULT_RTE_CALPRM_GROUP.TqLoaVehLatAGainY_Ary1D" 0 DISPLAY_IDENTIFIER CalRegn01Cmn.CalibrationPorts.TqLoaVehLatAGainY.Ary1D /end CHARACTERISTIC
/begin CHARACTERISTIC CalRegn01Cmn.TqLoaVehSpdScaFacX.Ary1D "MICROSAR RTE" VAL_BLK 0x0 RTE_RL_UWORD 0 NO_COMPU_METHOD 0 65535 MATRIX_DIM 5 1 1 SYMBOL_LINK "Rte_CalprmRom_CalRegn01Cmn_DEFAULT_RTE_CALPRM_GROUP.TqLoaVehSpdScaFacX_Ary1D" 0 DISPLAY_IDENTIFIER CalRegn01Cmn.CalibrationPorts.TqLoaVehSpdScaFacX.Ary1D /end CHARACTERISTIC
/begin CHARACTERISTIC CalRegn01Cmn.TqLoaVehSpdScaFacY.Ary1D "MICROSAR RTE" VAL_BLK 0x0 RTE_RL_UWORD 0 NO_COMPU_METHOD 0 65535 MATRIX_DIM 5 1 1 SYMBOL_LINK "Rte_CalprmRom_CalRegn01Cmn_DEFAULT_RTE_CALPRM_GROUP.TqLoaVehSpdScaFacY_Ary1D" 0 DISPLAY_IDENTIFIER CalRegn01Cmn.CalibrationPorts.TqLoaVehSpdScaFacY.Ary1D /end CHARACTERISTIC
/begin CHARACTERISTIC CalRegn01Cmn.TqLoaVehSpdX.Ary1D "MICROSAR RTE" VAL_BLK 0x0 RTE_RL_UWORD 0 NO_COMPU_METHOD 0 65535 MATRIX_DIM 8 1 1 SYMBOL_LINK "Rte_CalprmRom_CalRegn01Cmn_DEFAULT_RTE_CALPRM_GROUP.TqLoaVehSpdX_Ary1D" 0 DISPLAY_IDENTIFIER CalRegn01Cmn.CalibrationPorts.TqLoaVehSpdX.Ary1D /end CHARACTERISTIC
/begin CHARACTERISTIC CalRegn01Cmn.TqLoaVehSteerRat.Val "MICROSAR RTE" VALUE 0x0 RTE_RL_FLOAT32_IEEE 0 NO_COMPU_METHOD -3.402823466e+38 3.402823466e+38 SYMBOL_LINK "Rte_CalprmRom_CalRegn01Cmn_DEFAULT_RTE_CALPRM_GROUP.TqLoaVehSteerRat_Val" 0 DISPLAY_IDENTIFIER CalRegn01Cmn.CalibrationPorts.TqLoaVehSteerRat.Val /end CHARACTERISTIC
/begin CHARACTERISTIC CalRegn01Cmn.TqLoaVehUnderSteerGrdt.Val "MICROSAR RTE" VALUE 0x0 RTE_RL_FLOAT32_IEEE 0 NO_COMPU_METHOD -3.402823466e+38 3.402823466e+38 SYMBOL_LINK "Rte_CalprmRom_CalRegn01Cmn_DEFAULT_RTE_CALPRM_GROUP.TqLoaVehUnderSteerGrdt_Val" 0 DISPLAY_IDENTIFIER CalRegn01Cmn.CalibrationPorts.TqLoaVehUnderSteerGrdt.Val /end CHARACTERISTIC
/begin CHARACTERISTIC CalRegn01Cmn.TqLoaVehWhlBas.Val "MICROSAR RTE" VALUE 0x0 RTE_RL_FLOAT32_IEEE 0 NO_COMPU_METHOD -3.402823466e+38 3.402823466e+38 SYMBOL_LINK "Rte_CalprmRom_CalRegn01Cmn_DEFAULT_RTE_CALPRM_GROUP.TqLoaVehWhlBas_Val" 0 DISPLAY_IDENTIFIER CalRegn01Cmn.CalibrationPorts.TqLoaVehWhlBas.Val /end CHARACTERISTIC
/begin CHARACTERISTIC CalRegn01Cmn.VehSigCdngDftLatA.Val "MICROSAR RTE" VALUE 0x0 RTE_RL_FLOAT32_IEEE 0 NO_COMPU_METHOD -3.402823466e+38 3.402823466e+38 SYMBOL_LINK "Rte_CalprmRom_CalRegn01Cmn_DEFAULT_RTE_CALPRM_GROUP.VehSigCdngDftLatA_Val" 0 DISPLAY_IDENTIFIER CalRegn01Cmn.CalibrationPorts.VehSigCdngDftLatA.Val /end CHARACTERISTIC
/begin CHARACTERISTIC CalRegn01Cmn.VehSigCdngDftLgtA.Val "MICROSAR RTE" VALUE 0x0 RTE_RL_FLOAT32_IEEE 0 NO_COMPU_METHOD -3.402823466e+38 3.402823466e+38 SYMBOL_LINK "Rte_CalprmRom_CalRegn01Cmn_DEFAULT_RTE_CALPRM_GROUP.VehSigCdngDftLgtA_Val" 0 DISPLAY_IDENTIFIER CalRegn01Cmn.CalibrationPorts.VehSigCdngDftLgtA.Val /end CHARACTERISTIC
/begin CHARACTERISTIC CalRegn01Cmn.VehSigCdngDftVehSpd.Val "MICROSAR RTE" VALUE 0x0 RTE_RL_FLOAT32_IEEE 0 NO_COMPU_METHOD -3.402823466e+38 3.402823466e+38 SYMBOL_LINK "Rte_CalprmRom_CalRegn01Cmn_DEFAULT_RTE_CALPRM_GROUP.VehSigCdngDftVehSpd_Val" 0 DISPLAY_IDENTIFIER CalRegn01Cmn.CalibrationPorts.VehSigCdngDftVehSpd.Val /end CHARACTERISTIC
/begin GROUP CalRegn01Cmn.FordMsg47ABusHiSpdTrlrAidKnobBtnPassdTiThd.Val "MICROSAR RTE" /begin SUB_GROUP /end SUB_GROUP /begin FUNCTION_LIST /end FUNCTION_LIST
 /begin REF_CHARACTERISTIC CalRegn01Cmn.FordMsg47ABusHiSpdTrlrAidKnobBtnPassdTiThd.Val /end REF_CHARACTERISTIC
 /begin REF_MEASUREMENT /end REF_MEASUREMENT
/end GROUP
/begin GROUP CalRegn01Cmn.FordMsg47ABusHiSpdTrlrAidKnobPosFaildTiThd.Val "MICROSAR RTE" /begin SUB_GROUP /end SUB_GROUP /begin FUNCTION_LIST /end FUNCTION_LIST
 /begin REF_CHARACTERISTIC CalRegn01Cmn.FordMsg47ABusHiSpdTrlrAidKnobPosFaildTiThd.Val /end REF_CHARACTERISTIC
 /begin REF_MEASUREMENT /end REF_MEASUREMENT
/end GROUP
/begin GROUP CalRegn01Cmn.FordMsg47ABusHiSpdTrlrAidKnobPosInvldPassdTiThd.Val "MICROSAR RTE" /begin SUB_GROUP /end SUB_GROUP /begin FUNCTION_LIST /end FUNCTION_LIST
 /begin REF_CHARACTERISTIC CalRegn01Cmn.FordMsg47ABusHiSpdTrlrAidKnobPosInvldPassdTiThd.Val /end REF_CHARACTERISTIC
 /begin REF_MEASUREMENT /end REF_MEASUREMENT
/end GROUP
/begin GROUP CalRegn01Cmn.FordMsg47ABusHiSpdTrlrAidKnobPosMissTiThd.Val "MICROSAR RTE" /begin SUB_GROUP /end SUB_GROUP /begin FUNCTION_LIST /end FUNCTION_LIST /begin REF_CHARACTERISTIC CalRegn01Cmn.FordMsg47ABusHiSpdTrlrAidKnobPosMissTiThd.Val /end REF_CHARACTERISTIC /begin REF_MEASUREMENT /end REF_MEASUREMENT /end GROUP
/begin GROUP CalRegn01Cmn.FordMsg47ABusHiSpdTrlrAidKnobPosPassdTiThd.Val "MICROSAR RTE" /begin SUB_GROUP /end SUB_GROUP /begin FUNCTION_LIST /end FUNCTION_LIST
 /begin REF_CHARACTERISTIC CalRegn01Cmn.FordMsg47ABusHiSpdTrlrAidKnobPosPassdTiThd.Val /end REF_CHARACTERISTIC
 /begin REF_MEASUREMENT /end REF_MEASUREMENT
/end GROUP
/begin GROUP CalRegn01Cmn.FordMsg4B0BusHiSpdCanDtcInhbTiThd.Val "MICROSAR RTE" /begin SUB_GROUP /end SUB_GROUP /begin FUNCTION_LIST /end FUNCTION_LIST /begin REF_CHARACTERISTIC CalRegn01Cmn.FordMsg4B0BusHiSpdCanDtcInhbTiThd.Val /end REF_CHARACTERISTIC /begin REF_MEASUREMENT /end REF_MEASUREMENT /end GROUP
/begin GROUP CalRegn01Cmn.FordMsg4B0BusHiSpdMsgFltNtcDiagcTiThd.Val "MICROSAR RTE" /begin SUB_GROUP /end SUB_GROUP /begin FUNCTION_LIST /end FUNCTION_LIST /begin REF_CHARACTERISTIC CalRegn01Cmn.FordMsg4B0BusHiSpdMsgFltNtcDiagcTiThd.Val /end REF_CHARACTERISTIC /begin REF_MEASUREMENT /end REF_MEASUREMENT /end GROUP
/begin GROUP CalRegn01Cmn.FordMsg4B0BusHiSpdMsgFltTiThd.Val "MICROSAR RTE" /begin SUB_GROUP /end SUB_GROUP /begin FUNCTION_LIST /end FUNCTION_LIST /begin REF_CHARACTERISTIC CalRegn01Cmn.FordMsg4B0BusHiSpdMsgFltTiThd.Val /end REF_CHARACTERISTIC /begin REF_MEASUREMENT /end REF_MEASUREMENT /end GROUP
/begin GROUP CalRegn01Cmn.FordMsg4B0BusHiSpdMsgMissNtcDiagcTiThd.Val "MICROSAR RTE" /begin SUB_GROUP /end SUB_GROUP /begin FUNCTION_LIST /end FUNCTION_LIST /begin REF_CHARACTERISTIC CalRegn01Cmn.FordMsg4B0BusHiSpdMsgMissNtcDiagcTiThd.Val /end REF_CHARACTERISTIC /begin REF_MEASUREMENT /end REF_MEASUREMENT /end GROUP
/begin GROUP CalRegn01Cmn.FordMsg4B0BusHiSpdMsgMissTiThd.Val "MICROSAR RTE" /begin SUB_GROUP /end SUB_GROUP /begin FUNCTION_LIST /end FUNCTION_LIST /begin REF_CHARACTERISTIC CalRegn01Cmn.FordMsg4B0BusHiSpdMsgMissTiThd.Val /end REF_CHARACTERISTIC /begin REF_MEASUREMENT /end REF_MEASUREMENT /end GROUP
/begin GROUP CalRegn01Cmn.FordMsg4B0BusHiSpdMsgRxdNtcDiagcTiThd.Val "MICROSAR RTE" /begin SUB_GROUP /end SUB_GROUP /begin FUNCTION_LIST /end FUNCTION_LIST /begin REF_CHARACTERISTIC CalRegn01Cmn.FordMsg4B0BusHiSpdMsgRxdNtcDiagcTiThd.Val /end REF_CHARACTERISTIC /begin REF_MEASUREMENT /end REF_MEASUREMENT /end GROUP
/begin GROUP CalRegn01Cmn.FordMsg4B0BusHiSpdMsgVldNtcDiagcTiThd.Val "MICROSAR RTE" /begin SUB_GROUP /end SUB_GROUP /begin FUNCTION_LIST /end FUNCTION_LIST /begin REF_CHARACTERISTIC CalRegn01Cmn.FordMsg4B0BusHiSpdMsgVldNtcDiagcTiThd.Val /end REF_CHARACTERISTIC /begin REF_MEASUREMENT /end REF_MEASUREMENT /end GROUP
/begin GROUP CalRegn01Cmn.FordMsg4B0BusHiSpdMsgVldTiThd.Val "MICROSAR RTE" /begin SUB_GROUP /end SUB_GROUP /begin FUNCTION_LIST /end FUNCTION_LIST /begin REF_CHARACTERISTIC CalRegn01Cmn.FordMsg4B0BusHiSpdMsgVldTiThd.Val /end REF_CHARACTERISTIC /begin REF_MEASUREMENT /end REF_MEASUREMENT /end GROUP
/begin GROUP CalRegn01Cmn.GateDrv0CtrlErrFilFrq.Val "MICROSAR RTE" /begin SUB_GROUP /end SUB_GROUP /begin FUNCTION_LIST /end FUNCTION_LIST /begin REF_CHARACTERISTIC CalRegn01Cmn.GateDrv0CtrlErrFilFrq.Val /end REF_CHARACTERISTIC /begin REF_MEASUREMENT /end REF_MEASUREMENT /end GROUP
/begin GROUP CalRegn01Cmn.GateDrv0CtrlErrOffs.Val "MICROSAR RTE" /begin SUB_GROUP /end SUB_GROUP /begin FUNCTION_LIST /end FUNCTION_LIST /begin REF_CHARACTERISTIC CalRegn01Cmn.GateDrv0CtrlErrOffs.Val /end REF_CHARACTERISTIC /begin REF_MEASUREMENT /end REF_MEASUREMENT /end GROUP
/begin GROUP CalRegn01Cmn.GateDrv0CtrlErrThd.Val "MICROSAR RTE" /begin SUB_GROUP /end SUB_GROUP /begin FUNCTION_LIST /end FUNCTION_LIST /begin REF_CHARACTERISTIC CalRegn01Cmn.GateDrv0CtrlErrThd.Val /end REF_CHARACTERISTIC /begin REF_MEASUREMENT /end REF_MEASUREMENT /end GROUP
/begin GROUP CalRegn01Cmn.GateDrv0CtrlNtcNr0x050FailStep.Val "MICROSAR RTE" /begin SUB_GROUP /end SUB_GROUP /begin FUNCTION_LIST /end FUNCTION_LIST /begin REF_CHARACTERISTIC CalRegn01Cmn.GateDrv0CtrlNtcNr0x050FailStep.Val /end REF_CHARACTERISTIC /begin REF_MEASUREMENT /end REF_MEASUREMENT /end GROUP
/begin GROUP CalRegn01Cmn.GateDrv0CtrlNtcNr0x050PassStep.Val "MICROSAR RTE" /begin SUB_GROUP /end SUB_GROUP /begin FUNCTION_LIST /end FUNCTION_LIST /begin REF_CHARACTERISTIC CalRegn01Cmn.GateDrv0CtrlNtcNr0x050PassStep.Val /end REF_CHARACTERISTIC /begin REF_MEASUREMENT /end REF_MEASUREMENT /end GROUP
/begin GROUP CalRegn01Cmn.GateDrv0CtrlNtcNr0x051FailStep.Val "MICROSAR RTE" /begin SUB_GROUP /end SUB_GROUP /begin FUNCTION_LIST /end FUNCTION_LIST /begin REF_CHARACTERISTIC CalRegn01Cmn.GateDrv0CtrlNtcNr0x051FailStep.Val /end REF_CHARACTERISTIC /begin REF_MEASUREMENT /end REF_MEASUREMENT /end GROUP
/begin GROUP CalRegn01Cmn.GateDrv0CtrlNtcNr0x051PassStep.Val "MICROSAR RTE" /begin SUB_GROUP /end SUB_GROUP /begin FUNCTION_LIST /end FUNCTION_LIST /begin REF_CHARACTERISTIC CalRegn01Cmn.GateDrv0CtrlNtcNr0x051PassStep.Val /end REF_CHARACTERISTIC /begin REF_MEASUREMENT /end REF_MEASUREMENT /end GROUP
/begin GROUP CalRegn01Cmn.GateDrv0CtrlNtcNr0x055FailStep.Val "MICROSAR RTE" /begin SUB_GROUP /end SUB_GROUP /begin FUNCTION_LIST /end FUNCTION_LIST /begin REF_CHARACTERISTIC CalRegn01Cmn.GateDrv0CtrlNtcNr0x055FailStep.Val /end REF_CHARACTERISTIC /begin REF_MEASUREMENT /end REF_MEASUREMENT /end GROUP
/begin GROUP CalRegn01Cmn.GateDrv0CtrlNtcNr0x055PassStep.Val "MICROSAR RTE" /begin SUB_GROUP /end SUB_GROUP /begin FUNCTION_LIST /end FUNCTION_LIST /begin REF_CHARACTERISTIC CalRegn01Cmn.GateDrv0CtrlNtcNr0x055PassStep.Val /end REF_CHARACTERISTIC /begin REF_MEASUREMENT /end REF_MEASUREMENT /end GROUP
/begin GROUP CalRegn01Cmn.GateDrv0CtrlUnit0Cfg2WrVal.Val "MICROSAR RTE" /begin SUB_GROUP /end SUB_GROUP /begin FUNCTION_LIST /end FUNCTION_LIST /begin REF_CHARACTERISTIC CalRegn01Cmn.GateDrv0CtrlUnit0Cfg2WrVal.Val /end REF_CHARACTERISTIC /begin REF_MEASUREMENT /end REF_MEASUREMENT /end GROUP
/begin GROUP CalRegn01Cmn.GateDrv0CtrlUnit0Cfg3WrVal.Val "MICROSAR RTE" /begin SUB_GROUP /end SUB_GROUP /begin FUNCTION_LIST /end FUNCTION_LIST /begin REF_CHARACTERISTIC CalRegn01Cmn.GateDrv0CtrlUnit0Cfg3WrVal.Val /end REF_CHARACTERISTIC /begin REF_MEASUREMENT /end REF_MEASUREMENT /end GROUP
/begin GROUP CalRegn01Cmn.GateDrv0CtrlUnit0Cfg4WrVal.Val "MICROSAR RTE" /begin SUB_GROUP /end SUB_GROUP /begin FUNCTION_LIST /end FUNCTION_LIST /begin REF_CHARACTERISTIC CalRegn01Cmn.GateDrv0CtrlUnit0Cfg4WrVal.Val /end REF_CHARACTERISTIC /begin REF_MEASUREMENT /end REF_MEASUREMENT /end GROUP
/begin GROUP CalRegn01Cmn.GateDrv0CtrlUnit0Cfg7WrVal.Val "MICROSAR RTE" /begin SUB_GROUP /end SUB_GROUP /begin FUNCTION_LIST /end FUNCTION_LIST /begin REF_CHARACTERISTIC CalRegn01Cmn.GateDrv0CtrlUnit0Cfg7WrVal.Val /end REF_CHARACTERISTIC /begin REF_MEASUREMENT /end REF_MEASUREMENT /end GROUP
/begin GROUP CalRegn01Cmn.GtmCfgAndUseAdcStrtOfCnvn2Offs.Val "MICROSAR RTE" /begin SUB_GROUP /end SUB_GROUP /begin FUNCTION_LIST /end FUNCTION_LIST /begin REF_CHARACTERISTIC CalRegn01Cmn.GtmCfgAndUseAdcStrtOfCnvn2Offs.Val /end REF_CHARACTERISTIC /begin REF_MEASUREMENT /end REF_MEASUREMENT /end GROUP
/begin GROUP CalRegn01Cmn.GtmCfgAndUseAdcStrtOfCnvnPeakOffs.Val "MICROSAR RTE" /begin SUB_GROUP /end SUB_GROUP /begin FUNCTION_LIST /end FUNCTION_LIST /begin REF_CHARACTERISTIC CalRegn01Cmn.GtmCfgAndUseAdcStrtOfCnvnPeakOffs.Val /end REF_CHARACTERISTIC /begin REF_MEASUREMENT /end REF_MEASUREMENT /end GROUP
/begin GROUP CalRegn01Cmn.GtmCfgAndUseDma2MilliSecToMotCtrlTrig.Val "MICROSAR RTE" /begin SUB_GROUP /end SUB_GROUP /begin FUNCTION_LIST /end FUNCTION_LIST /begin REF_CHARACTERISTIC CalRegn01Cmn.GtmCfgAndUseDma2MilliSecToMotCtrlTrig.Val /end REF_CHARACTERISTIC /begin REF_MEASUREMENT /end REF_MEASUREMENT /end GROUP
/begin GROUP CalRegn01Cmn.GtmCfgAndUseDmaMotAgATrig.Val "MICROSAR RTE" /begin SUB_GROUP /end SUB_GROUP /begin FUNCTION_LIST /end FUNCTION_LIST /begin REF_CHARACTERISTIC CalRegn01Cmn.GtmCfgAndUseDmaMotAgATrig.Val /end REF_CHARACTERISTIC /begin REF_MEASUREMENT /end REF_MEASUREMENT /end GROUP
/begin GROUP CalRegn01Cmn.GtmCfgAndUseDmaMotCtrlTo2MilliSecTrig.Val "MICROSAR RTE" /begin SUB_GROUP /end SUB_GROUP /begin FUNCTION_LIST /end FUNCTION_LIST /begin REF_CHARACTERISTIC CalRegn01Cmn.GtmCfgAndUseDmaMotCtrlTo2MilliSecTrig.Val /end REF_CHARACTERISTIC /begin REF_MEASUREMENT /end REF_MEASUREMENT /end GROUP
/begin GROUP CalRegn01Cmn.GtmCfgAndUsePwmDbnd.Val "MICROSAR RTE" /begin SUB_GROUP /end SUB_GROUP /begin FUNCTION_LIST /end FUNCTION_LIST /begin REF_CHARACTERISTIC CalRegn01Cmn.GtmCfgAndUsePwmDbnd.Val /end REF_CHARACTERISTIC /begin REF_MEASUREMENT /end REF_MEASUREMENT /end GROUP
/begin GROUP CalRegn01Cmn.HwAgSnsrlsCorrdPinionAgConfThd.Val "MICROSAR RTE" /begin SUB_GROUP /end SUB_GROUP /begin FUNCTION_LIST /end FUNCTION_LIST /begin REF_CHARACTERISTIC CalRegn01Cmn.HwAgSnsrlsCorrdPinionAgConfThd.Val /end REF_CHARACTERISTIC /begin REF_MEASUREMENT /end REF_MEASUREMENT /end GROUP
/begin GROUP CalRegn01Cmn.HwAgSnsrlsCorrdPinionAgHwConf.Val "MICROSAR RTE" /begin SUB_GROUP /end SUB_GROUP /begin FUNCTION_LIST /end FUNCTION_LIST /begin REF_CHARACTERISTIC CalRegn01Cmn.HwAgSnsrlsCorrdPinionAgHwConf.Val /end REF_CHARACTERISTIC /begin REF_MEASUREMENT /end REF_MEASUREMENT /end GROUP
/begin GROUP CalRegn01Cmn.HwAgSnsrlsFCentrHwConf.Val "MICROSAR RTE" /begin SUB_GROUP /end SUB_GROUP /begin FUNCTION_LIST /end FUNCTION_LIST /begin REF_CHARACTERISTIC CalRegn01Cmn.HwAgSnsrlsFCentrHwConf.Val /end REF_CHARACTERISTIC /begin REF_MEASUREMENT /end REF_MEASUREMENT /end GROUP
/begin GROUP CalRegn01Cmn.HwAgSnsrlsMotAgIdptSigThd.Val "MICROSAR RTE" /begin SUB_GROUP /end SUB_GROUP /begin FUNCTION_LIST /end FUNCTION_LIST /begin REF_CHARACTERISTIC CalRegn01Cmn.HwAgSnsrlsMotAgIdptSigThd.Val /end REF_CHARACTERISTIC /begin REF_MEASUREMENT /end REF_MEASUREMENT /end GROUP
/begin GROUP CalRegn01Cmn.HwAgSnsrlsPinionTqFilFrq.Val "MICROSAR RTE" /begin SUB_GROUP /end SUB_GROUP /begin FUNCTION_LIST /end FUNCTION_LIST /begin REF_CHARACTERISTIC CalRegn01Cmn.HwAgSnsrlsPinionTqFilFrq.Val /end REF_CHARACTERISTIC /begin REF_MEASUREMENT /end REF_MEASUREMENT /end GROUP
/begin GROUP CalRegn01Cmn.HwAgSnsrlsRelHwAgFil1Frq.Val "MICROSAR RTE" /begin SUB_GROUP /end SUB_GROUP /begin FUNCTION_LIST /end FUNCTION_LIST /begin REF_CHARACTERISTIC CalRegn01Cmn.HwAgSnsrlsRelHwAgFil1Frq.Val /end REF_CHARACTERISTIC /begin REF_MEASUREMENT /end REF_MEASUREMENT /end GROUP
/begin GROUP CalRegn01Cmn.HwAgSnsrlsRelHwAgFil2Frq.Val "MICROSAR RTE" /begin SUB_GROUP /end SUB_GROUP /begin FUNCTION_LIST /end FUNCTION_LIST /begin REF_CHARACTERISTIC CalRegn01Cmn.HwAgSnsrlsRelHwAgFil2Frq.Val /end REF_CHARACTERISTIC /begin REF_MEASUREMENT /end REF_MEASUREMENT /end GROUP
/begin GROUP CalRegn01Cmn.HwAgSnsrlsSmotngCoeff.Val "MICROSAR RTE" /begin SUB_GROUP /end SUB_GROUP /begin FUNCTION_LIST /end FUNCTION_LIST /begin REF_CHARACTERISTIC CalRegn01Cmn.HwAgSnsrlsSmotngCoeff.Val /end REF_CHARACTERISTIC /begin REF_MEASUREMENT /end REF_MEASUREMENT /end GROUP
/begin GROUP CalRegn01Cmn.HwAgSnsrlsSmotngStepThd.Val "MICROSAR RTE" /begin SUB_GROUP /end SUB_GROUP /begin FUNCTION_LIST /end FUNCTION_LIST /begin REF_CHARACTERISTIC CalRegn01Cmn.HwAgSnsrlsSmotngStepThd.Val /end REF_CHARACTERISTIC /begin REF_MEASUREMENT /end REF_MEASUREMENT /end GROUP
/begin GROUP CalRegn01Cmn.HwAgSnsrlsStordPinionConf.Val "MICROSAR RTE" /begin SUB_GROUP /end SUB_GROUP /begin FUNCTION_LIST /end FUNCTION_LIST /begin REF_CHARACTERISTIC CalRegn01Cmn.HwAgSnsrlsStordPinionConf.Val /end REF_CHARACTERISTIC /begin REF_MEASUREMENT /end REF_MEASUREMENT /end GROUP
/begin GROUP CalRegn01Cmn.HwAgSnsrlsStordPinionConfThd.Val "MICROSAR RTE" /begin SUB_GROUP /end SUB_GROUP /begin FUNCTION_LIST /end FUNCTION_LIST /begin REF_CHARACTERISTIC CalRegn01Cmn.HwAgSnsrlsStordPinionConfThd.Val /end REF_CHARACTERISTIC /begin REF_MEASUREMENT /end REF_MEASUREMENT /end GROUP
/begin GROUP CalRegn01Cmn.HwAgSnsrlsVehDynDifThd.Val "MICROSAR RTE" /begin SUB_GROUP /end SUB_GROUP /begin FUNCTION_LIST /end FUNCTION_LIST /begin REF_CHARACTERISTIC CalRegn01Cmn.HwAgSnsrlsVehDynDifThd.Val /end REF_CHARACTERISTIC /begin REF_MEASUREMENT /end REF_MEASUREMENT /end GROUP
/begin GROUP CalRegn01Cmn.HwAgSnsrlsVehDynHwConf.Val "MICROSAR RTE" /begin SUB_GROUP /end SUB_GROUP /begin FUNCTION_LIST /end FUNCTION_LIST /begin REF_CHARACTERISTIC CalRegn01Cmn.HwAgSnsrlsVehDynHwConf.Val /end REF_CHARACTERISTIC /begin REF_MEASUREMENT /end REF_MEASUREMENT /end GROUP
/begin GROUP CalRegn01Cmn.HwAgSnsrlsVehDynMotVelThd.Val "MICROSAR RTE" /begin SUB_GROUP /end SUB_GROUP /begin FUNCTION_LIST /end FUNCTION_LIST /begin REF_CHARACTERISTIC CalRegn01Cmn.HwAgSnsrlsVehDynMotVelThd.Val /end REF_CHARACTERISTIC /begin REF_MEASUREMENT /end REF_MEASUREMENT /end GROUP
/begin GROUP CalRegn01Cmn.HwAgSnsrlsVehDynPinionTqThd.Val "MICROSAR RTE" /begin SUB_GROUP /end SUB_GROUP /begin FUNCTION_LIST /end FUNCTION_LIST /begin REF_CHARACTERISTIC CalRegn01Cmn.HwAgSnsrlsVehDynPinionTqThd.Val /end REF_CHARACTERISTIC /begin REF_MEASUREMENT /end REF_MEASUREMENT /end GROUP
/begin GROUP CalRegn01Cmn.HwAgSnsrlsVehDynTmr1Thd.Val "MICROSAR RTE" /begin SUB_GROUP /end SUB_GROUP /begin FUNCTION_LIST /end FUNCTION_LIST /begin REF_CHARACTERISTIC CalRegn01Cmn.HwAgSnsrlsVehDynTmr1Thd.Val /end REF_CHARACTERISTIC /begin REF_MEASUREMENT /end REF_MEASUREMENT /end GROUP
/begin GROUP CalRegn01Cmn.HwAgSnsrlsVehDynTmr2Thd.Val "MICROSAR RTE" /begin SUB_GROUP /end SUB_GROUP /begin FUNCTION_LIST /end FUNCTION_LIST /begin REF_CHARACTERISTIC CalRegn01Cmn.HwAgSnsrlsVehDynTmr2Thd.Val /end REF_CHARACTERISTIC /begin REF_MEASUREMENT /end REF_MEASUREMENT /end GROUP
/begin GROUP CalRegn01Cmn.HwAgSnsrlsWhlFrqThd.Val "MICROSAR RTE" /begin SUB_GROUP /end SUB_GROUP /begin FUNCTION_LIST /end FUNCTION_LIST /begin REF_CHARACTERISTIC CalRegn01Cmn.HwAgSnsrlsWhlFrqThd.Val /end REF_CHARACTERISTIC /begin REF_MEASUREMENT /end REF_MEASUREMENT /end GROUP
/begin GROUP CalRegn01Cmn.HwAgSnsrlsWhlSpdHwAgCoeff1.Val "MICROSAR RTE" /begin SUB_GROUP /end SUB_GROUP /begin FUNCTION_LIST /end FUNCTION_LIST /begin REF_CHARACTERISTIC CalRegn01Cmn.HwAgSnsrlsWhlSpdHwAgCoeff1.Val /end REF_CHARACTERISTIC /begin REF_MEASUREMENT /end REF_MEASUREMENT /end GROUP
/begin GROUP CalRegn01Cmn.HwAgSnsrlsWhlSpdHwAgCoeff2.Val "MICROSAR RTE" /begin SUB_GROUP /end SUB_GROUP /begin FUNCTION_LIST /end FUNCTION_LIST /begin REF_CHARACTERISTIC CalRegn01Cmn.HwAgSnsrlsWhlSpdHwAgCoeff2.Val /end REF_CHARACTERISTIC /begin REF_MEASUREMENT /end REF_MEASUREMENT /end GROUP
/begin GROUP CalRegn01Cmn.HwAgSnsrlsWhlSpdHwAgThd.Val "MICROSAR RTE" /begin SUB_GROUP /end SUB_GROUP /begin FUNCTION_LIST /end FUNCTION_LIST /begin REF_CHARACTERISTIC CalRegn01Cmn.HwAgSnsrlsWhlSpdHwAgThd.Val /end REF_CHARACTERISTIC /begin REF_MEASUREMENT /end REF_MEASUREMENT /end GROUP
/begin GROUP CalRegn01Cmn.HwAgSnsrlsWhlSpdHwConf.Val "MICROSAR RTE" /begin SUB_GROUP /end SUB_GROUP /begin FUNCTION_LIST /end FUNCTION_LIST /begin REF_CHARACTERISTIC CalRegn01Cmn.HwAgSnsrlsWhlSpdHwConf.Val /end REF_CHARACTERISTIC /begin REF_MEASUREMENT /end REF_MEASUREMENT /end GROUP
/begin GROUP CalRegn01Cmn.HwAgSnsrlsWhlSpdRatThd.Val "MICROSAR RTE" /begin SUB_GROUP /end SUB_GROUP /begin FUNCTION_LIST /end FUNCTION_LIST /begin REF_CHARACTERISTIC CalRegn01Cmn.HwAgSnsrlsWhlSpdRatThd.Val /end REF_CHARACTERISTIC /begin REF_MEASUREMENT /end REF_MEASUREMENT /end GROUP
/begin GROUP CalRegn01Cmn.HwAgSnsrlsWhlSpdTmrThd.Val "MICROSAR RTE" /begin SUB_GROUP /end SUB_GROUP /begin FUNCTION_LIST /end FUNCTION_LIST /begin REF_CHARACTERISTIC CalRegn01Cmn.HwAgSnsrlsWhlSpdTmrThd.Val /end REF_CHARACTERISTIC /begin REF_MEASUREMENT /end REF_MEASUREMENT /end GROUP
/begin GROUP CalRegn01Cmn.HwAgSnsrlsWhlSpdVehSpdThd.Val "MICROSAR RTE" /begin SUB_GROUP /end SUB_GROUP /begin FUNCTION_LIST /end FUNCTION_LIST /begin REF_CHARACTERISTIC CalRegn01Cmn.HwAgSnsrlsWhlSpdVehSpdThd.Val /end REF_CHARACTERISTIC /begin REF_MEASUREMENT /end REF_MEASUREMENT /end GROUP
/begin GROUP CalRegn01Cmn.HwAgSysArbnHwAgConf1Snsr.Val "MICROSAR RTE" /begin SUB_GROUP /end SUB_GROUP /begin FUNCTION_LIST /end FUNCTION_LIST /begin REF_CHARACTERISTIC CalRegn01Cmn.HwAgSysArbnHwAgConf1Snsr.Val /end REF_CHARACTERISTIC /begin REF_MEASUREMENT /end REF_MEASUREMENT /end GROUP
/begin GROUP CalRegn01Cmn.HwAgSysArbnHwAgConf1SnsrHwAgTrimNotPrfmd.Val "MICROSAR RTE" /begin SUB_GROUP /end SUB_GROUP /begin FUNCTION_LIST /end FUNCTION_LIST /begin REF_CHARACTERISTIC CalRegn01Cmn.HwAgSysArbnHwAgConf1SnsrHwAgTrimNotPrfmd.Val /end REF_CHARACTERISTIC /begin REF_MEASUREMENT /end REF_MEASUREMENT /end GROUP
/begin GROUP CalRegn01Cmn.HwAgSysArbnHwAgConf2Snsr.Val "MICROSAR RTE" /begin SUB_GROUP /end SUB_GROUP /begin FUNCTION_LIST /end FUNCTION_LIST /begin REF_CHARACTERISTIC CalRegn01Cmn.HwAgSysArbnHwAgConf2Snsr.Val /end REF_CHARACTERISTIC /begin REF_MEASUREMENT /end REF_MEASUREMENT /end GROUP
/begin GROUP CalRegn01Cmn.HwAgSysArbnHwAgConf2SnsrHwAgTrimNotPrfmd.Val "MICROSAR RTE" /begin SUB_GROUP /end SUB_GROUP /begin FUNCTION_LIST /end FUNCTION_LIST /begin REF_CHARACTERISTIC CalRegn01Cmn.HwAgSysArbnHwAgConf2SnsrHwAgTrimNotPrfmd.Val /end REF_CHARACTERISTIC /begin REF_MEASUREMENT /end REF_MEASUREMENT /end GROUP
/begin GROUP CalRegn01Cmn.HwAgSysArbnHwAgConfNoSnsr.Val "MICROSAR RTE" /begin SUB_GROUP /end SUB_GROUP /begin FUNCTION_LIST /end FUNCTION_LIST /begin REF_CHARACTERISTIC CalRegn01Cmn.HwAgSysArbnHwAgConfNoSnsr.Val /end REF_CHARACTERISTIC /begin REF_MEASUREMENT /end REF_MEASUREMENT /end GROUP
/begin GROUP CalRegn01Cmn.HwAgSysArbnHwAgConfTiThd.Val "MICROSAR RTE" /begin SUB_GROUP /end SUB_GROUP /begin FUNCTION_LIST /end FUNCTION_LIST /begin REF_CHARACTERISTIC CalRegn01Cmn.HwAgSysArbnHwAgConfTiThd.Val /end REF_CHARACTERISTIC /begin REF_MEASUREMENT /end REF_MEASUREMENT /end GROUP
/begin GROUP CalRegn01Cmn.HwAgSysArbnHwAgCorrdCorrlnThd.Val "MICROSAR RTE" /begin SUB_GROUP /end SUB_GROUP /begin FUNCTION_LIST /end FUNCTION_LIST /begin REF_CHARACTERISTIC CalRegn01Cmn.HwAgSysArbnHwAgCorrdCorrlnThd.Val /end REF_CHARACTERISTIC /begin REF_MEASUREMENT /end REF_MEASUREMENT /end GROUP
/begin GROUP CalRegn01Cmn.HwAgSysArbnHwAgCorrlnFailDebStep.Val "MICROSAR RTE" /begin SUB_GROUP /end SUB_GROUP /begin FUNCTION_LIST /end FUNCTION_LIST /begin REF_CHARACTERISTIC CalRegn01Cmn.HwAgSysArbnHwAgCorrlnFailDebStep.Val /end REF_CHARACTERISTIC /begin REF_MEASUREMENT /end REF_MEASUREMENT /end GROUP
/begin GROUP CalRegn01Cmn.HwAgSysArbnHwAgCorrlnPassDebStep.Val "MICROSAR RTE" /begin SUB_GROUP /end SUB_GROUP /begin FUNCTION_LIST /end FUNCTION_LIST /begin REF_CHARACTERISTIC CalRegn01Cmn.HwAgSysArbnHwAgCorrlnPassDebStep.Val /end REF_CHARACTERISTIC /begin REF_MEASUREMENT /end REF_MEASUREMENT /end GROUP
/begin GROUP CalRegn01Cmn.HwAgSysArbnHwAgCorrlnRng.Val "MICROSAR RTE" /begin SUB_GROUP /end SUB_GROUP /begin FUNCTION_LIST /end FUNCTION_LIST /begin REF_CHARACTERISTIC CalRegn01Cmn.HwAgSysArbnHwAgCorrlnRng.Val /end REF_CHARACTERISTIC /begin REF_MEASUREMENT /end REF_MEASUREMENT /end GROUP
/begin GROUP CalRegn01Cmn.HwAgSysArbnHwAgIdptSigLim.Val "MICROSAR RTE" /begin SUB_GROUP /end SUB_GROUP /begin FUNCTION_LIST /end FUNCTION_LIST /begin REF_CHARACTERISTIC CalRegn01Cmn.HwAgSysArbnHwAgIdptSigLim.Val /end REF_CHARACTERISTIC /begin REF_MEASUREMENT /end REF_MEASUREMENT /end GROUP
/begin GROUP CalRegn01Cmn.HwAgSysArbnHwAgSlewRate.Val "MICROSAR RTE" /begin SUB_GROUP /end SUB_GROUP /begin FUNCTION_LIST /end FUNCTION_LIST /begin REF_CHARACTERISTIC CalRegn01Cmn.HwAgSysArbnHwAgSlewRate.Val /end REF_CHARACTERISTIC /begin REF_MEASUREMENT /end REF_MEASUREMENT /end GROUP
/begin GROUP CalRegn01Cmn.HwAgSysArbnHwAgSnsrlsCorrlnThd.Val "MICROSAR RTE" /begin SUB_GROUP /end SUB_GROUP /begin FUNCTION_LIST /end FUNCTION_LIST /begin REF_CHARACTERISTIC CalRegn01Cmn.HwAgSysArbnHwAgSnsrlsCorrlnThd.Val /end REF_CHARACTERISTIC /begin REF_MEASUREMENT /end REF_MEASUREMENT /end GROUP
/begin GROUP CalRegn01Cmn.HwAgSysArbnHwAgSnsrlsKineThd.Val "MICROSAR RTE" /begin SUB_GROUP /end SUB_GROUP /begin FUNCTION_LIST /end FUNCTION_LIST /begin REF_CHARACTERISTIC CalRegn01Cmn.HwAgSysArbnHwAgSnsrlsKineThd.Val /end REF_CHARACTERISTIC /begin REF_MEASUREMENT /end REF_MEASUREMENT /end GROUP
/begin GROUP CalRegn01Cmn.HwAgSysArbnImcHwAgCorrlnRng.Val "MICROSAR RTE" /begin SUB_GROUP /end SUB_GROUP /begin FUNCTION_LIST /end FUNCTION_LIST /begin REF_CHARACTERISTIC CalRegn01Cmn.HwAgSysArbnImcHwAgCorrlnRng.Val /end REF_CHARACTERISTIC /begin REF_MEASUREMENT /end REF_MEASUREMENT /end GROUP
/begin GROUP CalRegn01Cmn.HwAgSysArbnPinionAgConfThd.Val "MICROSAR RTE" /begin SUB_GROUP /end SUB_GROUP /begin FUNCTION_LIST /end FUNCTION_LIST /begin REF_CHARACTERISTIC CalRegn01Cmn.HwAgSysArbnPinionAgConfThd.Val /end REF_CHARACTERISTIC /begin REF_MEASUREMENT /end REF_MEASUREMENT /end GROUP
/begin GROUP CalRegn01Cmn.HwAgSysArbnSerlComHwAgCorrdConf.Val "MICROSAR RTE" /begin SUB_GROUP /end SUB_GROUP /begin FUNCTION_LIST /end FUNCTION_LIST /begin REF_CHARACTERISTIC CalRegn01Cmn.HwAgSysArbnSerlComHwAgCorrdConf.Val /end REF_CHARACTERISTIC /begin REF_MEASUREMENT /end REF_MEASUREMENT /end GROUP
/begin GROUP CalRegn01Cmn.HwAgSysArbnSerlComHwAgSnsrlsConf.Val "MICROSAR RTE" /begin SUB_GROUP /end SUB_GROUP /begin FUNCTION_LIST /end FUNCTION_LIST /begin REF_CHARACTERISTIC CalRegn01Cmn.HwAgSysArbnSerlComHwAgSnsrlsConf.Val /end REF_CHARACTERISTIC /begin REF_MEASUREMENT /end REF_MEASUREMENT /end GROUP
/begin GROUP CalRegn01Cmn.HwAgSysArbnSlewRateTmr.Val "MICROSAR RTE" /begin SUB_GROUP /end SUB_GROUP /begin FUNCTION_LIST /end FUNCTION_LIST /begin REF_CHARACTERISTIC CalRegn01Cmn.HwAgSysArbnSlewRateTmr.Val /end REF_CHARACTERISTIC /begin REF_MEASUREMENT /end REF_MEASUREMENT /end GROUP
/begin GROUP CalRegn01Cmn.HwTqArbnHwTqMaxStallCnt.Val "MICROSAR RTE" /begin SUB_GROUP /end SUB_GROUP /begin FUNCTION_LIST /end FUNCTION_LIST /begin REF_CHARACTERISTIC CalRegn01Cmn.HwTqArbnHwTqMaxStallCnt.Val /end REF_CHARACTERISTIC /begin REF_MEASUREMENT /end REF_MEASUREMENT /end GROUP
/begin GROUP CalRegn01Cmn.HwTqCorrlnImdtCorrlnChkFailThd.Val "MICROSAR RTE" /begin SUB_GROUP /end SUB_GROUP /begin FUNCTION_LIST /end FUNCTION_LIST /begin REF_CHARACTERISTIC CalRegn01Cmn.HwTqCorrlnImdtCorrlnChkFailThd.Val /end REF_CHARACTERISTIC /begin REF_MEASUREMENT /end REF_MEASUREMENT /end GROUP
/begin GROUP CalRegn01Cmn.HwTqCorrlnNtcFailStep.Val "MICROSAR RTE" /begin SUB_GROUP /end SUB_GROUP /begin FUNCTION_LIST /end FUNCTION_LIST /begin REF_CHARACTERISTIC CalRegn01Cmn.HwTqCorrlnNtcFailStep.Val /end REF_CHARACTERISTIC /begin REF_MEASUREMENT /end REF_MEASUREMENT /end GROUP
/begin GROUP CalRegn01Cmn.HwTqCorrlnNtcPassStep.Val "MICROSAR RTE" /begin SUB_GROUP /end SUB_GROUP /begin FUNCTION_LIST /end FUNCTION_LIST /begin REF_CHARACTERISTIC CalRegn01Cmn.HwTqCorrlnNtcPassStep.Val /end REF_CHARACTERISTIC /begin REF_MEASUREMENT /end REF_MEASUREMENT /end GROUP
/begin GROUP CalRegn01Cmn.ImcArbnEcuIninTiOutThd.Val "MICROSAR RTE" /begin SUB_GROUP /end SUB_GROUP /begin FUNCTION_LIST /end FUNCTION_LIST /begin REF_CHARACTERISTIC CalRegn01Cmn.ImcArbnEcuIninTiOutThd.Val /end REF_CHARACTERISTIC /begin REF_MEASUREMENT /end REF_MEASUREMENT /end GROUP
/begin GROUP CalRegn01Cmn.ImcArbnFrmFltThd.Val "MICROSAR RTE" /begin SUB_GROUP /end SUB_GROUP /begin FUNCTION_LIST /end FUNCTION_LIST /begin REF_CHARACTERISTIC CalRegn01Cmn.ImcArbnFrmFltThd.Val /end REF_CHARACTERISTIC /begin REF_MEASUREMENT /end REF_MEASUREMENT /end GROUP
/begin GROUP CalRegn01Cmn.LoaMgrCurrIvtrMtgtnScaZeroEna.Logl "MICROSAR RTE" /begin SUB_GROUP /end SUB_GROUP /begin FUNCTION_LIST /end FUNCTION_LIST /begin REF_CHARACTERISTIC CalRegn01Cmn.LoaMgrCurrIvtrMtgtnScaZeroEna.Logl /end REF_CHARACTERISTIC /begin REF_MEASUREMENT /end REF_MEASUREMENT /end GROUP
/begin GROUP CalRegn01Cmn.LoaMgrCurrMeasIdptSig0Resp.Val "MICROSAR RTE" /begin SUB_GROUP /end SUB_GROUP /begin FUNCTION_LIST /end FUNCTION_LIST /begin REF_CHARACTERISTIC CalRegn01Cmn.LoaMgrCurrMeasIdptSig0Resp.Val /end REF_CHARACTERISTIC /begin REF_MEASUREMENT /end REF_MEASUREMENT /end GROUP
/begin GROUP CalRegn01Cmn.LoaMgrCurrMeasIdptSig1Resp.Val "MICROSAR RTE" /begin SUB_GROUP /end SUB_GROUP /begin FUNCTION_LIST /end FUNCTION_LIST /begin REF_CHARACTERISTIC CalRegn01Cmn.LoaMgrCurrMeasIdptSig1Resp.Val /end REF_CHARACTERISTIC /begin REF_MEASUREMENT /end REF_MEASUREMENT /end GROUP
/begin GROUP CalRegn01Cmn.LoaMgrCurrMeasIdptSig2Resp.Val "MICROSAR RTE" /begin SUB_GROUP /end SUB_GROUP /begin FUNCTION_LIST /end FUNCTION_LIST /begin REF_CHARACTERISTIC CalRegn01Cmn.LoaMgrCurrMeasIdptSig2Resp.Val /end REF_CHARACTERISTIC /begin REF_MEASUREMENT /end REF_MEASUREMENT /end GROUP
/begin GROUP CalRegn01Cmn.LoaMgrCurrMeasIdptSigFltThd.Val "MICROSAR RTE" /begin SUB_GROUP /end SUB_GROUP /begin FUNCTION_LIST /end FUNCTION_LIST /begin REF_CHARACTERISTIC CalRegn01Cmn.LoaMgrCurrMeasIdptSigFltThd.Val /end REF_CHARACTERISTIC /begin REF_MEASUREMENT /end REF_MEASUREMENT /end GROUP
/begin GROUP CalRegn01Cmn.LoaMgrCurrMeasMtgtnScaZeroEna.Logl "MICROSAR RTE" /begin SUB_GROUP /end SUB_GROUP /begin FUNCTION_LIST /end FUNCTION_LIST /begin REF_CHARACTERISTIC CalRegn01Cmn.LoaMgrCurrMeasMtgtnScaZeroEna.Logl /end REF_CHARACTERISTIC /begin REF_MEASUREMENT /end REF_MEASUREMENT /end GROUP
/begin GROUP CalRegn01Cmn.LoaMgrFadeOutStRate.Val "MICROSAR RTE" /begin SUB_GROUP /end SUB_GROUP /begin FUNCTION_LIST /end FUNCTION_LIST /begin REF_CHARACTERISTIC CalRegn01Cmn.LoaMgrFadeOutStRate.Val /end REF_CHARACTERISTIC /begin REF_MEASUREMENT /end REF_MEASUREMENT /end GROUP
/begin GROUP CalRegn01Cmn.LoaMgrHwTqIdptSig0NoTqLoaResp.Val "MICROSAR RTE" /begin SUB_GROUP /end SUB_GROUP /begin FUNCTION_LIST /end FUNCTION_LIST /begin REF_CHARACTERISTIC CalRegn01Cmn.LoaMgrHwTqIdptSig0NoTqLoaResp.Val /end REF_CHARACTERISTIC /begin REF_MEASUREMENT /end REF_MEASUREMENT /end GROUP
/begin GROUP CalRegn01Cmn.LoaMgrHwTqIdptSig1NoTqLoaResp.Val "MICROSAR RTE" /begin SUB_GROUP /end SUB_GROUP /begin FUNCTION_LIST /end FUNCTION_LIST /begin REF_CHARACTERISTIC CalRegn01Cmn.LoaMgrHwTqIdptSig1NoTqLoaResp.Val /end REF_CHARACTERISTIC /begin REF_MEASUREMENT /end REF_MEASUREMENT /end GROUP
/begin GROUP CalRegn01Cmn.LoaMgrHwTqIdptSig2Resp.Val "MICROSAR RTE" /begin SUB_GROUP /end SUB_GROUP /begin FUNCTION_LIST /end FUNCTION_LIST /begin REF_CHARACTERISTIC CalRegn01Cmn.LoaMgrHwTqIdptSig2Resp.Val /end REF_CHARACTERISTIC /begin REF_MEASUREMENT /end REF_MEASUREMENT /end GROUP
/begin GROUP CalRegn01Cmn.LoaMgrHwTqIdptSig3Resp.Val "MICROSAR RTE" /begin SUB_GROUP /end SUB_GROUP /begin FUNCTION_LIST /end FUNCTION_LIST /begin REF_CHARACTERISTIC CalRegn01Cmn.LoaMgrHwTqIdptSig3Resp.Val /end REF_CHARACTERISTIC /begin REF_MEASUREMENT /end REF_MEASUREMENT /end GROUP
/begin GROUP CalRegn01Cmn.LoaMgrHwTqIdptSig4Resp.Val "MICROSAR RTE" /begin SUB_GROUP /end SUB_GROUP /begin FUNCTION_LIST /end FUNCTION_LIST /begin REF_CHARACTERISTIC CalRegn01Cmn.LoaMgrHwTqIdptSig4Resp.Val /end REF_CHARACTERISTIC /begin REF_MEASUREMENT /end REF_MEASUREMENT /end GROUP
/begin GROUP CalRegn01Cmn.LoaMgrHwTqIdptSigFltThd.Val "MICROSAR RTE" /begin SUB_GROUP /end SUB_GROUP /begin FUNCTION_LIST /end FUNCTION_LIST /begin REF_CHARACTERISTIC CalRegn01Cmn.LoaMgrHwTqIdptSigFltThd.Val /end REF_CHARACTERISTIC /begin REF_MEASUREMENT /end REF_MEASUREMENT /end GROUP
/begin GROUP CalRegn01Cmn.LoaMgrHwTqLoaAvlResp.Val "MICROSAR RTE" /begin SUB_GROUP /end SUB_GROUP /begin FUNCTION_LIST /end FUNCTION_LIST /begin REF_CHARACTERISTIC CalRegn01Cmn.LoaMgrHwTqLoaAvlResp.Val /end REF_CHARACTERISTIC /begin REF_MEASUREMENT /end REF_MEASUREMENT /end GROUP
/begin GROUP CalRegn01Cmn.LoaMgrIvtrIdptSig0Resp.Val "MICROSAR RTE" /begin SUB_GROUP /end SUB_GROUP /begin FUNCTION_LIST /end FUNCTION_LIST /begin REF_CHARACTERISTIC CalRegn01Cmn.LoaMgrIvtrIdptSig0Resp.Val /end REF_CHARACTERISTIC /begin REF_MEASUREMENT /end REF_MEASUREMENT /end GROUP
/begin GROUP CalRegn01Cmn.LoaMgrIvtrIdptSig1Resp.Val "MICROSAR RTE" /begin SUB_GROUP /end SUB_GROUP /begin FUNCTION_LIST /end FUNCTION_LIST /begin REF_CHARACTERISTIC CalRegn01Cmn.LoaMgrIvtrIdptSig1Resp.Val /end REF_CHARACTERISTIC /begin REF_MEASUREMENT /end REF_MEASUREMENT /end GROUP
/begin GROUP CalRegn01Cmn.LoaMgrIvtrIdptSig2Resp.Val "MICROSAR RTE" /begin SUB_GROUP /end SUB_GROUP /begin FUNCTION_LIST /end FUNCTION_LIST /begin REF_CHARACTERISTIC CalRegn01Cmn.LoaMgrIvtrIdptSig2Resp.Val /end REF_CHARACTERISTIC /begin REF_MEASUREMENT /end REF_MEASUREMENT /end GROUP
/begin GROUP CalRegn01Cmn.LoaMgrIvtrIdptSigFltThd.Val "MICROSAR RTE" /begin SUB_GROUP /end SUB_GROUP /begin FUNCTION_LIST /end FUNCTION_LIST /begin REF_CHARACTERISTIC CalRegn01Cmn.LoaMgrIvtrIdptSigFltThd.Val /end REF_CHARACTERISTIC /begin REF_MEASUREMENT /end REF_MEASUREMENT /end GROUP
/begin GROUP CalRegn01Cmn.LoaMgrIvtrMtgtnScaZeroEna.Logl "MICROSAR RTE" /begin SUB_GROUP /end SUB_GROUP /begin FUNCTION_LIST /end FUNCTION_LIST /begin REF_CHARACTERISTIC CalRegn01Cmn.LoaMgrIvtrMtgtnScaZeroEna.Logl /end REF_CHARACTERISTIC /begin REF_MEASUREMENT /end REF_MEASUREMENT /end GROUP
/begin GROUP CalRegn01Cmn.LoaMgrMotAgAvlSnsrlsResp.Val "MICROSAR RTE" /begin SUB_GROUP /end SUB_GROUP /begin FUNCTION_LIST /end FUNCTION_LIST /begin REF_CHARACTERISTIC CalRegn01Cmn.LoaMgrMotAgAvlSnsrlsResp.Val /end REF_CHARACTERISTIC /begin REF_MEASUREMENT /end REF_MEASUREMENT /end GROUP
/begin GROUP CalRegn01Cmn.LoaMgrMotAgIdptSig0NoSnsrlsResp.Val "MICROSAR RTE" /begin SUB_GROUP /end SUB_GROUP /begin FUNCTION_LIST /end FUNCTION_LIST /begin REF_CHARACTERISTIC CalRegn01Cmn.LoaMgrMotAgIdptSig0NoSnsrlsResp.Val /end REF_CHARACTERISTIC /begin REF_MEASUREMENT /end REF_MEASUREMENT /end GROUP
/begin GROUP CalRegn01Cmn.LoaMgrMotAgIdptSig1NoSnsrlsResp.Val "MICROSAR RTE" /begin SUB_GROUP /end SUB_GROUP /begin FUNCTION_LIST /end FUNCTION_LIST /begin REF_CHARACTERISTIC CalRegn01Cmn.LoaMgrMotAgIdptSig1NoSnsrlsResp.Val /end REF_CHARACTERISTIC /begin REF_MEASUREMENT /end REF_MEASUREMENT /end GROUP
/begin GROUP CalRegn01Cmn.LoaMgrMotAgIdptSig2Resp.Val "MICROSAR RTE" /begin SUB_GROUP /end SUB_GROUP /begin FUNCTION_LIST /end FUNCTION_LIST /begin REF_CHARACTERISTIC CalRegn01Cmn.LoaMgrMotAgIdptSig2Resp.Val /end REF_CHARACTERISTIC /begin REF_MEASUREMENT /end REF_MEASUREMENT /end GROUP
/begin GROUP CalRegn01Cmn.LoaMgrMotAgIdptSig3Resp.Val "MICROSAR RTE" /begin SUB_GROUP /end SUB_GROUP /begin FUNCTION_LIST /end FUNCTION_LIST /begin REF_CHARACTERISTIC CalRegn01Cmn.LoaMgrMotAgIdptSig3Resp.Val /end REF_CHARACTERISTIC /begin REF_MEASUREMENT /end REF_MEASUREMENT /end GROUP
/begin GROUP CalRegn01Cmn.LoaMgrMotAgIdptSigFltThd.Val "MICROSAR RTE" /begin SUB_GROUP /end SUB_GROUP /begin FUNCTION_LIST /end FUNCTION_LIST /begin REF_CHARACTERISTIC CalRegn01Cmn.LoaMgrMotAgIdptSigFltThd.Val /end REF_CHARACTERISTIC /begin REF_MEASUREMENT /end REF_MEASUREMENT /end GROUP
/begin GROUP CalRegn01Cmn.LoaMgrMotAgMtgtnScaZeroEna.Logl "MICROSAR RTE" /begin SUB_GROUP /end SUB_GROUP /begin FUNCTION_LIST /end FUNCTION_LIST /begin REF_CHARACTERISTIC CalRegn01Cmn.LoaMgrMotAgMtgtnScaZeroEna.Logl /end REF_CHARACTERISTIC /begin REF_MEASUREMENT /end REF_MEASUREMENT /end GROUP
/begin GROUP CalRegn01Cmn.MotAg2MeasOffs.Val "MICROSAR RTE" /begin SUB_GROUP /end SUB_GROUP /begin FUNCTION_LIST /end FUNCTION_LIST /begin REF_CHARACTERISTIC CalRegn01Cmn.MotAg2MeasOffs.Val /end REF_CHARACTERISTIC /begin REF_MEASUREMENT /end REF_MEASUREMENT /end GROUP
/begin GROUP CalRegn01Cmn.MotAg5MeasAmpSqdMaxThd.Val "MICROSAR RTE" /begin SUB_GROUP /end SUB_GROUP /begin FUNCTION_LIST /end FUNCTION_LIST /begin REF_CHARACTERISTIC CalRegn01Cmn.MotAg5MeasAmpSqdMaxThd.Val /end REF_CHARACTERISTIC /begin REF_MEASUREMENT /end REF_MEASUREMENT /end GROUP
/begin GROUP CalRegn01Cmn.MotAg5MeasAmpSqdMinThd.Val "MICROSAR RTE" /begin SUB_GROUP /end SUB_GROUP /begin FUNCTION_LIST /end FUNCTION_LIST /begin REF_CHARACTERISTIC CalRegn01Cmn.MotAg5MeasAmpSqdMinThd.Val /end REF_CHARACTERISTIC /begin REF_MEASUREMENT /end REF_MEASUREMENT /end GROUP
/begin GROUP CalRegn01Cmn.MotAg5MeasLpFilFrq.Val "MICROSAR RTE" /begin SUB_GROUP /end SUB_GROUP /begin FUNCTION_LIST /end FUNCTION_LIST /begin REF_CHARACTERISTIC CalRegn01Cmn.MotAg5MeasLpFilFrq.Val /end REF_CHARACTERISTIC /begin REF_MEASUREMENT /end REF_MEASUREMENT /end GROUP
/begin GROUP CalRegn01Cmn.MotAg5MeasOffs.Val "MICROSAR RTE" /begin SUB_GROUP /end SUB_GROUP /begin FUNCTION_LIST /end FUNCTION_LIST /begin REF_CHARACTERISTIC CalRegn01Cmn.MotAg5MeasOffs.Val /end REF_CHARACTERISTIC /begin REF_MEASUREMENT /end REF_MEASUREMENT /end GROUP
/begin GROUP CalRegn01Cmn.MotAg5MeasRtAmpRecprLim.Val "MICROSAR RTE" /begin SUB_GROUP /end SUB_GROUP /begin FUNCTION_LIST /end FUNCTION_LIST /begin REF_CHARACTERISTIC CalRegn01Cmn.MotAg5MeasRtAmpRecprLim.Val /end REF_CHARACTERISTIC /begin REF_MEASUREMENT /end REF_MEASUREMENT /end GROUP
/begin GROUP CalRegn01Cmn.MotAg5MeasRtFilEnaThd.Val "MICROSAR RTE" /begin SUB_GROUP /end SUB_GROUP /begin FUNCTION_LIST /end FUNCTION_LIST /begin REF_CHARACTERISTIC CalRegn01Cmn.MotAg5MeasRtFilEnaThd.Val /end REF_CHARACTERISTIC /begin REF_MEASUREMENT /end REF_MEASUREMENT /end GROUP
/begin GROUP CalRegn01Cmn.MotAg5MeasRtMotVelFilEnaThd.Val "MICROSAR RTE" /begin SUB_GROUP /end SUB_GROUP /begin FUNCTION_LIST /end FUNCTION_LIST /begin REF_CHARACTERISTIC CalRegn01Cmn.MotAg5MeasRtMotVelFilEnaThd.Val /end REF_CHARACTERISTIC /begin REF_MEASUREMENT /end REF_MEASUREMENT /end GROUP
/begin GROUP CalRegn01Cmn.MotAg5MeasRtOffsLim.Val "MICROSAR RTE" /begin SUB_GROUP /end SUB_GROUP /begin FUNCTION_LIST /end FUNCTION_LIST /begin REF_CHARACTERISTIC CalRegn01Cmn.MotAg5MeasRtOffsLim.Val /end REF_CHARACTERISTIC /begin REF_MEASUREMENT /end REF_MEASUREMENT /end GROUP
/begin GROUP CalRegn01Cmn.MotAg5MeasRtToNomRatLim.Val "MICROSAR RTE" /begin SUB_GROUP /end SUB_GROUP /begin FUNCTION_LIST /end FUNCTION_LIST /begin REF_CHARACTERISTIC CalRegn01Cmn.MotAg5MeasRtToNomRatLim.Val /end REF_CHARACTERISTIC /begin REF_MEASUREMENT /end REF_MEASUREMENT /end GROUP
/begin GROUP CalRegn01Cmn.MotAg6MeasAmpSqdMaxThd.Val "MICROSAR RTE" /begin SUB_GROUP /end SUB_GROUP /begin FUNCTION_LIST /end FUNCTION_LIST /begin REF_CHARACTERISTIC CalRegn01Cmn.MotAg6MeasAmpSqdMaxThd.Val /end REF_CHARACTERISTIC /begin REF_MEASUREMENT /end REF_MEASUREMENT /end GROUP
/begin GROUP CalRegn01Cmn.MotAg6MeasAmpSqdMinThd.Val "MICROSAR RTE" /begin SUB_GROUP /end SUB_GROUP /begin FUNCTION_LIST /end FUNCTION_LIST /begin REF_CHARACTERISTIC CalRegn01Cmn.MotAg6MeasAmpSqdMinThd.Val /end REF_CHARACTERISTIC /begin REF_MEASUREMENT /end REF_MEASUREMENT /end GROUP
/begin GROUP CalRegn01Cmn.MotAg6MeasLpFilFrq.Val "MICROSAR RTE" /begin SUB_GROUP /end SUB_GROUP /begin FUNCTION_LIST /end FUNCTION_LIST /begin REF_CHARACTERISTIC CalRegn01Cmn.MotAg6MeasLpFilFrq.Val /end REF_CHARACTERISTIC /begin REF_MEASUREMENT /end REF_MEASUREMENT /end GROUP
/begin GROUP CalRegn01Cmn.MotAg6MeasOffs.Val "MICROSAR RTE" /begin SUB_GROUP /end SUB_GROUP /begin FUNCTION_LIST /end FUNCTION_LIST /begin REF_CHARACTERISTIC CalRegn01Cmn.MotAg6MeasOffs.Val /end REF_CHARACTERISTIC /begin REF_MEASUREMENT /end REF_MEASUREMENT /end GROUP
/begin GROUP CalRegn01Cmn.MotAg6MeasRtAmpRecprLim.Val "MICROSAR RTE" /begin SUB_GROUP /end SUB_GROUP /begin FUNCTION_LIST /end FUNCTION_LIST /begin REF_CHARACTERISTIC CalRegn01Cmn.MotAg6MeasRtAmpRecprLim.Val /end REF_CHARACTERISTIC /begin REF_MEASUREMENT /end REF_MEASUREMENT /end GROUP
/begin GROUP CalRegn01Cmn.MotAg6MeasRtFilEnaThd.Val "MICROSAR RTE" /begin SUB_GROUP /end SUB_GROUP /begin FUNCTION_LIST /end FUNCTION_LIST /begin REF_CHARACTERISTIC CalRegn01Cmn.MotAg6MeasRtFilEnaThd.Val /end REF_CHARACTERISTIC /begin REF_MEASUREMENT /end REF_MEASUREMENT /end GROUP
/begin GROUP CalRegn01Cmn.MotAg6MeasRtMotVelFilEnaThd.Val "MICROSAR RTE" /begin SUB_GROUP /end SUB_GROUP /begin FUNCTION_LIST /end FUNCTION_LIST /begin REF_CHARACTERISTIC CalRegn01Cmn.MotAg6MeasRtMotVelFilEnaThd.Val /end REF_CHARACTERISTIC /begin REF_MEASUREMENT /end REF_MEASUREMENT /end GROUP
/begin GROUP CalRegn01Cmn.MotAg6MeasRtOffsLim.Val "MICROSAR RTE" /begin SUB_GROUP /end SUB_GROUP /begin FUNCTION_LIST /end FUNCTION_LIST /begin REF_CHARACTERISTIC CalRegn01Cmn.MotAg6MeasRtOffsLim.Val /end REF_CHARACTERISTIC /begin REF_MEASUREMENT /end REF_MEASUREMENT /end GROUP
/begin GROUP CalRegn01Cmn.MotAg6MeasRtToNomRatLim.Val "MICROSAR RTE" /begin SUB_GROUP /end SUB_GROUP /begin FUNCTION_LIST /end FUNCTION_LIST /begin REF_CHARACTERISTIC CalRegn01Cmn.MotAg6MeasRtToNomRatLim.Val /end REF_CHARACTERISTIC /begin REF_MEASUREMENT /end REF_MEASUREMENT /end GROUP
/begin GROUP CalRegn01Cmn.MotAgSwCalVehSpdThd.Val "MICROSAR RTE" /begin SUB_GROUP /end SUB_GROUP /begin FUNCTION_LIST /end FUNCTION_LIST /begin REF_CHARACTERISTIC CalRegn01Cmn.MotAgSwCalVehSpdThd.Val /end REF_CHARACTERISTIC /begin REF_MEASUREMENT /end REF_MEASUREMENT /end GROUP
/begin GROUP CalRegn01Cmn.MotCtrlPrmEstimnFetRNom.Val "MICROSAR RTE" /begin SUB_GROUP /end SUB_GROUP /begin FUNCTION_LIST /end FUNCTION_LIST /begin REF_CHARACTERISTIC CalRegn01Cmn.MotCtrlPrmEstimnFetRNom.Val /end REF_CHARACTERISTIC /begin REF_MEASUREMENT /end REF_MEASUREMENT /end GROUP
/begin GROUP CalRegn01Cmn.MotCtrlPrmEstimnFetThermCoeff.Val "MICROSAR RTE" /begin SUB_GROUP /end SUB_GROUP /begin FUNCTION_LIST /end FUNCTION_LIST /begin REF_CHARACTERISTIC CalRegn01Cmn.MotCtrlPrmEstimnFetThermCoeff.Val /end REF_CHARACTERISTIC /begin REF_MEASUREMENT /end REF_MEASUREMENT /end GROUP
/begin GROUP CalRegn01Cmn.MotCtrlPrmEstimnMagThermCoeff.Val "MICROSAR RTE" /begin SUB_GROUP /end SUB_GROUP /begin FUNCTION_LIST /end FUNCTION_LIST /begin REF_CHARACTERISTIC CalRegn01Cmn.MotCtrlPrmEstimnMagThermCoeff.Val /end REF_CHARACTERISTIC /begin REF_MEASUREMENT /end REF_MEASUREMENT /end GROUP
/begin GROUP CalRegn01Cmn.MotCtrlPrmEstimnMotBackEmfConHiLim.Val "MICROSAR RTE" /begin SUB_GROUP /end SUB_GROUP /begin FUNCTION_LIST /end FUNCTION_LIST /begin REF_CHARACTERISTIC CalRegn01Cmn.MotCtrlPrmEstimnMotBackEmfConHiLim.Val /end REF_CHARACTERISTIC /begin REF_MEASUREMENT /end REF_MEASUREMENT /end GROUP
/begin GROUP CalRegn01Cmn.MotCtrlPrmEstimnMotBackEmfConLoLim.Val "MICROSAR RTE" /begin SUB_GROUP /end SUB_GROUP /begin FUNCTION_LIST /end FUNCTION_LIST /begin REF_CHARACTERISTIC CalRegn01Cmn.MotCtrlPrmEstimnMotBackEmfConLoLim.Val /end REF_CHARACTERISTIC /begin REF_MEASUREMENT /end REF_MEASUREMENT /end GROUP
/begin GROUP CalRegn01Cmn.MotCtrlPrmEstimnMotBackEmfConNom.Val "MICROSAR RTE" /begin SUB_GROUP /end SUB_GROUP /begin FUNCTION_LIST /end FUNCTION_LIST /begin REF_CHARACTERISTIC CalRegn01Cmn.MotCtrlPrmEstimnMotBackEmfConNom.Val /end REF_CHARACTERISTIC /begin REF_MEASUREMENT /end REF_MEASUREMENT /end GROUP
/begin GROUP CalRegn01Cmn.MotCtrlPrmEstimnMotBackEmfConSatnScaIvtrLoaMtgtn.Val "MICROSAR RTE" /begin SUB_GROUP /end SUB_GROUP /begin FUNCTION_LIST /end FUNCTION_LIST
 /begin REF_CHARACTERISTIC CalRegn01Cmn.MotCtrlPrmEstimnMotBackEmfConSatnScaIvtrLoaMtgtn.Val /end REF_CHARACTERISTIC
 /begin REF_MEASUREMENT /end REF_MEASUREMENT
/end GROUP
/begin GROUP CalRegn01Cmn.MotCtrlPrmEstimnMotBackEmfConSatnX.Ary1D "MICROSAR RTE" /begin SUB_GROUP /end SUB_GROUP /begin FUNCTION_LIST /end FUNCTION_LIST /begin REF_CHARACTERISTIC CalRegn01Cmn.MotCtrlPrmEstimnMotBackEmfConSatnX.Ary1D /end REF_CHARACTERISTIC /begin REF_MEASUREMENT /end REF_MEASUREMENT /end GROUP
/begin GROUP CalRegn01Cmn.MotCtrlPrmEstimnMotBackEmfConSatnY.Ary1D "MICROSAR RTE" /begin SUB_GROUP /end SUB_GROUP /begin FUNCTION_LIST /end FUNCTION_LIST /begin REF_CHARACTERISTIC CalRegn01Cmn.MotCtrlPrmEstimnMotBackEmfConSatnY.Ary1D /end REF_CHARACTERISTIC /begin REF_MEASUREMENT /end REF_MEASUREMENT /end GROUP
/begin GROUP CalRegn01Cmn.MotCtrlPrmEstimnMotCurrDaxInduSatnBilnrSeln.Ary1D "MICROSAR RTE" /begin SUB_GROUP /end SUB_GROUP /begin FUNCTION_LIST /end FUNCTION_LIST
 /begin REF_CHARACTERISTIC CalRegn01Cmn.MotCtrlPrmEstimnMotCurrDaxInduSatnBilnrSeln.Ary1D /end REF_CHARACTERISTIC
 /begin REF_MEASUREMENT /end REF_MEASUREMENT
/end GROUP
/begin GROUP CalRegn01Cmn.MotCtrlPrmEstimnMotCurrQaxInduSatnX.Ary1D "MICROSAR RTE" /begin SUB_GROUP /end SUB_GROUP /begin FUNCTION_LIST /end FUNCTION_LIST /begin REF_CHARACTERISTIC CalRegn01Cmn.MotCtrlPrmEstimnMotCurrQaxInduSatnX.Ary1D /end REF_CHARACTERISTIC /begin REF_MEASUREMENT /end REF_MEASUREMENT /end GROUP
/begin GROUP CalRegn01Cmn.MotCtrlPrmEstimnMotInduDaxHiLim.Val "MICROSAR RTE" /begin SUB_GROUP /end SUB_GROUP /begin FUNCTION_LIST /end FUNCTION_LIST /begin REF_CHARACTERISTIC CalRegn01Cmn.MotCtrlPrmEstimnMotInduDaxHiLim.Val /end REF_CHARACTERISTIC /begin REF_MEASUREMENT /end REF_MEASUREMENT /end GROUP
/begin GROUP CalRegn01Cmn.MotCtrlPrmEstimnMotInduDaxIvtrLoaMtgtn.Val "MICROSAR RTE" /begin SUB_GROUP /end SUB_GROUP /begin FUNCTION_LIST /end FUNCTION_LIST /begin REF_CHARACTERISTIC CalRegn01Cmn.MotCtrlPrmEstimnMotInduDaxIvtrLoaMtgtn.Val /end REF_CHARACTERISTIC /begin REF_MEASUREMENT /end REF_MEASUREMENT /end GROUP
/begin GROUP CalRegn01Cmn.MotCtrlPrmEstimnMotInduDaxLoLim.Val "MICROSAR RTE" /begin SUB_GROUP /end SUB_GROUP /begin FUNCTION_LIST /end FUNCTION_LIST /begin REF_CHARACTERISTIC CalRegn01Cmn.MotCtrlPrmEstimnMotInduDaxLoLim.Val /end REF_CHARACTERISTIC /begin REF_MEASUREMENT /end REF_MEASUREMENT /end GROUP
/begin GROUP CalRegn01Cmn.MotCtrlPrmEstimnMotInduDaxNom.Val "MICROSAR RTE" /begin SUB_GROUP /end SUB_GROUP /begin FUNCTION_LIST /end FUNCTION_LIST /begin REF_CHARACTERISTIC CalRegn01Cmn.MotCtrlPrmEstimnMotInduDaxNom.Val /end REF_CHARACTERISTIC /begin REF_MEASUREMENT /end REF_MEASUREMENT /end GROUP
/begin GROUP CalRegn01Cmn.MotCtrlPrmEstimnMotInduDaxSatnScaY.Ary2D "MICROSAR RTE" /begin SUB_GROUP /end SUB_GROUP /begin FUNCTION_LIST /end FUNCTION_LIST /begin REF_CHARACTERISTIC CalRegn01Cmn.MotCtrlPrmEstimnMotInduDaxSatnScaY.Ary2D /end REF_CHARACTERISTIC /begin REF_MEASUREMENT /end REF_MEASUREMENT /end GROUP
/begin GROUP CalRegn01Cmn.MotCtrlPrmEstimnMotInduQaxHiLim.Val "MICROSAR RTE" /begin SUB_GROUP /end SUB_GROUP /begin FUNCTION_LIST /end FUNCTION_LIST /begin REF_CHARACTERISTIC CalRegn01Cmn.MotCtrlPrmEstimnMotInduQaxHiLim.Val /end REF_CHARACTERISTIC /begin REF_MEASUREMENT /end REF_MEASUREMENT /end GROUP
/begin GROUP CalRegn01Cmn.MotCtrlPrmEstimnMotInduQaxIvtrLoaMtgtn.Val "MICROSAR RTE" /begin SUB_GROUP /end SUB_GROUP /begin FUNCTION_LIST /end FUNCTION_LIST /begin REF_CHARACTERISTIC CalRegn01Cmn.MotCtrlPrmEstimnMotInduQaxIvtrLoaMtgtn.Val /end REF_CHARACTERISTIC /begin REF_MEASUREMENT /end REF_MEASUREMENT /end GROUP
/begin GROUP CalRegn01Cmn.MotCtrlPrmEstimnMotInduQaxLoLim.Val "MICROSAR RTE" /begin SUB_GROUP /end SUB_GROUP /begin FUNCTION_LIST /end FUNCTION_LIST /begin REF_CHARACTERISTIC CalRegn01Cmn.MotCtrlPrmEstimnMotInduQaxLoLim.Val /end REF_CHARACTERISTIC /begin REF_MEASUREMENT /end REF_MEASUREMENT /end GROUP
/begin GROUP CalRegn01Cmn.MotCtrlPrmEstimnMotInduQaxNom.Val "MICROSAR RTE" /begin SUB_GROUP /end SUB_GROUP /begin FUNCTION_LIST /end FUNCTION_LIST /begin REF_CHARACTERISTIC CalRegn01Cmn.MotCtrlPrmEstimnMotInduQaxNom.Val /end REF_CHARACTERISTIC /begin REF_MEASUREMENT /end REF_MEASUREMENT /end GROUP
/begin GROUP CalRegn01Cmn.MotCtrlPrmEstimnMotInduQaxSatnScaY.Ary2D "MICROSAR RTE" /begin SUB_GROUP /end SUB_GROUP /begin FUNCTION_LIST /end FUNCTION_LIST /begin REF_CHARACTERISTIC CalRegn01Cmn.MotCtrlPrmEstimnMotInduQaxSatnScaY.Ary2D /end REF_CHARACTERISTIC /begin REF_MEASUREMENT /end REF_MEASUREMENT /end GROUP
/begin GROUP CalRegn01Cmn.MotCtrlPrmEstimnMotRHiLim.Val "MICROSAR RTE" /begin SUB_GROUP /end SUB_GROUP /begin FUNCTION_LIST /end FUNCTION_LIST /begin REF_CHARACTERISTIC CalRegn01Cmn.MotCtrlPrmEstimnMotRHiLim.Val /end REF_CHARACTERISTIC /begin REF_MEASUREMENT /end REF_MEASUREMENT /end GROUP
/begin GROUP CalRegn01Cmn.MotCtrlPrmEstimnMotRLoLim.Val "MICROSAR RTE" /begin SUB_GROUP /end SUB_GROUP /begin FUNCTION_LIST /end FUNCTION_LIST /begin REF_CHARACTERISTIC CalRegn01Cmn.MotCtrlPrmEstimnMotRLoLim.Val /end REF_CHARACTERISTIC /begin REF_MEASUREMENT /end REF_MEASUREMENT /end GROUP
/begin GROUP CalRegn01Cmn.MotCtrlPrmEstimnMotRNom.Val "MICROSAR RTE" /begin SUB_GROUP /end SUB_GROUP /begin FUNCTION_LIST /end FUNCTION_LIST /begin REF_CHARACTERISTIC CalRegn01Cmn.MotCtrlPrmEstimnMotRNom.Val /end REF_CHARACTERISTIC /begin REF_MEASUREMENT /end REF_MEASUREMENT /end GROUP
/begin GROUP CalRegn01Cmn.MotCtrlPrmEstimnMotWidgThermCoeff.Val "MICROSAR RTE" /begin SUB_GROUP /end SUB_GROUP /begin FUNCTION_LIST /end FUNCTION_LIST /begin REF_CHARACTERISTIC CalRegn01Cmn.MotCtrlPrmEstimnMotWidgThermCoeff.Val /end REF_CHARACTERISTIC /begin REF_MEASUREMENT /end REF_MEASUREMENT /end GROUP
/begin GROUP CalRegn01Cmn.MotCtrlPrmEstimnTNom.Val "MICROSAR RTE" /begin SUB_GROUP /end SUB_GROUP /begin FUNCTION_LIST /end FUNCTION_LIST /begin REF_CHARACTERISTIC CalRegn01Cmn.MotCtrlPrmEstimnTNom.Val /end REF_CHARACTERISTIC /begin REF_MEASUREMENT /end REF_MEASUREMENT /end GROUP
/begin GROUP CalRegn01Cmn.MotCurrPeakEstimnCurrFilFrq.Val "MICROSAR RTE" /begin SUB_GROUP /end SUB_GROUP /begin FUNCTION_LIST /end FUNCTION_LIST /begin REF_CHARACTERISTIC CalRegn01Cmn.MotCurrPeakEstimnCurrFilFrq.Val /end REF_CHARACTERISTIC /begin REF_MEASUREMENT /end REF_MEASUREMENT /end GROUP
/begin GROUP CalRegn01Cmn.MotCurrPeakEstimnCurrPeakEstimdFilFrq.Val "MICROSAR RTE" /begin SUB_GROUP /end SUB_GROUP /begin FUNCTION_LIST /end FUNCTION_LIST /begin REF_CHARACTERISTIC CalRegn01Cmn.MotCurrPeakEstimnCurrPeakEstimdFilFrq.Val /end REF_CHARACTERISTIC /begin REF_MEASUREMENT /end REF_MEASUREMENT /end GROUP
/begin GROUP CalRegn01Cmn.MotCurrRegCfgCtrlrDynGainVehSpdCutOff.Val "MICROSAR RTE" /begin SUB_GROUP /end SUB_GROUP /begin FUNCTION_LIST /end FUNCTION_LIST /begin REF_CHARACTERISTIC CalRegn01Cmn.MotCurrRegCfgCtrlrDynGainVehSpdCutOff.Val /end REF_CHARACTERISTIC /begin REF_MEASUREMENT /end REF_MEASUREMENT /end GROUP
/begin GROUP CalRegn01Cmn.MotCurrRegCfgCurrLoopSecOrderTrfFctEna.Logl "MICROSAR RTE" /begin SUB_GROUP /end SUB_GROUP /begin FUNCTION_LIST /end FUNCTION_LIST /begin REF_CHARACTERISTIC CalRegn01Cmn.MotCurrRegCfgCurrLoopSecOrderTrfFctEna.Logl /end REF_CHARACTERISTIC /begin REF_MEASUREMENT /end REF_MEASUREMENT /end GROUP
/begin GROUP CalRegn01Cmn.MotCurrRegCfgIntglGainSampleTi.Val "MICROSAR RTE" /begin SUB_GROUP /end SUB_GROUP /begin FUNCTION_LIST /end FUNCTION_LIST /begin REF_CHARACTERISTIC CalRegn01Cmn.MotCurrRegCfgIntglGainSampleTi.Val /end REF_CHARACTERISTIC /begin REF_MEASUREMENT /end REF_MEASUREMENT /end GROUP
/begin GROUP CalRegn01Cmn.MotCurrRegCfgMotAgCompuDly.Val "MICROSAR RTE" /begin SUB_GROUP /end SUB_GROUP /begin FUNCTION_LIST /end FUNCTION_LIST /begin REF_CHARACTERISTIC CalRegn01Cmn.MotCurrRegCfgMotAgCompuDly.Val /end REF_CHARACTERISTIC /begin REF_MEASUREMENT /end REF_MEASUREMENT /end GROUP
/begin GROUP CalRegn01Cmn.MotCurrRegCfgMotClsdLoopBwDaxY.Ary1D "MICROSAR RTE" /begin SUB_GROUP /end SUB_GROUP /begin FUNCTION_LIST /end FUNCTION_LIST /begin REF_CHARACTERISTIC CalRegn01Cmn.MotCurrRegCfgMotClsdLoopBwDaxY.Ary1D /end REF_CHARACTERISTIC /begin REF_MEASUREMENT /end REF_MEASUREMENT /end GROUP
/begin GROUP CalRegn01Cmn.MotCurrRegCfgMotClsdLoopBwQaxY.Ary1D "MICROSAR RTE" /begin SUB_GROUP /end SUB_GROUP /begin FUNCTION_LIST /end FUNCTION_LIST /begin REF_CHARACTERISTIC CalRegn01Cmn.MotCurrRegCfgMotClsdLoopBwQaxY.Ary1D /end REF_CHARACTERISTIC /begin REF_MEASUREMENT /end REF_MEASUREMENT /end GROUP
/begin GROUP CalRegn01Cmn.MotCurrRegCfgMotCtrlPrmSelnX.Ary1D "MICROSAR RTE" /begin SUB_GROUP /end SUB_GROUP /begin FUNCTION_LIST /end FUNCTION_LIST /begin REF_CHARACTERISTIC CalRegn01Cmn.MotCurrRegCfgMotCtrlPrmSelnX.Ary1D /end REF_CHARACTERISTIC /begin REF_MEASUREMENT /end REF_MEASUREMENT /end GROUP
/begin GROUP CalRegn01Cmn.MotCurrRegCfgMotDampgRatDax.Val "MICROSAR RTE" /begin SUB_GROUP /end SUB_GROUP /begin FUNCTION_LIST /end FUNCTION_LIST /begin REF_CHARACTERISTIC CalRegn01Cmn.MotCurrRegCfgMotDampgRatDax.Val /end REF_CHARACTERISTIC /begin REF_MEASUREMENT /end REF_MEASUREMENT /end GROUP
/begin GROUP CalRegn01Cmn.MotCurrRegCfgMotDampgRatQax.Val "MICROSAR RTE" /begin SUB_GROUP /end SUB_GROUP /begin FUNCTION_LIST /end FUNCTION_LIST /begin REF_CHARACTERISTIC CalRegn01Cmn.MotCurrRegCfgMotDampgRatQax.Val /end REF_CHARACTERISTIC /begin REF_MEASUREMENT /end REF_MEASUREMENT /end GROUP
/begin GROUP CalRegn01Cmn.MotCurrRegCfgMotNatFrqDaxY.Ary1D "MICROSAR RTE" /begin SUB_GROUP /end SUB_GROUP /begin FUNCTION_LIST /end FUNCTION_LIST /begin REF_CHARACTERISTIC CalRegn01Cmn.MotCurrRegCfgMotNatFrqDaxY.Ary1D /end REF_CHARACTERISTIC /begin REF_MEASUREMENT /end REF_MEASUREMENT /end GROUP
/begin GROUP CalRegn01Cmn.MotCurrRegCfgMotNatFrqQaxY.Ary1D "MICROSAR RTE" /begin SUB_GROUP /end SUB_GROUP /begin FUNCTION_LIST /end FUNCTION_LIST /begin REF_CHARACTERISTIC CalRegn01Cmn.MotCurrRegCfgMotNatFrqQaxY.Ary1D /end REF_CHARACTERISTIC /begin REF_MEASUREMENT /end REF_MEASUREMENT /end GROUP
/begin GROUP CalRegn01Cmn.MotCurrRegCfgMotRVirtDax.Val "MICROSAR RTE" /begin SUB_GROUP /end SUB_GROUP /begin FUNCTION_LIST /end FUNCTION_LIST /begin REF_CHARACTERISTIC CalRegn01Cmn.MotCurrRegCfgMotRVirtDax.Val /end REF_CHARACTERISTIC /begin REF_MEASUREMENT /end REF_MEASUREMENT /end GROUP
/begin GROUP CalRegn01Cmn.MotCurrRegCfgMotRVirtQax.Val "MICROSAR RTE" /begin SUB_GROUP /end SUB_GROUP /begin FUNCTION_LIST /end FUNCTION_LIST /begin REF_CHARACTERISTIC CalRegn01Cmn.MotCurrRegCfgMotRVirtQax.Val /end REF_CHARACTERISTIC /begin REF_MEASUREMENT /end REF_MEASUREMENT /end GROUP
/begin GROUP CalRegn01Cmn.MotCurrRegCfgMotVelFilFrq.Val "MICROSAR RTE" /begin SUB_GROUP /end SUB_GROUP /begin FUNCTION_LIST /end FUNCTION_LIST /begin REF_CHARACTERISTIC CalRegn01Cmn.MotCurrRegCfgMotVelFilFrq.Val /end REF_CHARACTERISTIC /begin REF_MEASUREMENT /end REF_MEASUREMENT /end GROUP
/begin GROUP CalRegn01Cmn.MotCurrRegVltgLimrCurrLoaScarSlewRate.Val "MICROSAR RTE" /begin SUB_GROUP /end SUB_GROUP /begin FUNCTION_LIST /end FUNCTION_LIST /begin REF_CHARACTERISTIC CalRegn01Cmn.MotCurrRegVltgLimrCurrLoaScarSlewRate.Val /end REF_CHARACTERISTIC /begin REF_MEASUREMENT /end REF_MEASUREMENT /end GROUP
/begin GROUP CalRegn01Cmn.MotCurrRegVltgLimrDaxAntiWdupCoeff.Val "MICROSAR RTE" /begin SUB_GROUP /end SUB_GROUP /begin FUNCTION_LIST /end FUNCTION_LIST /begin REF_CHARACTERISTIC CalRegn01Cmn.MotCurrRegVltgLimrDaxAntiWdupCoeff.Val /end REF_CHARACTERISTIC /begin REF_MEASUREMENT /end REF_MEASUREMENT /end GROUP
/begin GROUP CalRegn01Cmn.MotCurrRegVltgLimrDualEcuLoaScarSlewRate.Val "MICROSAR RTE" /begin SUB_GROUP /end SUB_GROUP /begin FUNCTION_LIST /end FUNCTION_LIST /begin REF_CHARACTERISTIC CalRegn01Cmn.MotCurrRegVltgLimrDualEcuLoaScarSlewRate.Val /end REF_CHARACTERISTIC /begin REF_MEASUREMENT /end REF_MEASUREMENT /end GROUP
/begin GROUP CalRegn01Cmn.MotCurrRegVltgLimrFETLoaScarSlewRate.Val "MICROSAR RTE" /begin SUB_GROUP /end SUB_GROUP /begin FUNCTION_LIST /end FUNCTION_LIST /begin REF_CHARACTERISTIC CalRegn01Cmn.MotCurrRegVltgLimrFETLoaScarSlewRate.Val /end REF_CHARACTERISTIC /begin REF_MEASUREMENT /end REF_MEASUREMENT /end GROUP
/begin GROUP CalRegn01Cmn.MotCurrRegVltgLimrIvtrLoaScarSlewRate.Val "MICROSAR RTE" /begin SUB_GROUP /end SUB_GROUP /begin FUNCTION_LIST /end FUNCTION_LIST /begin REF_CHARACTERISTIC CalRegn01Cmn.MotCurrRegVltgLimrIvtrLoaScarSlewRate.Val /end REF_CHARACTERISTIC /begin REF_MEASUREMENT /end REF_MEASUREMENT /end GROUP
/begin GROUP CalRegn01Cmn.MotCurrRegVltgLimrMotCurrPredEna.Logl "MICROSAR RTE" /begin SUB_GROUP /end SUB_GROUP /begin FUNCTION_LIST /end FUNCTION_LIST /begin REF_CHARACTERISTIC CalRegn01Cmn.MotCurrRegVltgLimrMotCurrPredEna.Logl /end REF_CHARACTERISTIC /begin REF_MEASUREMENT /end REF_MEASUREMENT /end GROUP
/begin GROUP CalRegn01Cmn.MotCurrRegVltgLimrMotCurrPredTi.Val "MICROSAR RTE" /begin SUB_GROUP /end SUB_GROUP /begin FUNCTION_LIST /end FUNCTION_LIST /begin REF_CHARACTERISTIC CalRegn01Cmn.MotCurrRegVltgLimrMotCurrPredTi.Val /end REF_CHARACTERISTIC /begin REF_MEASUREMENT /end REF_MEASUREMENT /end GROUP
/begin GROUP CalRegn01Cmn.MotCurrRegVltgLimrMotCurrQaxRefMdfnRplEna.Logl "MICROSAR RTE" /begin SUB_GROUP /end SUB_GROUP /begin FUNCTION_LIST /end FUNCTION_LIST
 /begin REF_CHARACTERISTIC CalRegn01Cmn.MotCurrRegVltgLimrMotCurrQaxRefMdfnRplEna.Logl /end REF_CHARACTERISTIC
 /begin REF_MEASUREMENT /end REF_MEASUREMENT
/end GROUP
/begin GROUP CalRegn01Cmn.MotCurrRegVltgLimrMotVltgBrdgFilEna.Logl "MICROSAR RTE" /begin SUB_GROUP /end SUB_GROUP /begin FUNCTION_LIST /end FUNCTION_LIST /begin REF_CHARACTERISTIC CalRegn01Cmn.MotCurrRegVltgLimrMotVltgBrdgFilEna.Logl /end REF_CHARACTERISTIC /begin REF_MEASUREMENT /end REF_MEASUREMENT /end GROUP
/begin GROUP CalRegn01Cmn.MotCurrRegVltgLimrMotVltgBrdgLpFilFrq.Val "MICROSAR RTE" /begin SUB_GROUP /end SUB_GROUP /begin FUNCTION_LIST /end FUNCTION_LIST /begin REF_CHARACTERISTIC CalRegn01Cmn.MotCurrRegVltgLimrMotVltgBrdgLpFilFrq.Val /end REF_CHARACTERISTIC /begin REF_MEASUREMENT /end REF_MEASUREMENT /end GROUP
/begin GROUP CalRegn01Cmn.MotCurrRegVltgLimrMotVltgDaxIntglHiLim.Val "MICROSAR RTE" /begin SUB_GROUP /end SUB_GROUP /begin FUNCTION_LIST /end FUNCTION_LIST /begin REF_CHARACTERISTIC CalRegn01Cmn.MotCurrRegVltgLimrMotVltgDaxIntglHiLim.Val /end REF_CHARACTERISTIC /begin REF_MEASUREMENT /end REF_MEASUREMENT /end GROUP
/begin GROUP CalRegn01Cmn.MotCurrRegVltgLimrMotVltgDaxIntglLoLim.Val "MICROSAR RTE" /begin SUB_GROUP /end SUB_GROUP /begin FUNCTION_LIST /end FUNCTION_LIST /begin REF_CHARACTERISTIC CalRegn01Cmn.MotCurrRegVltgLimrMotVltgDaxIntglLoLim.Val /end REF_CHARACTERISTIC /begin REF_MEASUREMENT /end REF_MEASUREMENT /end GROUP
/begin GROUP CalRegn01Cmn.MotCurrRegVltgLimrMotVltgQaxFfFilEna.Logl "MICROSAR RTE" /begin SUB_GROUP /end SUB_GROUP /begin FUNCTION_LIST /end FUNCTION_LIST /begin REF_CHARACTERISTIC CalRegn01Cmn.MotCurrRegVltgLimrMotVltgQaxFfFilEna.Logl /end REF_CHARACTERISTIC /begin REF_MEASUREMENT /end REF_MEASUREMENT /end GROUP
/begin GROUP CalRegn01Cmn.MotCurrRegVltgLimrMotVltgQaxFfLpFilFrq.Val "MICROSAR RTE" /begin SUB_GROUP /end SUB_GROUP /begin FUNCTION_LIST /end FUNCTION_LIST /begin REF_CHARACTERISTIC CalRegn01Cmn.MotCurrRegVltgLimrMotVltgQaxFfLpFilFrq.Val /end REF_CHARACTERISTIC /begin REF_MEASUREMENT /end REF_MEASUREMENT /end GROUP
/begin GROUP CalRegn01Cmn.MotCurrRegVltgLimrMotVltgQaxIntglHiLim.Val "MICROSAR RTE" /begin SUB_GROUP /end SUB_GROUP /begin FUNCTION_LIST /end FUNCTION_LIST /begin REF_CHARACTERISTIC CalRegn01Cmn.MotCurrRegVltgLimrMotVltgQaxIntglHiLim.Val /end REF_CHARACTERISTIC /begin REF_MEASUREMENT /end REF_MEASUREMENT /end GROUP
/begin GROUP CalRegn01Cmn.MotCurrRegVltgLimrMotVltgQaxIntglLoLim.Val "MICROSAR RTE" /begin SUB_GROUP /end SUB_GROUP /begin FUNCTION_LIST /end FUNCTION_LIST /begin REF_CHARACTERISTIC CalRegn01Cmn.MotCurrRegVltgLimrMotVltgQaxIntglLoLim.Val /end REF_CHARACTERISTIC /begin REF_MEASUREMENT /end REF_MEASUREMENT /end GROUP
/begin GROUP CalRegn01Cmn.MotCurrRegVltgLimrQaxAntiWdupCoeff.Val "MICROSAR RTE" /begin SUB_GROUP /end SUB_GROUP /begin FUNCTION_LIST /end FUNCTION_LIST /begin REF_CHARACTERISTIC CalRegn01Cmn.MotCurrRegVltgLimrQaxAntiWdupCoeff.Val /end REF_CHARACTERISTIC /begin REF_MEASUREMENT /end REF_MEASUREMENT /end GROUP
/begin GROUP CalRegn01Cmn.MotCurrRegVltgLimrQaxAntiWdupScagDi.Logl "MICROSAR RTE" /begin SUB_GROUP /end SUB_GROUP /begin FUNCTION_LIST /end FUNCTION_LIST /begin REF_CHARACTERISTIC CalRegn01Cmn.MotCurrRegVltgLimrQaxAntiWdupScagDi.Logl /end REF_CHARACTERISTIC /begin REF_MEASUREMENT /end REF_MEASUREMENT /end GROUP
/begin GROUP CalRegn01Cmn.MotQuadDetnMotDirHysInsts.Val "MICROSAR RTE" /begin SUB_GROUP /end SUB_GROUP /begin FUNCTION_LIST /end FUNCTION_LIST /begin REF_CHARACTERISTIC CalRegn01Cmn.MotQuadDetnMotDirHysInsts.Val /end REF_CHARACTERISTIC /begin REF_MEASUREMENT /end REF_MEASUREMENT /end GROUP
/begin GROUP CalRegn01Cmn.MotRefMdlCurrDaxBoostGain.Val "MICROSAR RTE" /begin SUB_GROUP /end SUB_GROUP /begin FUNCTION_LIST /end FUNCTION_LIST /begin REF_CHARACTERISTIC CalRegn01Cmn.MotRefMdlCurrDaxBoostGain.Val /end REF_CHARACTERISTIC /begin REF_MEASUREMENT /end REF_MEASUREMENT /end GROUP
/begin GROUP CalRegn01Cmn.MotRefMdlCurrDaxBoostTqScaX.Ary1D "MICROSAR RTE" /begin SUB_GROUP /end SUB_GROUP /begin FUNCTION_LIST /end FUNCTION_LIST /begin REF_CHARACTERISTIC CalRegn01Cmn.MotRefMdlCurrDaxBoostTqScaX.Ary1D /end REF_CHARACTERISTIC /begin REF_MEASUREMENT /end REF_MEASUREMENT /end GROUP
/begin GROUP CalRegn01Cmn.MotRefMdlCurrDaxBoostTqScaY.Ary1D "MICROSAR RTE" /begin SUB_GROUP /end SUB_GROUP /begin FUNCTION_LIST /end FUNCTION_LIST /begin REF_CHARACTERISTIC CalRegn01Cmn.MotRefMdlCurrDaxBoostTqScaY.Ary1D /end REF_CHARACTERISTIC /begin REF_MEASUREMENT /end REF_MEASUREMENT /end GROUP
/begin GROUP CalRegn01Cmn.MotRefMdlCurrDaxQaxRefDelta.Ary1D "MICROSAR RTE" /begin SUB_GROUP /end SUB_GROUP /begin FUNCTION_LIST /end FUNCTION_LIST /begin REF_CHARACTERISTIC CalRegn01Cmn.MotRefMdlCurrDaxQaxRefDelta.Ary1D /end REF_CHARACTERISTIC /begin REF_MEASUREMENT /end REF_MEASUREMENT /end GROUP
/begin GROUP CalRegn01Cmn.MotRefMdlCurrItrnTolr.Val "MICROSAR RTE" /begin SUB_GROUP /end SUB_GROUP /begin FUNCTION_LIST /end FUNCTION_LIST /begin REF_CHARACTERISTIC CalRegn01Cmn.MotRefMdlCurrItrnTolr.Val /end REF_CHARACTERISTIC /begin REF_MEASUREMENT /end REF_MEASUREMENT /end GROUP
/begin GROUP CalRegn01Cmn.MotRefMdlFbCtrlDi.Logl "MICROSAR RTE" /begin SUB_GROUP /end SUB_GROUP /begin FUNCTION_LIST /end FUNCTION_LIST /begin REF_CHARACTERISTIC CalRegn01Cmn.MotRefMdlFbCtrlDi.Logl /end REF_CHARACTERISTIC /begin REF_MEASUREMENT /end REF_MEASUREMENT /end GROUP
/begin GROUP CalRegn01Cmn.MotRefMdlIvtrDeadTiBrdgVltgSca.Val "MICROSAR RTE" /begin SUB_GROUP /end SUB_GROUP /begin FUNCTION_LIST /end FUNCTION_LIST /begin REF_CHARACTERISTIC CalRegn01Cmn.MotRefMdlIvtrDeadTiBrdgVltgSca.Val /end REF_CHARACTERISTIC /begin REF_MEASUREMENT /end REF_MEASUREMENT /end GROUP
/begin GROUP CalRegn01Cmn.MotRefMdlMinCurrItrnLim.Val "MICROSAR RTE" /begin SUB_GROUP /end SUB_GROUP /begin FUNCTION_LIST /end FUNCTION_LIST /begin REF_CHARACTERISTIC CalRegn01Cmn.MotRefMdlMinCurrItrnLim.Val /end REF_CHARACTERISTIC /begin REF_MEASUREMENT /end REF_MEASUREMENT /end GROUP
/begin GROUP CalRegn01Cmn.MotRefMdlMotCurrDaxMaxSca.Val "MICROSAR RTE" /begin SUB_GROUP /end SUB_GROUP /begin FUNCTION_LIST /end FUNCTION_LIST /begin REF_CHARACTERISTIC CalRegn01Cmn.MotRefMdlMotCurrDaxMaxSca.Val /end REF_CHARACTERISTIC /begin REF_MEASUREMENT /end REF_MEASUREMENT /end GROUP
/begin GROUP CalRegn01Cmn.MotRefMdlMotVelLpFilFrq.Val "MICROSAR RTE" /begin SUB_GROUP /end SUB_GROUP /begin FUNCTION_LIST /end FUNCTION_LIST /begin REF_CHARACTERISTIC CalRegn01Cmn.MotRefMdlMotVelLpFilFrq.Val /end REF_CHARACTERISTIC /begin REF_MEASUREMENT /end REF_MEASUREMENT /end GROUP
/begin GROUP CalRegn01Cmn.MotRefMdlMotVltgDerivtvTiCon.Val "MICROSAR RTE" /begin SUB_GROUP /end SUB_GROUP /begin FUNCTION_LIST /end FUNCTION_LIST /begin REF_CHARACTERISTIC CalRegn01Cmn.MotRefMdlMotVltgDerivtvTiCon.Val /end REF_CHARACTERISTIC /begin REF_MEASUREMENT /end REF_MEASUREMENT /end GROUP
/begin GROUP CalRegn01Cmn.MotRefMdlQuad13VltgSdlX.Ary1D "MICROSAR RTE" /begin SUB_GROUP /end SUB_GROUP /begin FUNCTION_LIST /end FUNCTION_LIST /begin REF_CHARACTERISTIC CalRegn01Cmn.MotRefMdlQuad13VltgSdlX.Ary1D /end REF_CHARACTERISTIC /begin REF_MEASUREMENT /end REF_MEASUREMENT /end GROUP
/begin GROUP CalRegn01Cmn.MotRefMdlQuad13VltgSdlY.Ary1D "MICROSAR RTE" /begin SUB_GROUP /end SUB_GROUP /begin FUNCTION_LIST /end FUNCTION_LIST /begin REF_CHARACTERISTIC CalRegn01Cmn.MotRefMdlQuad13VltgSdlY.Ary1D /end REF_CHARACTERISTIC /begin REF_MEASUREMENT /end REF_MEASUREMENT /end GROUP
/begin GROUP CalRegn01Cmn.MotRefMdlQuad24VltgSdlX.Ary1D "MICROSAR RTE" /begin SUB_GROUP /end SUB_GROUP /begin FUNCTION_LIST /end FUNCTION_LIST /begin REF_CHARACTERISTIC CalRegn01Cmn.MotRefMdlQuad24VltgSdlX.Ary1D /end REF_CHARACTERISTIC /begin REF_MEASUREMENT /end REF_MEASUREMENT /end GROUP
/begin GROUP CalRegn01Cmn.MotRefMdlQuad24VltgSdlY.Ary1D "MICROSAR RTE" /begin SUB_GROUP /end SUB_GROUP /begin FUNCTION_LIST /end FUNCTION_LIST /begin REF_CHARACTERISTIC CalRegn01Cmn.MotRefMdlQuad24VltgSdlY.Ary1D /end REF_CHARACTERISTIC /begin REF_MEASUREMENT /end REF_MEASUREMENT /end GROUP
/begin GROUP CalRegn01Cmn.MotRefMdlRefLocnItrnLim.Val "MICROSAR RTE" /begin SUB_GROUP /end SUB_GROUP /begin FUNCTION_LIST /end FUNCTION_LIST /begin REF_CHARACTERISTIC CalRegn01Cmn.MotRefMdlRefLocnItrnLim.Val /end REF_CHARACTERISTIC /begin REF_MEASUREMENT /end REF_MEASUREMENT /end GROUP
/begin GROUP CalRegn01Cmn.MotRefMdlTqItrnLim.Val "MICROSAR RTE" /begin SUB_GROUP /end SUB_GROUP /begin FUNCTION_LIST /end FUNCTION_LIST /begin REF_CHARACTERISTIC CalRegn01Cmn.MotRefMdlTqItrnLim.Val /end REF_CHARACTERISTIC /begin REF_MEASUREMENT /end REF_MEASUREMENT /end GROUP
/begin GROUP CalRegn01Cmn.MotRefMdlTqItrnTolr.Val "MICROSAR RTE" /begin SUB_GROUP /end SUB_GROUP /begin FUNCTION_LIST /end FUNCTION_LIST /begin REF_CHARACTERISTIC CalRegn01Cmn.MotRefMdlTqItrnTolr.Val /end REF_CHARACTERISTIC /begin REF_MEASUREMENT /end REF_MEASUREMENT /end GROUP
/begin GROUP CalRegn01Cmn.MotRefMdlVltgModDynCmpEna.Logl "MICROSAR RTE" /begin SUB_GROUP /end SUB_GROUP /begin FUNCTION_LIST /end FUNCTION_LIST /begin REF_CHARACTERISTIC CalRegn01Cmn.MotRefMdlVltgModDynCmpEna.Logl /end REF_CHARACTERISTIC /begin REF_MEASUREMENT /end REF_MEASUREMENT /end GROUP
/begin GROUP CalRegn01Cmn.MotRefMdlVltgOverRThdSca.Val "MICROSAR RTE" /begin SUB_GROUP /end SUB_GROUP /begin FUNCTION_LIST /end FUNCTION_LIST /begin REF_CHARACTERISTIC CalRegn01Cmn.MotRefMdlVltgOverRThdSca.Val /end REF_CHARACTERISTIC /begin REF_MEASUREMENT /end REF_MEASUREMENT /end GROUP
/begin GROUP CalRegn01Cmn.MotTqTranlDampgVehSpdBlndY.Ary1D "MICROSAR RTE" /begin SUB_GROUP /end SUB_GROUP /begin FUNCTION_LIST /end FUNCTION_LIST /begin REF_CHARACTERISTIC CalRegn01Cmn.MotTqTranlDampgVehSpdBlndY.Ary1D /end REF_CHARACTERISTIC /begin REF_MEASUREMENT /end REF_MEASUREMENT /end GROUP
/begin GROUP CalRegn01Cmn.NxtrCalIdsCal0DevlpAuthor.Ary1D "MICROSAR RTE" /begin SUB_GROUP /end SUB_GROUP /begin FUNCTION_LIST /end FUNCTION_LIST /begin REF_CHARACTERISTIC CalRegn01Cmn.NxtrCalIdsCal0DevlpAuthor.Ary1D /end REF_CHARACTERISTIC /begin REF_MEASUREMENT /end REF_MEASUREMENT /end GROUP
/begin GROUP CalRegn01Cmn.NxtrCalIdsCal0DevlpDesc.Ary1D "MICROSAR RTE" /begin SUB_GROUP /end SUB_GROUP /begin FUNCTION_LIST /end FUNCTION_LIST /begin REF_CHARACTERISTIC CalRegn01Cmn.NxtrCalIdsCal0DevlpDesc.Ary1D /end REF_CHARACTERISTIC /begin REF_MEASUREMENT /end REF_MEASUREMENT /end GROUP
/begin GROUP CalRegn01Cmn.NxtrCalIdsCal0DevlpRelNr.Val "MICROSAR RTE" /begin SUB_GROUP /end SUB_GROUP /begin FUNCTION_LIST /end FUNCTION_LIST /begin REF_CHARACTERISTIC CalRegn01Cmn.NxtrCalIdsCal0DevlpRelNr.Val /end REF_CHARACTERISTIC /begin REF_MEASUREMENT /end REF_MEASUREMENT /end GROUP
/begin GROUP CalRegn01Cmn.NxtrCalIdsCal0DevlpRelSt.Val "MICROSAR RTE" /begin SUB_GROUP /end SUB_GROUP /begin FUNCTION_LIST /end FUNCTION_LIST /begin REF_CHARACTERISTIC CalRegn01Cmn.NxtrCalIdsCal0DevlpRelSt.Val /end REF_CHARACTERISTIC /begin REF_MEASUREMENT /end REF_MEASUREMENT /end GROUP
/begin GROUP CalRegn01Cmn.NxtrCalIdsCal0DevlpTiStamp.Val "MICROSAR RTE" /begin SUB_GROUP /end SUB_GROUP /begin FUNCTION_LIST /end FUNCTION_LIST /begin REF_CHARACTERISTIC CalRegn01Cmn.NxtrCalIdsCal0DevlpTiStamp.Val /end REF_CHARACTERISTIC /begin REF_MEASUREMENT /end REF_MEASUREMENT /end GROUP
/begin GROUP CalRegn01Cmn.NxtrCalIdsCal0DevlpVers.Val "MICROSAR RTE" /begin SUB_GROUP /end SUB_GROUP /begin FUNCTION_LIST /end FUNCTION_LIST /begin REF_CHARACTERISTIC CalRegn01Cmn.NxtrCalIdsCal0DevlpVers.Val /end REF_CHARACTERISTIC /begin REF_MEASUREMENT /end REF_MEASUREMENT /end GROUP
/begin GROUP CalRegn01Cmn.NxtrCalIdsCal2DevlpAuthor.Ary1D "MICROSAR RTE" /begin SUB_GROUP /end SUB_GROUP /begin FUNCTION_LIST /end FUNCTION_LIST /begin REF_CHARACTERISTIC CalRegn01Cmn.NxtrCalIdsCal2DevlpAuthor.Ary1D /end REF_CHARACTERISTIC /begin REF_MEASUREMENT /end REF_MEASUREMENT /end GROUP
/begin GROUP CalRegn01Cmn.NxtrCalIdsCal2DevlpDesc.Ary1D "MICROSAR RTE" /begin SUB_GROUP /end SUB_GROUP /begin FUNCTION_LIST /end FUNCTION_LIST /begin REF_CHARACTERISTIC CalRegn01Cmn.NxtrCalIdsCal2DevlpDesc.Ary1D /end REF_CHARACTERISTIC /begin REF_MEASUREMENT /end REF_MEASUREMENT /end GROUP
/begin GROUP CalRegn01Cmn.NxtrCalIdsCal2DevlpRelNr.Val "MICROSAR RTE" /begin SUB_GROUP /end SUB_GROUP /begin FUNCTION_LIST /end FUNCTION_LIST /begin REF_CHARACTERISTIC CalRegn01Cmn.NxtrCalIdsCal2DevlpRelNr.Val /end REF_CHARACTERISTIC /begin REF_MEASUREMENT /end REF_MEASUREMENT /end GROUP
/begin GROUP CalRegn01Cmn.NxtrCalIdsCal2DevlpRelSt.Val "MICROSAR RTE" /begin SUB_GROUP /end SUB_GROUP /begin FUNCTION_LIST /end FUNCTION_LIST /begin REF_CHARACTERISTIC CalRegn01Cmn.NxtrCalIdsCal2DevlpRelSt.Val /end REF_CHARACTERISTIC /begin REF_MEASUREMENT /end REF_MEASUREMENT /end GROUP
/begin GROUP CalRegn01Cmn.NxtrCalIdsCal2DevlpTiStamp.Val "MICROSAR RTE" /begin SUB_GROUP /end SUB_GROUP /begin FUNCTION_LIST /end FUNCTION_LIST /begin REF_CHARACTERISTIC CalRegn01Cmn.NxtrCalIdsCal2DevlpTiStamp.Val /end REF_CHARACTERISTIC /begin REF_MEASUREMENT /end REF_MEASUREMENT /end GROUP
/begin GROUP CalRegn01Cmn.NxtrCalIdsCal2DevlpVers.Val "MICROSAR RTE" /begin SUB_GROUP /end SUB_GROUP /begin FUNCTION_LIST /end FUNCTION_LIST /begin REF_CHARACTERISTIC CalRegn01Cmn.NxtrCalIdsCal2DevlpVers.Val /end REF_CHARACTERISTIC /begin REF_MEASUREMENT /end REF_MEASUREMENT /end GROUP
/begin GROUP CalRegn01Cmn.PwrLimrAssiRednLpFilFrq.Val "MICROSAR RTE" /begin SUB_GROUP /end SUB_GROUP /begin FUNCTION_LIST /end FUNCTION_LIST /begin REF_CHARACTERISTIC CalRegn01Cmn.PwrLimrAssiRednLpFilFrq.Val /end REF_CHARACTERISTIC /begin REF_MEASUREMENT /end REF_MEASUREMENT /end GROUP
/begin GROUP CalRegn01Cmn.PwrLimrBackEmfConStdT.Val "MICROSAR RTE" /begin SUB_GROUP /end SUB_GROUP /begin FUNCTION_LIST /end FUNCTION_LIST /begin REF_CHARACTERISTIC CalRegn01Cmn.PwrLimrBackEmfConStdT.Val /end REF_CHARACTERISTIC /begin REF_MEASUREMENT /end REF_MEASUREMENT /end GROUP
/begin GROUP CalRegn01Cmn.PwrLimrBrdgVltgAdjSlew.Val "MICROSAR RTE" /begin SUB_GROUP /end SUB_GROUP /begin FUNCTION_LIST /end FUNCTION_LIST /begin REF_CHARACTERISTIC CalRegn01Cmn.PwrLimrBrdgVltgAdjSlew.Val /end REF_CHARACTERISTIC /begin REF_MEASUREMENT /end REF_MEASUREMENT /end GROUP
/begin GROUP CalRegn01Cmn.PwrLimrBrdgVltgAltFltAdj.Val "MICROSAR RTE" /begin SUB_GROUP /end SUB_GROUP /begin FUNCTION_LIST /end FUNCTION_LIST /begin REF_CHARACTERISTIC CalRegn01Cmn.PwrLimrBrdgVltgAltFltAdj.Val /end REF_CHARACTERISTIC /begin REF_MEASUREMENT /end REF_MEASUREMENT /end GROUP
/begin GROUP CalRegn01Cmn.PwrLimrFilAssiRednThd.Val "MICROSAR RTE" /begin SUB_GROUP /end SUB_GROUP /begin FUNCTION_LIST /end FUNCTION_LIST /begin REF_CHARACTERISTIC CalRegn01Cmn.PwrLimrFilAssiRednThd.Val /end REF_CHARACTERISTIC /begin REF_MEASUREMENT /end REF_MEASUREMENT /end GROUP
/begin GROUP CalRegn01Cmn.PwrLimrLoVoltAssiRcvrThd.Val "MICROSAR RTE" /begin SUB_GROUP /end SUB_GROUP /begin FUNCTION_LIST /end FUNCTION_LIST /begin REF_CHARACTERISTIC CalRegn01Cmn.PwrLimrLoVoltAssiRcvrThd.Val /end REF_CHARACTERISTIC /begin REF_MEASUREMENT /end REF_MEASUREMENT /end GROUP
/begin GROUP CalRegn01Cmn.PwrLimrLoVoltAssiRcvrTi.Val "MICROSAR RTE" /begin SUB_GROUP /end SUB_GROUP /begin FUNCTION_LIST /end FUNCTION_LIST /begin REF_CHARACTERISTIC CalRegn01Cmn.PwrLimrLoVoltAssiRcvrTi.Val /end REF_CHARACTERISTIC /begin REF_MEASUREMENT /end REF_MEASUREMENT /end GROUP
/begin GROUP CalRegn01Cmn.PwrLimrMotEnvlpX.Ary1D "MICROSAR RTE" /begin SUB_GROUP /end SUB_GROUP /begin FUNCTION_LIST /end FUNCTION_LIST /begin REF_CHARACTERISTIC CalRegn01Cmn.PwrLimrMotEnvlpX.Ary1D /end REF_CHARACTERISTIC /begin REF_MEASUREMENT /end REF_MEASUREMENT /end GROUP
/begin GROUP CalRegn01Cmn.PwrLimrMotEnvlpY.Ary1D "MICROSAR RTE" /begin SUB_GROUP /end SUB_GROUP /begin FUNCTION_LIST /end FUNCTION_LIST /begin REF_CHARACTERISTIC CalRegn01Cmn.PwrLimrMotEnvlpY.Ary1D /end REF_CHARACTERISTIC /begin REF_MEASUREMENT /end REF_MEASUREMENT /end GROUP
/begin GROUP CalRegn01Cmn.PwrLimrMotVelLpFilFrq.Val "MICROSAR RTE" /begin SUB_GROUP /end SUB_GROUP /begin FUNCTION_LIST /end FUNCTION_LIST /begin REF_CHARACTERISTIC CalRegn01Cmn.PwrLimrMotVelLpFilFrq.Val /end REF_CHARACTERISTIC /begin REF_MEASUREMENT /end REF_MEASUREMENT /end GROUP
/begin GROUP CalRegn01Cmn.PwrLimrSpdAdjSlewDec.Val "MICROSAR RTE" /begin SUB_GROUP /end SUB_GROUP /begin FUNCTION_LIST /end FUNCTION_LIST /begin REF_CHARACTERISTIC CalRegn01Cmn.PwrLimrSpdAdjSlewDec.Val /end REF_CHARACTERISTIC /begin REF_MEASUREMENT /end REF_MEASUREMENT /end GROUP
/begin GROUP CalRegn01Cmn.PwrLimrSpdAdjSlewEna.Logl "MICROSAR RTE" /begin SUB_GROUP /end SUB_GROUP /begin FUNCTION_LIST /end FUNCTION_LIST /begin REF_CHARACTERISTIC CalRegn01Cmn.PwrLimrSpdAdjSlewEna.Logl /end REF_CHARACTERISTIC /begin REF_MEASUREMENT /end REF_MEASUREMENT /end GROUP
/begin GROUP CalRegn01Cmn.PwrLimrSpdAdjSlewInc.Val "MICROSAR RTE" /begin SUB_GROUP /end SUB_GROUP /begin FUNCTION_LIST /end FUNCTION_LIST /begin REF_CHARACTERISTIC CalRegn01Cmn.PwrLimrSpdAdjSlewInc.Val /end REF_CHARACTERISTIC /begin REF_MEASUREMENT /end REF_MEASUREMENT /end GROUP
/begin GROUP CalRegn01Cmn.PwrLimrStdOperMotEnvlpX.Ary1D "MICROSAR RTE" /begin SUB_GROUP /end SUB_GROUP /begin FUNCTION_LIST /end FUNCTION_LIST /begin REF_CHARACTERISTIC CalRegn01Cmn.PwrLimrStdOperMotEnvlpX.Ary1D /end REF_CHARACTERISTIC /begin REF_MEASUREMENT /end REF_MEASUREMENT /end GROUP
/begin GROUP CalRegn01Cmn.PwrLimrStdOperMotEnvlpY.Ary1D "MICROSAR RTE" /begin SUB_GROUP /end SUB_GROUP /begin FUNCTION_LIST /end FUNCTION_LIST /begin REF_CHARACTERISTIC CalRegn01Cmn.PwrLimrStdOperMotEnvlpY.Ary1D /end REF_CHARACTERISTIC /begin REF_MEASUREMENT /end REF_MEASUREMENT /end GROUP
/begin GROUP CalRegn01Cmn.PwrLimrVltgDptMotVelOffsX.Ary1D "MICROSAR RTE" /begin SUB_GROUP /end SUB_GROUP /begin FUNCTION_LIST /end FUNCTION_LIST /begin REF_CHARACTERISTIC CalRegn01Cmn.PwrLimrVltgDptMotVelOffsX.Ary1D /end REF_CHARACTERISTIC /begin REF_MEASUREMENT /end REF_MEASUREMENT /end GROUP
/begin GROUP CalRegn01Cmn.PwrLimrVltgDptMotVelOffsY.Ary1D "MICROSAR RTE" /begin SUB_GROUP /end SUB_GROUP /begin FUNCTION_LIST /end FUNCTION_LIST /begin REF_CHARACTERISTIC CalRegn01Cmn.PwrLimrVltgDptMotVelOffsY.Ary1D /end REF_CHARACTERISTIC /begin REF_MEASUREMENT /end REF_MEASUREMENT /end GROUP
/begin GROUP CalRegn01Cmn.PwrSplyNtc0x07BFailStep.Val "MICROSAR RTE" /begin SUB_GROUP /end SUB_GROUP /begin FUNCTION_LIST /end FUNCTION_LIST /begin REF_CHARACTERISTIC CalRegn01Cmn.PwrSplyNtc0x07BFailStep.Val /end REF_CHARACTERISTIC /begin REF_MEASUREMENT /end REF_MEASUREMENT /end GROUP
/begin GROUP CalRegn01Cmn.PwrSplyNtc0x07BPassStep.Val "MICROSAR RTE" /begin SUB_GROUP /end SUB_GROUP /begin FUNCTION_LIST /end FUNCTION_LIST /begin REF_CHARACTERISTIC CalRegn01Cmn.PwrSplyNtc0x07BPassStep.Val /end REF_CHARACTERISTIC /begin REF_MEASUREMENT /end REF_MEASUREMENT /end GROUP
/begin GROUP CalRegn01Cmn.PwrSplyNtc0x07CFailStep.Val "MICROSAR RTE" /begin SUB_GROUP /end SUB_GROUP /begin FUNCTION_LIST /end FUNCTION_LIST /begin REF_CHARACTERISTIC CalRegn01Cmn.PwrSplyNtc0x07CFailStep.Val /end REF_CHARACTERISTIC /begin REF_MEASUREMENT /end REF_MEASUREMENT /end GROUP
/begin GROUP CalRegn01Cmn.PwrSplyNtc0x07CPassStep.Val "MICROSAR RTE" /begin SUB_GROUP /end SUB_GROUP /begin FUNCTION_LIST /end FUNCTION_LIST /begin REF_CHARACTERISTIC CalRegn01Cmn.PwrSplyNtc0x07CPassStep.Val /end REF_CHARACTERISTIC /begin REF_MEASUREMENT /end REF_MEASUREMENT /end GROUP
/begin GROUP CalRegn01Cmn.PwrSplyNtc0x07DFailStep.Val "MICROSAR RTE" /begin SUB_GROUP /end SUB_GROUP /begin FUNCTION_LIST /end FUNCTION_LIST /begin REF_CHARACTERISTIC CalRegn01Cmn.PwrSplyNtc0x07DFailStep.Val /end REF_CHARACTERISTIC /begin REF_MEASUREMENT /end REF_MEASUREMENT /end GROUP
/begin GROUP CalRegn01Cmn.PwrSplyNtc0x07DPassStep.Val "MICROSAR RTE" /begin SUB_GROUP /end SUB_GROUP /begin FUNCTION_LIST /end FUNCTION_LIST /begin REF_CHARACTERISTIC CalRegn01Cmn.PwrSplyNtc0x07DPassStep.Val /end REF_CHARACTERISTIC /begin REF_MEASUREMENT /end REF_MEASUREMENT /end GROUP
/begin GROUP CalRegn01Cmn.SinVltgGennDthrEna.Logl "MICROSAR RTE" /begin SUB_GROUP /end SUB_GROUP /begin FUNCTION_LIST /end FUNCTION_LIST /begin REF_CHARACTERISTIC CalRegn01Cmn.SinVltgGennDthrEna.Logl /end REF_CHARACTERISTIC /begin REF_MEASUREMENT /end REF_MEASUREMENT /end GROUP
/begin GROUP CalRegn01Cmn.SinVltgGennDthrLpFilCoeff.Val "MICROSAR RTE" /begin SUB_GROUP /end SUB_GROUP /begin FUNCTION_LIST /end FUNCTION_LIST /begin REF_CHARACTERISTIC CalRegn01Cmn.SinVltgGennDthrLpFilCoeff.Val /end REF_CHARACTERISTIC /begin REF_MEASUREMENT /end REF_MEASUREMENT /end GROUP
/begin GROUP CalRegn01Cmn.SysPrfmncStsAbsltCtrlTFltThd.Val "MICROSAR RTE" /begin SUB_GROUP /end SUB_GROUP /begin FUNCTION_LIST /end FUNCTION_LIST /begin REF_CHARACTERISTIC CalRegn01Cmn.SysPrfmncStsAbsltCtrlTFltThd.Val /end REF_CHARACTERISTIC /begin REF_MEASUREMENT /end REF_MEASUREMENT /end GROUP
/begin GROUP CalRegn01Cmn.SysPrfmncStsAssiStallLimDecThd.Val "MICROSAR RTE" /begin SUB_GROUP /end SUB_GROUP /begin FUNCTION_LIST /end FUNCTION_LIST /begin REF_CHARACTERISTIC CalRegn01Cmn.SysPrfmncStsAssiStallLimDecThd.Val /end REF_CHARACTERISTIC /begin REF_MEASUREMENT /end REF_MEASUREMENT /end GROUP
/begin GROUP CalRegn01Cmn.SysPrfmncStsBattDiagcHiCrit.Val "MICROSAR RTE" /begin SUB_GROUP /end SUB_GROUP /begin FUNCTION_LIST /end FUNCTION_LIST /begin REF_CHARACTERISTIC CalRegn01Cmn.SysPrfmncStsBattDiagcHiCrit.Val /end REF_CHARACTERISTIC /begin REF_MEASUREMENT /end REF_MEASUREMENT /end GROUP
/begin GROUP CalRegn01Cmn.SysPrfmncStsBattDiagcHiWarn.Val "MICROSAR RTE" /begin SUB_GROUP /end SUB_GROUP /begin FUNCTION_LIST /end FUNCTION_LIST /begin REF_CHARACTERISTIC CalRegn01Cmn.SysPrfmncStsBattDiagcHiWarn.Val /end REF_CHARACTERISTIC /begin REF_MEASUREMENT /end REF_MEASUREMENT /end GROUP
/begin GROUP CalRegn01Cmn.SysPrfmncStsBattDiagcLoCrit.Val "MICROSAR RTE" /begin SUB_GROUP /end SUB_GROUP /begin FUNCTION_LIST /end FUNCTION_LIST /begin REF_CHARACTERISTIC CalRegn01Cmn.SysPrfmncStsBattDiagcLoCrit.Val /end REF_CHARACTERISTIC /begin REF_MEASUREMENT /end REF_MEASUREMENT /end GROUP
/begin GROUP CalRegn01Cmn.SysPrfmncStsBattDiagcLoWarn.Val "MICROSAR RTE" /begin SUB_GROUP /end SUB_GROUP /begin FUNCTION_LIST /end FUNCTION_LIST /begin REF_CHARACTERISTIC CalRegn01Cmn.SysPrfmncStsBattDiagcLoWarn.Val /end REF_CHARACTERISTIC /begin REF_MEASUREMENT /end REF_MEASUREMENT /end GROUP
/begin GROUP CalRegn01Cmn.SysPrfmncStsBattVltgFilFrq.Val "MICROSAR RTE" /begin SUB_GROUP /end SUB_GROUP /begin FUNCTION_LIST /end FUNCTION_LIST /begin REF_CHARACTERISTIC CalRegn01Cmn.SysPrfmncStsBattVltgFilFrq.Val /end REF_CHARACTERISTIC /begin REF_MEASUREMENT /end REF_MEASUREMENT /end GROUP
/begin GROUP CalRegn01Cmn.SysPrfmncStsDutyCycLvlFltThd.Val "MICROSAR RTE" /begin SUB_GROUP /end SUB_GROUP /begin FUNCTION_LIST /end FUNCTION_LIST /begin REF_CHARACTERISTIC CalRegn01Cmn.SysPrfmncStsDutyCycLvlFltThd.Val /end REF_CHARACTERISTIC /begin REF_MEASUREMENT /end REF_MEASUREMENT /end GROUP
/begin GROUP CalRegn01Cmn.SysPrfmncStsLoadDptLimDecThd.Val "MICROSAR RTE" /begin SUB_GROUP /end SUB_GROUP /begin FUNCTION_LIST /end FUNCTION_LIST /begin REF_CHARACTERISTIC CalRegn01Cmn.SysPrfmncStsLoadDptLimDecThd.Val /end REF_CHARACTERISTIC /begin REF_MEASUREMENT /end REF_MEASUREMENT /end GROUP
/begin GROUP CalRegn01Cmn.SysPrfmncStsTDptLimThd.Val "MICROSAR RTE" /begin SUB_GROUP /end SUB_GROUP /begin FUNCTION_LIST /end FUNCTION_LIST /begin REF_CHARACTERISTIC CalRegn01Cmn.SysPrfmncStsTDptLimThd.Val /end REF_CHARACTERISTIC /begin REF_MEASUREMENT /end REF_MEASUREMENT /end GROUP
/begin GROUP CalRegn01Cmn.TEstimnIgnOffCtrlEna.Logl "MICROSAR RTE" /begin SUB_GROUP /end SUB_GROUP /begin FUNCTION_LIST /end FUNCTION_LIST /begin REF_CHARACTERISTIC CalRegn01Cmn.TEstimnIgnOffCtrlEna.Logl /end REF_CHARACTERISTIC /begin REF_MEASUREMENT /end REF_MEASUREMENT /end GROUP
/begin GROUP CalRegn01Cmn.TEstimnIgnOffMsgWaitTi.Val "MICROSAR RTE" /begin SUB_GROUP /end SUB_GROUP /begin FUNCTION_LIST /end FUNCTION_LIST /begin REF_CHARACTERISTIC CalRegn01Cmn.TEstimnIgnOffMsgWaitTi.Val /end REF_CHARACTERISTIC /begin REF_MEASUREMENT /end REF_MEASUREMENT /end GROUP
/begin GROUP CalRegn01Cmn.TqLoaDrvrTqNom.Val "MICROSAR RTE" /begin SUB_GROUP /end SUB_GROUP /begin FUNCTION_LIST /end FUNCTION_LIST /begin REF_CHARACTERISTIC CalRegn01Cmn.TqLoaDrvrTqNom.Val /end REF_CHARACTERISTIC /begin REF_MEASUREMENT /end REF_MEASUREMENT /end GROUP
/begin GROUP CalRegn01Cmn.TqLoaMotTqCmdLim.Val "MICROSAR RTE" /begin SUB_GROUP /end SUB_GROUP /begin FUNCTION_LIST /end FUNCTION_LIST /begin REF_CHARACTERISTIC CalRegn01Cmn.TqLoaMotTqCmdLim.Val /end REF_CHARACTERISTIC /begin REF_MEASUREMENT /end REF_MEASUREMENT /end GROUP
/begin GROUP CalRegn01Cmn.TqLoaMotVelAndTqBasdScaFacFallRate.Val "MICROSAR RTE" /begin SUB_GROUP /end SUB_GROUP /begin FUNCTION_LIST /end FUNCTION_LIST /begin REF_CHARACTERISTIC CalRegn01Cmn.TqLoaMotVelAndTqBasdScaFacFallRate.Val /end REF_CHARACTERISTIC /begin REF_MEASUREMENT /end REF_MEASUREMENT /end GROUP
/begin GROUP CalRegn01Cmn.TqLoaMotVelAndTqBasdScaFacMax.Val "MICROSAR RTE" /begin SUB_GROUP /end SUB_GROUP /begin FUNCTION_LIST /end FUNCTION_LIST /begin REF_CHARACTERISTIC CalRegn01Cmn.TqLoaMotVelAndTqBasdScaFacMax.Val /end REF_CHARACTERISTIC /begin REF_MEASUREMENT /end REF_MEASUREMENT /end GROUP
/begin GROUP CalRegn01Cmn.TqLoaMotVelAndTqBasdScaFacMin.Val "MICROSAR RTE" /begin SUB_GROUP /end SUB_GROUP /begin FUNCTION_LIST /end FUNCTION_LIST /begin REF_CHARACTERISTIC CalRegn01Cmn.TqLoaMotVelAndTqBasdScaFacMin.Val /end REF_CHARACTERISTIC /begin REF_MEASUREMENT /end REF_MEASUREMENT /end GROUP
/begin GROUP CalRegn01Cmn.TqLoaMotVelAndTqBasdScaFacRiseRate.Val "MICROSAR RTE" /begin SUB_GROUP /end SUB_GROUP /begin FUNCTION_LIST /end FUNCTION_LIST /begin REF_CHARACTERISTIC CalRegn01Cmn.TqLoaMotVelAndTqBasdScaFacRiseRate.Val /end REF_CHARACTERISTIC /begin REF_MEASUREMENT /end REF_MEASUREMENT /end GROUP
/begin GROUP CalRegn01Cmn.TqLoaMotVelMgnThd.Val "MICROSAR RTE" /begin SUB_GROUP /end SUB_GROUP /begin FUNCTION_LIST /end FUNCTION_LIST /begin REF_CHARACTERISTIC CalRegn01Cmn.TqLoaMotVelMgnThd.Val /end REF_CHARACTERISTIC /begin REF_MEASUREMENT /end REF_MEASUREMENT /end GROUP
/begin GROUP CalRegn01Cmn.TqLoaTqCmdLimY.Ary1D "MICROSAR RTE" /begin SUB_GROUP /end SUB_GROUP /begin FUNCTION_LIST /end FUNCTION_LIST /begin REF_CHARACTERISTIC CalRegn01Cmn.TqLoaTqCmdLimY.Ary1D /end REF_CHARACTERISTIC /begin REF_MEASUREMENT /end REF_MEASUREMENT /end GROUP
/begin GROUP CalRegn01Cmn.TqLoaTqCmdMgnThd.Val "MICROSAR RTE" /begin SUB_GROUP /end SUB_GROUP /begin FUNCTION_LIST /end FUNCTION_LIST /begin REF_CHARACTERISTIC CalRegn01Cmn.TqLoaTqCmdMgnThd.Val /end REF_CHARACTERISTIC /begin REF_MEASUREMENT /end REF_MEASUREMENT /end GROUP
/begin GROUP CalRegn01Cmn.TqLoaVehLatADifScaFacFallRate.Val "MICROSAR RTE" /begin SUB_GROUP /end SUB_GROUP /begin FUNCTION_LIST /end FUNCTION_LIST /begin REF_CHARACTERISTIC CalRegn01Cmn.TqLoaVehLatADifScaFacFallRate.Val /end REF_CHARACTERISTIC /begin REF_MEASUREMENT /end REF_MEASUREMENT /end GROUP
/begin GROUP CalRegn01Cmn.TqLoaVehLatADifScaFacRiseRate.Val "MICROSAR RTE" /begin SUB_GROUP /end SUB_GROUP /begin FUNCTION_LIST /end FUNCTION_LIST /begin REF_CHARACTERISTIC CalRegn01Cmn.TqLoaVehLatADifScaFacRiseRate.Val /end REF_CHARACTERISTIC /begin REF_MEASUREMENT /end REF_MEASUREMENT /end GROUP
/begin GROUP CalRegn01Cmn.TqLoaVehLatADifScaFacX.Ary1D "MICROSAR RTE" /begin SUB_GROUP /end SUB_GROUP /begin FUNCTION_LIST /end FUNCTION_LIST /begin REF_CHARACTERISTIC CalRegn01Cmn.TqLoaVehLatADifScaFacX.Ary1D /end REF_CHARACTERISTIC /begin REF_MEASUREMENT /end REF_MEASUREMENT /end GROUP
/begin GROUP CalRegn01Cmn.TqLoaVehLatADifScaFacY.Ary2D "MICROSAR RTE" /begin SUB_GROUP /end SUB_GROUP /begin FUNCTION_LIST /end FUNCTION_LIST /begin REF_CHARACTERISTIC CalRegn01Cmn.TqLoaVehLatADifScaFacY.Ary2D /end REF_CHARACTERISTIC /begin REF_MEASUREMENT /end REF_MEASUREMENT /end GROUP
/begin GROUP CalRegn01Cmn.TqLoaVehLatAEstimnFilFrq.Val "MICROSAR RTE" /begin SUB_GROUP /end SUB_GROUP /begin FUNCTION_LIST /end FUNCTION_LIST /begin REF_CHARACTERISTIC CalRegn01Cmn.TqLoaVehLatAEstimnFilFrq.Val /end REF_CHARACTERISTIC /begin REF_MEASUREMENT /end REF_MEASUREMENT /end GROUP
/begin GROUP CalRegn01Cmn.TqLoaVehLatAGainY.Ary1D "MICROSAR RTE" /begin SUB_GROUP /end SUB_GROUP /begin FUNCTION_LIST /end FUNCTION_LIST /begin REF_CHARACTERISTIC CalRegn01Cmn.TqLoaVehLatAGainY.Ary1D /end REF_CHARACTERISTIC /begin REF_MEASUREMENT /end REF_MEASUREMENT /end GROUP
/begin GROUP CalRegn01Cmn.TqLoaVehSpdScaFacX.Ary1D "MICROSAR RTE" /begin SUB_GROUP /end SUB_GROUP /begin FUNCTION_LIST /end FUNCTION_LIST /begin REF_CHARACTERISTIC CalRegn01Cmn.TqLoaVehSpdScaFacX.Ary1D /end REF_CHARACTERISTIC /begin REF_MEASUREMENT /end REF_MEASUREMENT /end GROUP
/begin GROUP CalRegn01Cmn.TqLoaVehSpdScaFacY.Ary1D "MICROSAR RTE" /begin SUB_GROUP /end SUB_GROUP /begin FUNCTION_LIST /end FUNCTION_LIST /begin REF_CHARACTERISTIC CalRegn01Cmn.TqLoaVehSpdScaFacY.Ary1D /end REF_CHARACTERISTIC /begin REF_MEASUREMENT /end REF_MEASUREMENT /end GROUP
/begin GROUP CalRegn01Cmn.TqLoaVehSpdX.Ary1D "MICROSAR RTE" /begin SUB_GROUP /end SUB_GROUP /begin FUNCTION_LIST /end FUNCTION_LIST /begin REF_CHARACTERISTIC CalRegn01Cmn.TqLoaVehSpdX.Ary1D /end REF_CHARACTERISTIC /begin REF_MEASUREMENT /end REF_MEASUREMENT /end GROUP
/begin GROUP CalRegn01Cmn.TqLoaVehSteerRat.Val "MICROSAR RTE" /begin SUB_GROUP /end SUB_GROUP /begin FUNCTION_LIST /end FUNCTION_LIST /begin REF_CHARACTERISTIC CalRegn01Cmn.TqLoaVehSteerRat.Val /end REF_CHARACTERISTIC /begin REF_MEASUREMENT /end REF_MEASUREMENT /end GROUP
/begin GROUP CalRegn01Cmn.TqLoaVehUnderSteerGrdt.Val "MICROSAR RTE" /begin SUB_GROUP /end SUB_GROUP /begin FUNCTION_LIST /end FUNCTION_LIST /begin REF_CHARACTERISTIC CalRegn01Cmn.TqLoaVehUnderSteerGrdt.Val /end REF_CHARACTERISTIC /begin REF_MEASUREMENT /end REF_MEASUREMENT /end GROUP
/begin GROUP CalRegn01Cmn.TqLoaVehWhlBas.Val "MICROSAR RTE" /begin SUB_GROUP /end SUB_GROUP /begin FUNCTION_LIST /end FUNCTION_LIST /begin REF_CHARACTERISTIC CalRegn01Cmn.TqLoaVehWhlBas.Val /end REF_CHARACTERISTIC /begin REF_MEASUREMENT /end REF_MEASUREMENT /end GROUP
/begin GROUP CalRegn01Cmn.VehSigCdngDftLatA.Val "MICROSAR RTE" /begin SUB_GROUP /end SUB_GROUP /begin FUNCTION_LIST /end FUNCTION_LIST /begin REF_CHARACTERISTIC CalRegn01Cmn.VehSigCdngDftLatA.Val /end REF_CHARACTERISTIC /begin REF_MEASUREMENT /end REF_MEASUREMENT /end GROUP
/begin GROUP CalRegn01Cmn.VehSigCdngDftLgtA.Val "MICROSAR RTE" /begin SUB_GROUP /end SUB_GROUP /begin FUNCTION_LIST /end FUNCTION_LIST /begin REF_CHARACTERISTIC CalRegn01Cmn.VehSigCdngDftLgtA.Val /end REF_CHARACTERISTIC /begin REF_MEASUREMENT /end REF_MEASUREMENT /end GROUP
/begin GROUP CalRegn01Cmn.VehSigCdngDftVehSpd.Val "MICROSAR RTE" /begin SUB_GROUP /end SUB_GROUP /begin FUNCTION_LIST /end FUNCTION_LIST /begin REF_CHARACTERISTIC CalRegn01Cmn.VehSigCdngDftVehSpd.Val /end REF_CHARACTERISTIC /begin REF_MEASUREMENT /end REF_MEASUREMENT /end GROUP
/**********************************************************************************************************************
* RECORD_LAYOUT
*********************************************************************************************************************/
/begin RECORD_LAYOUT RTE_RL_UBYTE FNC_VALUES 1 UBYTE ROW_DIR DIRECT /end RECORD_LAYOUT
/begin RECORD_LAYOUT RTE_RL_UWORD FNC_VALUES 1 UWORD ROW_DIR DIRECT /end RECORD_LAYOUT
/begin RECORD_LAYOUT RTE_RL_ULONG FNC_VALUES 1 ULONG ROW_DIR DIRECT /end RECORD_LAYOUT
/begin RECORD_LAYOUT RTE_RL_SWORD FNC_VALUES 1 SWORD ROW_DIR DIRECT /end RECORD_LAYOUT
/begin RECORD_LAYOUT RTE_RL_SLONG FNC_VALUES 1 SLONG ROW_DIR DIRECT /end RECORD_LAYOUT
/begin RECORD_LAYOUT RTE_RL_FLOAT32_IEEE FNC_VALUES 1 FLOAT32_IEEE ROW_DIR DIRECT /end RECORD_LAYOUT
/begin RECORD_LAYOUT RTE_RL_BOOLEAN FNC_VALUES 1 UBYTE ROW_DIR DIRECT /end RECORD_LAYOUT
/**********************************************************************************************************************
* COMPU_METHOD / COMPU_VTAB_RANGE
*********************************************************************************************************************/
/begin COMPU_METHOD RTE_CM_BOOLEAN "" TAB_VERB "%3.1" "" COMPU_TAB_REF RTE_CM_BOOLEAN /end COMPU_METHOD
/begin COMPU_VTAB_RANGE RTE_CM_BOOLEAN "" 2 0 0 "false" 1 255 "true" /end COMPU_VTAB_RANGE
/begin COMPU_METHOD RTE_CM_Curr8 "" RAT_FUNC "%.1" "Amp" COEFFS 0 128 0 0 0 1 /end COMPU_METHOD
/begin COMPU_METHOD RTE_CM_Uls11 "" RAT_FUNC "%.1" "Uls" COEFFS 0 16384 0 0 0 1 /end COMPU_METHOD
/begin COMPU_METHOD RTE_CM_Tq13 "" RAT_FUNC "%.1" "MotNm" COEFFS 0 0.000244140625 0 0 0 1 /end COMPU_METHOD
/begin COMPU_METHOD RTE_CM_Uls15 "" RAT_FUNC "%.1" "Uls" COEFFS 0 3.0517578125e-005 0 0 0 1 /end COMPU_METHOD
/begin COMPU_METHOD RTE_CM_Vel4 "" RAT_FUNC "%.1" "MotRad/s" COEFFS 0 32 0 0 0 1 /end COMPU_METHOD
/begin COMPU_METHOD RTE_CM_Volt18 "" RAT_FUNC "%.1" "V" COEFFS 0 8192 0 0 0 1 /end COMPU_METHOD
