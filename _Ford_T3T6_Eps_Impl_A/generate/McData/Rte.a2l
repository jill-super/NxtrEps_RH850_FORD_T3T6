/begin CHARACTERISTIC CalRegn02Rt03GroupA.InertiaCmpVelDampgFilFrq.Ary1D "MICROSAR RTE" VAL_BLK 0x0 RTE_RL_UWORD 0 NO_COMPU_METHOD 0 65535 MATRIX_DIM 12 1 1 SYMBOL_LINK "Rte_CalprmRom_CalRegn02Rt03GroupA_DEFAULT_RTE_CALPRM_GROUP.InertiaCmpVelDampgFilFrq_Ary1D" 0 DISPLAY_IDENTIFIER CalRegn02Rt03GroupA.CalibrationPorts.InertiaCmpVelDampgFilFrq.Ary1D /end CHARACTERISTIC
/begin CHARACTERISTIC CalRegn02Rt03GroupA.InertiaCmpVelDampgFilFrqWhlImbRejctnOn.Ary1D "MICROSAR RTE" VAL_BLK 0x0 RTE_RL_UWORD 0 NO_COMPU_METHOD 0 65535 MATRIX_DIM 12 1 1 SYMBOL_LINK "Rte_CalprmRom_CalRegn02Rt03GroupA_DEFAULT_RTE_CALPRM_GROUP.InertiaCmpVelDampgFilFrqWhlImbRejctnOn_Ary1D" 0 DISPLAY_IDENTIFIER CalRegn02Rt03GroupA.CalibrationPorts.InertiaCmpVelDampgFilFrqWhlImbRejctnOn.Ary1D /end CHARACTERISTIC
/begin CHARACTERISTIC CalRegn02Rt03GroupA.InertiaCmpVelDampgSpdBlndY.Ary1D "MICROSAR RTE" VAL_BLK 0x0 RTE_RL_UWORD 0 NO_COMPU_METHOD 0 65535 MATRIX_DIM 12 1 1 SYMBOL_LINK "Rte_CalprmRom_CalRegn02Rt03GroupA_DEFAULT_RTE_CALPRM_GROUP.InertiaCmpVelDampgSpdBlndY_Ary1D" 0 DISPLAY_IDENTIFIER CalRegn02Rt03GroupA.CalibrationPorts.InertiaCmpVelDampgSpdBlndY.Ary1D /end CHARACTERISTIC
/begin CHARACTERISTIC CalRegn02Rt03GroupA.InertiaCmpVelDampgWhlImbRejctnBlndX.Ary1D "MICROSAR RTE" VAL_BLK 0x0 RTE_RL_UWORD 0 NO_COMPU_METHOD 0 65535 MATRIX_DIM 5 1 1 SYMBOL_LINK "Rte_CalprmRom_CalRegn02Rt03GroupA_DEFAULT_RTE_CALPRM_GROUP.InertiaCmpVelDampgWhlImbRejctnBlndX_Ary1D" 0 DISPLAY_IDENTIFIER CalRegn02Rt03GroupA.CalibrationPorts.InertiaCmpVelDampgWhlImbRejctnBlndX.Ary1D /end CHARACTERISTIC
/begin CHARACTERISTIC CalRegn02Rt03GroupA.InertiaCmpVelDampgWhlImbRejctnBlndY.Ary1D "MICROSAR RTE" VAL_BLK 0x0 RTE_RL_UWORD 0 NO_COMPU_METHOD 0 65535 MATRIX_DIM 5 1 1 SYMBOL_LINK "Rte_CalprmRom_CalRegn02Rt03GroupA_DEFAULT_RTE_CALPRM_GROUP.InertiaCmpVelDampgWhlImbRejctnBlndY_Ary1D" 0 DISPLAY_IDENTIFIER CalRegn02Rt03GroupA.CalibrationPorts.InertiaCmpVelDampgWhlImbRejctnBlndY.Ary1D /end CHARACTERISTIC
/begin CHARACTERISTIC CalRegn02Rt03GroupB.EotProtnDampgVehSpdTbl.Ary1D "MICROSAR RTE" VAL_BLK 0x0 RTE_RL_UWORD 0 NO_COMPU_METHOD 0 65535 MATRIX_DIM 4 1 1 SYMBOL_LINK "Rte_CalprmRom_CalRegn02Rt03GroupB_DEFAULT_RTE_CALPRM_GROUP.EotProtnDampgVehSpdTbl_Ary1D" 0 DISPLAY_IDENTIFIER CalRegn02Rt03GroupB.CalibrationPorts.EotProtnDampgVehSpdTbl.Ary1D /end CHARACTERISTIC
/begin CHARACTERISTIC CalRegn02Rt03GroupB.EotProtnDeltaTqThd.Val "MICROSAR RTE" VALUE 0x0 RTE_RL_FLOAT32_IEEE 0 NO_COMPU_METHOD -3.402823466e+38 3.402823466e+38 SYMBOL_LINK "Rte_CalprmRom_CalRegn02Rt03GroupB_DEFAULT_RTE_CALPRM_GROUP.EotProtnDeltaTqThd_Val" 0 DISPLAY_IDENTIFIER CalRegn02Rt03GroupB.CalibrationPorts.EotProtnDeltaTqThd.Val /end CHARACTERISTIC
/begin CHARACTERISTIC CalRegn02Rt03GroupB.EotProtnEntrGainVehSpdTbl.Ary1D "MICROSAR RTE" VAL_BLK 0x0 RTE_RL_UWORD 0 NO_COMPU_METHOD 0 65535 MATRIX_DIM 5 1 1 SYMBOL_LINK "Rte_CalprmRom_CalRegn02Rt03GroupB_DEFAULT_RTE_CALPRM_GROUP.EotProtnEntrGainVehSpdTbl_Ary1D" 0 DISPLAY_IDENTIFIER CalRegn02Rt03GroupB.CalibrationPorts.EotProtnEntrGainVehSpdTbl.Ary1D /end CHARACTERISTIC
/begin CHARACTERISTIC CalRegn02Rt03GroupB.EotProtnEntrGainY.Ary2D "MICROSAR RTE" VAL_BLK 0x0 RTE_RL_UWORD 0 NO_COMPU_METHOD 0 65535 MATRIX_DIM 4 5 1 SYMBOL_LINK "Rte_CalprmRom_CalRegn02Rt03GroupB_DEFAULT_RTE_CALPRM_GROUP.EotProtnEntrGainY_Ary2D" 0 DISPLAY_IDENTIFIER CalRegn02Rt03GroupB.CalibrationPorts.EotProtnEntrGainY.Ary2D /end CHARACTERISTIC
/begin CHARACTERISTIC CalRegn02Rt03GroupB.EotProtnLoAuthyEntrGainY.Ary2D "MICROSAR RTE" VAL_BLK 0x0 RTE_RL_UWORD 0 NO_COMPU_METHOD 0 65535 MATRIX_DIM 4 5 1 SYMBOL_LINK "Rte_CalprmRom_CalRegn02Rt03GroupB_DEFAULT_RTE_CALPRM_GROUP.EotProtnLoAuthyEntrGainY_Ary2D" 0 DISPLAY_IDENTIFIER CalRegn02Rt03GroupB.CalibrationPorts.EotProtnLoAuthyEntrGainY.Ary2D /end CHARACTERISTIC
/begin CHARACTERISTIC CalRegn02Rt03GroupB.EotProtnMotSpdIncptY.Ary1D "MICROSAR RTE" VAL_BLK 0x0 RTE_RL_UWORD 0 NO_COMPU_METHOD 0 65535 MATRIX_DIM 2 1 1 SYMBOL_LINK "Rte_CalprmRom_CalRegn02Rt03GroupB_DEFAULT_RTE_CALPRM_GROUP.EotProtnMotSpdIncptY_Ary1D" 0 DISPLAY_IDENTIFIER CalRegn02Rt03GroupB.CalibrationPorts.EotProtnMotSpdIncptY.Ary1D /end CHARACTERISTIC
/begin CHARACTERISTIC CalRegn02Rt03GroupB.EotProtnNormDampgY.Ary2D "MICROSAR RTE" VAL_BLK 0x0 RTE_RL_UWORD 0 NO_COMPU_METHOD 0 65535 MATRIX_DIM 2 4 1 SYMBOL_LINK "Rte_CalprmRom_CalRegn02Rt03GroupB_DEFAULT_RTE_CALPRM_GROUP.EotProtnNormDampgY_Ary2D" 0 DISPLAY_IDENTIFIER CalRegn02Rt03GroupB.CalibrationPorts.EotProtnNormDampgY.Ary2D /end CHARACTERISTIC
/begin CHARACTERISTIC CalRegn02Rt03GroupB.EotProtnSoftEndStopAuthyThd.Val "MICROSAR RTE" VALUE 0x0 RTE_RL_FLOAT32_IEEE 0 NO_COMPU_METHOD -3.402823466e+38 3.402823466e+38 SYMBOL_LINK "Rte_CalprmRom_CalRegn02Rt03GroupB_DEFAULT_RTE_CALPRM_GROUP.EotProtnSoftEndStopAuthyThd_Val" 0 DISPLAY_IDENTIFIER CalRegn02Rt03GroupB.CalibrationPorts.EotProtnSoftEndStopAuthyThd.Val /end CHARACTERISTIC
/begin CHARACTERISTIC CalRegn02Rt03GroupB.RtnHwAgOffsCalcdX.Ary2D "MICROSAR RTE" VAL_BLK 0x0 RTE_RL_UWORD 0 NO_COMPU_METHOD 0 65535 MATRIX_DIM 16 9 1 SYMBOL_LINK "Rte_CalprmRom_CalRegn02Rt03GroupB_DEFAULT_RTE_CALPRM_GROUP.RtnHwAgOffsCalcdX_Ary2D" 0 DISPLAY_IDENTIFIER CalRegn02Rt03GroupB.CalibrationPorts.RtnHwAgOffsCalcdX.Ary2D /end CHARACTERISTIC
/begin CHARACTERISTIC CalRegn02Rt03GroupB.RtnHwAgOffsCalcdY.Ary2D "MICROSAR RTE" VAL_BLK 0x0 RTE_RL_UWORD 0 NO_COMPU_METHOD 0 65535 MATRIX_DIM 16 9 1 SYMBOL_LINK "Rte_CalprmRom_CalRegn02Rt03GroupB_DEFAULT_RTE_CALPRM_GROUP.RtnHwAgOffsCalcdY_Ary2D" 0 DISPLAY_IDENTIFIER CalRegn02Rt03GroupB.CalibrationPorts.RtnHwAgOffsCalcdY.Ary2D /end CHARACTERISTIC
/begin CHARACTERISTIC CalRegn02Rt03GroupB.RtnScaTqX.Ary2D "MICROSAR RTE" VAL_BLK 0x0 RTE_RL_UWORD 0 NO_COMPU_METHOD 0 65535 MATRIX_DIM 8 9 1 SYMBOL_LINK "Rte_CalprmRom_CalRegn02Rt03GroupB_DEFAULT_RTE_CALPRM_GROUP.RtnScaTqX_Ary2D" 0 DISPLAY_IDENTIFIER CalRegn02Rt03GroupB.CalibrationPorts.RtnScaTqX.Ary2D /end CHARACTERISTIC
/begin CHARACTERISTIC CalRegn02Rt03GroupB.RtnScaTqY.Ary2D "MICROSAR RTE" VAL_BLK 0x0 RTE_RL_UWORD 0 NO_COMPU_METHOD 0 65535 MATRIX_DIM 8 9 1 SYMBOL_LINK "Rte_CalprmRom_CalRegn02Rt03GroupB_DEFAULT_RTE_CALPRM_GROUP.RtnScaTqY_Ary2D" 0 DISPLAY_IDENTIFIER CalRegn02Rt03GroupB.CalibrationPorts.RtnScaTqY.Ary2D /end CHARACTERISTIC
/begin CHARACTERISTIC CalRegn02Rt03GroupB.RtnScaVelX.Ary2D "MICROSAR RTE" VAL_BLK 0x0 RTE_RL_UWORD 0 NO_COMPU_METHOD 0 65535 MATRIX_DIM 4 9 1 SYMBOL_LINK "Rte_CalprmRom_CalRegn02Rt03GroupB_DEFAULT_RTE_CALPRM_GROUP.RtnScaVelX_Ary2D" 0 DISPLAY_IDENTIFIER CalRegn02Rt03GroupB.CalibrationPorts.RtnScaVelX.Ary2D /end CHARACTERISTIC
/begin CHARACTERISTIC CalRegn02Rt03GroupB.RtnScaVelY.Ary2D "MICROSAR RTE" VAL_BLK 0x0 RTE_RL_UWORD 0 NO_COMPU_METHOD 0 65535 MATRIX_DIM 4 9 1 SYMBOL_LINK "Rte_CalprmRom_CalRegn02Rt03GroupB_DEFAULT_RTE_CALPRM_GROUP.RtnScaVelY_Ary2D" 0 DISPLAY_IDENTIFIER CalRegn02Rt03GroupB.CalibrationPorts.RtnScaVelY.Ary2D /end CHARACTERISTIC
/begin CHARACTERISTIC CalRegn02Rt03GroupB.RtnVehSpdSeln.Ary1D "MICROSAR RTE" VAL_BLK 0x0 RTE_RL_UWORD 0 NO_COMPU_METHOD 0 65535 MATRIX_DIM 9 1 1 SYMBOL_LINK "Rte_CalprmRom_CalRegn02Rt03GroupB_DEFAULT_RTE_CALPRM_GROUP.RtnVehSpdSeln_Ary1D" 0 DISPLAY_IDENTIFIER CalRegn02Rt03GroupB.CalibrationPorts.RtnVehSpdSeln.Ary1D /end CHARACTERISTIC
/begin CHARACTERISTIC CalRegn02Rt04GroupA.AssiHiFrqGainY.Ary2D "MICROSAR RTE" VAL_BLK 0x0 RTE_RL_UWORD 0 NO_COMPU_METHOD 0 65535 MATRIX_DIM 13 12 1 SYMBOL_LINK "Rte_CalprmRom_CalRegn02Rt04GroupA_DEFAULT_RTE_CALPRM_GROUP.AssiHiFrqGainY_Ary2D" 0 DISPLAY_IDENTIFIER CalRegn02Rt04GroupA.CalibrationPorts.AssiHiFrqGainY.Ary2D /end CHARACTERISTIC
/begin CHARACTERISTIC CalRegn02Rt04GroupA.AssiHiFrqHpFilFrqY.Ary1D "MICROSAR RTE" VAL_BLK 0x0 RTE_RL_UWORD 0 NO_COMPU_METHOD 0 65535 MATRIX_DIM 12 1 1 SYMBOL_LINK "Rte_CalprmRom_CalRegn02Rt04GroupA_DEFAULT_RTE_CALPRM_GROUP.AssiHiFrqHpFilFrqY_Ary1D" 0 DISPLAY_IDENTIFIER CalRegn02Rt04GroupA.CalibrationPorts.AssiHiFrqHpFilFrqY.Ary1D /end CHARACTERISTIC
/begin CHARACTERISTIC CalRegn02Rt04GroupA.AssiHiFrqTqWhlImbRejctnTqX.Ary2D "MICROSAR RTE" VAL_BLK 0x0 RTE_RL_UWORD 0 NO_COMPU_METHOD 0 65535 MATRIX_DIM 13 12 1 SYMBOL_LINK "Rte_CalprmRom_CalRegn02Rt04GroupA_DEFAULT_RTE_CALPRM_GROUP.AssiHiFrqTqWhlImbRejctnTqX_Ary2D" 0 DISPLAY_IDENTIFIER CalRegn02Rt04GroupA.CalibrationPorts.AssiHiFrqTqWhlImbRejctnTqX.Ary2D /end CHARACTERISTIC
/begin CHARACTERISTIC CalRegn02Rt04GroupA.AssiHiFrqTqX.Ary2D "MICROSAR RTE" VAL_BLK 0x0 RTE_RL_UWORD 0 NO_COMPU_METHOD 0 65535 MATRIX_DIM 13 12 1 SYMBOL_LINK "Rte_CalprmRom_CalRegn02Rt04GroupA_DEFAULT_RTE_CALPRM_GROUP.AssiHiFrqTqX_Ary2D" 0 DISPLAY_IDENTIFIER CalRegn02Rt04GroupA.CalibrationPorts.AssiHiFrqTqX.Ary2D /end CHARACTERISTIC
/begin CHARACTERISTIC CalRegn02Rt04GroupA.AssiHiFrqWhlImbRejctnBlndX.Ary2D "MICROSAR RTE" VAL_BLK 0x0 RTE_RL_UWORD 0 NO_COMPU_METHOD 0 65535 MATRIX_DIM 5 12 1 SYMBOL_LINK "Rte_CalprmRom_CalRegn02Rt04GroupA_DEFAULT_RTE_CALPRM_GROUP.AssiHiFrqWhlImbRejctnBlndX_Ary2D" 0 DISPLAY_IDENTIFIER CalRegn02Rt04GroupA.CalibrationPorts.AssiHiFrqWhlImbRejctnBlndX.Ary2D /end CHARACTERISTIC
/begin CHARACTERISTIC CalRegn02Rt04GroupA.AssiHiFrqWhlImbRejctnBlndY.Ary2D "MICROSAR RTE" VAL_BLK 0x0 RTE_RL_UWORD 0 NO_COMPU_METHOD 0 65535 MATRIX_DIM 5 12 1 SYMBOL_LINK "Rte_CalprmRom_CalRegn02Rt04GroupA_DEFAULT_RTE_CALPRM_GROUP.AssiHiFrqWhlImbRejctnBlndY_Ary2D" 0 DISPLAY_IDENTIFIER CalRegn02Rt04GroupA.CalibrationPorts.AssiHiFrqWhlImbRejctnBlndY.Ary2D /end CHARACTERISTIC
/begin CHARACTERISTIC CalRegn02Rt04GroupA.AssiHiFrqWhlImbRejctnGainY.Ary2D "MICROSAR RTE" VAL_BLK 0x0 RTE_RL_UWORD 0 NO_COMPU_METHOD 0 65535 MATRIX_DIM 13 12 1 SYMBOL_LINK "Rte_CalprmRom_CalRegn02Rt04GroupA_DEFAULT_RTE_CALPRM_GROUP.AssiHiFrqWhlImbRejctnGainY_Ary2D" 0 DISPLAY_IDENTIFIER CalRegn02Rt04GroupA.CalibrationPorts.AssiHiFrqWhlImbRejctnGainY.Ary2D /end CHARACTERISTIC
/begin CHARACTERISTIC CalRegn02Rt04GroupA.AssiMotTqWhlImbRejctnMaxX.Ary2D "MICROSAR RTE" VAL_BLK 0x0 RTE_RL_UWORD 0 NO_COMPU_METHOD 0 65535 MATRIX_DIM 20 12 1 SYMBOL_LINK "Rte_CalprmRom_CalRegn02Rt04GroupA_DEFAULT_RTE_CALPRM_GROUP.AssiMotTqWhlImbRejctnMaxX_Ary2D" 0 DISPLAY_IDENTIFIER CalRegn02Rt04GroupA.CalibrationPorts.AssiMotTqWhlImbRejctnMaxX.Ary2D /end CHARACTERISTIC
/begin CHARACTERISTIC CalRegn02Rt04GroupA.AssiMotTqWhlImbRejctnMaxY.Ary2D "MICROSAR RTE" VAL_BLK 0x0 RTE_RL_SWORD 0 NO_COMPU_METHOD -32768 32767 MATRIX_DIM 20 12 1 SYMBOL_LINK "Rte_CalprmRom_CalRegn02Rt04GroupA_DEFAULT_RTE_CALPRM_GROUP.AssiMotTqWhlImbRejctnMaxY_Ary2D" 0 DISPLAY_IDENTIFIER CalRegn02Rt04GroupA.CalibrationPorts.AssiMotTqWhlImbRejctnMaxY.Ary2D /end CHARACTERISTIC
/begin CHARACTERISTIC CalRegn02Rt04GroupA.AssiMotTqWhlImbRejctnMinX.Ary2D "MICROSAR RTE" VAL_BLK 0x0 RTE_RL_UWORD 0 NO_COMPU_METHOD 0 65535 MATRIX_DIM 20 12 1 SYMBOL_LINK "Rte_CalprmRom_CalRegn02Rt04GroupA_DEFAULT_RTE_CALPRM_GROUP.AssiMotTqWhlImbRejctnMinX_Ary2D" 0 DISPLAY_IDENTIFIER CalRegn02Rt04GroupA.CalibrationPorts.AssiMotTqWhlImbRejctnMinX.Ary2D /end CHARACTERISTIC
/begin CHARACTERISTIC CalRegn02Rt04GroupA.AssiMotTqWhlImbRejctnMinY.Ary2D "MICROSAR RTE" VAL_BLK 0x0 RTE_RL_SWORD 0 NO_COMPU_METHOD -32768 32767 MATRIX_DIM 20 12 1 SYMBOL_LINK "Rte_CalprmRom_CalRegn02Rt04GroupA_DEFAULT_RTE_CALPRM_GROUP.AssiMotTqWhlImbRejctnMinY_Ary2D" 0 DISPLAY_IDENTIFIER CalRegn02Rt04GroupA.CalibrationPorts.AssiMotTqWhlImbRejctnMinY.Ary2D /end CHARACTERISTIC
/begin CHARACTERISTIC CalRegn02Rt04GroupA.AssiWhlImbRejctnBlndScaX.Ary2D "MICROSAR RTE" VAL_BLK 0x0 RTE_RL_UWORD 0 NO_COMPU_METHOD 0 65535 MATRIX_DIM 5 12 1 SYMBOL_LINK "Rte_CalprmRom_CalRegn02Rt04GroupA_DEFAULT_RTE_CALPRM_GROUP.AssiWhlImbRejctnBlndScaX_Ary2D" 0 DISPLAY_IDENTIFIER CalRegn02Rt04GroupA.CalibrationPorts.AssiWhlImbRejctnBlndScaX.Ary2D /end CHARACTERISTIC
/begin CHARACTERISTIC CalRegn02Rt04GroupA.AssiWhlImbRejctnBlndScaY.Ary2D "MICROSAR RTE" VAL_BLK 0x0 RTE_RL_UWORD 0 NO_COMPU_METHOD 0 65535 MATRIX_DIM 5 12 1 SYMBOL_LINK "Rte_CalprmRom_CalRegn02Rt04GroupA_DEFAULT_RTE_CALPRM_GROUP.AssiWhlImbRejctnBlndScaY_Ary2D" 0 DISPLAY_IDENTIFIER CalRegn02Rt04GroupA.CalibrationPorts.AssiWhlImbRejctnBlndScaY.Ary2D /end CHARACTERISTIC
/begin CHARACTERISTIC CalRegn02Rt04GroupA.DampgHwTqX.Ary1D "MICROSAR RTE" VAL_BLK 0x0 RTE_RL_UWORD 0 NO_COMPU_METHOD 0 65535 MATRIX_DIM 2 1 1 SYMBOL_LINK "Rte_CalprmRom_CalRegn02Rt04GroupA_DEFAULT_RTE_CALPRM_GROUP.DampgHwTqX_Ary1D" 0 DISPLAY_IDENTIFIER CalRegn02Rt04GroupA.CalibrationPorts.DampgHwTqX.Ary1D /end CHARACTERISTIC
/begin CHARACTERISTIC CalRegn02Rt04GroupA.DampgHwTqY.Ary1D "MICROSAR RTE" VAL_BLK 0x0 RTE_RL_UWORD 0 NO_COMPU_METHOD 0 65535 MATRIX_DIM 2 1 1 SYMBOL_LINK "Rte_CalprmRom_CalRegn02Rt04GroupA_DEFAULT_RTE_CALPRM_GROUP.DampgHwTqY_Ary1D" 0 DISPLAY_IDENTIFIER CalRegn02Rt04GroupA.CalibrationPorts.DampgHwTqY.Ary1D /end CHARACTERISTIC
/begin CHARACTERISTIC CalRegn02Rt04GroupA.DampgHydCoeff1ScaY.Ary1D "MICROSAR RTE" VAL_BLK 0x0 RTE_RL_UWORD 0 NO_COMPU_METHOD 0 65535 MATRIX_DIM 12 1 1 SYMBOL_LINK "Rte_CalprmRom_CalRegn02Rt04GroupA_DEFAULT_RTE_CALPRM_GROUP.DampgHydCoeff1ScaY_Ary1D" 0 DISPLAY_IDENTIFIER CalRegn02Rt04GroupA.CalibrationPorts.DampgHydCoeff1ScaY.Ary1D /end CHARACTERISTIC
/begin CHARACTERISTIC CalRegn02Rt04GroupA.DampgHydCoeff2ScaY.Ary1D "MICROSAR RTE" VAL_BLK 0x0 RTE_RL_UWORD 0 NO_COMPU_METHOD 0 65535 MATRIX_DIM 12 1 1 SYMBOL_LINK "Rte_CalprmRom_CalRegn02Rt04GroupA_DEFAULT_RTE_CALPRM_GROUP.DampgHydCoeff2ScaY_Ary1D" 0 DISPLAY_IDENTIFIER CalRegn02Rt04GroupA.CalibrationPorts.DampgHydCoeff2ScaY.Ary1D /end CHARACTERISTIC
/begin CHARACTERISTIC CalRegn02Rt04GroupA.DampgHydCoeff3ScaY.Ary1D "MICROSAR RTE" VAL_BLK 0x0 RTE_RL_UWORD 0 NO_COMPU_METHOD 0 65535 MATRIX_DIM 12 1 1 SYMBOL_LINK "Rte_CalprmRom_CalRegn02Rt04GroupA_DEFAULT_RTE_CALPRM_GROUP.DampgHydCoeff3ScaY_Ary1D" 0 DISPLAY_IDENTIFIER CalRegn02Rt04GroupA.CalibrationPorts.DampgHydCoeff3ScaY.Ary1D /end CHARACTERISTIC
/begin CHARACTERISTIC CalRegn02Rt04GroupA.DampgHydCoeff4ScaY.Ary1D "MICROSAR RTE" VAL_BLK 0x0 RTE_RL_UWORD 0 NO_COMPU_METHOD 0 65535 MATRIX_DIM 12 1 1 SYMBOL_LINK "Rte_CalprmRom_CalRegn02Rt04GroupA_DEFAULT_RTE_CALPRM_GROUP.DampgHydCoeff4ScaY_Ary1D" 0 DISPLAY_IDENTIFIER CalRegn02Rt04GroupA.CalibrationPorts.DampgHydCoeff4ScaY.Ary1D /end CHARACTERISTIC
/begin CHARACTERISTIC CalRegn02Rt04GroupA.DampgMotVelX.Ary2D "MICROSAR RTE" VAL_BLK 0x0 RTE_RL_UWORD 0 NO_COMPU_METHOD 0 65535 MATRIX_DIM 13 12 1 SYMBOL_LINK "Rte_CalprmRom_CalRegn02Rt04GroupA_DEFAULT_RTE_CALPRM_GROUP.DampgMotVelX_Ary2D" 0 DISPLAY_IDENTIFIER CalRegn02Rt04GroupA.CalibrationPorts.DampgMotVelX.Ary2D /end CHARACTERISTIC
/begin CHARACTERISTIC CalRegn02Rt04GroupA.DampgMotVelY.Ary2D "MICROSAR RTE" VAL_BLK 0x0 RTE_RL_UWORD 0 NO_COMPU_METHOD 0 65535 MATRIX_DIM 13 12 1 SYMBOL_LINK "Rte_CalprmRom_CalRegn02Rt04GroupA_DEFAULT_RTE_CALPRM_GROUP.DampgMotVelY_Ary2D" 0 DISPLAY_IDENTIFIER CalRegn02Rt04GroupA.CalibrationPorts.DampgMotVelY.Ary2D /end CHARACTERISTIC
/begin CHARACTERISTIC CalRegn02Rt04GroupA.HysCmpEffLossY.Ary1D "MICROSAR RTE" VAL_BLK 0x0 RTE_RL_UWORD 0 NO_COMPU_METHOD 0 65535 MATRIX_DIM 12 1 1 SYMBOL_LINK "Rte_CalprmRom_CalRegn02Rt04GroupA_DEFAULT_RTE_CALPRM_GROUP.HysCmpEffLossY_Ary1D" 0 DISPLAY_IDENTIFIER CalRegn02Rt04GroupA.CalibrationPorts.HysCmpEffLossY.Ary1D /end CHARACTERISTIC
/begin CHARACTERISTIC CalRegn02Rt04GroupA.HysCmpEffOffsY.Ary1D "MICROSAR RTE" VAL_BLK 0x0 RTE_RL_UWORD 0 NO_COMPU_METHOD 0 65535 MATRIX_DIM 12 1 1 SYMBOL_LINK "Rte_CalprmRom_CalRegn02Rt04GroupA_DEFAULT_RTE_CALPRM_GROUP.HysCmpEffOffsY_Ary1D" 0 DISPLAY_IDENTIFIER CalRegn02Rt04GroupA.CalibrationPorts.HysCmpEffOffsY.Ary1D /end CHARACTERISTIC
/begin CHARACTERISTIC CalRegn02Rt04GroupA.HysCmpFricWhlImbRejctnBlndX.Ary1D "MICROSAR RTE" VAL_BLK 0x0 RTE_RL_UWORD 0 NO_COMPU_METHOD 0 65535 MATRIX_DIM 6 1 1 SYMBOL_LINK "Rte_CalprmRom_CalRegn02Rt04GroupA_DEFAULT_RTE_CALPRM_GROUP.HysCmpFricWhlImbRejctnBlndX_Ary1D" 0 DISPLAY_IDENTIFIER CalRegn02Rt04GroupA.CalibrationPorts.HysCmpFricWhlImbRejctnBlndX.Ary1D /end CHARACTERISTIC
/begin CHARACTERISTIC CalRegn02Rt04GroupA.HysCmpFricWhlImbRejctnBlndY.Ary1D "MICROSAR RTE" VAL_BLK 0x0 RTE_RL_UWORD 0 NO_COMPU_METHOD 0 65535 MATRIX_DIM 6 1 1 SYMBOL_LINK "Rte_CalprmRom_CalRegn02Rt04GroupA_DEFAULT_RTE_CALPRM_GROUP.HysCmpFricWhlImbRejctnBlndY_Ary1D" 0 DISPLAY_IDENTIFIER CalRegn02Rt04GroupA.CalibrationPorts.HysCmpFricWhlImbRejctnBlndY.Ary1D /end CHARACTERISTIC
/begin CHARACTERISTIC CalRegn02Rt04GroupA.HysCmpFricWhlImbRejctnOffY.Ary1D "MICROSAR RTE" VAL_BLK 0x0 RTE_RL_UWORD 0 NO_COMPU_METHOD 0 65535 MATRIX_DIM 12 1 1 SYMBOL_LINK "Rte_CalprmRom_CalRegn02Rt04GroupA_DEFAULT_RTE_CALPRM_GROUP.HysCmpFricWhlImbRejctnOffY_Ary1D" 0 DISPLAY_IDENTIFIER CalRegn02Rt04GroupA.CalibrationPorts.HysCmpFricWhlImbRejctnOffY.Ary1D /end CHARACTERISTIC
/begin CHARACTERISTIC CalRegn02Rt04GroupA.HysCmpFricWhlImbRejctnOnY.Ary1D "MICROSAR RTE" VAL_BLK 0x0 RTE_RL_UWORD 0 NO_COMPU_METHOD 0 65535 MATRIX_DIM 12 1 1 SYMBOL_LINK "Rte_CalprmRom_CalRegn02Rt04GroupA_DEFAULT_RTE_CALPRM_GROUP.HysCmpFricWhlImbRejctnOnY_Ary1D" 0 DISPLAY_IDENTIFIER CalRegn02Rt04GroupA.CalibrationPorts.HysCmpFricWhlImbRejctnOnY.Ary1D /end CHARACTERISTIC
/begin CHARACTERISTIC CalRegn02Rt04GroupA.HysCmpHwTqScaX.Ary2D "MICROSAR RTE" VAL_BLK 0x0 RTE_RL_UWORD 0 NO_COMPU_METHOD 0 65535 MATRIX_DIM 8 12 1 SYMBOL_LINK "Rte_CalprmRom_CalRegn02Rt04GroupA_DEFAULT_RTE_CALPRM_GROUP.HysCmpHwTqScaX_Ary2D" 0 DISPLAY_IDENTIFIER CalRegn02Rt04GroupA.CalibrationPorts.HysCmpHwTqScaX.Ary2D /end CHARACTERISTIC
/begin CHARACTERISTIC CalRegn02Rt04GroupA.HysCmpHwTqScaY.Ary2D "MICROSAR RTE" VAL_BLK 0x0 RTE_RL_UWORD 0 NO_COMPU_METHOD 0 65535 MATRIX_DIM 8 12 1 SYMBOL_LINK "Rte_CalprmRom_CalRegn02Rt04GroupA_DEFAULT_RTE_CALPRM_GROUP.HysCmpHwTqScaY_Ary2D" 0 DISPLAY_IDENTIFIER CalRegn02Rt04GroupA.CalibrationPorts.HysCmpHwTqScaY.Ary2D /end CHARACTERISTIC
/begin CHARACTERISTIC CalRegn02Rt04GroupA.HysCmpHysSatnY.Ary1D "MICROSAR RTE" VAL_BLK 0x0 RTE_RL_UWORD 0 NO_COMPU_METHOD 0 65535 MATRIX_DIM 12 1 1 SYMBOL_LINK "Rte_CalprmRom_CalRegn02Rt04GroupA_DEFAULT_RTE_CALPRM_GROUP.HysCmpHysSatnY_Ary1D" 0 DISPLAY_IDENTIFIER CalRegn02Rt04GroupA.CalibrationPorts.HysCmpHysSatnY.Ary1D /end CHARACTERISTIC
/begin CHARACTERISTIC CalRegn02Rt04GroupA.HysCmpNegHysCmpScaX.Ary1D "MICROSAR RTE" VAL_BLK 0x0 RTE_RL_UWORD 0 NO_COMPU_METHOD 0 65535 MATRIX_DIM 5 1 1 SYMBOL_LINK "Rte_CalprmRom_CalRegn02Rt04GroupA_DEFAULT_RTE_CALPRM_GROUP.HysCmpNegHysCmpScaX_Ary1D" 0 DISPLAY_IDENTIFIER CalRegn02Rt04GroupA.CalibrationPorts.HysCmpNegHysCmpScaX.Ary1D /end CHARACTERISTIC
/begin CHARACTERISTIC CalRegn02Rt04GroupA.HysCmpNegHysCmpScaY.Ary1D "MICROSAR RTE" VAL_BLK 0x0 RTE_RL_UWORD 0 NO_COMPU_METHOD 0 65535 MATRIX_DIM 5 1 1 SYMBOL_LINK "Rte_CalprmRom_CalRegn02Rt04GroupA_DEFAULT_RTE_CALPRM_GROUP.HysCmpNegHysCmpScaY_Ary1D" 0 DISPLAY_IDENTIFIER CalRegn02Rt04GroupA.CalibrationPorts.HysCmpNegHysCmpScaY.Ary1D /end CHARACTERISTIC
/begin CHARACTERISTIC CalRegn02Rt04GroupA.HysCmpNegHysCmpX.Ary1D "MICROSAR RTE" VAL_BLK 0x0 RTE_RL_UWORD 0 NO_COMPU_METHOD 0 65535 MATRIX_DIM 8 1 1 SYMBOL_LINK "Rte_CalprmRom_CalRegn02Rt04GroupA_DEFAULT_RTE_CALPRM_GROUP.HysCmpNegHysCmpX_Ary1D" 0 DISPLAY_IDENTIFIER CalRegn02Rt04GroupA.CalibrationPorts.HysCmpNegHysCmpX.Ary1D /end CHARACTERISTIC
/begin CHARACTERISTIC CalRegn02Rt04GroupA.HysCmpNegHysCmpY.Ary1D "MICROSAR RTE" VAL_BLK 0x0 RTE_RL_UWORD 0 NO_COMPU_METHOD 0 65535 MATRIX_DIM 8 1 1 SYMBOL_LINK "Rte_CalprmRom_CalRegn02Rt04GroupA_DEFAULT_RTE_CALPRM_GROUP.HysCmpNegHysCmpY_Ary1D" 0 DISPLAY_IDENTIFIER CalRegn02Rt04GroupA.CalibrationPorts.HysCmpNegHysCmpY.Ary1D /end CHARACTERISTIC
/begin CHARACTERISTIC CalRegn02Rt04GroupA.HysCmpOutpLim.Val "MICROSAR RTE" VALUE 0x0 RTE_RL_FLOAT32_IEEE 0 NO_COMPU_METHOD -3.402823466e+38 3.402823466e+38 SYMBOL_LINK "Rte_CalprmRom_CalRegn02Rt04GroupA_DEFAULT_RTE_CALPRM_GROUP.HysCmpOutpLim_Val" 0 DISPLAY_IDENTIFIER CalRegn02Rt04GroupA.CalibrationPorts.HysCmpOutpLim.Val /end CHARACTERISTIC
/begin CHARACTERISTIC CalRegn02Rt04GroupA.HysCmpRevGain.Val "MICROSAR RTE" VALUE 0x0 RTE_RL_FLOAT32_IEEE 0 NO_COMPU_METHOD -3.402823466e+38 3.402823466e+38 SYMBOL_LINK "Rte_CalprmRom_CalRegn02Rt04GroupA_DEFAULT_RTE_CALPRM_GROUP.HysCmpRevGain_Val" 0 DISPLAY_IDENTIFIER CalRegn02Rt04GroupA.CalibrationPorts.HysCmpRevGain.Val /end CHARACTERISTIC
/begin CHARACTERISTIC CalRegn02Rt04GroupA.HysCmpRiseX.Ary1D "MICROSAR RTE" VAL_BLK 0x0 RTE_RL_UWORD 0 NO_COMPU_METHOD 0 65535 MATRIX_DIM 6 1 1 SYMBOL_LINK "Rte_CalprmRom_CalRegn02Rt04GroupA_DEFAULT_RTE_CALPRM_GROUP.HysCmpRiseX_Ary1D" 0 DISPLAY_IDENTIFIER CalRegn02Rt04GroupA.CalibrationPorts.HysCmpRiseX.Ary1D /end CHARACTERISTIC
/begin CHARACTERISTIC CalRegn02Rt04GroupA.HysCmpRiseY.Ary1D "MICROSAR RTE" VAL_BLK 0x0 RTE_RL_UWORD 0 NO_COMPU_METHOD 0 65535 MATRIX_DIM 6 1 1 SYMBOL_LINK "Rte_CalprmRom_CalRegn02Rt04GroupA_DEFAULT_RTE_CALPRM_GROUP.HysCmpRiseY_Ary1D" 0 DISPLAY_IDENTIFIER CalRegn02Rt04GroupA.CalibrationPorts.HysCmpRiseY.Ary1D /end CHARACTERISTIC
/begin CHARACTERISTIC CalRegn02Rt04GroupA.InertiaCmpVelAssiBasdDampgStatY.Ary1D "MICROSAR RTE" VAL_BLK 0x0 RTE_RL_UWORD 0 NO_COMPU_METHOD 0 65535 MATRIX_DIM 10 1 1 SYMBOL_LINK "Rte_CalprmRom_CalRegn02Rt04GroupA_DEFAULT_RTE_CALPRM_GROUP.InertiaCmpVelAssiBasdDampgStatY_Ary1D" 0 DISPLAY_IDENTIFIER CalRegn02Rt04GroupA.CalibrationPorts.InertiaCmpVelAssiBasdDampgStatY.Ary1D /end CHARACTERISTIC
/begin CHARACTERISTIC CalRegn02Rt04GroupA.InertiaCmpVelDampgFilFrq.Ary1D "MICROSAR RTE" VAL_BLK 0x0 RTE_RL_UWORD 0 NO_COMPU_METHOD 0 65535 MATRIX_DIM 12 1 1 SYMBOL_LINK "Rte_CalprmRom_CalRegn02Rt04GroupA_DEFAULT_RTE_CALPRM_GROUP.InertiaCmpVelDampgFilFrq_Ary1D" 0 DISPLAY_IDENTIFIER CalRegn02Rt04GroupA.CalibrationPorts.InertiaCmpVelDampgFilFrq.Ary1D /end CHARACTERISTIC
/begin CHARACTERISTIC CalRegn02Rt04GroupA.InertiaCmpVelDampgFilFrqWhlImbRejctnOn.Ary1D "MICROSAR RTE" VAL_BLK 0x0 RTE_RL_UWORD 0 NO_COMPU_METHOD 0 65535 MATRIX_DIM 12 1 1 SYMBOL_LINK "Rte_CalprmRom_CalRegn02Rt04GroupA_DEFAULT_RTE_CALPRM_GROUP.InertiaCmpVelDampgFilFrqWhlImbRejctnOn_Ary1D" 0 DISPLAY_IDENTIFIER CalRegn02Rt04GroupA.CalibrationPorts.InertiaCmpVelDampgFilFrqWhlImbRejctnOn.Ary1D /end CHARACTERISTIC
/begin CHARACTERISTIC CalRegn02Rt04GroupA.InertiaCmpVelDampgSpdBlndY.Ary1D "MICROSAR RTE" VAL_BLK 0x0 RTE_RL_UWORD 0 NO_COMPU_METHOD 0 65535 MATRIX_DIM 12 1 1 SYMBOL_LINK "Rte_CalprmRom_CalRegn02Rt04GroupA_DEFAULT_RTE_CALPRM_GROUP.InertiaCmpVelDampgSpdBlndY_Ary1D" 0 DISPLAY_IDENTIFIER CalRegn02Rt04GroupA.CalibrationPorts.InertiaCmpVelDampgSpdBlndY.Ary1D /end CHARACTERISTIC
/begin CHARACTERISTIC CalRegn02Rt04GroupA.InertiaCmpVelDampgWhlImbRejctnBlndX.Ary1D "MICROSAR RTE" VAL_BLK 0x0 RTE_RL_UWORD 0 NO_COMPU_METHOD 0 65535 MATRIX_DIM 5 1 1 SYMBOL_LINK "Rte_CalprmRom_CalRegn02Rt04GroupA_DEFAULT_RTE_CALPRM_GROUP.InertiaCmpVelDampgWhlImbRejctnBlndX_Ary1D" 0 DISPLAY_IDENTIFIER CalRegn02Rt04GroupA.CalibrationPorts.InertiaCmpVelDampgWhlImbRejctnBlndX.Ary1D /end CHARACTERISTIC
/begin CHARACTERISTIC CalRegn02Rt04GroupA.InertiaCmpVelDampgWhlImbRejctnBlndY.Ary1D "MICROSAR RTE" VAL_BLK 0x0 RTE_RL_UWORD 0 NO_COMPU_METHOD 0 65535 MATRIX_DIM 5 1 1 SYMBOL_LINK "Rte_CalprmRom_CalRegn02Rt04GroupA_DEFAULT_RTE_CALPRM_GROUP.InertiaCmpVelDampgWhlImbRejctnBlndY_Ary1D" 0 DISPLAY_IDENTIFIER CalRegn02Rt04GroupA.CalibrationPorts.InertiaCmpVelDampgWhlImbRejctnBlndY.Ary1D /end CHARACTERISTIC
/begin CHARACTERISTIC CalRegn02Rt04GroupB.EotProtnDampgVehSpdTbl.Ary1D "MICROSAR RTE" VAL_BLK 0x0 RTE_RL_UWORD 0 NO_COMPU_METHOD 0 65535 MATRIX_DIM 4 1 1 SYMBOL_LINK "Rte_CalprmRom_CalRegn02Rt04GroupB_DEFAULT_RTE_CALPRM_GROUP.EotProtnDampgVehSpdTbl_Ary1D" 0 DISPLAY_IDENTIFIER CalRegn02Rt04GroupB.CalibrationPorts.EotProtnDampgVehSpdTbl.Ary1D /end CHARACTERISTIC
/begin CHARACTERISTIC CalRegn02Rt04GroupB.EotProtnDeltaTqThd.Val "MICROSAR RTE" VALUE 0x0 RTE_RL_FLOAT32_IEEE 0 NO_COMPU_METHOD -3.402823466e+38 3.402823466e+38 SYMBOL_LINK "Rte_CalprmRom_CalRegn02Rt04GroupB_DEFAULT_RTE_CALPRM_GROUP.EotProtnDeltaTqThd_Val" 0 DISPLAY_IDENTIFIER CalRegn02Rt04GroupB.CalibrationPorts.EotProtnDeltaTqThd.Val /end CHARACTERISTIC
/begin CHARACTERISTIC CalRegn02Rt04GroupB.EotProtnEntrGainVehSpdTbl.Ary1D "MICROSAR RTE" VAL_BLK 0x0 RTE_RL_UWORD 0 NO_COMPU_METHOD 0 65535 MATRIX_DIM 5 1 1 SYMBOL_LINK "Rte_CalprmRom_CalRegn02Rt04GroupB_DEFAULT_RTE_CALPRM_GROUP.EotProtnEntrGainVehSpdTbl_Ary1D" 0 DISPLAY_IDENTIFIER CalRegn02Rt04GroupB.CalibrationPorts.EotProtnEntrGainVehSpdTbl.Ary1D /end CHARACTERISTIC
/begin CHARACTERISTIC CalRegn02Rt04GroupB.EotProtnEntrGainY.Ary2D "MICROSAR RTE" VAL_BLK 0x0 RTE_RL_UWORD 0 NO_COMPU_METHOD 0 65535 MATRIX_DIM 4 5 1 SYMBOL_LINK "Rte_CalprmRom_CalRegn02Rt04GroupB_DEFAULT_RTE_CALPRM_GROUP.EotProtnEntrGainY_Ary2D" 0 DISPLAY_IDENTIFIER CalRegn02Rt04GroupB.CalibrationPorts.EotProtnEntrGainY.Ary2D /end CHARACTERISTIC
/begin CHARACTERISTIC CalRegn02Rt04GroupB.EotProtnLoAuthyEntrGainY.Ary2D "MICROSAR RTE" VAL_BLK 0x0 RTE_RL_UWORD 0 NO_COMPU_METHOD 0 65535 MATRIX_DIM 4 5 1 SYMBOL_LINK "Rte_CalprmRom_CalRegn02Rt04GroupB_DEFAULT_RTE_CALPRM_GROUP.EotProtnLoAuthyEntrGainY_Ary2D" 0 DISPLAY_IDENTIFIER CalRegn02Rt04GroupB.CalibrationPorts.EotProtnLoAuthyEntrGainY.Ary2D /end CHARACTERISTIC
/begin CHARACTERISTIC CalRegn02Rt04GroupB.EotProtnMotSpdIncptY.Ary1D "MICROSAR RTE" VAL_BLK 0x0 RTE_RL_UWORD 0 NO_COMPU_METHOD 0 65535 MATRIX_DIM 2 1 1 SYMBOL_LINK "Rte_CalprmRom_CalRegn02Rt04GroupB_DEFAULT_RTE_CALPRM_GROUP.EotProtnMotSpdIncptY_Ary1D" 0 DISPLAY_IDENTIFIER CalRegn02Rt04GroupB.CalibrationPorts.EotProtnMotSpdIncptY.Ary1D /end CHARACTERISTIC
/begin CHARACTERISTIC CalRegn02Rt04GroupB.EotProtnNormDampgY.Ary2D "MICROSAR RTE" VAL_BLK 0x0 RTE_RL_UWORD 0 NO_COMPU_METHOD 0 65535 MATRIX_DIM 2 4 1 SYMBOL_LINK "Rte_CalprmRom_CalRegn02Rt04GroupB_DEFAULT_RTE_CALPRM_GROUP.EotProtnNormDampgY_Ary2D" 0 DISPLAY_IDENTIFIER CalRegn02Rt04GroupB.CalibrationPorts.EotProtnNormDampgY.Ary2D /end CHARACTERISTIC
/begin CHARACTERISTIC CalRegn02Rt04GroupB.EotProtnSoftEndStopAuthyThd.Val "MICROSAR RTE" VALUE 0x0 RTE_RL_FLOAT32_IEEE 0 NO_COMPU_METHOD -3.402823466e+38 3.402823466e+38 SYMBOL_LINK "Rte_CalprmRom_CalRegn02Rt04GroupB_DEFAULT_RTE_CALPRM_GROUP.EotProtnSoftEndStopAuthyThd_Val" 0 DISPLAY_IDENTIFIER CalRegn02Rt04GroupB.CalibrationPorts.EotProtnSoftEndStopAuthyThd.Val /end CHARACTERISTIC
/begin CHARACTERISTIC CalRegn02Rt04GroupB.RtnHwAgOffsCalcdX.Ary2D "MICROSAR RTE" VAL_BLK 0x0 RTE_RL_UWORD 0 NO_COMPU_METHOD 0 65535 MATRIX_DIM 16 9 1 SYMBOL_LINK "Rte_CalprmRom_CalRegn02Rt04GroupB_DEFAULT_RTE_CALPRM_GROUP.RtnHwAgOffsCalcdX_Ary2D" 0 DISPLAY_IDENTIFIER CalRegn02Rt04GroupB.CalibrationPorts.RtnHwAgOffsCalcdX.Ary2D /end CHARACTERISTIC
/begin CHARACTERISTIC CalRegn02Rt04GroupB.RtnHwAgOffsCalcdY.Ary2D "MICROSAR RTE" VAL_BLK 0x0 RTE_RL_UWORD 0 NO_COMPU_METHOD 0 65535 MATRIX_DIM 16 9 1 SYMBOL_LINK "Rte_CalprmRom_CalRegn02Rt04GroupB_DEFAULT_RTE_CALPRM_GROUP.RtnHwAgOffsCalcdY_Ary2D" 0 DISPLAY_IDENTIFIER CalRegn02Rt04GroupB.CalibrationPorts.RtnHwAgOffsCalcdY.Ary2D /end CHARACTERISTIC
/begin CHARACTERISTIC CalRegn02Rt04GroupB.RtnScaTqX.Ary2D "MICROSAR RTE" VAL_BLK 0x0 RTE_RL_UWORD 0 NO_COMPU_METHOD 0 65535 MATRIX_DIM 8 9 1 SYMBOL_LINK "Rte_CalprmRom_CalRegn02Rt04GroupB_DEFAULT_RTE_CALPRM_GROUP.RtnScaTqX_Ary2D" 0 DISPLAY_IDENTIFIER CalRegn02Rt04GroupB.CalibrationPorts.RtnScaTqX.Ary2D /end CHARACTERISTIC
/begin CHARACTERISTIC CalRegn02Rt04GroupB.RtnScaTqY.Ary2D "MICROSAR RTE" VAL_BLK 0x0 RTE_RL_UWORD 0 NO_COMPU_METHOD 0 65535 MATRIX_DIM 8 9 1 SYMBOL_LINK "Rte_CalprmRom_CalRegn02Rt04GroupB_DEFAULT_RTE_CALPRM_GROUP.RtnScaTqY_Ary2D" 0 DISPLAY_IDENTIFIER CalRegn02Rt04GroupB.CalibrationPorts.RtnScaTqY.Ary2D /end CHARACTERISTIC
/begin CHARACTERISTIC CalRegn02Rt04GroupB.RtnScaVelX.Ary2D "MICROSAR RTE" VAL_BLK 0x0 RTE_RL_UWORD 0 NO_COMPU_METHOD 0 65535 MATRIX_DIM 4 9 1 SYMBOL_LINK "Rte_CalprmRom_CalRegn02Rt04GroupB_DEFAULT_RTE_CALPRM_GROUP.RtnScaVelX_Ary2D" 0 DISPLAY_IDENTIFIER CalRegn02Rt04GroupB.CalibrationPorts.RtnScaVelX.Ary2D /end CHARACTERISTIC
/begin CHARACTERISTIC CalRegn02Rt04GroupB.RtnScaVelY.Ary2D "MICROSAR RTE" VAL_BLK 0x0 RTE_RL_UWORD 0 NO_COMPU_METHOD 0 65535 MATRIX_DIM 4 9 1 SYMBOL_LINK "Rte_CalprmRom_CalRegn02Rt04GroupB_DEFAULT_RTE_CALPRM_GROUP.RtnScaVelY_Ary2D" 0 DISPLAY_IDENTIFIER CalRegn02Rt04GroupB.CalibrationPorts.RtnScaVelY.Ary2D /end CHARACTERISTIC
/begin CHARACTERISTIC CalRegn02Rt04GroupB.RtnVehSpdSeln.Ary1D "MICROSAR RTE" VAL_BLK 0x0 RTE_RL_UWORD 0 NO_COMPU_METHOD 0 65535 MATRIX_DIM 9 1 1 SYMBOL_LINK "Rte_CalprmRom_CalRegn02Rt04GroupB_DEFAULT_RTE_CALPRM_GROUP.RtnVehSpdSeln_Ary1D" 0 DISPLAY_IDENTIFIER CalRegn02Rt04GroupB.CalibrationPorts.RtnVehSpdSeln.Ary1D /end CHARACTERISTIC
/begin CHARACTERISTIC CalRegn02Rt05GroupA.AssiHiFrqGainY.Ary2D "MICROSAR RTE" VAL_BLK 0x0 RTE_RL_UWORD 0 NO_COMPU_METHOD 0 65535 MATRIX_DIM 13 12 1 SYMBOL_LINK "Rte_CalprmRom_CalRegn02Rt05GroupA_DEFAULT_RTE_CALPRM_GROUP.AssiHiFrqGainY_Ary2D" 0 DISPLAY_IDENTIFIER CalRegn02Rt05GroupA.CalibrationPorts.AssiHiFrqGainY.Ary2D /end CHARACTERISTIC
/begin CHARACTERISTIC CalRegn02Rt05GroupA.AssiHiFrqHpFilFrqY.Ary1D "MICROSAR RTE" VAL_BLK 0x0 RTE_RL_UWORD 0 NO_COMPU_METHOD 0 65535 MATRIX_DIM 12 1 1 SYMBOL_LINK "Rte_CalprmRom_CalRegn02Rt05GroupA_DEFAULT_RTE_CALPRM_GROUP.AssiHiFrqHpFilFrqY_Ary1D" 0 DISPLAY_IDENTIFIER CalRegn02Rt05GroupA.CalibrationPorts.AssiHiFrqHpFilFrqY.Ary1D /end CHARACTERISTIC
/begin CHARACTERISTIC CalRegn02Rt05GroupA.AssiHiFrqTqWhlImbRejctnTqX.Ary2D "MICROSAR RTE" VAL_BLK 0x0 RTE_RL_UWORD 0 NO_COMPU_METHOD 0 65535 MATRIX_DIM 13 12 1 SYMBOL_LINK "Rte_CalprmRom_CalRegn02Rt05GroupA_DEFAULT_RTE_CALPRM_GROUP.AssiHiFrqTqWhlImbRejctnTqX_Ary2D" 0 DISPLAY_IDENTIFIER CalRegn02Rt05GroupA.CalibrationPorts.AssiHiFrqTqWhlImbRejctnTqX.Ary2D /end CHARACTERISTIC
/begin CHARACTERISTIC CalRegn02Rt05GroupA.AssiHiFrqTqX.Ary2D "MICROSAR RTE" VAL_BLK 0x0 RTE_RL_UWORD 0 NO_COMPU_METHOD 0 65535 MATRIX_DIM 13 12 1 SYMBOL_LINK "Rte_CalprmRom_CalRegn02Rt05GroupA_DEFAULT_RTE_CALPRM_GROUP.AssiHiFrqTqX_Ary2D" 0 DISPLAY_IDENTIFIER CalRegn02Rt05GroupA.CalibrationPorts.AssiHiFrqTqX.Ary2D /end CHARACTERISTIC
/begin CHARACTERISTIC CalRegn02Rt05GroupA.AssiHiFrqWhlImbRejctnBlndX.Ary2D "MICROSAR RTE" VAL_BLK 0x0 RTE_RL_UWORD 0 NO_COMPU_METHOD 0 65535 MATRIX_DIM 5 12 1 SYMBOL_LINK "Rte_CalprmRom_CalRegn02Rt05GroupA_DEFAULT_RTE_CALPRM_GROUP.AssiHiFrqWhlImbRejctnBlndX_Ary2D" 0 DISPLAY_IDENTIFIER CalRegn02Rt05GroupA.CalibrationPorts.AssiHiFrqWhlImbRejctnBlndX.Ary2D /end CHARACTERISTIC
/begin CHARACTERISTIC CalRegn02Rt05GroupA.AssiHiFrqWhlImbRejctnBlndY.Ary2D "MICROSAR RTE" VAL_BLK 0x0 RTE_RL_UWORD 0 NO_COMPU_METHOD 0 65535 MATRIX_DIM 5 12 1 SYMBOL_LINK "Rte_CalprmRom_CalRegn02Rt05GroupA_DEFAULT_RTE_CALPRM_GROUP.AssiHiFrqWhlImbRejctnBlndY_Ary2D" 0 DISPLAY_IDENTIFIER CalRegn02Rt05GroupA.CalibrationPorts.AssiHiFrqWhlImbRejctnBlndY.Ary2D /end CHARACTERISTIC
/begin CHARACTERISTIC CalRegn02Rt05GroupA.AssiHiFrqWhlImbRejctnGainY.Ary2D "MICROSAR RTE" VAL_BLK 0x0 RTE_RL_UWORD 0 NO_COMPU_METHOD 0 65535 MATRIX_DIM 13 12 1 SYMBOL_LINK "Rte_CalprmRom_CalRegn02Rt05GroupA_DEFAULT_RTE_CALPRM_GROUP.AssiHiFrqWhlImbRejctnGainY_Ary2D" 0 DISPLAY_IDENTIFIER CalRegn02Rt05GroupA.CalibrationPorts.AssiHiFrqWhlImbRejctnGainY.Ary2D /end CHARACTERISTIC
/begin CHARACTERISTIC CalRegn02Rt05GroupA.AssiMotTqWhlImbRejctnMaxX.Ary2D "MICROSAR RTE" VAL_BLK 0x0 RTE_RL_UWORD 0 NO_COMPU_METHOD 0 65535 MATRIX_DIM 20 12 1 SYMBOL_LINK "Rte_CalprmRom_CalRegn02Rt05GroupA_DEFAULT_RTE_CALPRM_GROUP.AssiMotTqWhlImbRejctnMaxX_Ary2D" 0 DISPLAY_IDENTIFIER CalRegn02Rt05GroupA.CalibrationPorts.AssiMotTqWhlImbRejctnMaxX.Ary2D /end CHARACTERISTIC
/begin CHARACTERISTIC CalRegn02Rt05GroupA.AssiMotTqWhlImbRejctnMaxY.Ary2D "MICROSAR RTE" VAL_BLK 0x0 RTE_RL_SWORD 0 NO_COMPU_METHOD -32768 32767 MATRIX_DIM 20 12 1 SYMBOL_LINK "Rte_CalprmRom_CalRegn02Rt05GroupA_DEFAULT_RTE_CALPRM_GROUP.AssiMotTqWhlImbRejctnMaxY_Ary2D" 0 DISPLAY_IDENTIFIER CalRegn02Rt05GroupA.CalibrationPorts.AssiMotTqWhlImbRejctnMaxY.Ary2D /end CHARACTERISTIC
/begin CHARACTERISTIC CalRegn02Rt05GroupA.AssiMotTqWhlImbRejctnMinX.Ary2D "MICROSAR RTE" VAL_BLK 0x0 RTE_RL_UWORD 0 NO_COMPU_METHOD 0 65535 MATRIX_DIM 20 12 1 SYMBOL_LINK "Rte_CalprmRom_CalRegn02Rt05GroupA_DEFAULT_RTE_CALPRM_GROUP.AssiMotTqWhlImbRejctnMinX_Ary2D" 0 DISPLAY_IDENTIFIER CalRegn02Rt05GroupA.CalibrationPorts.AssiMotTqWhlImbRejctnMinX.Ary2D /end CHARACTERISTIC
/begin CHARACTERISTIC CalRegn02Rt05GroupA.AssiMotTqWhlImbRejctnMinY.Ary2D "MICROSAR RTE" VAL_BLK 0x0 RTE_RL_SWORD 0 NO_COMPU_METHOD -32768 32767 MATRIX_DIM 20 12 1 SYMBOL_LINK "Rte_CalprmRom_CalRegn02Rt05GroupA_DEFAULT_RTE_CALPRM_GROUP.AssiMotTqWhlImbRejctnMinY_Ary2D" 0 DISPLAY_IDENTIFIER CalRegn02Rt05GroupA.CalibrationPorts.AssiMotTqWhlImbRejctnMinY.Ary2D /end CHARACTERISTIC
/begin CHARACTERISTIC CalRegn02Rt05GroupA.AssiWhlImbRejctnBlndScaX.Ary2D "MICROSAR RTE" VAL_BLK 0x0 RTE_RL_UWORD 0 NO_COMPU_METHOD 0 65535 MATRIX_DIM 5 12 1 SYMBOL_LINK "Rte_CalprmRom_CalRegn02Rt05GroupA_DEFAULT_RTE_CALPRM_GROUP.AssiWhlImbRejctnBlndScaX_Ary2D" 0 DISPLAY_IDENTIFIER CalRegn02Rt05GroupA.CalibrationPorts.AssiWhlImbRejctnBlndScaX.Ary2D /end CHARACTERISTIC
/begin CHARACTERISTIC CalRegn02Rt05GroupA.AssiWhlImbRejctnBlndScaY.Ary2D "MICROSAR RTE" VAL_BLK 0x0 RTE_RL_UWORD 0 NO_COMPU_METHOD 0 65535 MATRIX_DIM 5 12 1 SYMBOL_LINK "Rte_CalprmRom_CalRegn02Rt05GroupA_DEFAULT_RTE_CALPRM_GROUP.AssiWhlImbRejctnBlndScaY_Ary2D" 0 DISPLAY_IDENTIFIER CalRegn02Rt05GroupA.CalibrationPorts.AssiWhlImbRejctnBlndScaY.Ary2D /end CHARACTERISTIC
/begin CHARACTERISTIC CalRegn02Rt05GroupA.DampgHwTqX.Ary1D "MICROSAR RTE" VAL_BLK 0x0 RTE_RL_UWORD 0 NO_COMPU_METHOD 0 65535 MATRIX_DIM 2 1 1 SYMBOL_LINK "Rte_CalprmRom_CalRegn02Rt05GroupA_DEFAULT_RTE_CALPRM_GROUP.DampgHwTqX_Ary1D" 0 DISPLAY_IDENTIFIER CalRegn02Rt05GroupA.CalibrationPorts.DampgHwTqX.Ary1D /end CHARACTERISTIC
/begin CHARACTERISTIC CalRegn02Rt05GroupA.DampgHwTqY.Ary1D "MICROSAR RTE" VAL_BLK 0x0 RTE_RL_UWORD 0 NO_COMPU_METHOD 0 65535 MATRIX_DIM 2 1 1 SYMBOL_LINK "Rte_CalprmRom_CalRegn02Rt05GroupA_DEFAULT_RTE_CALPRM_GROUP.DampgHwTqY_Ary1D" 0 DISPLAY_IDENTIFIER CalRegn02Rt05GroupA.CalibrationPorts.DampgHwTqY.Ary1D /end CHARACTERISTIC
/begin CHARACTERISTIC CalRegn02Rt05GroupA.DampgHydCoeff1ScaY.Ary1D "MICROSAR RTE" VAL_BLK 0x0 RTE_RL_UWORD 0 NO_COMPU_METHOD 0 65535 MATRIX_DIM 12 1 1 SYMBOL_LINK "Rte_CalprmRom_CalRegn02Rt05GroupA_DEFAULT_RTE_CALPRM_GROUP.DampgHydCoeff1ScaY_Ary1D" 0 DISPLAY_IDENTIFIER CalRegn02Rt05GroupA.CalibrationPorts.DampgHydCoeff1ScaY.Ary1D /end CHARACTERISTIC
/begin CHARACTERISTIC CalRegn02Rt05GroupA.DampgHydCoeff2ScaY.Ary1D "MICROSAR RTE" VAL_BLK 0x0 RTE_RL_UWORD 0 NO_COMPU_METHOD 0 65535 MATRIX_DIM 12 1 1 SYMBOL_LINK "Rte_CalprmRom_CalRegn02Rt05GroupA_DEFAULT_RTE_CALPRM_GROUP.DampgHydCoeff2ScaY_Ary1D" 0 DISPLAY_IDENTIFIER CalRegn02Rt05GroupA.CalibrationPorts.DampgHydCoeff2ScaY.Ary1D /end CHARACTERISTIC
/begin CHARACTERISTIC CalRegn02Rt05GroupA.DampgHydCoeff3ScaY.Ary1D "MICROSAR RTE" VAL_BLK 0x0 RTE_RL_UWORD 0 NO_COMPU_METHOD 0 65535 MATRIX_DIM 12 1 1 SYMBOL_LINK "Rte_CalprmRom_CalRegn02Rt05GroupA_DEFAULT_RTE_CALPRM_GROUP.DampgHydCoeff3ScaY_Ary1D" 0 DISPLAY_IDENTIFIER CalRegn02Rt05GroupA.CalibrationPorts.DampgHydCoeff3ScaY.Ary1D /end CHARACTERISTIC
/begin CHARACTERISTIC CalRegn02Rt05GroupA.DampgHydCoeff4ScaY.Ary1D "MICROSAR RTE" VAL_BLK 0x0 RTE_RL_UWORD 0 NO_COMPU_METHOD 0 65535 MATRIX_DIM 12 1 1 SYMBOL_LINK "Rte_CalprmRom_CalRegn02Rt05GroupA_DEFAULT_RTE_CALPRM_GROUP.DampgHydCoeff4ScaY_Ary1D" 0 DISPLAY_IDENTIFIER CalRegn02Rt05GroupA.CalibrationPorts.DampgHydCoeff4ScaY.Ary1D /end CHARACTERISTIC
/begin CHARACTERISTIC CalRegn02Rt05GroupA.DampgMotVelX.Ary2D "MICROSAR RTE" VAL_BLK 0x0 RTE_RL_UWORD 0 NO_COMPU_METHOD 0 65535 MATRIX_DIM 13 12 1 SYMBOL_LINK "Rte_CalprmRom_CalRegn02Rt05GroupA_DEFAULT_RTE_CALPRM_GROUP.DampgMotVelX_Ary2D" 0 DISPLAY_IDENTIFIER CalRegn02Rt05GroupA.CalibrationPorts.DampgMotVelX.Ary2D /end CHARACTERISTIC
/begin CHARACTERISTIC CalRegn02Rt05GroupA.DampgMotVelY.Ary2D "MICROSAR RTE" VAL_BLK 0x0 RTE_RL_UWORD 0 NO_COMPU_METHOD 0 65535 MATRIX_DIM 13 12 1 SYMBOL_LINK "Rte_CalprmRom_CalRegn02Rt05GroupA_DEFAULT_RTE_CALPRM_GROUP.DampgMotVelY_Ary2D" 0 DISPLAY_IDENTIFIER CalRegn02Rt05GroupA.CalibrationPorts.DampgMotVelY.Ary2D /end CHARACTERISTIC
/begin CHARACTERISTIC CalRegn02Rt05GroupA.HysCmpEffLossY.Ary1D "MICROSAR RTE" VAL_BLK 0x0 RTE_RL_UWORD 0 NO_COMPU_METHOD 0 65535 MATRIX_DIM 12 1 1 SYMBOL_LINK "Rte_CalprmRom_CalRegn02Rt05GroupA_DEFAULT_RTE_CALPRM_GROUP.HysCmpEffLossY_Ary1D" 0 DISPLAY_IDENTIFIER CalRegn02Rt05GroupA.CalibrationPorts.HysCmpEffLossY.Ary1D /end CHARACTERISTIC
/begin CHARACTERISTIC CalRegn02Rt05GroupA.HysCmpEffOffsY.Ary1D "MICROSAR RTE" VAL_BLK 0x0 RTE_RL_UWORD 0 NO_COMPU_METHOD 0 65535 MATRIX_DIM 12 1 1 SYMBOL_LINK "Rte_CalprmRom_CalRegn02Rt05GroupA_DEFAULT_RTE_CALPRM_GROUP.HysCmpEffOffsY_Ary1D" 0 DISPLAY_IDENTIFIER CalRegn02Rt05GroupA.CalibrationPorts.HysCmpEffOffsY.Ary1D /end CHARACTERISTIC
/begin CHARACTERISTIC CalRegn02Rt05GroupA.HysCmpFricWhlImbRejctnBlndX.Ary1D "MICROSAR RTE" VAL_BLK 0x0 RTE_RL_UWORD 0 NO_COMPU_METHOD 0 65535 MATRIX_DIM 6 1 1 SYMBOL_LINK "Rte_CalprmRom_CalRegn02Rt05GroupA_DEFAULT_RTE_CALPRM_GROUP.HysCmpFricWhlImbRejctnBlndX_Ary1D" 0 DISPLAY_IDENTIFIER CalRegn02Rt05GroupA.CalibrationPorts.HysCmpFricWhlImbRejctnBlndX.Ary1D /end CHARACTERISTIC
/begin CHARACTERISTIC CalRegn02Rt05GroupA.HysCmpFricWhlImbRejctnBlndY.Ary1D "MICROSAR RTE" VAL_BLK 0x0 RTE_RL_UWORD 0 NO_COMPU_METHOD 0 65535 MATRIX_DIM 6 1 1 SYMBOL_LINK "Rte_CalprmRom_CalRegn02Rt05GroupA_DEFAULT_RTE_CALPRM_GROUP.HysCmpFricWhlImbRejctnBlndY_Ary1D" 0 DISPLAY_IDENTIFIER CalRegn02Rt05GroupA.CalibrationPorts.HysCmpFricWhlImbRejctnBlndY.Ary1D /end CHARACTERISTIC
/begin CHARACTERISTIC CalRegn02Rt05GroupA.HysCmpFricWhlImbRejctnOffY.Ary1D "MICROSAR RTE" VAL_BLK 0x0 RTE_RL_UWORD 0 NO_COMPU_METHOD 0 65535 MATRIX_DIM 12 1 1 SYMBOL_LINK "Rte_CalprmRom_CalRegn02Rt05GroupA_DEFAULT_RTE_CALPRM_GROUP.HysCmpFricWhlImbRejctnOffY_Ary1D" 0 DISPLAY_IDENTIFIER CalRegn02Rt05GroupA.CalibrationPorts.HysCmpFricWhlImbRejctnOffY.Ary1D /end CHARACTERISTIC
/begin CHARACTERISTIC CalRegn02Rt05GroupA.HysCmpFricWhlImbRejctnOnY.Ary1D "MICROSAR RTE" VAL_BLK 0x0 RTE_RL_UWORD 0 NO_COMPU_METHOD 0 65535 MATRIX_DIM 12 1 1 SYMBOL_LINK "Rte_CalprmRom_CalRegn02Rt05GroupA_DEFAULT_RTE_CALPRM_GROUP.HysCmpFricWhlImbRejctnOnY_Ary1D" 0 DISPLAY_IDENTIFIER CalRegn02Rt05GroupA.CalibrationPorts.HysCmpFricWhlImbRejctnOnY.Ary1D /end CHARACTERISTIC
/begin CHARACTERISTIC CalRegn02Rt05GroupA.HysCmpHwTqScaX.Ary2D "MICROSAR RTE" VAL_BLK 0x0 RTE_RL_UWORD 0 NO_COMPU_METHOD 0 65535 MATRIX_DIM 8 12 1 SYMBOL_LINK "Rte_CalprmRom_CalRegn02Rt05GroupA_DEFAULT_RTE_CALPRM_GROUP.HysCmpHwTqScaX_Ary2D" 0 DISPLAY_IDENTIFIER CalRegn02Rt05GroupA.CalibrationPorts.HysCmpHwTqScaX.Ary2D /end CHARACTERISTIC
/begin CHARACTERISTIC CalRegn02Rt05GroupA.HysCmpHwTqScaY.Ary2D "MICROSAR RTE" VAL_BLK 0x0 RTE_RL_UWORD 0 NO_COMPU_METHOD 0 65535 MATRIX_DIM 8 12 1 SYMBOL_LINK "Rte_CalprmRom_CalRegn02Rt05GroupA_DEFAULT_RTE_CALPRM_GROUP.HysCmpHwTqScaY_Ary2D" 0 DISPLAY_IDENTIFIER CalRegn02Rt05GroupA.CalibrationPorts.HysCmpHwTqScaY.Ary2D /end CHARACTERISTIC
/begin CHARACTERISTIC CalRegn02Rt05GroupA.HysCmpHysSatnY.Ary1D "MICROSAR RTE" VAL_BLK 0x0 RTE_RL_UWORD 0 NO_COMPU_METHOD 0 65535 MATRIX_DIM 12 1 1 SYMBOL_LINK "Rte_CalprmRom_CalRegn02Rt05GroupA_DEFAULT_RTE_CALPRM_GROUP.HysCmpHysSatnY_Ary1D" 0 DISPLAY_IDENTIFIER CalRegn02Rt05GroupA.CalibrationPorts.HysCmpHysSatnY.Ary1D /end CHARACTERISTIC
/begin CHARACTERISTIC CalRegn02Rt05GroupA.HysCmpNegHysCmpScaX.Ary1D "MICROSAR RTE" VAL_BLK 0x0 RTE_RL_UWORD 0 NO_COMPU_METHOD 0 65535 MATRIX_DIM 5 1 1 SYMBOL_LINK "Rte_CalprmRom_CalRegn02Rt05GroupA_DEFAULT_RTE_CALPRM_GROUP.HysCmpNegHysCmpScaX_Ary1D" 0 DISPLAY_IDENTIFIER CalRegn02Rt05GroupA.CalibrationPorts.HysCmpNegHysCmpScaX.Ary1D /end CHARACTERISTIC
/begin CHARACTERISTIC CalRegn02Rt05GroupA.HysCmpNegHysCmpScaY.Ary1D "MICROSAR RTE" VAL_BLK 0x0 RTE_RL_UWORD 0 NO_COMPU_METHOD 0 65535 MATRIX_DIM 5 1 1 SYMBOL_LINK "Rte_CalprmRom_CalRegn02Rt05GroupA_DEFAULT_RTE_CALPRM_GROUP.HysCmpNegHysCmpScaY_Ary1D" 0 DISPLAY_IDENTIFIER CalRegn02Rt05GroupA.CalibrationPorts.HysCmpNegHysCmpScaY.Ary1D /end CHARACTERISTIC
/begin CHARACTERISTIC CalRegn02Rt05GroupA.HysCmpNegHysCmpX.Ary1D "MICROSAR RTE" VAL_BLK 0x0 RTE_RL_UWORD 0 NO_COMPU_METHOD 0 65535 MATRIX_DIM 8 1 1 SYMBOL_LINK "Rte_CalprmRom_CalRegn02Rt05GroupA_DEFAULT_RTE_CALPRM_GROUP.HysCmpNegHysCmpX_Ary1D" 0 DISPLAY_IDENTIFIER CalRegn02Rt05GroupA.CalibrationPorts.HysCmpNegHysCmpX.Ary1D /end CHARACTERISTIC
/begin CHARACTERISTIC CalRegn02Rt05GroupA.HysCmpNegHysCmpY.Ary1D "MICROSAR RTE" VAL_BLK 0x0 RTE_RL_UWORD 0 NO_COMPU_METHOD 0 65535 MATRIX_DIM 8 1 1 SYMBOL_LINK "Rte_CalprmRom_CalRegn02Rt05GroupA_DEFAULT_RTE_CALPRM_GROUP.HysCmpNegHysCmpY_Ary1D" 0 DISPLAY_IDENTIFIER CalRegn02Rt05GroupA.CalibrationPorts.HysCmpNegHysCmpY.Ary1D /end CHARACTERISTIC
/begin CHARACTERISTIC CalRegn02Rt05GroupA.HysCmpOutpLim.Val "MICROSAR RTE" VALUE 0x0 RTE_RL_FLOAT32_IEEE 0 NO_COMPU_METHOD -3.402823466e+38 3.402823466e+38 SYMBOL_LINK "Rte_CalprmRom_CalRegn02Rt05GroupA_DEFAULT_RTE_CALPRM_GROUP.HysCmpOutpLim_Val" 0 DISPLAY_IDENTIFIER CalRegn02Rt05GroupA.CalibrationPorts.HysCmpOutpLim.Val /end CHARACTERISTIC
/begin CHARACTERISTIC CalRegn02Rt05GroupA.HysCmpRevGain.Val "MICROSAR RTE" VALUE 0x0 RTE_RL_FLOAT32_IEEE 0 NO_COMPU_METHOD -3.402823466e+38 3.402823466e+38 SYMBOL_LINK "Rte_CalprmRom_CalRegn02Rt05GroupA_DEFAULT_RTE_CALPRM_GROUP.HysCmpRevGain_Val" 0 DISPLAY_IDENTIFIER CalRegn02Rt05GroupA.CalibrationPorts.HysCmpRevGain.Val /end CHARACTERISTIC
/begin CHARACTERISTIC CalRegn02Rt05GroupA.HysCmpRiseX.Ary1D "MICROSAR RTE" VAL_BLK 0x0 RTE_RL_UWORD 0 NO_COMPU_METHOD 0 65535 MATRIX_DIM 6 1 1 SYMBOL_LINK "Rte_CalprmRom_CalRegn02Rt05GroupA_DEFAULT_RTE_CALPRM_GROUP.HysCmpRiseX_Ary1D" 0 DISPLAY_IDENTIFIER CalRegn02Rt05GroupA.CalibrationPorts.HysCmpRiseX.Ary1D /end CHARACTERISTIC
/begin CHARACTERISTIC CalRegn02Rt05GroupA.HysCmpRiseY.Ary1D "MICROSAR RTE" VAL_BLK 0x0 RTE_RL_UWORD 0 NO_COMPU_METHOD 0 65535 MATRIX_DIM 6 1 1 SYMBOL_LINK "Rte_CalprmRom_CalRegn02Rt05GroupA_DEFAULT_RTE_CALPRM_GROUP.HysCmpRiseY_Ary1D" 0 DISPLAY_IDENTIFIER CalRegn02Rt05GroupA.CalibrationPorts.HysCmpRiseY.Ary1D /end CHARACTERISTIC
/begin CHARACTERISTIC CalRegn02Rt05GroupA.InertiaCmpVelAssiBasdDampgStatY.Ary1D "MICROSAR RTE" VAL_BLK 0x0 RTE_RL_UWORD 0 NO_COMPU_METHOD 0 65535 MATRIX_DIM 10 1 1 SYMBOL_LINK "Rte_CalprmRom_CalRegn02Rt05GroupA_DEFAULT_RTE_CALPRM_GROUP.InertiaCmpVelAssiBasdDampgStatY_Ary1D" 0 DISPLAY_IDENTIFIER CalRegn02Rt05GroupA.CalibrationPorts.InertiaCmpVelAssiBasdDampgStatY.Ary1D /end CHARACTERISTIC
/begin CHARACTERISTIC CalRegn02Rt05GroupA.InertiaCmpVelDampgFilFrq.Ary1D "MICROSAR RTE" VAL_BLK 0x0 RTE_RL_UWORD 0 NO_COMPU_METHOD 0 65535 MATRIX_DIM 12 1 1 SYMBOL_LINK "Rte_CalprmRom_CalRegn02Rt05GroupA_DEFAULT_RTE_CALPRM_GROUP.InertiaCmpVelDampgFilFrq_Ary1D" 0 DISPLAY_IDENTIFIER CalRegn02Rt05GroupA.CalibrationPorts.InertiaCmpVelDampgFilFrq.Ary1D /end CHARACTERISTIC
/begin CHARACTERISTIC CalRegn02Rt05GroupA.InertiaCmpVelDampgFilFrqWhlImbRejctnOn.Ary1D "MICROSAR RTE" VAL_BLK 0x0 RTE_RL_UWORD 0 NO_COMPU_METHOD 0 65535 MATRIX_DIM 12 1 1 SYMBOL_LINK "Rte_CalprmRom_CalRegn02Rt05GroupA_DEFAULT_RTE_CALPRM_GROUP.InertiaCmpVelDampgFilFrqWhlImbRejctnOn_Ary1D" 0 DISPLAY_IDENTIFIER CalRegn02Rt05GroupA.CalibrationPorts.InertiaCmpVelDampgFilFrqWhlImbRejctnOn.Ary1D /end CHARACTERISTIC
/begin CHARACTERISTIC CalRegn02Rt05GroupA.InertiaCmpVelDampgSpdBlndY.Ary1D "MICROSAR RTE" VAL_BLK 0x0 RTE_RL_UWORD 0 NO_COMPU_METHOD 0 65535 MATRIX_DIM 12 1 1 SYMBOL_LINK "Rte_CalprmRom_CalRegn02Rt05GroupA_DEFAULT_RTE_CALPRM_GROUP.InertiaCmpVelDampgSpdBlndY_Ary1D" 0 DISPLAY_IDENTIFIER CalRegn02Rt05GroupA.CalibrationPorts.InertiaCmpVelDampgSpdBlndY.Ary1D /end CHARACTERISTIC
/begin CHARACTERISTIC CalRegn02Rt05GroupA.InertiaCmpVelDampgWhlImbRejctnBlndX.Ary1D "MICROSAR RTE" VAL_BLK 0x0 RTE_RL_UWORD 0 NO_COMPU_METHOD 0 65535 MATRIX_DIM 5 1 1 SYMBOL_LINK "Rte_CalprmRom_CalRegn02Rt05GroupA_DEFAULT_RTE_CALPRM_GROUP.InertiaCmpVelDampgWhlImbRejctnBlndX_Ary1D" 0 DISPLAY_IDENTIFIER CalRegn02Rt05GroupA.CalibrationPorts.InertiaCmpVelDampgWhlImbRejctnBlndX.Ary1D /end CHARACTERISTIC
/begin CHARACTERISTIC CalRegn02Rt05GroupA.InertiaCmpVelDampgWhlImbRejctnBlndY.Ary1D "MICROSAR RTE" VAL_BLK 0x0 RTE_RL_UWORD 0 NO_COMPU_METHOD 0 65535 MATRIX_DIM 5 1 1 SYMBOL_LINK "Rte_CalprmRom_CalRegn02Rt05GroupA_DEFAULT_RTE_CALPRM_GROUP.InertiaCmpVelDampgWhlImbRejctnBlndY_Ary1D" 0 DISPLAY_IDENTIFIER CalRegn02Rt05GroupA.CalibrationPorts.InertiaCmpVelDampgWhlImbRejctnBlndY.Ary1D /end CHARACTERISTIC
/begin CHARACTERISTIC CalRegn02Rt05GroupB.EotProtnDampgVehSpdTbl.Ary1D "MICROSAR RTE" VAL_BLK 0x0 RTE_RL_UWORD 0 NO_COMPU_METHOD 0 65535 MATRIX_DIM 4 1 1 SYMBOL_LINK "Rte_CalprmRom_CalRegn02Rt05GroupB_DEFAULT_RTE_CALPRM_GROUP.EotProtnDampgVehSpdTbl_Ary1D" 0 DISPLAY_IDENTIFIER CalRegn02Rt05GroupB.CalibrationPorts.EotProtnDampgVehSpdTbl.Ary1D /end CHARACTERISTIC
/begin CHARACTERISTIC CalRegn02Rt05GroupB.EotProtnDeltaTqThd.Val "MICROSAR RTE" VALUE 0x0 RTE_RL_FLOAT32_IEEE 0 NO_COMPU_METHOD -3.402823466e+38 3.402823466e+38 SYMBOL_LINK "Rte_CalprmRom_CalRegn02Rt05GroupB_DEFAULT_RTE_CALPRM_GROUP.EotProtnDeltaTqThd_Val" 0 DISPLAY_IDENTIFIER CalRegn02Rt05GroupB.CalibrationPorts.EotProtnDeltaTqThd.Val /end CHARACTERISTIC
/begin CHARACTERISTIC CalRegn02Rt05GroupB.EotProtnEntrGainVehSpdTbl.Ary1D "MICROSAR RTE" VAL_BLK 0x0 RTE_RL_UWORD 0 NO_COMPU_METHOD 0 65535 MATRIX_DIM 5 1 1 SYMBOL_LINK "Rte_CalprmRom_CalRegn02Rt05GroupB_DEFAULT_RTE_CALPRM_GROUP.EotProtnEntrGainVehSpdTbl_Ary1D" 0 DISPLAY_IDENTIFIER CalRegn02Rt05GroupB.CalibrationPorts.EotProtnEntrGainVehSpdTbl.Ary1D /end CHARACTERISTIC
/begin CHARACTERISTIC CalRegn02Rt05GroupB.EotProtnEntrGainY.Ary2D "MICROSAR RTE" VAL_BLK 0x0 RTE_RL_UWORD 0 NO_COMPU_METHOD 0 65535 MATRIX_DIM 4 5 1 SYMBOL_LINK "Rte_CalprmRom_CalRegn02Rt05GroupB_DEFAULT_RTE_CALPRM_GROUP.EotProtnEntrGainY_Ary2D" 0 DISPLAY_IDENTIFIER CalRegn02Rt05GroupB.CalibrationPorts.EotProtnEntrGainY.Ary2D /end CHARACTERISTIC
/begin CHARACTERISTIC CalRegn02Rt05GroupB.EotProtnLoAuthyEntrGainY.Ary2D "MICROSAR RTE" VAL_BLK 0x0 RTE_RL_UWORD 0 NO_COMPU_METHOD 0 65535 MATRIX_DIM 4 5 1 SYMBOL_LINK "Rte_CalprmRom_CalRegn02Rt05GroupB_DEFAULT_RTE_CALPRM_GROUP.EotProtnLoAuthyEntrGainY_Ary2D" 0 DISPLAY_IDENTIFIER CalRegn02Rt05GroupB.CalibrationPorts.EotProtnLoAuthyEntrGainY.Ary2D /end CHARACTERISTIC
/begin CHARACTERISTIC CalRegn02Rt05GroupB.EotProtnMotSpdIncptY.Ary1D "MICROSAR RTE" VAL_BLK 0x0 RTE_RL_UWORD 0 NO_COMPU_METHOD 0 65535 MATRIX_DIM 2 1 1 SYMBOL_LINK "Rte_CalprmRom_CalRegn02Rt05GroupB_DEFAULT_RTE_CALPRM_GROUP.EotProtnMotSpdIncptY_Ary1D" 0 DISPLAY_IDENTIFIER CalRegn02Rt05GroupB.CalibrationPorts.EotProtnMotSpdIncptY.Ary1D /end CHARACTERISTIC
/begin CHARACTERISTIC CalRegn02Rt05GroupB.EotProtnNormDampgY.Ary2D "MICROSAR RTE" VAL_BLK 0x0 RTE_RL_UWORD 0 NO_COMPU_METHOD 0 65535 MATRIX_DIM 2 4 1 SYMBOL_LINK "Rte_CalprmRom_CalRegn02Rt05GroupB_DEFAULT_RTE_CALPRM_GROUP.EotProtnNormDampgY_Ary2D" 0 DISPLAY_IDENTIFIER CalRegn02Rt05GroupB.CalibrationPorts.EotProtnNormDampgY.Ary2D /end CHARACTERISTIC
/begin CHARACTERISTIC CalRegn02Rt05GroupB.EotProtnSoftEndStopAuthyThd.Val "MICROSAR RTE" VALUE 0x0 RTE_RL_FLOAT32_IEEE 0 NO_COMPU_METHOD -3.402823466e+38 3.402823466e+38 SYMBOL_LINK "Rte_CalprmRom_CalRegn02Rt05GroupB_DEFAULT_RTE_CALPRM_GROUP.EotProtnSoftEndStopAuthyThd_Val" 0 DISPLAY_IDENTIFIER CalRegn02Rt05GroupB.CalibrationPorts.EotProtnSoftEndStopAuthyThd.Val /end CHARACTERISTIC
/begin CHARACTERISTIC CalRegn02Rt05GroupB.RtnHwAgOffsCalcdX.Ary2D "MICROSAR RTE" VAL_BLK 0x0 RTE_RL_UWORD 0 NO_COMPU_METHOD 0 65535 MATRIX_DIM 16 9 1 SYMBOL_LINK "Rte_CalprmRom_CalRegn02Rt05GroupB_DEFAULT_RTE_CALPRM_GROUP.RtnHwAgOffsCalcdX_Ary2D" 0 DISPLAY_IDENTIFIER CalRegn02Rt05GroupB.CalibrationPorts.RtnHwAgOffsCalcdX.Ary2D /end CHARACTERISTIC
/begin CHARACTERISTIC CalRegn02Rt05GroupB.RtnHwAgOffsCalcdY.Ary2D "MICROSAR RTE" VAL_BLK 0x0 RTE_RL_UWORD 0 NO_COMPU_METHOD 0 65535 MATRIX_DIM 16 9 1 SYMBOL_LINK "Rte_CalprmRom_CalRegn02Rt05GroupB_DEFAULT_RTE_CALPRM_GROUP.RtnHwAgOffsCalcdY_Ary2D" 0 DISPLAY_IDENTIFIER CalRegn02Rt05GroupB.CalibrationPorts.RtnHwAgOffsCalcdY.Ary2D /end CHARACTERISTIC
/begin CHARACTERISTIC CalRegn02Rt05GroupB.RtnScaTqX.Ary2D "MICROSAR RTE" VAL_BLK 0x0 RTE_RL_UWORD 0 NO_COMPU_METHOD 0 65535 MATRIX_DIM 8 9 1 SYMBOL_LINK "Rte_CalprmRom_CalRegn02Rt05GroupB_DEFAULT_RTE_CALPRM_GROUP.RtnScaTqX_Ary2D" 0 DISPLAY_IDENTIFIER CalRegn02Rt05GroupB.CalibrationPorts.RtnScaTqX.Ary2D /end CHARACTERISTIC
/begin CHARACTERISTIC CalRegn02Rt05GroupB.RtnScaTqY.Ary2D "MICROSAR RTE" VAL_BLK 0x0 RTE_RL_UWORD 0 NO_COMPU_METHOD 0 65535 MATRIX_DIM 8 9 1 SYMBOL_LINK "Rte_CalprmRom_CalRegn02Rt05GroupB_DEFAULT_RTE_CALPRM_GROUP.RtnScaTqY_Ary2D" 0 DISPLAY_IDENTIFIER CalRegn02Rt05GroupB.CalibrationPorts.RtnScaTqY.Ary2D /end CHARACTERISTIC
/begin CHARACTERISTIC CalRegn02Rt05GroupB.RtnScaVelX.Ary2D "MICROSAR RTE" VAL_BLK 0x0 RTE_RL_UWORD 0 NO_COMPU_METHOD 0 65535 MATRIX_DIM 4 9 1 SYMBOL_LINK "Rte_CalprmRom_CalRegn02Rt05GroupB_DEFAULT_RTE_CALPRM_GROUP.RtnScaVelX_Ary2D" 0 DISPLAY_IDENTIFIER CalRegn02Rt05GroupB.CalibrationPorts.RtnScaVelX.Ary2D /end CHARACTERISTIC
/begin CHARACTERISTIC CalRegn02Rt05GroupB.RtnScaVelY.Ary2D "MICROSAR RTE" VAL_BLK 0x0 RTE_RL_UWORD 0 NO_COMPU_METHOD 0 65535 MATRIX_DIM 4 9 1 SYMBOL_LINK "Rte_CalprmRom_CalRegn02Rt05GroupB_DEFAULT_RTE_CALPRM_GROUP.RtnScaVelY_Ary2D" 0 DISPLAY_IDENTIFIER CalRegn02Rt05GroupB.CalibrationPorts.RtnScaVelY.Ary2D /end CHARACTERISTIC
/begin CHARACTERISTIC CalRegn02Rt05GroupB.RtnVehSpdSeln.Ary1D "MICROSAR RTE" VAL_BLK 0x0 RTE_RL_UWORD 0 NO_COMPU_METHOD 0 65535 MATRIX_DIM 9 1 1 SYMBOL_LINK "Rte_CalprmRom_CalRegn02Rt05GroupB_DEFAULT_RTE_CALPRM_GROUP.RtnVehSpdSeln_Ary1D" 0 DISPLAY_IDENTIFIER CalRegn02Rt05GroupB.CalibrationPorts.RtnVehSpdSeln.Ary1D /end CHARACTERISTIC
/begin CHARACTERISTIC CmnMfgSrv.CmnMfgSrvSecuAcsAtmptTiOut.Val "MICROSAR RTE" VALUE 0x0 RTE_RL_UWORD 0 NO_COMPU_METHOD 0 65535 SYMBOL_LINK "Rte_CalprmRom_CalRegn01Cmn_DEFAULT_RTE_CALPRM_GROUP.CmnMfgSrvSecuAcsAtmptTiOut_Val" 0 DISPLAY_IDENTIFIER CmnMfgSrv.CalibrationPorts.CmnMfgSrvSecuAcsAtmptTiOut.Val /end CHARACTERISTIC
/begin CHARACTERISTIC CmnMfgSrv.CmnMfgSrvSecuAcsMaxNrAtmpt.Val "MICROSAR RTE" VALUE 0x0 RTE_RL_UBYTE 0 NO_COMPU_METHOD 0 255 SYMBOL_LINK "Rte_CalprmRom_CalRegn01Cmn_DEFAULT_RTE_CALPRM_GROUP.CmnMfgSrvSecuAcsMaxNrAtmpt_Val" 0 DISPLAY_IDENTIFIER CmnMfgSrv.CalibrationPorts.CmnMfgSrvSecuAcsMaxNrAtmpt.Val /end CHARACTERISTIC
/begin CHARACTERISTIC CmnMfgSrv.NvmIgnCntr_DefaultValue "MICROSAR RTE" VALUE 0x0 RTE_RL_ULONG 0 NO_COMPU_METHOD 0 4294967295 SYMBOL_LINK "Rte_CalprmRom_CmnMfgSrv_DEFAULT_RTE_CDATA_GROUP.NvmIgnCntr_DefaultValue" 0 DISPLAY_IDENTIFIER CmnMfgSrv.CalibrationParameters.NvmIgnCntr_DefaultValue /end CHARACTERISTIC
/begin CHARACTERISTIC CmnMfgSrv.NvmMfgEnaCntr_DefaultValue "MICROSAR RTE" VALUE 0x0 RTE_RL_UBYTE 0 NO_COMPU_METHOD 0 255 SYMBOL_LINK "Rte_CalprmRom_CmnMfgSrv_DEFAULT_RTE_CDATA_GROUP.NvmMfgEnaCntr_DefaultValue" 0 DISPLAY_IDENTIFIER CmnMfgSrv.CalibrationParameters.NvmMfgEnaCntr_DefaultValue /end CHARACTERISTIC
/begin CHARACTERISTIC CmnMfgSrv.NvmNxtrSeedKey_DefaultValue "MICROSAR RTE" VAL_BLK 0x0 RTE_RL_UBYTE 0 NO_COMPU_METHOD 0 255 MATRIX_DIM 10 1 1 SYMBOL_LINK "Rte_CalprmRom_CmnMfgSrv_DEFAULT_RTE_CDATA_GROUP.NvmNxtrSeedKey_DefaultValue" 0 DISPLAY_IDENTIFIER CmnMfgSrv.CalibrationParameters.NvmNxtrSeedKey_DefaultValue /end CHARACTERISTIC
/begin CHARACTERISTIC CmnMfgSrv.SeedKeyDft "MICROSAR RTE" VAL_BLK 0x0 RTE_RL_ULONG 0 NO_COMPU_METHOD 0 4294967295 MATRIX_DIM 2 1 1 SYMBOL_LINK "Rte_CalprmRom_CmnMfgSrv_DEFAULT_RTE_CDATA_GROUP.SeedKeyDft" 0 DISPLAY_IDENTIFIER CmnMfgSrv.CalibrationParameters.SeedKeyDft /end CHARACTERISTIC
/begin CHARACTERISTIC CmplncErr.CmplncErrHwAgNonLinCmplncDepTblY.Ary1D "MICROSAR RTE" VAL_BLK 0x0 RTE_RL_UWORD 0 NO_COMPU_METHOD 0 65535 MATRIX_DIM 6 1 1 SYMBOL_LINK "Rte_CalprmRom_CalRegn01Inin00_DEFAULT_RTE_CALPRM_GROUP.CmplncErrHwAgNonLinCmplncDepTblY_Ary1D" 0 DISPLAY_IDENTIFIER CmplncErr.CalibrationPorts.CmplncErrHwAgNonLinCmplncDepTblY.Ary1D /end CHARACTERISTIC
/begin CHARACTERISTIC CmplncErr.CmplncErrHwAgNonLinCmplncIndTblX.Ary1D "MICROSAR RTE" VAL_BLK 0x0 RTE_RL_UWORD 0 NO_COMPU_METHOD 0 65535 MATRIX_DIM 6 1 1 SYMBOL_LINK "Rte_CalprmRom_CalRegn01Inin00_DEFAULT_RTE_CALPRM_GROUP.CmplncErrHwAgNonLinCmplncIndTblX_Ary1D" 0 DISPLAY_IDENTIFIER CmplncErr.CalibrationPorts.CmplncErrHwAgNonLinCmplncIndTblX.Ary1D /end CHARACTERISTIC
/begin CHARACTERISTIC CmplncErr.CmplncErrMotAgNonLinCmplncDepTblY.Ary1D "MICROSAR RTE" VAL_BLK 0x0 RTE_RL_UWORD 0 NO_COMPU_METHOD 0 65535 MATRIX_DIM 6 1 1 SYMBOL_LINK "Rte_CalprmRom_CalRegn01Inin00_DEFAULT_RTE_CALPRM_GROUP.CmplncErrMotAgNonLinCmplncDepTblY_Ary1D" 0 DISPLAY_IDENTIFIER CmplncErr.CalibrationPorts.CmplncErrMotAgNonLinCmplncDepTblY.Ary1D /end CHARACTERISTIC
/begin CHARACTERISTIC CmplncErr.CmplncErrMotAgNonLinCmplncIndTblX.Ary1D "MICROSAR RTE" VAL_BLK 0x0 RTE_RL_UWORD 0 NO_COMPU_METHOD 0 65535 MATRIX_DIM 6 1 1 SYMBOL_LINK "Rte_CalprmRom_CalRegn01Inin00_DEFAULT_RTE_CALPRM_GROUP.CmplncErrMotAgNonLinCmplncIndTblX_Ary1D" 0 DISPLAY_IDENTIFIER CmplncErr.CalibrationPorts.CmplncErrMotAgNonLinCmplncIndTblX.Ary1D /end CHARACTERISTIC
/begin CHARACTERISTIC CurrMeasCorrln.CurrMeasCorrlnMaxErrCurr.Val "MICROSAR RTE" VALUE 0x0 RTE_RL_FLOAT32_IEEE 0 NO_COMPU_METHOD -3.402823466e+38 3.402823466e+38 SYMBOL_LINK "Rte_CalprmRom_CalRegn01Cmn_DEFAULT_RTE_CALPRM_GROUP.CurrMeasCorrlnMaxErrCurr_Val" 0 DISPLAY_IDENTIFIER CurrMeasCorrln.CalibrationPorts.CurrMeasCorrlnMaxErrCurr.Val /end CHARACTERISTIC
/begin CHARACTERISTIC CurrMeasCorrln.CurrMeasCorrlnMaxStallCntr.Val "MICROSAR RTE" VALUE 0x0 RTE_RL_UBYTE 0 NO_COMPU_METHOD 0 255 SYMBOL_LINK "Rte_CalprmRom_CalRegn01Cmn_DEFAULT_RTE_CALPRM_GROUP.CurrMeasCorrlnMaxStallCntr_Val" 0 DISPLAY_IDENTIFIER CurrMeasCorrln.CalibrationPorts.CurrMeasCorrlnMaxStallCntr.Val /end CHARACTERISTIC
/begin CHARACTERISTIC CurrMeasCorrln.CurrMeasCorrlnNtc0x04DFailStep.Val "MICROSAR RTE" VALUE 0x0 RTE_RL_UWORD 0 NO_COMPU_METHOD 0 65535 SYMBOL_LINK "Rte_CalprmRom_CalRegn01Cmn_DEFAULT_RTE_CALPRM_GROUP.CurrMeasCorrlnNtc0x04DFailStep_Val" 0 DISPLAY_IDENTIFIER CurrMeasCorrln.CalibrationPorts.CurrMeasCorrlnNtc0x04DFailStep.Val /end CHARACTERISTIC
/begin CHARACTERISTIC CurrMeasCorrln.CurrMeasCorrlnNtc0x04DPassStep.Val "MICROSAR RTE" VALUE 0x0 RTE_RL_UWORD 0 NO_COMPU_METHOD 0 65535 SYMBOL_LINK "Rte_CalprmRom_CalRegn01Cmn_DEFAULT_RTE_CALPRM_GROUP.CurrMeasCorrlnNtc0x04DPassStep_Val" 0 DISPLAY_IDENTIFIER CurrMeasCorrln.CalibrationPorts.CurrMeasCorrlnNtc0x04DPassStep.Val /end CHARACTERISTIC
/begin CHARACTERISTIC CustDiag.Did205ADft "MICROSAR RTE" VAL_BLK 0x0 RTE_RL_UBYTE 0 NO_COMPU_METHOD 0 255 MATRIX_DIM 2 1 1 SYMBOL_LINK "Rte_CalprmRom_CustDiag_DEFAULT_RTE_CDATA_GROUP.Did205ADft" 0 DISPLAY_IDENTIFIER CustDiag.CalibrationParameters.Did205ADft /end CHARACTERISTIC
/begin CHARACTERISTIC CustDiag.Did205BDft "MICROSAR RTE" VAL_BLK 0x0 RTE_RL_UBYTE 0 NO_COMPU_METHOD 0 255 MATRIX_DIM 2 1 1 SYMBOL_LINK "Rte_CalprmRom_CustDiag_DEFAULT_RTE_CDATA_GROUP.Did205BDft" 0 DISPLAY_IDENTIFIER CustDiag.CalibrationParameters.Did205BDft /end CHARACTERISTIC
/begin CHARACTERISTIC CustDiag.Did3003Dft "MICROSAR RTE" VAL_BLK 0x0 RTE_RL_UBYTE 0 NO_COMPU_METHOD 0 255 MATRIX_DIM 24 1 1 SYMBOL_LINK "Rte_CalprmRom_CustDiag_DEFAULT_RTE_CDATA_GROUP.Did3003Dft" 0 DISPLAY_IDENTIFIER CustDiag.CalibrationParameters.Did3003Dft /end CHARACTERISTIC
/begin CHARACTERISTIC CustDiag.Did301ADft "MICROSAR RTE" VAL_BLK 0x0 RTE_RL_UBYTE 0 NO_COMPU_METHOD 0 255 MATRIX_DIM 2 1 1 SYMBOL_LINK "Rte_CalprmRom_CustDiag_DEFAULT_RTE_CDATA_GROUP.Did301ADft" 0 DISPLAY_IDENTIFIER CustDiag.CalibrationParameters.Did301ADft /end CHARACTERISTIC
/begin CHARACTERISTIC CustDiag.Did630FChkDft "MICROSAR RTE" VALUE 0x0 RTE_RL_BOOLEAN 0 RTE_CM_BOOLEAN 0 255 SYMBOL_LINK "Rte_CalprmRom_CustDiag_DEFAULT_RTE_CDATA_GROUP.Did630FChkDft" 0 DISPLAY_IDENTIFIER CustDiag.CalibrationParameters.Did630FChkDft /end CHARACTERISTIC
/begin CHARACTERISTIC CustDiag.Did630FDft "MICROSAR RTE" VAL_BLK 0x0 RTE_RL_UBYTE 0 NO_COMPU_METHOD 0 255 MATRIX_DIM 24 1 1 SYMBOL_LINK "Rte_CalprmRom_CustDiag_DEFAULT_RTE_CDATA_GROUP.Did630FDft" 0 DISPLAY_IDENTIFIER CustDiag.CalibrationParameters.Did630FDft /end CHARACTERISTIC
/begin CHARACTERISTIC CustDiag.DidDE00Dft "MICROSAR RTE" VAL_BLK 0x0 RTE_RL_UBYTE 0 NO_COMPU_METHOD 0 255 MATRIX_DIM 24 1 1 SYMBOL_LINK "Rte_CalprmRom_CustDiag_DEFAULT_RTE_CDATA_GROUP.DidDE00Dft" 0 DISPLAY_IDENTIFIER CustDiag.CalibrationParameters.DidDE00Dft /end CHARACTERISTIC
/begin CHARACTERISTIC CustDiag.DidDE01Dft "MICROSAR RTE" VAL_BLK 0x0 RTE_RL_UBYTE 0 NO_COMPU_METHOD 0 255 MATRIX_DIM 24 1 1 SYMBOL_LINK "Rte_CalprmRom_CustDiag_DEFAULT_RTE_CDATA_GROUP.DidDE01Dft" 0 DISPLAY_IDENTIFIER CustDiag.CalibrationParameters.DidDE01Dft /end CHARACTERISTIC
/begin CHARACTERISTIC CustDiag.DidDE02Dft "MICROSAR RTE" VAL_BLK 0x0 RTE_RL_UBYTE 0 NO_COMPU_METHOD 0 255 MATRIX_DIM 24 1 1 SYMBOL_LINK "Rte_CalprmRom_CustDiag_DEFAULT_RTE_CDATA_GROUP.DidDE02Dft" 0 DISPLAY_IDENTIFIER CustDiag.CalibrationParameters.DidDE02Dft /end CHARACTERISTIC
/begin CHARACTERISTIC CustDiag.DidDE03Dft "MICROSAR RTE" VAL_BLK 0x0 RTE_RL_UBYTE 0 NO_COMPU_METHOD 0 255 MATRIX_DIM 64 1 1 SYMBOL_LINK "Rte_CalprmRom_CustDiag_DEFAULT_RTE_CDATA_GROUP.DidDE03Dft" 0 DISPLAY_IDENTIFIER CustDiag.CalibrationParameters.DidDE03Dft /end CHARACTERISTIC
/begin CHARACTERISTIC CustDiag.DidDE04Dft "MICROSAR RTE" VAL_BLK 0x0 RTE_RL_UBYTE 0 NO_COMPU_METHOD 0 255 MATRIX_DIM 2 1 1 SYMBOL_LINK "Rte_CalprmRom_CustDiag_DEFAULT_RTE_CDATA_GROUP.DidDE04Dft" 0 DISPLAY_IDENTIFIER CustDiag.CalibrationParameters.DidDE04Dft /end CHARACTERISTIC
/begin CHARACTERISTIC CustDiag.DidDE05Dft "MICROSAR RTE" VAL_BLK 0x0 RTE_RL_UBYTE 0 NO_COMPU_METHOD 0 255 MATRIX_DIM 24 1 1 SYMBOL_LINK "Rte_CalprmRom_CustDiag_DEFAULT_RTE_CDATA_GROUP.DidDE05Dft" 0 DISPLAY_IDENTIFIER CustDiag.CalibrationParameters.DidDE05Dft /end CHARACTERISTIC
/begin MEASUREMENT CmnMfgSrv.AssiLnrGain.Val "MICROSAR RTE" FLOAT32_IEEE NO_COMPU_METHOD 0 0 -3.402823466e+38 3.402823466e+38 ECU_ADDRESS 0 SYMBOL_LINK "Rte_CmnMfgSrv_AssiLnrGain_Val" 0 DISPLAY_IDENTIFIER CmnMfgSrv.SenderPorts.AssiLnrGain.Val /end MEASUREMENT
/begin MEASUREMENT CmnMfgSrv.AssiLnrGainEna.Logl "MICROSAR RTE" UBYTE RTE_CM_BOOLEAN 0 0 0 255 ECU_ADDRESS 0 SYMBOL_LINK "Rte_CmnMfgSrv_AssiLnrGainEna_Logl" 0 DISPLAY_IDENTIFIER CmnMfgSrv.SenderPorts.AssiLnrGainEna.Logl /end MEASUREMENT
/begin MEASUREMENT CmnMfgSrv.AssiMechTEstimnDi.Logl "MICROSAR RTE" UBYTE RTE_CM_BOOLEAN 0 0 0 255 ECU_ADDRESS 0 SYMBOL_LINK "Rte_CmnMfgSrv_AssiMechTEstimnDi_Logl" 0 DISPLAY_IDENTIFIER CmnMfgSrv.SenderPorts.AssiMechTEstimnDi.Logl /end MEASUREMENT
/begin MEASUREMENT CmnMfgSrv.BrdgVltg.Val "MICROSAR RTE" FLOAT32_IEEE NO_COMPU_METHOD 0 0 -3.402823466e+38 3.402823466e+38 ECU_ADDRESS 0 SYMBOL_LINK "Rte_BattVltg_BrdgVltg_Val" 0 DISPLAY_IDENTIFIER CmnMfgSrv.ReceiverPorts.BrdgVltg.Val /end MEASUREMENT
/begin MEASUREMENT CmnMfgSrv.CcaHwPartNr "MICROSAR RTE" UBYTE NO_COMPU_METHOD 0 0 0 255 MATRIX_DIM 20 1 1 ECU_ADDRESS 0 SYMBOL_LINK "Rte_CmnMfgSrv_CcaHwPartNr" 0 DISPLAY_IDENTIFIER CmnMfgSrv.PerInstanceMemories.CcaHwPartNr /end MEASUREMENT
/begin MEASUREMENT CmnMfgSrv.CcaSerlNr "MICROSAR RTE" UBYTE NO_COMPU_METHOD 0 0 0 255 MATRIX_DIM 20 1 1 ECU_ADDRESS 0 SYMBOL_LINK "Rte_CmnMfgSrv_CcaSerlNr" 0 DISPLAY_IDENTIFIER CmnMfgSrv.PerInstanceMemories.CcaSerlNr /end MEASUREMENT
/begin MEASUREMENT CmnMfgSrv.DampgCmdBasDi.Logl "MICROSAR RTE" UBYTE RTE_CM_BOOLEAN 0 0 0 255 ECU_ADDRESS 0 SYMBOL_LINK "Rte_CmnMfgSrv_DampgCmdBasDi_Logl" 0 DISPLAY_IDENTIFIER CmnMfgSrv.SenderPorts.DampgCmdBasDi.Logl /end MEASUREMENT
/begin MEASUREMENT CmnMfgSrv.DiAssiMechTEstimn "MICROSAR RTE" UBYTE RTE_CM_BOOLEAN 0 0 0 255 ECU_ADDRESS 0 SYMBOL_LINK "Rte_CmnMfgSrv_DiAssiMechTEstimn" 0 DISPLAY_IDENTIFIER CmnMfgSrv.PerInstanceMemories.DiAssiMechTEstimn /end MEASUREMENT
/begin MEASUREMENT CmnMfgSrv.DiDampg "MICROSAR RTE" UBYTE RTE_CM_BOOLEAN 0 0 0 255 ECU_ADDRESS 0 SYMBOL_LINK "Rte_CmnMfgSrv_DiDampg" 0 DISPLAY_IDENTIFIER CmnMfgSrv.PerInstanceMemories.DiDampg /end MEASUREMENT
/begin MEASUREMENT CmnMfgSrv.DiDutyCycThermProtn "MICROSAR RTE" UBYTE RTE_CM_BOOLEAN 0 0 0 255 ECU_ADDRESS 0 SYMBOL_LINK "Rte_CmnMfgSrv_DiDutyCycThermProtn" 0 DISPLAY_IDENTIFIER CmnMfgSrv.PerInstanceMemories.DiDutyCycThermProtn /end MEASUREMENT
/begin MEASUREMENT CmnMfgSrv.DiEotProtn "MICROSAR RTE" UBYTE RTE_CM_BOOLEAN 0 0 0 255 ECU_ADDRESS 0 SYMBOL_LINK "Rte_CmnMfgSrv_DiEotProtn" 0 DISPLAY_IDENTIFIER CmnMfgSrv.PerInstanceMemories.DiEotProtn /end MEASUREMENT
/begin MEASUREMENT CmnMfgSrv.DiHysCmp "MICROSAR RTE" UBYTE RTE_CM_BOOLEAN 0 0 0 255 ECU_ADDRESS 0 SYMBOL_LINK "Rte_CmnMfgSrv_DiHysCmp" 0 DISPLAY_IDENTIFIER CmnMfgSrv.PerInstanceMemories.DiHysCmp /end MEASUREMENT
/begin MEASUREMENT CmnMfgSrv.DiInertiaCmp "MICROSAR RTE" UBYTE RTE_CM_BOOLEAN 0 0 0 255 ECU_ADDRESS 0 SYMBOL_LINK "Rte_CmnMfgSrv_DiInertiaCmp" 0 DISPLAY_IDENTIFIER CmnMfgSrv.PerInstanceMemories.DiInertiaCmp /end MEASUREMENT
/begin MEASUREMENT CmnMfgSrv.DiLoaSca "MICROSAR RTE" UBYTE RTE_CM_BOOLEAN 0 0 0 255 ECU_ADDRESS 0 SYMBOL_LINK "Rte_CmnMfgSrv_DiLoaSca" 0 DISPLAY_IDENTIFIER CmnMfgSrv.PerInstanceMemories.DiLoaSca /end MEASUREMENT
/begin MEASUREMENT CmnMfgSrv.DiPullCmpActvCmd "MICROSAR RTE" UBYTE RTE_CM_BOOLEAN 0 0 0 255 ECU_ADDRESS 0 SYMBOL_LINK "Rte_CmnMfgSrv_DiPullCmpActvCmd" 0 DISPLAY_IDENTIFIER CmnMfgSrv.PerInstanceMemories.DiPullCmpActvCmd /end MEASUREMENT
/begin MEASUREMENT CmnMfgSrv.DiPullCmpActvLrng "MICROSAR RTE" UBYTE RTE_CM_BOOLEAN 0 0 0 255 ECU_ADDRESS 0 SYMBOL_LINK "Rte_CmnMfgSrv_DiPullCmpActvLrng" 0 DISPLAY_IDENTIFIER CmnMfgSrv.PerInstanceMemories.DiPullCmpActvLrng /end MEASUREMENT
/begin MEASUREMENT CmnMfgSrv.DiRestore "MICROSAR RTE" UBYTE NO_COMPU_METHOD 0 0 0 255 MATRIX_DIM 8 1 1 ECU_ADDRESS 0 SYMBOL_LINK "Rte_CmnMfgSrv_DiRestore" 0 DISPLAY_IDENTIFIER CmnMfgSrv.PerInstanceMemories.DiRestore /end MEASUREMENT
/begin MEASUREMENT CmnMfgSrv.DiRtn "MICROSAR RTE" UBYTE RTE_CM_BOOLEAN 0 0 0 255 ECU_ADDRESS 0 SYMBOL_LINK "Rte_CmnMfgSrv_DiRtn" 0 DISPLAY_IDENTIFIER CmnMfgSrv.PerInstanceMemories.DiRtn /end MEASUREMENT
/begin MEASUREMENT CmnMfgSrv.DiStallMotTqLim "MICROSAR RTE" UBYTE RTE_CM_BOOLEAN 0 0 0 255 ECU_ADDRESS 0 SYMBOL_LINK "Rte_CmnMfgSrv_DiStallMotTqLim" 0 DISPLAY_IDENTIFIER CmnMfgSrv.PerInstanceMemories.DiStallMotTqLim /end MEASUREMENT
/begin MEASUREMENT CmnMfgSrv.DiSysFricLrng "MICROSAR RTE" UBYTE RTE_CM_BOOLEAN 0 0 0 255 ECU_ADDRESS 0 SYMBOL_LINK "Rte_CmnMfgSrv_DiSysFricLrng" 0 DISPLAY_IDENTIFIER CmnMfgSrv.PerInstanceMemories.DiSysFricLrng /end MEASUREMENT
/begin MEASUREMENT CmnMfgSrv.DiSysMotTqCmdRampRate "MICROSAR RTE" UBYTE RTE_CM_BOOLEAN 0 0 0 255 ECU_ADDRESS 0 SYMBOL_LINK "Rte_CmnMfgSrv_DiSysMotTqCmdRampRate" 0 DISPLAY_IDENTIFIER CmnMfgSrv.PerInstanceMemories.DiSysMotTqCmdRampRate /end MEASUREMENT
/begin MEASUREMENT CmnMfgSrv.DutyCycThermProtnDi.Logl "MICROSAR RTE" UBYTE RTE_CM_BOOLEAN 0 0 0 255 ECU_ADDRESS 0 SYMBOL_LINK "Rte_CmnMfgSrv_DutyCycThermProtnDi_Logl" 0 DISPLAY_IDENTIFIER CmnMfgSrv.SenderPorts.DutyCycThermProtnDi.Logl /end MEASUREMENT
/begin MEASUREMENT CmnMfgSrv.EcuTFild.Val "MICROSAR RTE" FLOAT32_IEEE NO_COMPU_METHOD 0 0 -3.402823466e+38 3.402823466e+38 ECU_ADDRESS 0 SYMBOL_LINK "Rte_EcuTMeas_EcuTFild_Val" 0 DISPLAY_IDENTIFIER CmnMfgSrv.ReceiverPorts.EcuTFild.Val /end MEASUREMENT
/begin MEASUREMENT CmnMfgSrv.EotProtnDi.Logl "MICROSAR RTE" UBYTE RTE_CM_BOOLEAN 0 0 0 255 ECU_ADDRESS 0 SYMBOL_LINK "Rte_CmnMfgSrv_EotProtnDi_Logl" 0 DISPLAY_IDENTIFIER CmnMfgSrv.SenderPorts.EotProtnDi.Logl /end MEASUREMENT
/begin MEASUREMENT CmnMfgSrv.EpsSysSerlNr "MICROSAR RTE" UBYTE NO_COMPU_METHOD 0 0 0 255 MATRIX_DIM 20 1 1 ECU_ADDRESS 0 SYMBOL_LINK "Rte_CmnMfgSrv_EpsSysSerlNr" 0 DISPLAY_IDENTIFIER CmnMfgSrv.PerInstanceMemories.EpsSysSerlNr /end MEASUREMENT
/begin MEASUREMENT CmnMfgSrv.FricLrngDi.Logl "MICROSAR RTE" UBYTE RTE_CM_BOOLEAN 0 0 0 255 ECU_ADDRESS 0 SYMBOL_LINK "Rte_CmnMfgSrv_FricLrngDi_Logl" 0 DISPLAY_IDENTIFIER CmnMfgSrv.SenderPorts.FricLrngDi.Logl /end MEASUREMENT
/begin MEASUREMENT CmnMfgSrv.HwAg.Val "MICROSAR RTE" FLOAT32_IEEE NO_COMPU_METHOD 0 0 -3.402823466e+38 3.402823466e+38 ECU_ADDRESS 0 SYMBOL_LINK "Rte_HwAgSysArbn_HwAgFinal_Val" 0 DISPLAY_IDENTIFIER CmnMfgSrv.ReceiverPorts.HwAg.Val /end MEASUREMENT
/begin MEASUREMENT CmnMfgSrv.HwAg0.Val "MICROSAR RTE" FLOAT32_IEEE NO_COMPU_METHOD 0 0 -3.402823466e+38 3.402823466e+38 ECU_ADDRESS 0 SYMBOL_LINK "Rte_CmnMfgSrv_HwAg0_Val" 0 DISPLAY_IDENTIFIER CmnMfgSrv.ReceiverPorts.HwAg0.Val /end MEASUREMENT
/begin MEASUREMENT CmnMfgSrv.HwAg1.Val "MICROSAR RTE" FLOAT32_IEEE NO_COMPU_METHOD 0 0 -3.402823466e+38 3.402823466e+38 ECU_ADDRESS 0 SYMBOL_LINK "Rte_HwAg1Meas_HwAg1_Val" 0 DISPLAY_IDENTIFIER CmnMfgSrv.ReceiverPorts.HwAg1.Val /end MEASUREMENT
/begin MEASUREMENT CmnMfgSrv.HwTq.Val "MICROSAR RTE" FLOAT32_IEEE NO_COMPU_METHOD 0 0 -3.402823466e+38 3.402823466e+38 ECU_ADDRESS 0 SYMBOL_LINK "Rte_ImcSigArbn_HwTqImcCorrd_Val" 0 DISPLAY_IDENTIFIER CmnMfgSrv.ReceiverPorts.HwTq.Val /end MEASUREMENT
/begin MEASUREMENT CmnMfgSrv.HwTq0.Val "MICROSAR RTE" FLOAT32_IEEE NO_COMPU_METHOD 0 0 -3.402823466e+38 3.402823466e+38 ECU_ADDRESS 0 SYMBOL_LINK "Rte_CDD_HwTq8Meas_HwTq8_Val" 0 DISPLAY_IDENTIFIER CmnMfgSrv.ReceiverPorts.HwTq0.Val /end MEASUREMENT
/begin MEASUREMENT CmnMfgSrv.HwTq1.Val "MICROSAR RTE" FLOAT32_IEEE NO_COMPU_METHOD 0 0 -3.402823466e+38 3.402823466e+38 ECU_ADDRESS 0 SYMBOL_LINK "Rte_CDD_HwTq1Meas_HwTq1_Val" 0 DISPLAY_IDENTIFIER CmnMfgSrv.ReceiverPorts.HwTq1.Val /end MEASUREMENT
/begin MEASUREMENT CmnMfgSrv.HwTq2.Val "MICROSAR RTE" FLOAT32_IEEE NO_COMPU_METHOD 0 0 -3.402823466e+38 3.402823466e+38 ECU_ADDRESS 0 SYMBOL_LINK "Rte_HwTq9Meas_HwTq9_Val" 0 DISPLAY_IDENTIFIER CmnMfgSrv.ReceiverPorts.HwTq2.Val /end MEASUREMENT
/begin MEASUREMENT CmnMfgSrv.HwTq3.Val "MICROSAR RTE" FLOAT32_IEEE NO_COMPU_METHOD 0 0 -3.402823466e+38 3.402823466e+38 ECU_ADDRESS 0 SYMBOL_LINK "Rte_HwTq10Meas_HwTq10_Val" 0 DISPLAY_IDENTIFIER CmnMfgSrv.ReceiverPorts.HwTq3.Val /end MEASUREMENT
/begin MEASUREMENT CmnMfgSrv.HysCmpCmdDi.Logl "MICROSAR RTE" UBYTE RTE_CM_BOOLEAN 0 0 0 255 ECU_ADDRESS 0 SYMBOL_LINK "Rte_CmnMfgSrv_HysCmpCmdDi_Logl" 0 DISPLAY_IDENTIFIER CmnMfgSrv.SenderPorts.HysCmpCmdDi.Logl /end MEASUREMENT
/begin MEASUREMENT CmnMfgSrv.IgnCntr "MICROSAR RTE" ULONG NO_COMPU_METHOD 0 0 0 4294967295 ECU_ADDRESS 0 SYMBOL_LINK "Rte_CmnMfgSrv_IgnCntr" 0 DISPLAY_IDENTIFIER CmnMfgSrv.PerInstanceMemories.IgnCntr /end MEASUREMENT
/begin MEASUREMENT CmnMfgSrv.IgnCntr.Val "MICROSAR RTE" ULONG NO_COMPU_METHOD 0 0 0 4294967295 ECU_ADDRESS 0 SYMBOL_LINK "Rte_CmnMfgSrv_IgnCntr_Val" 0 DISPLAY_IDENTIFIER CmnMfgSrv.SenderPorts.IgnCntr.Val /end MEASUREMENT
/begin MEASUREMENT CmnMfgSrv.InertiaCmpVelCmdDi.Logl "MICROSAR RTE" UBYTE RTE_CM_BOOLEAN 0 0 0 255 ECU_ADDRESS 0 SYMBOL_LINK "Rte_CmnMfgSrv_InertiaCmpVelCmdDi_Logl" 0 DISPLAY_IDENTIFIER CmnMfgSrv.SenderPorts.InertiaCmpVelCmdDi.Logl /end MEASUREMENT
/begin MEASUREMENT CmnMfgSrv.InpOutpCtrlAssiGain "MICROSAR RTE" FLOAT32_IEEE NO_COMPU_METHOD 0 0 -3.402823466e+38 3.402823466e+38 ECU_ADDRESS 0 SYMBOL_LINK "Rte_CmnMfgSrv_InpOutpCtrlAssiGain" 0 DISPLAY_IDENTIFIER CmnMfgSrv.PerInstanceMemories.InpOutpCtrlAssiGain /end MEASUREMENT
/begin MEASUREMENT CmnMfgSrv.InpOutpCtrlVehSpdOvrd "MICROSAR RTE" FLOAT32_IEEE NO_COMPU_METHOD 0 0 -3.402823466e+38 3.402823466e+38 ECU_ADDRESS 0 SYMBOL_LINK "Rte_CmnMfgSrv_InpOutpCtrlVehSpdOvrd" 0 DISPLAY_IDENTIFIER CmnMfgSrv.PerInstanceMemories.InpOutpCtrlVehSpdOvrd /end MEASUREMENT
/begin MEASUREMENT CmnMfgSrv.LoaScaDi.Logl "MICROSAR RTE" UBYTE RTE_CM_BOOLEAN 0 0 0 255 ECU_ADDRESS 0 SYMBOL_LINK "Rte_CmnMfgSrv_LoaScaDi_Logl" 0 DISPLAY_IDENTIFIER CmnMfgSrv.SenderPorts.LoaScaDi.Logl /end MEASUREMENT
/begin MEASUREMENT CmnMfgSrv.MfgDiagcInhb "MICROSAR RTE" UBYTE RTE_CM_BOOLEAN 0 0 0 255 ECU_ADDRESS 0 SYMBOL_LINK "Rte_CmnMfgSrv_MfgDiagcInhb" 0 DISPLAY_IDENTIFIER CmnMfgSrv.PerInstanceMemories.MfgDiagcInhb /end MEASUREMENT
/begin MEASUREMENT CmnMfgSrv.MfgDiagcInhb.Logl "MICROSAR RTE" UBYTE RTE_CM_BOOLEAN 0 0 0 255 ECU_ADDRESS 0 SYMBOL_LINK "Rte_CmnMfgSrv_MfgDiagcInhb_Logl" 0 DISPLAY_IDENTIFIER CmnMfgSrv.SenderPorts.MfgDiagcInhb.Logl /end MEASUREMENT
/begin MEASUREMENT CmnMfgSrv.MfgTmpBuf0 "MICROSAR RTE" UBYTE NO_COMPU_METHOD 0 0 0 255 MATRIX_DIM 16 1 1 ECU_ADDRESS 0 SYMBOL_LINK "Rte_CmnMfgSrv_MfgTmpBuf0" 0 DISPLAY_IDENTIFIER CmnMfgSrv.PerInstanceMemories.MfgTmpBuf0 /end MEASUREMENT
/begin MEASUREMENT CmnMfgSrv.MfgTmpBuf1 "MICROSAR RTE" UBYTE NO_COMPU_METHOD 0 0 0 255 MATRIX_DIM 16 1 1 ECU_ADDRESS 0 SYMBOL_LINK "Rte_CmnMfgSrv_MfgTmpBuf1" 0 DISPLAY_IDENTIFIER CmnMfgSrv.PerInstanceMemories.MfgTmpBuf1 /end MEASUREMENT
/begin MEASUREMENT CmnMfgSrv.MfgTmpBuf2 "MICROSAR RTE" UBYTE NO_COMPU_METHOD 0 0 0 255 MATRIX_DIM 16 1 1 ECU_ADDRESS 0 SYMBOL_LINK "Rte_CmnMfgSrv_MfgTmpBuf2" 0 DISPLAY_IDENTIFIER CmnMfgSrv.PerInstanceMemories.MfgTmpBuf2 /end MEASUREMENT
/begin MEASUREMENT CmnMfgSrv.MfgTmpBuf3 "MICROSAR RTE" UBYTE NO_COMPU_METHOD 0 0 0 255 MATRIX_DIM 16 1 1 ECU_ADDRESS 0 SYMBOL_LINK "Rte_CmnMfgSrv_MfgTmpBuf3" 0 DISPLAY_IDENTIFIER CmnMfgSrv.PerInstanceMemories.MfgTmpBuf3 /end MEASUREMENT
/begin MEASUREMENT CmnMfgSrv.MfgTmpBuf4 "MICROSAR RTE" UBYTE NO_COMPU_METHOD 0 0 0 255 MATRIX_DIM 16 1 1 ECU_ADDRESS 0 SYMBOL_LINK "Rte_CmnMfgSrv_MfgTmpBuf4" 0 DISPLAY_IDENTIFIER CmnMfgSrv.PerInstanceMemories.MfgTmpBuf4 /end MEASUREMENT
/begin MEASUREMENT CmnMfgSrv.MotAg0Mecl.Val "MICROSAR RTE" UWORD NO_COMPU_METHOD 0 0 0 65535 ECU_ADDRESS 0 SYMBOL_LINK "Rte_CmnMfgSrv_MotAg0Mecl_Val" 0 DISPLAY_IDENTIFIER CmnMfgSrv.ReceiverPorts.MotAg0Mecl.Val /end MEASUREMENT
/begin MEASUREMENT CmnMfgSrv.MotAg1Mecl.Val "MICROSAR RTE" UWORD NO_COMPU_METHOD 0 0 0 65535 ECU_ADDRESS 0 SYMBOL_LINK "Rte_CmnMfgSrv_MotAg1Mecl_Val" 0 DISPLAY_IDENTIFIER CmnMfgSrv.ReceiverPorts.MotAg1Mecl.Val /end MEASUREMENT
/begin MEASUREMENT CmnMfgSrv.MotAg2Mecl.Val "MICROSAR RTE" UWORD NO_COMPU_METHOD 0 0 0 65535 ECU_ADDRESS 0 SYMBOL_LINK "Rte_MotAg2Meas_MotAg2Mecl_Val" 0 DISPLAY_IDENTIFIER CmnMfgSrv.ReceiverPorts.MotAg2Mecl.Val /end MEASUREMENT
/begin MEASUREMENT CmnMfgSrv.MotAgCumvAlgndMrf.Val "MICROSAR RTE" SLONG NO_COMPU_METHOD 0 0 -2147483648 2147483647 ECU_ADDRESS 0 SYMBOL_LINK "Rte_CDD_MotAgCmp_MotAgCumvAlgndMrf_Val" 0 DISPLAY_IDENTIFIER CmnMfgSrv.ReceiverPorts.MotAgCumvAlgndMrf.Val /end MEASUREMENT
/begin MEASUREMENT CmnMfgSrv.MotAgMecl.Val "MICROSAR RTE" UWORD NO_COMPU_METHOD 0 0 0 65535 ECU_ADDRESS 0 SYMBOL_LINK "Rte_CmnMfgSrv_MotAgMecl_Val" 0 DISPLAY_IDENTIFIER CmnMfgSrv.ReceiverPorts.MotAgMecl.Val /end MEASUREMENT
/begin MEASUREMENT CmnMfgSrv.MotCurrDax.Val "MICROSAR RTE" FLOAT32_IEEE NO_COMPU_METHOD 0 0 -3.402823466e+38 3.402823466e+38 ECU_ADDRESS 0 SYMBOL_LINK "Rte_CDD_MotCtrlMgr_MotCurrDax_Val" 0 DISPLAY_IDENTIFIER CmnMfgSrv.ReceiverPorts.MotCurrDax.Val /end MEASUREMENT
/begin MEASUREMENT CmnMfgSrv.MotCurrQax.Val "MICROSAR RTE" FLOAT32_IEEE NO_COMPU_METHOD 0 0 -3.402823466e+38 3.402823466e+38 ECU_ADDRESS 0 SYMBOL_LINK "Rte_CDD_MotCtrlMgr_MotCurrQax_Val" 0 DISPLAY_IDENTIFIER CmnMfgSrv.ReceiverPorts.MotCurrQax.Val /end MEASUREMENT
/begin MEASUREMENT CmnMfgSrv.MotTqCmd.Val "MICROSAR RTE" FLOAT32_IEEE NO_COMPU_METHOD 0 0 -3.402823466e+38 3.402823466e+38 ECU_ADDRESS 0 SYMBOL_LINK "Rte_Swp_MotTqCmdSwp_Val" 0 DISPLAY_IDENTIFIER CmnMfgSrv.ReceiverPorts.MotTqCmd.Val /end MEASUREMENT
/begin MEASUREMENT CmnMfgSrv.MotVelMrf.Val "MICROSAR RTE" FLOAT32_IEEE NO_COMPU_METHOD 0 0 -3.402823466e+38 3.402823466e+38 ECU_ADDRESS 0 SYMBOL_LINK "Rte_CDD_MotVel_MotVelMrf_Val" 0 DISPLAY_IDENTIFIER CmnMfgSrv.ReceiverPorts.MotVelMrf.Val /end MEASUREMENT
/begin MEASUREMENT CmnMfgSrv.NxtrMfgEnaCntr "MICROSAR RTE" UBYTE NO_COMPU_METHOD 0 0 0 255 ECU_ADDRESS 0 SYMBOL_LINK "Rte_CmnMfgSrv_NxtrMfgEnaCntr" 0 DISPLAY_IDENTIFIER CmnMfgSrv.PerInstanceMemories.NxtrMfgEnaCntr /end MEASUREMENT
/begin MEASUREMENT CmnMfgSrv.PerCyc "MICROSAR RTE" UWORD NO_COMPU_METHOD 0 0 0 65535 ECU_ADDRESS 0 SYMBOL_LINK "Rte_CmnMfgSrv_PerCyc" 0 DISPLAY_IDENTIFIER CmnMfgSrv.PerInstanceMemories.PerCyc /end MEASUREMENT
/begin MEASUREMENT CmnMfgSrv.PerDivdr "MICROSAR RTE" UWORD NO_COMPU_METHOD 0 0 0 65535 ECU_ADDRESS 0 SYMBOL_LINK "Rte_CmnMfgSrv_PerDivdr" 0 DISPLAY_IDENTIFIER CmnMfgSrv.PerInstanceMemories.PerDivdr /end MEASUREMENT
/begin MEASUREMENT CmnMfgSrv.PerPidTbl "MICROSAR RTE" UWORD NO_COMPU_METHOD 0 0 0 65535 MATRIX_DIM 16 1 1 ECU_ADDRESS 0 SYMBOL_LINK "Rte_CmnMfgSrv_PerPidTbl" 0 DISPLAY_IDENTIFIER CmnMfgSrv.PerInstanceMemories.PerPidTbl /end MEASUREMENT
/begin MEASUREMENT CmnMfgSrv.PerPidTblLen "MICROSAR RTE" UBYTE NO_COMPU_METHOD 0 0 0 255 ECU_ADDRESS 0 SYMBOL_LINK "Rte_CmnMfgSrv_PerPidTblLen" 0 DISPLAY_IDENTIFIER CmnMfgSrv.PerInstanceMemories.PerPidTblLen /end MEASUREMENT
/begin MEASUREMENT CmnMfgSrv.PerRunng "MICROSAR RTE" UBYTE RTE_CM_BOOLEAN 0 0 0 255 ECU_ADDRESS 0 SYMBOL_LINK "Rte_CmnMfgSrv_PerRunng" 0 DISPLAY_IDENTIFIER CmnMfgSrv.PerInstanceMemories.PerRunng /end MEASUREMENT
/begin MEASUREMENT CmnMfgSrv.PinionAg.Val "MICROSAR RTE" FLOAT32_IEEE NO_COMPU_METHOD 0 0 -3.402823466e+38 3.402823466e+38 ECU_ADDRESS 0 SYMBOL_LINK "Rte_HwAgSysArbn_PinionAg_Val" 0 DISPLAY_IDENTIFIER CmnMfgSrv.ReceiverPorts.PinionAg.Val /end MEASUREMENT
/begin MEASUREMENT CmnMfgSrv.PullCmpCmdDi.Logl "MICROSAR RTE" UBYTE RTE_CM_BOOLEAN 0 0 0 255 ECU_ADDRESS 0 SYMBOL_LINK "Rte_CmnMfgSrv_PullCmpCmdDi_Logl" 0 DISPLAY_IDENTIFIER CmnMfgSrv.SenderPorts.PullCmpCmdDi.Logl /end MEASUREMENT
/begin MEASUREMENT CmnMfgSrv.PullCmpLrngDi.Logl "MICROSAR RTE" UBYTE RTE_CM_BOOLEAN 0 0 0 255 ECU_ADDRESS 0 SYMBOL_LINK "Rte_CmnMfgSrv_PullCmpLrngDi_Logl" 0 DISPLAY_IDENTIFIER CmnMfgSrv.SenderPorts.PullCmpLrngDi.Logl /end MEASUREMENT
/begin MEASUREMENT CmnMfgSrv.ReqLen "MICROSAR RTE" UWORD NO_COMPU_METHOD 0 0 0 65535 ECU_ADDRESS 0 SYMBOL_LINK "Rte_CmnMfgSrv_ReqLen" 0 DISPLAY_IDENTIFIER CmnMfgSrv.PerInstanceMemories.ReqLen /end MEASUREMENT
/begin MEASUREMENT CmnMfgSrv.RtnCmdDi.Logl "MICROSAR RTE" UBYTE RTE_CM_BOOLEAN 0 0 0 255 ECU_ADDRESS 0 SYMBOL_LINK "Rte_CmnMfgSrv_RtnCmdDi_Logl" 0 DISPLAY_IDENTIFIER CmnMfgSrv.SenderPorts.RtnCmdDi.Logl /end MEASUREMENT
/begin MEASUREMENT CmnMfgSrv.SecuAcsAtmptCntr "MICROSAR RTE" UBYTE NO_COMPU_METHOD 0 0 0 255 ECU_ADDRESS 0 SYMBOL_LINK "Rte_CmnMfgSrv_SecuAcsAtmptCntr" 0 DISPLAY_IDENTIFIER CmnMfgSrv.PerInstanceMemories.SecuAcsAtmptCntr /end MEASUREMENT
/begin MEASUREMENT CmnMfgSrv.SecuAcsAtmptTmr "MICROSAR RTE" ULONG NO_COMPU_METHOD 0 0 0 4294967295 ECU_ADDRESS 0 SYMBOL_LINK "Rte_CmnMfgSrv_SecuAcsAtmptTmr" 0 DISPLAY_IDENTIFIER CmnMfgSrv.PerInstanceMemories.SecuAcsAtmptTmr /end MEASUREMENT
/begin MEASUREMENT CmnMfgSrv.SecuAcsSeedReqCmpl "MICROSAR RTE" UBYTE RTE_CM_BOOLEAN 0 0 0 255 ECU_ADDRESS 0 SYMBOL_LINK "Rte_CmnMfgSrv_SecuAcsSeedReqCmpl" 0 DISPLAY_IDENTIFIER CmnMfgSrv.PerInstanceMemories.SecuAcsSeedReqCmpl /end MEASUREMENT
/begin MEASUREMENT CmnMfgSrv.SecuAcsUnlckd "MICROSAR RTE" UBYTE RTE_CM_BOOLEAN 0 0 0 255 ECU_ADDRESS 0 SYMBOL_LINK "Rte_CmnMfgSrv_SecuAcsUnlckd" 0 DISPLAY_IDENTIFIER CmnMfgSrv.PerInstanceMemories.SecuAcsUnlckd /end MEASUREMENT
/begin MEASUREMENT CmnMfgSrv.SeedKey "MICROSAR RTE" ULONG NO_COMPU_METHOD 0 0 0 4294967295 MATRIX_DIM 2 1 1 ECU_ADDRESS 0 SYMBOL_LINK "Rte_CmnMfgSrv_SeedKey" 0 DISPLAY_IDENTIFIER CmnMfgSrv.PerInstanceMemories.SeedKey /end MEASUREMENT
/begin MEASUREMENT CmnMfgSrv.SessionCurr "MICROSAR RTE" UBYTE NO_COMPU_METHOD 0 0 0 255 ECU_ADDRESS 0 SYMBOL_LINK "Rte_CmnMfgSrv_SessionCurr" 0 DISPLAY_IDENTIFIER CmnMfgSrv.PerInstanceMemories.SessionCurr /end MEASUREMENT
/begin MEASUREMENT CmnMfgSrv.SessionTiOut "MICROSAR RTE" ULONG NO_COMPU_METHOD 0 0 0 4294967295 ECU_ADDRESS 0 SYMBOL_LINK "Rte_CmnMfgSrv_SessionTiOut" 0 DISPLAY_IDENTIFIER CmnMfgSrv.PerInstanceMemories.SessionTiOut /end MEASUREMENT
/begin MEASUREMENT CmnMfgSrv.StallMotTqLimDi.Logl "MICROSAR RTE" UBYTE RTE_CM_BOOLEAN 0 0 0 255 ECU_ADDRESS 0 SYMBOL_LINK "Rte_CmnMfgSrv_StallMotTqLimDi_Logl" 0 DISPLAY_IDENTIFIER CmnMfgSrv.SenderPorts.StallMotTqLimDi.Logl /end MEASUREMENT
/begin MEASUREMENT CmnMfgSrv.SysMotTqCmdRampRateDi.Logl "MICROSAR RTE" UBYTE RTE_CM_BOOLEAN 0 0 0 255 ECU_ADDRESS 0 SYMBOL_LINK "Rte_CmnMfgSrv_SysMotTqCmdRampRateDi_Logl" 0 DISPLAY_IDENTIFIER CmnMfgSrv.SenderPorts.SysMotTqCmdRampRateDi.Logl /end MEASUREMENT
/begin MEASUREMENT CmnMfgSrv.SysSt.Val "MICROSAR RTE" UBYTE RTE_CM_ENUM_SysSt1 0 0 0 255 ECU_ADDRESS 0 SYMBOL_LINK "Rte_SysStMod_SysSt_Val" 0 DISPLAY_IDENTIFIER CmnMfgSrv.ReceiverPorts.SysSt.Val /end MEASUREMENT
/begin MEASUREMENT CmnMfgSrv.SysStImdtTranReqOff.Logl "MICROSAR RTE" UBYTE RTE_CM_BOOLEAN 0 0 0 255 ECU_ADDRESS 0 SYMBOL_LINK "Rte_CmnMfgSrv_SysStImdtTranReqOff_Logl" 0 DISPLAY_IDENTIFIER CmnMfgSrv.SenderPorts.SysStImdtTranReqOff.Logl /end MEASUREMENT
/begin MEASUREMENT CmnMfgSrv.SysStReqEnaOvrd "MICROSAR RTE" UBYTE RTE_CM_BOOLEAN 0 0 0 255 ECU_ADDRESS 0 SYMBOL_LINK "Rte_CmnMfgSrv_SysStReqEnaOvrd" 0 DISPLAY_IDENTIFIER CmnMfgSrv.PerInstanceMemories.SysStReqEnaOvrd /end MEASUREMENT
/begin MEASUREMENT CmnMfgSrv.SysStReqEnaOvrd.Logl "MICROSAR RTE" UBYTE RTE_CM_BOOLEAN 0 0 0 255 ECU_ADDRESS 0 SYMBOL_LINK "Rte_CmnMfgSrv_SysStReqEnaOvrd_Logl" 0 DISPLAY_IDENTIFIER CmnMfgSrv.SenderPorts.SysStReqEnaOvrd.Logl /end MEASUREMENT
/begin MEASUREMENT CmnMfgSrv.VehSpdOvrd.Val "MICROSAR RTE" FLOAT32_IEEE NO_COMPU_METHOD 0 0 -3.402823466e+38 3.402823466e+38 ECU_ADDRESS 0 SYMBOL_LINK "Rte_CmnMfgSrv_VehSpdOvrd_Val" 0 DISPLAY_IDENTIFIER CmnMfgSrv.SenderPorts.VehSpdOvrd.Val /end MEASUREMENT
/begin MEASUREMENT CmnMfgSrv.VehSpdOvrdEna.Logl "MICROSAR RTE" UBYTE RTE_CM_BOOLEAN 0 0 0 255 ECU_ADDRESS 0 SYMBOL_LINK "Rte_CmnMfgSrv_VehSpdOvrdEna_Logl" 0 DISPLAY_IDENTIFIER CmnMfgSrv.SenderPorts.VehSpdOvrdEna.Logl /end MEASUREMENT
/begin MEASUREMENT CmplncErr.CmplncErrMotToPinion.Val "MICROSAR RTE" FLOAT32_IEEE NO_COMPU_METHOD 0 0 -3.402823466e+38 3.402823466e+38 ECU_ADDRESS 0 SYMBOL_LINK "Rte_CmplncErr_CmplncErrMotToPinion_Val" 0 DISPLAY_IDENTIFIER CmplncErr.SenderPorts.CmplncErrMotToPinion.Val /end MEASUREMENT
/begin MEASUREMENT CmplncErr.CmplncErrPinionToHw.Val "MICROSAR RTE" FLOAT32_IEEE NO_COMPU_METHOD 0 0 -3.402823466e+38 3.402823466e+38 ECU_ADDRESS 0 SYMBOL_LINK "Rte_CmplncErr_CmplncErrPinionToHw_Val" 0 DISPLAY_IDENTIFIER CmplncErr.SenderPorts.CmplncErrPinionToHw.Val /end MEASUREMENT
/begin MEASUREMENT CmplncErr.HwTq.Val "MICROSAR RTE" FLOAT32_IEEE NO_COMPU_METHOD 0 0 -3.402823466e+38 3.402823466e+38 ECU_ADDRESS 0 SYMBOL_LINK "Rte_ImcSigArbn_HwTqImcCorrd_Val" 0 DISPLAY_IDENTIFIER CmplncErr.ReceiverPorts.HwTq.Val /end MEASUREMENT
/begin MEASUREMENT CmplncErr.MotTqCmdCrf.Val "MICROSAR RTE" FLOAT32_IEEE NO_COMPU_METHOD 0 0 -3.402823466e+38 3.402823466e+38 ECU_ADDRESS 0 SYMBOL_LINK "Rte_MotTqTranlDampg_MotTqCmdCrfDampd_Val" 0 DISPLAY_IDENTIFIER CmplncErr.ReceiverPorts.MotTqCmdCrf.Val /end MEASUREMENT
/begin MEASUREMENT CurrMeasCorrln.CurrMeasCorrlnSts.Val "MICROSAR RTE" UBYTE NO_COMPU_METHOD 0 0 0 255 ECU_ADDRESS 0 SYMBOL_LINK "Rte_CurrMeasCorrln_CurrMeasCorrlnSts_Val" 0 DISPLAY_IDENTIFIER CurrMeasCorrln.SenderPorts.CurrMeasCorrlnSts.Val /end MEASUREMENT
/begin MEASUREMENT CurrMeasCorrln.CurrMeasIdptSig.Val "MICROSAR RTE" UBYTE NO_COMPU_METHOD 0 0 0 255 ECU_ADDRESS 0 SYMBOL_LINK "Rte_CurrMeasCorrln_CurrMeasIdptSig_Val" 0 DISPLAY_IDENTIFIER CurrMeasCorrln.SenderPorts.CurrMeasIdptSig.Val /end MEASUREMENT
/begin MEASUREMENT CurrMeasCorrln.CurrMotSumABC.Val "MICROSAR RTE" FLOAT32_IEEE NO_COMPU_METHOD 0 0 -3.402823466e+38 3.402823466e+38 ECU_ADDRESS 0 SYMBOL_LINK "Rte_CurrMeasCorrln_CurrMotSumABC_Val" 0 DISPLAY_IDENTIFIER CurrMeasCorrln.SenderPorts.CurrMotSumABC.Val /end MEASUREMENT
/begin MEASUREMENT CurrMeasCorrln.DiagcStsIvtr1Inactv.Logl "MICROSAR RTE" UBYTE RTE_CM_BOOLEAN 0 0 0 255 ECU_ADDRESS 0 SYMBOL_LINK "Rte_GateDrv0Ctrl_DiagcStsIvtr1Inactv_Logl" 0 DISPLAY_IDENTIFIER CurrMeasCorrln.ReceiverPorts.DiagcStsIvtr1Inactv.Logl /end MEASUREMENT
/begin MEASUREMENT CurrMeasCorrln.LongTermCorrlnStsABC "MICROSAR RTE" UBYTE RTE_CM_BOOLEAN 0 0 0 255 ECU_ADDRESS 0 SYMBOL_LINK "Rte_CurrMeasCorrln_LongTermCorrlnStsABC" 0 DISPLAY_IDENTIFIER CurrMeasCorrln.PerInstanceMemories.LongTermCorrlnStsABC /end MEASUREMENT
/begin MEASUREMENT CurrMeasCorrln.MotCurrCorrdA.Val "MICROSAR RTE" FLOAT32_IEEE NO_COMPU_METHOD 0 0 -3.402823466e+38 3.402823466e+38 ECU_ADDRESS 0 SYMBOL_LINK "Rte_CDD_MotCtrlMgr_MotCurrCorrdA_Val" 0 DISPLAY_IDENTIFIER CurrMeasCorrln.ReceiverPorts.MotCurrCorrdA.Val /end MEASUREMENT
/begin MEASUREMENT CurrMeasCorrln.MotCurrCorrdB.Val "MICROSAR RTE" FLOAT32_IEEE NO_COMPU_METHOD 0 0 -3.402823466e+38 3.402823466e+38 ECU_ADDRESS 0 SYMBOL_LINK "Rte_CDD_MotCtrlMgr_MotCurrCorrdB_Val" 0 DISPLAY_IDENTIFIER CurrMeasCorrln.ReceiverPorts.MotCurrCorrdB.Val /end MEASUREMENT
/begin MEASUREMENT CurrMeasCorrln.MotCurrCorrdC.Val "MICROSAR RTE" FLOAT32_IEEE NO_COMPU_METHOD 0 0 -3.402823466e+38 3.402823466e+38 ECU_ADDRESS 0 SYMBOL_LINK "Rte_CDD_MotCtrlMgr_MotCurrCorrdC_Val" 0 DISPLAY_IDENTIFIER CurrMeasCorrln.ReceiverPorts.MotCurrCorrdC.Val /end MEASUREMENT
/begin MEASUREMENT CurrMeasCorrln.MotCurrEolCalSt.Val "MICROSAR RTE" UBYTE RTE_CM_ENUM_MotCurrEolCalSt2 0 0 0 255 ECU_ADDRESS 0 SYMBOL_LINK "Rte_CDD_CurrMeas_MotCurrEolCalSt_Val" 0 DISPLAY_IDENTIFIER CurrMeasCorrln.ReceiverPorts.MotCurrEolCalSt.Val /end MEASUREMENT
/begin MEASUREMENT CurrMeasCorrln.MotCurrRollgCntr1.Val "MICROSAR RTE" UBYTE NO_COMPU_METHOD 0 0 0 255 ECU_ADDRESS 0 SYMBOL_LINK "Rte_CDD_MotCtrlMgr_MotCurrRollgCntr1_Val" 0 DISPLAY_IDENTIFIER CurrMeasCorrln.ReceiverPorts.MotCurrRollgCntr1.Val /end MEASUREMENT
/begin MEASUREMENT CurrMeasCorrln.Snsr0RollgCntPrev "MICROSAR RTE" UBYTE NO_COMPU_METHOD 0 0 0 255 ECU_ADDRESS 0 SYMBOL_LINK "Rte_CurrMeasCorrln_Snsr0RollgCntPrev" 0 DISPLAY_IDENTIFIER CurrMeasCorrln.PerInstanceMemories.Snsr0RollgCntPrev /end MEASUREMENT
/begin MEASUREMENT CurrMeasCorrln.Snsr0StallCntPrev "MICROSAR RTE" UBYTE NO_COMPU_METHOD 0 0 0 255 ECU_ADDRESS 0 SYMBOL_LINK "Rte_CurrMeasCorrln_Snsr0StallCntPrev" 0 DISPLAY_IDENTIFIER CurrMeasCorrln.PerInstanceMemories.Snsr0StallCntPrev /end MEASUREMENT
/begin MEASUREMENT CurrMeasCorrln.SysSt.Val "MICROSAR RTE" UBYTE RTE_CM_ENUM_SysSt1 0 0 0 255 ECU_ADDRESS 0 SYMBOL_LINK "Rte_SysStMod_SysSt_Val" 0 DISPLAY_IDENTIFIER CurrMeasCorrln.ReceiverPorts.SysSt.Val /end MEASUREMENT
/begin MEASUREMENT CustDiag.BswM_MSI_BswMEcuResetMod.BswM_MDGP_BswMEcuResetMod "MICROSAR RTE" UBYTE RTE_CM_ENUM_BswMEcuResetMod 0 0 0 255 ECU_ADDRESS 0 SYMBOL_LINK "Rte_ModeMachine_CustDiag_BswM_MSI_BswMEcuResetMod_BswM_MDGP_BswMEcuResetMod" 0 DISPLAY_IDENTIFIER CustDiag.ModeProvidePorts.BswM_MSI_BswMEcuResetMod.BswM_MDGP_BswMEcuResetMod /end MEASUREMENT
/begin MEASUREMENT CustDiag.ClrDiagcReq "MICROSAR RTE" UBYTE NO_COMPU_METHOD 0 0 0 255 ECU_ADDRESS 0 SYMBOL_LINK "Rte_CustDiag_ClrDiagcReq" 0 DISPLAY_IDENTIFIER CustDiag.PerInstanceMemories.ClrDiagcReq /end MEASUREMENT
/begin MEASUREMENT CustDiag.ClrDiagcReq.Val "MICROSAR RTE" UBYTE NO_COMPU_METHOD 0 0 0 255 ECU_ADDRESS 0 SYMBOL_LINK "Rte_CustDiag_ClrDiagcReq_Val" 0 DISPLAY_IDENTIFIER CustDiag.SenderPorts.ClrDiagcReq.Val /end MEASUREMENT
/begin MEASUREMENT CustDiag.CustXcpEna.Logl "MICROSAR RTE" UBYTE RTE_CM_BOOLEAN 0 0 0 255 ECU_ADDRESS 0 SYMBOL_LINK "Rte_CustDiag_CustXcpEna_Logl" 0 DISPLAY_IDENTIFIER CustDiag.SenderPorts.CustXcpEna.Logl /end MEASUREMENT
/begin MEASUREMENT CustDiag.Did205A "MICROSAR RTE" UBYTE NO_COMPU_METHOD 0 0 0 255 MATRIX_DIM 2 1 1 ECU_ADDRESS 0 SYMBOL_LINK "Rte_CustDiag_Did205A" 0 DISPLAY_IDENTIFIER CustDiag.PerInstanceMemories.Did205A /end MEASUREMENT
/begin MEASUREMENT CustDiag.Did205B "MICROSAR RTE" UBYTE NO_COMPU_METHOD 0 0 0 255 MATRIX_DIM 2 1 1 ECU_ADDRESS 0 SYMBOL_LINK "Rte_CustDiag_Did205B" 0 DISPLAY_IDENTIFIER CustDiag.PerInstanceMemories.Did205B /end MEASUREMENT
/begin MEASUREMENT CustDiag.Did3003 "MICROSAR RTE" UBYTE NO_COMPU_METHOD 0 0 0 255 MATRIX_DIM 24 1 1 ECU_ADDRESS 0 SYMBOL_LINK "Rte_CustDiag_Did3003" 0 DISPLAY_IDENTIFIER CustDiag.PerInstanceMemories.Did3003 /end MEASUREMENT
/begin MEASUREMENT CustDiag.Did301A "MICROSAR RTE" UBYTE NO_COMPU_METHOD 0 0 0 255 MATRIX_DIM 2 1 1 ECU_ADDRESS 0 SYMBOL_LINK "Rte_CustDiag_Did301A" 0 DISPLAY_IDENTIFIER CustDiag.PerInstanceMemories.Did301A /end MEASUREMENT
/begin MEASUREMENT CustDiag.Did630F "MICROSAR RTE" UBYTE NO_COMPU_METHOD 0 0 0 255 MATRIX_DIM 24 1 1 ECU_ADDRESS 0 SYMBOL_LINK "Rte_CustDiag_Did630F" 0 DISPLAY_IDENTIFIER CustDiag.PerInstanceMemories.Did630F /end MEASUREMENT
/begin MEASUREMENT CustDiag.Did630FChk "MICROSAR RTE" UBYTE RTE_CM_BOOLEAN 0 0 0 255 ECU_ADDRESS 0 SYMBOL_LINK "Rte_CustDiag_Did630FChk" 0 DISPLAY_IDENTIFIER CustDiag.PerInstanceMemories.Did630FChk /end MEASUREMENT
/begin MEASUREMENT CustDiag.DidDE00 "MICROSAR RTE" UBYTE NO_COMPU_METHOD 0 0 0 255 MATRIX_DIM 24 1 1 ECU_ADDRESS 0 SYMBOL_LINK "Rte_CustDiag_DidDE00" 0 DISPLAY_IDENTIFIER CustDiag.PerInstanceMemories.DidDE00 /end MEASUREMENT
/begin MEASUREMENT CustDiag.DidDE01 "MICROSAR RTE" UBYTE NO_COMPU_METHOD 0 0 0 255 MATRIX_DIM 24 1 1 ECU_ADDRESS 0 SYMBOL_LINK "Rte_CustDiag_DidDE01" 0 DISPLAY_IDENTIFIER CustDiag.PerInstanceMemories.DidDE01 /end MEASUREMENT
/begin MEASUREMENT CustDiag.DidDE02 "MICROSAR RTE" UBYTE NO_COMPU_METHOD 0 0 0 255 MATRIX_DIM 24 1 1 ECU_ADDRESS 0 SYMBOL_LINK "Rte_CustDiag_DidDE02" 0 DISPLAY_IDENTIFIER CustDiag.PerInstanceMemories.DidDE02 /end MEASUREMENT
/begin MEASUREMENT CustDiag.DidDE03 "MICROSAR RTE" UBYTE NO_COMPU_METHOD 0 0 0 255 MATRIX_DIM 64 1 1 ECU_ADDRESS 0 SYMBOL_LINK "Rte_CustDiag_DidDE03" 0 DISPLAY_IDENTIFIER CustDiag.PerInstanceMemories.DidDE03 /end MEASUREMENT
/begin MEASUREMENT CustDiag.DidDE04 "MICROSAR RTE" UBYTE NO_COMPU_METHOD 0 0 0 255 MATRIX_DIM 2 1 1 ECU_ADDRESS 0 SYMBOL_LINK "Rte_CustDiag_DidDE04" 0 DISPLAY_IDENTIFIER CustDiag.PerInstanceMemories.DidDE04 /end MEASUREMENT
/begin MEASUREMENT CustDiag.DidDE05 "MICROSAR RTE" UBYTE NO_COMPU_METHOD 0 0 0 255 MATRIX_DIM 24 1 1 ECU_ADDRESS 0 SYMBOL_LINK "Rte_CustDiag_DidDE05" 0 DISPLAY_IDENTIFIER CustDiag.PerInstanceMemories.DidDE05 /end MEASUREMENT
/begin GROUP CalRegn02Rt03GroupA.InertiaCmpVelDampgFilFrq.Ary1D "MICROSAR RTE" /begin SUB_GROUP /end SUB_GROUP /begin FUNCTION_LIST /end FUNCTION_LIST /begin REF_CHARACTERISTIC CalRegn02Rt03GroupA.InertiaCmpVelDampgFilFrq.Ary1D /end REF_CHARACTERISTIC /begin REF_MEASUREMENT /end REF_MEASUREMENT /end GROUP
/begin GROUP CalRegn02Rt03GroupA.InertiaCmpVelDampgFilFrqWhlImbRejctnOn.Ary1D "MICROSAR RTE" /begin SUB_GROUP /end SUB_GROUP /begin FUNCTION_LIST /end FUNCTION_LIST
 /begin REF_CHARACTERISTIC CalRegn02Rt03GroupA.InertiaCmpVelDampgFilFrqWhlImbRejctnOn.Ary1D /end REF_CHARACTERISTIC
 /begin REF_MEASUREMENT /end REF_MEASUREMENT
/end GROUP
/begin GROUP CalRegn02Rt03GroupA.InertiaCmpVelDampgSpdBlndY.Ary1D "MICROSAR RTE" /begin SUB_GROUP /end SUB_GROUP /begin FUNCTION_LIST /end FUNCTION_LIST /begin REF_CHARACTERISTIC CalRegn02Rt03GroupA.InertiaCmpVelDampgSpdBlndY.Ary1D /end REF_CHARACTERISTIC /begin REF_MEASUREMENT /end REF_MEASUREMENT /end GROUP
/begin GROUP CalRegn02Rt03GroupA.InertiaCmpVelDampgWhlImbRejctnBlndX.Ary1D "MICROSAR RTE" /begin SUB_GROUP /end SUB_GROUP /begin FUNCTION_LIST /end FUNCTION_LIST
 /begin REF_CHARACTERISTIC CalRegn02Rt03GroupA.InertiaCmpVelDampgWhlImbRejctnBlndX.Ary1D /end REF_CHARACTERISTIC
 /begin REF_MEASUREMENT /end REF_MEASUREMENT
/end GROUP
/begin GROUP CalRegn02Rt03GroupA.InertiaCmpVelDampgWhlImbRejctnBlndY.Ary1D "MICROSAR RTE" /begin SUB_GROUP /end SUB_GROUP /begin FUNCTION_LIST /end FUNCTION_LIST
 /begin REF_CHARACTERISTIC CalRegn02Rt03GroupA.InertiaCmpVelDampgWhlImbRejctnBlndY.Ary1D /end REF_CHARACTERISTIC
 /begin REF_MEASUREMENT /end REF_MEASUREMENT
/end GROUP
/begin GROUP CalRegn02Rt03GroupB "MICROSAR RTE" /begin SUB_GROUP CalRegn02Rt03GroupB.CalibrationPorts /end SUB_GROUP /begin FUNCTION_LIST /end FUNCTION_LIST /begin REF_CHARACTERISTIC /end REF_CHARACTERISTIC /begin REF_MEASUREMENT /end REF_MEASUREMENT /end GROUP
/begin GROUP CalRegn02Rt03GroupB.CalibrationPorts "MICROSAR RTE"
 /begin SUB_GROUP CalRegn02Rt03GroupB.EotProtnDampgVehSpdTbl.Ary1D CalRegn02Rt03GroupB.EotProtnDeltaTqThd.Val CalRegn02Rt03GroupB.EotProtnEntrGainVehSpdTbl.Ary1D CalRegn02Rt03GroupB.EotProtnEntrGainY.Ary2D CalRegn02Rt03GroupB.EotProtnLoAuthyEntrGainY.Ary2D CalRegn02Rt03GroupB.EotProtnMotSpdIncptY.Ary1D CalRegn02Rt03GroupB.EotProtnNormDampgY.Ary2D CalRegn02Rt03GroupB.EotProtnSoftEndStopAuthyThd.Val CalRegn02Rt03GroupB.RtnHwAgOffsCalcdX.Ary2D CalRegn02Rt03GroupB.RtnHwAgOffsCalcdY.Ary2D CalRegn02Rt03GroupB.RtnScaTqX.Ary2D CalRegn02Rt03GroupB.RtnScaTqY.Ary2D CalRegn02Rt03GroupB.RtnScaVelX.Ary2D CalRegn02Rt03GroupB.RtnScaVelY.Ary2D CalRegn02Rt03GroupB.RtnVehSpdSeln.Ary1D /end SUB_GROUP
 /begin FUNCTION_LIST /end FUNCTION_LIST
 /begin REF_CHARACTERISTIC /end REF_CHARACTERISTIC
 /begin REF_MEASUREMENT /end REF_MEASUREMENT
/end GROUP
/begin GROUP CalRegn02Rt03GroupB.EotProtnDampgVehSpdTbl.Ary1D "MICROSAR RTE" /begin SUB_GROUP /end SUB_GROUP /begin FUNCTION_LIST /end FUNCTION_LIST /begin REF_CHARACTERISTIC CalRegn02Rt03GroupB.EotProtnDampgVehSpdTbl.Ary1D /end REF_CHARACTERISTIC /begin REF_MEASUREMENT /end REF_MEASUREMENT /end GROUP
/begin GROUP CalRegn02Rt03GroupB.EotProtnDeltaTqThd.Val "MICROSAR RTE" /begin SUB_GROUP /end SUB_GROUP /begin FUNCTION_LIST /end FUNCTION_LIST /begin REF_CHARACTERISTIC CalRegn02Rt03GroupB.EotProtnDeltaTqThd.Val /end REF_CHARACTERISTIC /begin REF_MEASUREMENT /end REF_MEASUREMENT /end GROUP
/begin GROUP CalRegn02Rt03GroupB.EotProtnEntrGainVehSpdTbl.Ary1D "MICROSAR RTE" /begin SUB_GROUP /end SUB_GROUP /begin FUNCTION_LIST /end FUNCTION_LIST /begin REF_CHARACTERISTIC CalRegn02Rt03GroupB.EotProtnEntrGainVehSpdTbl.Ary1D /end REF_CHARACTERISTIC /begin REF_MEASUREMENT /end REF_MEASUREMENT /end GROUP
/begin GROUP CalRegn02Rt03GroupB.EotProtnEntrGainY.Ary2D "MICROSAR RTE" /begin SUB_GROUP /end SUB_GROUP /begin FUNCTION_LIST /end FUNCTION_LIST /begin REF_CHARACTERISTIC CalRegn02Rt03GroupB.EotProtnEntrGainY.Ary2D /end REF_CHARACTERISTIC /begin REF_MEASUREMENT /end REF_MEASUREMENT /end GROUP
/begin GROUP CalRegn02Rt03GroupB.EotProtnLoAuthyEntrGainY.Ary2D "MICROSAR RTE" /begin SUB_GROUP /end SUB_GROUP /begin FUNCTION_LIST /end FUNCTION_LIST /begin REF_CHARACTERISTIC CalRegn02Rt03GroupB.EotProtnLoAuthyEntrGainY.Ary2D /end REF_CHARACTERISTIC /begin REF_MEASUREMENT /end REF_MEASUREMENT /end GROUP
/begin GROUP CalRegn02Rt03GroupB.EotProtnMotSpdIncptY.Ary1D "MICROSAR RTE" /begin SUB_GROUP /end SUB_GROUP /begin FUNCTION_LIST /end FUNCTION_LIST /begin REF_CHARACTERISTIC CalRegn02Rt03GroupB.EotProtnMotSpdIncptY.Ary1D /end REF_CHARACTERISTIC /begin REF_MEASUREMENT /end REF_MEASUREMENT /end GROUP
/begin GROUP CalRegn02Rt03GroupB.EotProtnNormDampgY.Ary2D "MICROSAR RTE" /begin SUB_GROUP /end SUB_GROUP /begin FUNCTION_LIST /end FUNCTION_LIST /begin REF_CHARACTERISTIC CalRegn02Rt03GroupB.EotProtnNormDampgY.Ary2D /end REF_CHARACTERISTIC /begin REF_MEASUREMENT /end REF_MEASUREMENT /end GROUP
/begin GROUP CalRegn02Rt03GroupB.EotProtnSoftEndStopAuthyThd.Val "MICROSAR RTE" /begin SUB_GROUP /end SUB_GROUP /begin FUNCTION_LIST /end FUNCTION_LIST /begin REF_CHARACTERISTIC CalRegn02Rt03GroupB.EotProtnSoftEndStopAuthyThd.Val /end REF_CHARACTERISTIC /begin REF_MEASUREMENT /end REF_MEASUREMENT /end GROUP
/begin GROUP CalRegn02Rt03GroupB.RtnHwAgOffsCalcdX.Ary2D "MICROSAR RTE" /begin SUB_GROUP /end SUB_GROUP /begin FUNCTION_LIST /end FUNCTION_LIST /begin REF_CHARACTERISTIC CalRegn02Rt03GroupB.RtnHwAgOffsCalcdX.Ary2D /end REF_CHARACTERISTIC /begin REF_MEASUREMENT /end REF_MEASUREMENT /end GROUP
/begin GROUP CalRegn02Rt03GroupB.RtnHwAgOffsCalcdY.Ary2D "MICROSAR RTE" /begin SUB_GROUP /end SUB_GROUP /begin FUNCTION_LIST /end FUNCTION_LIST /begin REF_CHARACTERISTIC CalRegn02Rt03GroupB.RtnHwAgOffsCalcdY.Ary2D /end REF_CHARACTERISTIC /begin REF_MEASUREMENT /end REF_MEASUREMENT /end GROUP
/begin GROUP CalRegn02Rt03GroupB.RtnScaTqX.Ary2D "MICROSAR RTE" /begin SUB_GROUP /end SUB_GROUP /begin FUNCTION_LIST /end FUNCTION_LIST /begin REF_CHARACTERISTIC CalRegn02Rt03GroupB.RtnScaTqX.Ary2D /end REF_CHARACTERISTIC /begin REF_MEASUREMENT /end REF_MEASUREMENT /end GROUP
/begin GROUP CalRegn02Rt03GroupB.RtnScaTqY.Ary2D "MICROSAR RTE" /begin SUB_GROUP /end SUB_GROUP /begin FUNCTION_LIST /end FUNCTION_LIST /begin REF_CHARACTERISTIC CalRegn02Rt03GroupB.RtnScaTqY.Ary2D /end REF_CHARACTERISTIC /begin REF_MEASUREMENT /end REF_MEASUREMENT /end GROUP
/begin GROUP CalRegn02Rt03GroupB.RtnScaVelX.Ary2D "MICROSAR RTE" /begin SUB_GROUP /end SUB_GROUP /begin FUNCTION_LIST /end FUNCTION_LIST /begin REF_CHARACTERISTIC CalRegn02Rt03GroupB.RtnScaVelX.Ary2D /end REF_CHARACTERISTIC /begin REF_MEASUREMENT /end REF_MEASUREMENT /end GROUP
/begin GROUP CalRegn02Rt03GroupB.RtnScaVelY.Ary2D "MICROSAR RTE" /begin SUB_GROUP /end SUB_GROUP /begin FUNCTION_LIST /end FUNCTION_LIST /begin REF_CHARACTERISTIC CalRegn02Rt03GroupB.RtnScaVelY.Ary2D /end REF_CHARACTERISTIC /begin REF_MEASUREMENT /end REF_MEASUREMENT /end GROUP
/begin GROUP CalRegn02Rt03GroupB.RtnVehSpdSeln.Ary1D "MICROSAR RTE" /begin SUB_GROUP /end SUB_GROUP /begin FUNCTION_LIST /end FUNCTION_LIST /begin REF_CHARACTERISTIC CalRegn02Rt03GroupB.RtnVehSpdSeln.Ary1D /end REF_CHARACTERISTIC /begin REF_MEASUREMENT /end REF_MEASUREMENT /end GROUP
/begin GROUP CalRegn02Rt04GroupA "MICROSAR RTE" /begin SUB_GROUP CalRegn02Rt04GroupA.CalibrationPorts /end SUB_GROUP /begin FUNCTION_LIST /end FUNCTION_LIST /begin REF_CHARACTERISTIC /end REF_CHARACTERISTIC /begin REF_MEASUREMENT /end REF_MEASUREMENT /end GROUP
/begin GROUP CalRegn02Rt04GroupA.AssiHiFrqGainY.Ary2D "MICROSAR RTE" /begin SUB_GROUP /end SUB_GROUP /begin FUNCTION_LIST /end FUNCTION_LIST /begin REF_CHARACTERISTIC CalRegn02Rt04GroupA.AssiHiFrqGainY.Ary2D /end REF_CHARACTERISTIC /begin REF_MEASUREMENT /end REF_MEASUREMENT /end GROUP
/begin GROUP CalRegn02Rt04GroupA.AssiHiFrqHpFilFrqY.Ary1D "MICROSAR RTE" /begin SUB_GROUP /end SUB_GROUP /begin FUNCTION_LIST /end FUNCTION_LIST /begin REF_CHARACTERISTIC CalRegn02Rt04GroupA.AssiHiFrqHpFilFrqY.Ary1D /end REF_CHARACTERISTIC /begin REF_MEASUREMENT /end REF_MEASUREMENT /end GROUP
/begin GROUP CalRegn02Rt04GroupA.AssiHiFrqTqWhlImbRejctnTqX.Ary2D "MICROSAR RTE" /begin SUB_GROUP /end SUB_GROUP /begin FUNCTION_LIST /end FUNCTION_LIST /begin REF_CHARACTERISTIC CalRegn02Rt04GroupA.AssiHiFrqTqWhlImbRejctnTqX.Ary2D /end REF_CHARACTERISTIC /begin REF_MEASUREMENT /end REF_MEASUREMENT /end GROUP
/begin GROUP CalRegn02Rt04GroupA.AssiHiFrqTqX.Ary2D "MICROSAR RTE" /begin SUB_GROUP /end SUB_GROUP /begin FUNCTION_LIST /end FUNCTION_LIST /begin REF_CHARACTERISTIC CalRegn02Rt04GroupA.AssiHiFrqTqX.Ary2D /end REF_CHARACTERISTIC /begin REF_MEASUREMENT /end REF_MEASUREMENT /end GROUP
/begin GROUP CalRegn02Rt04GroupA.AssiHiFrqWhlImbRejctnBlndX.Ary2D "MICROSAR RTE" /begin SUB_GROUP /end SUB_GROUP /begin FUNCTION_LIST /end FUNCTION_LIST /begin REF_CHARACTERISTIC CalRegn02Rt04GroupA.AssiHiFrqWhlImbRejctnBlndX.Ary2D /end REF_CHARACTERISTIC /begin REF_MEASUREMENT /end REF_MEASUREMENT /end GROUP
/begin GROUP CalRegn02Rt04GroupA.AssiHiFrqWhlImbRejctnBlndY.Ary2D "MICROSAR RTE" /begin SUB_GROUP /end SUB_GROUP /begin FUNCTION_LIST /end FUNCTION_LIST /begin REF_CHARACTERISTIC CalRegn02Rt04GroupA.AssiHiFrqWhlImbRejctnBlndY.Ary2D /end REF_CHARACTERISTIC /begin REF_MEASUREMENT /end REF_MEASUREMENT /end GROUP
/begin GROUP CalRegn02Rt04GroupA.AssiHiFrqWhlImbRejctnGainY.Ary2D "MICROSAR RTE" /begin SUB_GROUP /end SUB_GROUP /begin FUNCTION_LIST /end FUNCTION_LIST /begin REF_CHARACTERISTIC CalRegn02Rt04GroupA.AssiHiFrqWhlImbRejctnGainY.Ary2D /end REF_CHARACTERISTIC /begin REF_MEASUREMENT /end REF_MEASUREMENT /end GROUP
/begin GROUP CalRegn02Rt04GroupA.AssiMotTqWhlImbRejctnMaxX.Ary2D "MICROSAR RTE" /begin SUB_GROUP /end SUB_GROUP /begin FUNCTION_LIST /end FUNCTION_LIST /begin REF_CHARACTERISTIC CalRegn02Rt04GroupA.AssiMotTqWhlImbRejctnMaxX.Ary2D /end REF_CHARACTERISTIC /begin REF_MEASUREMENT /end REF_MEASUREMENT /end GROUP
/begin GROUP CalRegn02Rt04GroupA.AssiMotTqWhlImbRejctnMaxY.Ary2D "MICROSAR RTE" /begin SUB_GROUP /end SUB_GROUP /begin FUNCTION_LIST /end FUNCTION_LIST /begin REF_CHARACTERISTIC CalRegn02Rt04GroupA.AssiMotTqWhlImbRejctnMaxY.Ary2D /end REF_CHARACTERISTIC /begin REF_MEASUREMENT /end REF_MEASUREMENT /end GROUP
/begin GROUP CalRegn02Rt04GroupA.AssiMotTqWhlImbRejctnMinX.Ary2D "MICROSAR RTE" /begin SUB_GROUP /end SUB_GROUP /begin FUNCTION_LIST /end FUNCTION_LIST /begin REF_CHARACTERISTIC CalRegn02Rt04GroupA.AssiMotTqWhlImbRejctnMinX.Ary2D /end REF_CHARACTERISTIC /begin REF_MEASUREMENT /end REF_MEASUREMENT /end GROUP
/begin GROUP CalRegn02Rt04GroupA.AssiMotTqWhlImbRejctnMinY.Ary2D "MICROSAR RTE" /begin SUB_GROUP /end SUB_GROUP /begin FUNCTION_LIST /end FUNCTION_LIST /begin REF_CHARACTERISTIC CalRegn02Rt04GroupA.AssiMotTqWhlImbRejctnMinY.Ary2D /end REF_CHARACTERISTIC /begin REF_MEASUREMENT /end REF_MEASUREMENT /end GROUP
/begin GROUP CalRegn02Rt04GroupA.AssiWhlImbRejctnBlndScaX.Ary2D "MICROSAR RTE" /begin SUB_GROUP /end SUB_GROUP /begin FUNCTION_LIST /end FUNCTION_LIST /begin REF_CHARACTERISTIC CalRegn02Rt04GroupA.AssiWhlImbRejctnBlndScaX.Ary2D /end REF_CHARACTERISTIC /begin REF_MEASUREMENT /end REF_MEASUREMENT /end GROUP
/begin GROUP CalRegn02Rt04GroupA.AssiWhlImbRejctnBlndScaY.Ary2D "MICROSAR RTE" /begin SUB_GROUP /end SUB_GROUP /begin FUNCTION_LIST /end FUNCTION_LIST /begin REF_CHARACTERISTIC CalRegn02Rt04GroupA.AssiWhlImbRejctnBlndScaY.Ary2D /end REF_CHARACTERISTIC /begin REF_MEASUREMENT /end REF_MEASUREMENT /end GROUP
/begin GROUP CalRegn02Rt04GroupA.CalibrationPorts "MICROSAR RTE"
 /begin SUB_GROUP CalRegn02Rt04GroupA.AssiHiFrqGainY.Ary2D CalRegn02Rt04GroupA.AssiHiFrqHpFilFrqY.Ary1D CalRegn02Rt04GroupA.AssiHiFrqTqWhlImbRejctnTqX.Ary2D CalRegn02Rt04GroupA.AssiHiFrqTqX.Ary2D CalRegn02Rt04GroupA.AssiHiFrqWhlImbRejctnBlndX.Ary2D CalRegn02Rt04GroupA.AssiHiFrqWhlImbRejctnBlndY.Ary2D CalRegn02Rt04GroupA.AssiHiFrqWhlImbRejctnGainY.Ary2D CalRegn02Rt04GroupA.AssiMotTqWhlImbRejctnMaxX.Ary2D CalRegn02Rt04GroupA.AssiMotTqWhlImbRejctnMaxY.Ary2D CalRegn02Rt04GroupA.AssiMotTqWhlImbRejctnMinX.Ary2D CalRegn02Rt04GroupA.AssiMotTqWhlImbRejctnMinY.Ary2D CalRegn02Rt04GroupA.AssiWhlImbRejctnBlndScaX.Ary2D CalRegn02Rt04GroupA.AssiWhlImbRejctnBlndScaY.Ary2D CalRegn02Rt04GroupA.DampgHwTqX.Ary1D CalRegn02Rt04GroupA.DampgHwTqY.Ary1D CalRegn02Rt04GroupA.DampgHydCoeff1ScaY.Ary1D CalRegn02Rt04GroupA.DampgHydCoeff2ScaY.Ary1D CalRegn02Rt04GroupA.DampgHydCoeff3ScaY.Ary1D CalRegn02Rt04GroupA.DampgHydCoeff4ScaY.Ary1D CalRegn02Rt04GroupA.DampgMotVelX.Ary2D CalRegn02Rt04GroupA.DampgMotVelY.Ary2D CalRegn02Rt04GroupA.HysCmpEffLossY.Ary1D CalRegn02Rt04GroupA.HysCmpEffOffsY.Ary1D CalRegn02Rt04GroupA.HysCmpFricWhlImbRejctnBlndX.Ary1D CalRegn02Rt04GroupA.HysCmpFricWhlImbRejctnBlndY.Ary1D CalRegn02Rt04GroupA.HysCmpFricWhlImbRejctnOffY.Ary1D CalRegn02Rt04GroupA.HysCmpFricWhlImbRejctnOnY.Ary1D CalRegn02Rt04GroupA.HysCmpHwTqScaX.Ary2D CalRegn02Rt04GroupA.HysCmpHwTqScaY.Ary2D CalRegn02Rt04GroupA.HysCmpHysSatnY.Ary1D CalRegn02Rt04GroupA.HysCmpNegHysCmpScaX.Ary1D CalRegn02Rt04GroupA.HysCmpNegHysCmpScaY.Ary1D CalRegn02Rt04GroupA.HysCmpNegHysCmpX.Ary1D CalRegn02Rt04GroupA.HysCmpNegHysCmpY.Ary1D CalRegn02Rt04GroupA.HysCmpOutpLim.Val CalRegn02Rt04GroupA.HysCmpRevGain.Val CalRegn02Rt04GroupA.HysCmpRiseX.Ary1D CalRegn02Rt04GroupA.HysCmpRiseY.Ary1D CalRegn02Rt04GroupA.InertiaCmpVelAssiBasdDampgStatY.Ary1D CalRegn02Rt04GroupA.InertiaCmpVelDampgFilFrq.Ary1D CalRegn02Rt04GroupA.InertiaCmpVelDampgFilFrqWhlImbRejctnOn.Ary1D CalRegn02Rt04GroupA.InertiaCmpVelDampgSpdBlndY.Ary1D CalRegn02Rt04GroupA.InertiaCmpVelDampgWhlImbRejctnBlndX.Ary1D CalRegn02Rt04GroupA.InertiaCmpVelDampgWhlImbRejctnBlndY.Ary1D /end SUB_GROUP
 /begin FUNCTION_LIST /end FUNCTION_LIST
 /begin REF_CHARACTERISTIC /end REF_CHARACTERISTIC
 /begin REF_MEASUREMENT /end REF_MEASUREMENT
/end GROUP
/begin GROUP CalRegn02Rt04GroupA.DampgHwTqX.Ary1D "MICROSAR RTE" /begin SUB_GROUP /end SUB_GROUP /begin FUNCTION_LIST /end FUNCTION_LIST /begin REF_CHARACTERISTIC CalRegn02Rt04GroupA.DampgHwTqX.Ary1D /end REF_CHARACTERISTIC /begin REF_MEASUREMENT /end REF_MEASUREMENT /end GROUP
/begin GROUP CalRegn02Rt04GroupA.DampgHwTqY.Ary1D "MICROSAR RTE" /begin SUB_GROUP /end SUB_GROUP /begin FUNCTION_LIST /end FUNCTION_LIST /begin REF_CHARACTERISTIC CalRegn02Rt04GroupA.DampgHwTqY.Ary1D /end REF_CHARACTERISTIC /begin REF_MEASUREMENT /end REF_MEASUREMENT /end GROUP
/begin GROUP CalRegn02Rt04GroupA.DampgHydCoeff1ScaY.Ary1D "MICROSAR RTE" /begin SUB_GROUP /end SUB_GROUP /begin FUNCTION_LIST /end FUNCTION_LIST /begin REF_CHARACTERISTIC CalRegn02Rt04GroupA.DampgHydCoeff1ScaY.Ary1D /end REF_CHARACTERISTIC /begin REF_MEASUREMENT /end REF_MEASUREMENT /end GROUP
/begin GROUP CalRegn02Rt04GroupA.DampgHydCoeff2ScaY.Ary1D "MICROSAR RTE" /begin SUB_GROUP /end SUB_GROUP /begin FUNCTION_LIST /end FUNCTION_LIST /begin REF_CHARACTERISTIC CalRegn02Rt04GroupA.DampgHydCoeff2ScaY.Ary1D /end REF_CHARACTERISTIC /begin REF_MEASUREMENT /end REF_MEASUREMENT /end GROUP
/begin GROUP CalRegn02Rt04GroupA.DampgHydCoeff3ScaY.Ary1D "MICROSAR RTE" /begin SUB_GROUP /end SUB_GROUP /begin FUNCTION_LIST /end FUNCTION_LIST /begin REF_CHARACTERISTIC CalRegn02Rt04GroupA.DampgHydCoeff3ScaY.Ary1D /end REF_CHARACTERISTIC /begin REF_MEASUREMENT /end REF_MEASUREMENT /end GROUP
/begin GROUP CalRegn02Rt04GroupA.DampgHydCoeff4ScaY.Ary1D "MICROSAR RTE" /begin SUB_GROUP /end SUB_GROUP /begin FUNCTION_LIST /end FUNCTION_LIST /begin REF_CHARACTERISTIC CalRegn02Rt04GroupA.DampgHydCoeff4ScaY.Ary1D /end REF_CHARACTERISTIC /begin REF_MEASUREMENT /end REF_MEASUREMENT /end GROUP
/begin GROUP CalRegn02Rt04GroupA.DampgMotVelX.Ary2D "MICROSAR RTE" /begin SUB_GROUP /end SUB_GROUP /begin FUNCTION_LIST /end FUNCTION_LIST /begin REF_CHARACTERISTIC CalRegn02Rt04GroupA.DampgMotVelX.Ary2D /end REF_CHARACTERISTIC /begin REF_MEASUREMENT /end REF_MEASUREMENT /end GROUP
/begin GROUP CalRegn02Rt04GroupA.DampgMotVelY.Ary2D "MICROSAR RTE" /begin SUB_GROUP /end SUB_GROUP /begin FUNCTION_LIST /end FUNCTION_LIST /begin REF_CHARACTERISTIC CalRegn02Rt04GroupA.DampgMotVelY.Ary2D /end REF_CHARACTERISTIC /begin REF_MEASUREMENT /end REF_MEASUREMENT /end GROUP
/begin GROUP CalRegn02Rt04GroupA.HysCmpEffLossY.Ary1D "MICROSAR RTE" /begin SUB_GROUP /end SUB_GROUP /begin FUNCTION_LIST /end FUNCTION_LIST /begin REF_CHARACTERISTIC CalRegn02Rt04GroupA.HysCmpEffLossY.Ary1D /end REF_CHARACTERISTIC /begin REF_MEASUREMENT /end REF_MEASUREMENT /end GROUP
/begin GROUP CalRegn02Rt04GroupA.HysCmpEffOffsY.Ary1D "MICROSAR RTE" /begin SUB_GROUP /end SUB_GROUP /begin FUNCTION_LIST /end FUNCTION_LIST /begin REF_CHARACTERISTIC CalRegn02Rt04GroupA.HysCmpEffOffsY.Ary1D /end REF_CHARACTERISTIC /begin REF_MEASUREMENT /end REF_MEASUREMENT /end GROUP
/begin GROUP CalRegn02Rt04GroupA.HysCmpFricWhlImbRejctnBlndX.Ary1D "MICROSAR RTE" /begin SUB_GROUP /end SUB_GROUP /begin FUNCTION_LIST /end FUNCTION_LIST /begin REF_CHARACTERISTIC CalRegn02Rt04GroupA.HysCmpFricWhlImbRejctnBlndX.Ary1D /end REF_CHARACTERISTIC /begin REF_MEASUREMENT /end REF_MEASUREMENT /end GROUP
/begin GROUP CalRegn02Rt04GroupA.HysCmpFricWhlImbRejctnBlndY.Ary1D "MICROSAR RTE" /begin SUB_GROUP /end SUB_GROUP /begin FUNCTION_LIST /end FUNCTION_LIST /begin REF_CHARACTERISTIC CalRegn02Rt04GroupA.HysCmpFricWhlImbRejctnBlndY.Ary1D /end REF_CHARACTERISTIC /begin REF_MEASUREMENT /end REF_MEASUREMENT /end GROUP
/begin GROUP CalRegn02Rt04GroupA.HysCmpFricWhlImbRejctnOffY.Ary1D "MICROSAR RTE" /begin SUB_GROUP /end SUB_GROUP /begin FUNCTION_LIST /end FUNCTION_LIST /begin REF_CHARACTERISTIC CalRegn02Rt04GroupA.HysCmpFricWhlImbRejctnOffY.Ary1D /end REF_CHARACTERISTIC /begin REF_MEASUREMENT /end REF_MEASUREMENT /end GROUP
/begin GROUP CalRegn02Rt04GroupA.HysCmpFricWhlImbRejctnOnY.Ary1D "MICROSAR RTE" /begin SUB_GROUP /end SUB_GROUP /begin FUNCTION_LIST /end FUNCTION_LIST /begin REF_CHARACTERISTIC CalRegn02Rt04GroupA.HysCmpFricWhlImbRejctnOnY.Ary1D /end REF_CHARACTERISTIC /begin REF_MEASUREMENT /end REF_MEASUREMENT /end GROUP
/begin GROUP CalRegn02Rt04GroupA.HysCmpHwTqScaX.Ary2D "MICROSAR RTE" /begin SUB_GROUP /end SUB_GROUP /begin FUNCTION_LIST /end FUNCTION_LIST /begin REF_CHARACTERISTIC CalRegn02Rt04GroupA.HysCmpHwTqScaX.Ary2D /end REF_CHARACTERISTIC /begin REF_MEASUREMENT /end REF_MEASUREMENT /end GROUP
/begin GROUP CalRegn02Rt04GroupA.HysCmpHwTqScaY.Ary2D "MICROSAR RTE" /begin SUB_GROUP /end SUB_GROUP /begin FUNCTION_LIST /end FUNCTION_LIST /begin REF_CHARACTERISTIC CalRegn02Rt04GroupA.HysCmpHwTqScaY.Ary2D /end REF_CHARACTERISTIC /begin REF_MEASUREMENT /end REF_MEASUREMENT /end GROUP
/begin GROUP CalRegn02Rt04GroupA.HysCmpHysSatnY.Ary1D "MICROSAR RTE" /begin SUB_GROUP /end SUB_GROUP /begin FUNCTION_LIST /end FUNCTION_LIST /begin REF_CHARACTERISTIC CalRegn02Rt04GroupA.HysCmpHysSatnY.Ary1D /end REF_CHARACTERISTIC /begin REF_MEASUREMENT /end REF_MEASUREMENT /end GROUP
/begin GROUP CalRegn02Rt04GroupA.HysCmpNegHysCmpScaX.Ary1D "MICROSAR RTE" /begin SUB_GROUP /end SUB_GROUP /begin FUNCTION_LIST /end FUNCTION_LIST /begin REF_CHARACTERISTIC CalRegn02Rt04GroupA.HysCmpNegHysCmpScaX.Ary1D /end REF_CHARACTERISTIC /begin REF_MEASUREMENT /end REF_MEASUREMENT /end GROUP
/begin GROUP CalRegn02Rt04GroupA.HysCmpNegHysCmpScaY.Ary1D "MICROSAR RTE" /begin SUB_GROUP /end SUB_GROUP /begin FUNCTION_LIST /end FUNCTION_LIST /begin REF_CHARACTERISTIC CalRegn02Rt04GroupA.HysCmpNegHysCmpScaY.Ary1D /end REF_CHARACTERISTIC /begin REF_MEASUREMENT /end REF_MEASUREMENT /end GROUP
/begin GROUP CalRegn02Rt04GroupA.HysCmpNegHysCmpX.Ary1D "MICROSAR RTE" /begin SUB_GROUP /end SUB_GROUP /begin FUNCTION_LIST /end FUNCTION_LIST /begin REF_CHARACTERISTIC CalRegn02Rt04GroupA.HysCmpNegHysCmpX.Ary1D /end REF_CHARACTERISTIC /begin REF_MEASUREMENT /end REF_MEASUREMENT /end GROUP
/begin GROUP CalRegn02Rt04GroupA.HysCmpNegHysCmpY.Ary1D "MICROSAR RTE" /begin SUB_GROUP /end SUB_GROUP /begin FUNCTION_LIST /end FUNCTION_LIST /begin REF_CHARACTERISTIC CalRegn02Rt04GroupA.HysCmpNegHysCmpY.Ary1D /end REF_CHARACTERISTIC /begin REF_MEASUREMENT /end REF_MEASUREMENT /end GROUP
/begin GROUP CalRegn02Rt04GroupA.HysCmpOutpLim.Val "MICROSAR RTE" /begin SUB_GROUP /end SUB_GROUP /begin FUNCTION_LIST /end FUNCTION_LIST /begin REF_CHARACTERISTIC CalRegn02Rt04GroupA.HysCmpOutpLim.Val /end REF_CHARACTERISTIC /begin REF_MEASUREMENT /end REF_MEASUREMENT /end GROUP
/begin GROUP CalRegn02Rt04GroupA.HysCmpRevGain.Val "MICROSAR RTE" /begin SUB_GROUP /end SUB_GROUP /begin FUNCTION_LIST /end FUNCTION_LIST /begin REF_CHARACTERISTIC CalRegn02Rt04GroupA.HysCmpRevGain.Val /end REF_CHARACTERISTIC /begin REF_MEASUREMENT /end REF_MEASUREMENT /end GROUP
/begin GROUP CalRegn02Rt04GroupA.HysCmpRiseX.Ary1D "MICROSAR RTE" /begin SUB_GROUP /end SUB_GROUP /begin FUNCTION_LIST /end FUNCTION_LIST /begin REF_CHARACTERISTIC CalRegn02Rt04GroupA.HysCmpRiseX.Ary1D /end REF_CHARACTERISTIC /begin REF_MEASUREMENT /end REF_MEASUREMENT /end GROUP
/begin GROUP CalRegn02Rt04GroupA.HysCmpRiseY.Ary1D "MICROSAR RTE" /begin SUB_GROUP /end SUB_GROUP /begin FUNCTION_LIST /end FUNCTION_LIST /begin REF_CHARACTERISTIC CalRegn02Rt04GroupA.HysCmpRiseY.Ary1D /end REF_CHARACTERISTIC /begin REF_MEASUREMENT /end REF_MEASUREMENT /end GROUP
/begin GROUP CalRegn02Rt04GroupA.InertiaCmpVelAssiBasdDampgStatY.Ary1D "MICROSAR RTE" /begin SUB_GROUP /end SUB_GROUP /begin FUNCTION_LIST /end FUNCTION_LIST /begin REF_CHARACTERISTIC CalRegn02Rt04GroupA.InertiaCmpVelAssiBasdDampgStatY.Ary1D /end REF_CHARACTERISTIC /begin REF_MEASUREMENT /end REF_MEASUREMENT /end GROUP
/begin GROUP CalRegn02Rt04GroupA.InertiaCmpVelDampgFilFrq.Ary1D "MICROSAR RTE" /begin SUB_GROUP /end SUB_GROUP /begin FUNCTION_LIST /end FUNCTION_LIST /begin REF_CHARACTERISTIC CalRegn02Rt04GroupA.InertiaCmpVelDampgFilFrq.Ary1D /end REF_CHARACTERISTIC /begin REF_MEASUREMENT /end REF_MEASUREMENT /end GROUP
/begin GROUP CalRegn02Rt04GroupA.InertiaCmpVelDampgFilFrqWhlImbRejctnOn.Ary1D "MICROSAR RTE" /begin SUB_GROUP /end SUB_GROUP /begin FUNCTION_LIST /end FUNCTION_LIST
 /begin REF_CHARACTERISTIC CalRegn02Rt04GroupA.InertiaCmpVelDampgFilFrqWhlImbRejctnOn.Ary1D /end REF_CHARACTERISTIC
 /begin REF_MEASUREMENT /end REF_MEASUREMENT
/end GROUP
/begin GROUP CalRegn02Rt04GroupA.InertiaCmpVelDampgSpdBlndY.Ary1D "MICROSAR RTE" /begin SUB_GROUP /end SUB_GROUP /begin FUNCTION_LIST /end FUNCTION_LIST /begin REF_CHARACTERISTIC CalRegn02Rt04GroupA.InertiaCmpVelDampgSpdBlndY.Ary1D /end REF_CHARACTERISTIC /begin REF_MEASUREMENT /end REF_MEASUREMENT /end GROUP
/begin GROUP CalRegn02Rt04GroupA.InertiaCmpVelDampgWhlImbRejctnBlndX.Ary1D "MICROSAR RTE" /begin SUB_GROUP /end SUB_GROUP /begin FUNCTION_LIST /end FUNCTION_LIST
 /begin REF_CHARACTERISTIC CalRegn02Rt04GroupA.InertiaCmpVelDampgWhlImbRejctnBlndX.Ary1D /end REF_CHARACTERISTIC
 /begin REF_MEASUREMENT /end REF_MEASUREMENT
/end GROUP
/begin GROUP CalRegn02Rt04GroupA.InertiaCmpVelDampgWhlImbRejctnBlndY.Ary1D "MICROSAR RTE" /begin SUB_GROUP /end SUB_GROUP /begin FUNCTION_LIST /end FUNCTION_LIST
 /begin REF_CHARACTERISTIC CalRegn02Rt04GroupA.InertiaCmpVelDampgWhlImbRejctnBlndY.Ary1D /end REF_CHARACTERISTIC
 /begin REF_MEASUREMENT /end REF_MEASUREMENT
/end GROUP
/begin GROUP CalRegn02Rt04GroupB "MICROSAR RTE" /begin SUB_GROUP CalRegn02Rt04GroupB.CalibrationPorts /end SUB_GROUP /begin FUNCTION_LIST /end FUNCTION_LIST /begin REF_CHARACTERISTIC /end REF_CHARACTERISTIC /begin REF_MEASUREMENT /end REF_MEASUREMENT /end GROUP
/begin GROUP CalRegn02Rt04GroupB.CalibrationPorts "MICROSAR RTE"
 /begin SUB_GROUP CalRegn02Rt04GroupB.EotProtnDampgVehSpdTbl.Ary1D CalRegn02Rt04GroupB.EotProtnDeltaTqThd.Val CalRegn02Rt04GroupB.EotProtnEntrGainVehSpdTbl.Ary1D CalRegn02Rt04GroupB.EotProtnEntrGainY.Ary2D CalRegn02Rt04GroupB.EotProtnLoAuthyEntrGainY.Ary2D CalRegn02Rt04GroupB.EotProtnMotSpdIncptY.Ary1D CalRegn02Rt04GroupB.EotProtnNormDampgY.Ary2D CalRegn02Rt04GroupB.EotProtnSoftEndStopAuthyThd.Val CalRegn02Rt04GroupB.RtnHwAgOffsCalcdX.Ary2D CalRegn02Rt04GroupB.RtnHwAgOffsCalcdY.Ary2D CalRegn02Rt04GroupB.RtnScaTqX.Ary2D CalRegn02Rt04GroupB.RtnScaTqY.Ary2D CalRegn02Rt04GroupB.RtnScaVelX.Ary2D CalRegn02Rt04GroupB.RtnScaVelY.Ary2D CalRegn02Rt04GroupB.RtnVehSpdSeln.Ary1D /end SUB_GROUP
 /begin FUNCTION_LIST /end FUNCTION_LIST
 /begin REF_CHARACTERISTIC /end REF_CHARACTERISTIC
 /begin REF_MEASUREMENT /end REF_MEASUREMENT
/end GROUP
/begin GROUP CalRegn02Rt04GroupB.EotProtnDampgVehSpdTbl.Ary1D "MICROSAR RTE" /begin SUB_GROUP /end SUB_GROUP /begin FUNCTION_LIST /end FUNCTION_LIST /begin REF_CHARACTERISTIC CalRegn02Rt04GroupB.EotProtnDampgVehSpdTbl.Ary1D /end REF_CHARACTERISTIC /begin REF_MEASUREMENT /end REF_MEASUREMENT /end GROUP
/begin GROUP CalRegn02Rt04GroupB.EotProtnDeltaTqThd.Val "MICROSAR RTE" /begin SUB_GROUP /end SUB_GROUP /begin FUNCTION_LIST /end FUNCTION_LIST /begin REF_CHARACTERISTIC CalRegn02Rt04GroupB.EotProtnDeltaTqThd.Val /end REF_CHARACTERISTIC /begin REF_MEASUREMENT /end REF_MEASUREMENT /end GROUP
/begin GROUP CalRegn02Rt04GroupB.EotProtnEntrGainVehSpdTbl.Ary1D "MICROSAR RTE" /begin SUB_GROUP /end SUB_GROUP /begin FUNCTION_LIST /end FUNCTION_LIST /begin REF_CHARACTERISTIC CalRegn02Rt04GroupB.EotProtnEntrGainVehSpdTbl.Ary1D /end REF_CHARACTERISTIC /begin REF_MEASUREMENT /end REF_MEASUREMENT /end GROUP
/begin GROUP CalRegn02Rt04GroupB.EotProtnEntrGainY.Ary2D "MICROSAR RTE" /begin SUB_GROUP /end SUB_GROUP /begin FUNCTION_LIST /end FUNCTION_LIST /begin REF_CHARACTERISTIC CalRegn02Rt04GroupB.EotProtnEntrGainY.Ary2D /end REF_CHARACTERISTIC /begin REF_MEASUREMENT /end REF_MEASUREMENT /end GROUP
/begin GROUP CalRegn02Rt04GroupB.EotProtnLoAuthyEntrGainY.Ary2D "MICROSAR RTE" /begin SUB_GROUP /end SUB_GROUP /begin FUNCTION_LIST /end FUNCTION_LIST /begin REF_CHARACTERISTIC CalRegn02Rt04GroupB.EotProtnLoAuthyEntrGainY.Ary2D /end REF_CHARACTERISTIC /begin REF_MEASUREMENT /end REF_MEASUREMENT /end GROUP
/begin GROUP CalRegn02Rt04GroupB.EotProtnMotSpdIncptY.Ary1D "MICROSAR RTE" /begin SUB_GROUP /end SUB_GROUP /begin FUNCTION_LIST /end FUNCTION_LIST /begin REF_CHARACTERISTIC CalRegn02Rt04GroupB.EotProtnMotSpdIncptY.Ary1D /end REF_CHARACTERISTIC /begin REF_MEASUREMENT /end REF_MEASUREMENT /end GROUP
/begin GROUP CalRegn02Rt04GroupB.EotProtnNormDampgY.Ary2D "MICROSAR RTE" /begin SUB_GROUP /end SUB_GROUP /begin FUNCTION_LIST /end FUNCTION_LIST /begin REF_CHARACTERISTIC CalRegn02Rt04GroupB.EotProtnNormDampgY.Ary2D /end REF_CHARACTERISTIC /begin REF_MEASUREMENT /end REF_MEASUREMENT /end GROUP
/begin GROUP CalRegn02Rt04GroupB.EotProtnSoftEndStopAuthyThd.Val "MICROSAR RTE" /begin SUB_GROUP /end SUB_GROUP /begin FUNCTION_LIST /end FUNCTION_LIST /begin REF_CHARACTERISTIC CalRegn02Rt04GroupB.EotProtnSoftEndStopAuthyThd.Val /end REF_CHARACTERISTIC /begin REF_MEASUREMENT /end REF_MEASUREMENT /end GROUP
/begin GROUP CalRegn02Rt04GroupB.RtnHwAgOffsCalcdX.Ary2D "MICROSAR RTE" /begin SUB_GROUP /end SUB_GROUP /begin FUNCTION_LIST /end FUNCTION_LIST /begin REF_CHARACTERISTIC CalRegn02Rt04GroupB.RtnHwAgOffsCalcdX.Ary2D /end REF_CHARACTERISTIC /begin REF_MEASUREMENT /end REF_MEASUREMENT /end GROUP
/begin GROUP CalRegn02Rt04GroupB.RtnHwAgOffsCalcdY.Ary2D "MICROSAR RTE" /begin SUB_GROUP /end SUB_GROUP /begin FUNCTION_LIST /end FUNCTION_LIST /begin REF_CHARACTERISTIC CalRegn02Rt04GroupB.RtnHwAgOffsCalcdY.Ary2D /end REF_CHARACTERISTIC /begin REF_MEASUREMENT /end REF_MEASUREMENT /end GROUP
/begin GROUP CalRegn02Rt04GroupB.RtnScaTqX.Ary2D "MICROSAR RTE" /begin SUB_GROUP /end SUB_GROUP /begin FUNCTION_LIST /end FUNCTION_LIST /begin REF_CHARACTERISTIC CalRegn02Rt04GroupB.RtnScaTqX.Ary2D /end REF_CHARACTERISTIC /begin REF_MEASUREMENT /end REF_MEASUREMENT /end GROUP
/begin GROUP CalRegn02Rt04GroupB.RtnScaTqY.Ary2D "MICROSAR RTE" /begin SUB_GROUP /end SUB_GROUP /begin FUNCTION_LIST /end FUNCTION_LIST /begin REF_CHARACTERISTIC CalRegn02Rt04GroupB.RtnScaTqY.Ary2D /end REF_CHARACTERISTIC /begin REF_MEASUREMENT /end REF_MEASUREMENT /end GROUP
/begin GROUP CalRegn02Rt04GroupB.RtnScaVelX.Ary2D "MICROSAR RTE" /begin SUB_GROUP /end SUB_GROUP /begin FUNCTION_LIST /end FUNCTION_LIST /begin REF_CHARACTERISTIC CalRegn02Rt04GroupB.RtnScaVelX.Ary2D /end REF_CHARACTERISTIC /begin REF_MEASUREMENT /end REF_MEASUREMENT /end GROUP
/begin GROUP CalRegn02Rt04GroupB.RtnScaVelY.Ary2D "MICROSAR RTE" /begin SUB_GROUP /end SUB_GROUP /begin FUNCTION_LIST /end FUNCTION_LIST /begin REF_CHARACTERISTIC CalRegn02Rt04GroupB.RtnScaVelY.Ary2D /end REF_CHARACTERISTIC /begin REF_MEASUREMENT /end REF_MEASUREMENT /end GROUP
/begin GROUP CalRegn02Rt04GroupB.RtnVehSpdSeln.Ary1D "MICROSAR RTE" /begin SUB_GROUP /end SUB_GROUP /begin FUNCTION_LIST /end FUNCTION_LIST /begin REF_CHARACTERISTIC CalRegn02Rt04GroupB.RtnVehSpdSeln.Ary1D /end REF_CHARACTERISTIC /begin REF_MEASUREMENT /end REF_MEASUREMENT /end GROUP
/begin GROUP CalRegn02Rt05GroupA "MICROSAR RTE" /begin SUB_GROUP CalRegn02Rt05GroupA.CalibrationPorts /end SUB_GROUP /begin FUNCTION_LIST /end FUNCTION_LIST /begin REF_CHARACTERISTIC /end REF_CHARACTERISTIC /begin REF_MEASUREMENT /end REF_MEASUREMENT /end GROUP
/begin GROUP CalRegn02Rt05GroupA.AssiHiFrqGainY.Ary2D "MICROSAR RTE" /begin SUB_GROUP /end SUB_GROUP /begin FUNCTION_LIST /end FUNCTION_LIST /begin REF_CHARACTERISTIC CalRegn02Rt05GroupA.AssiHiFrqGainY.Ary2D /end REF_CHARACTERISTIC /begin REF_MEASUREMENT /end REF_MEASUREMENT /end GROUP
/begin GROUP CalRegn02Rt05GroupA.AssiHiFrqHpFilFrqY.Ary1D "MICROSAR RTE" /begin SUB_GROUP /end SUB_GROUP /begin FUNCTION_LIST /end FUNCTION_LIST /begin REF_CHARACTERISTIC CalRegn02Rt05GroupA.AssiHiFrqHpFilFrqY.Ary1D /end REF_CHARACTERISTIC /begin REF_MEASUREMENT /end REF_MEASUREMENT /end GROUP
/begin GROUP CalRegn02Rt05GroupA.AssiHiFrqTqWhlImbRejctnTqX.Ary2D "MICROSAR RTE" /begin SUB_GROUP /end SUB_GROUP /begin FUNCTION_LIST /end FUNCTION_LIST /begin REF_CHARACTERISTIC CalRegn02Rt05GroupA.AssiHiFrqTqWhlImbRejctnTqX.Ary2D /end REF_CHARACTERISTIC /begin REF_MEASUREMENT /end REF_MEASUREMENT /end GROUP
/begin GROUP CalRegn02Rt05GroupA.AssiHiFrqTqX.Ary2D "MICROSAR RTE" /begin SUB_GROUP /end SUB_GROUP /begin FUNCTION_LIST /end FUNCTION_LIST /begin REF_CHARACTERISTIC CalRegn02Rt05GroupA.AssiHiFrqTqX.Ary2D /end REF_CHARACTERISTIC /begin REF_MEASUREMENT /end REF_MEASUREMENT /end GROUP
/begin GROUP CalRegn02Rt05GroupA.AssiHiFrqWhlImbRejctnBlndX.Ary2D "MICROSAR RTE" /begin SUB_GROUP /end SUB_GROUP /begin FUNCTION_LIST /end FUNCTION_LIST /begin REF_CHARACTERISTIC CalRegn02Rt05GroupA.AssiHiFrqWhlImbRejctnBlndX.Ary2D /end REF_CHARACTERISTIC /begin REF_MEASUREMENT /end REF_MEASUREMENT /end GROUP
/begin GROUP CalRegn02Rt05GroupA.AssiHiFrqWhlImbRejctnBlndY.Ary2D "MICROSAR RTE" /begin SUB_GROUP /end SUB_GROUP /begin FUNCTION_LIST /end FUNCTION_LIST /begin REF_CHARACTERISTIC CalRegn02Rt05GroupA.AssiHiFrqWhlImbRejctnBlndY.Ary2D /end REF_CHARACTERISTIC /begin REF_MEASUREMENT /end REF_MEASUREMENT /end GROUP
/begin GROUP CalRegn02Rt05GroupA.AssiHiFrqWhlImbRejctnGainY.Ary2D "MICROSAR RTE" /begin SUB_GROUP /end SUB_GROUP /begin FUNCTION_LIST /end FUNCTION_LIST /begin REF_CHARACTERISTIC CalRegn02Rt05GroupA.AssiHiFrqWhlImbRejctnGainY.Ary2D /end REF_CHARACTERISTIC /begin REF_MEASUREMENT /end REF_MEASUREMENT /end GROUP
/begin GROUP CalRegn02Rt05GroupA.AssiMotTqWhlImbRejctnMaxX.Ary2D "MICROSAR RTE" /begin SUB_GROUP /end SUB_GROUP /begin FUNCTION_LIST /end FUNCTION_LIST /begin REF_CHARACTERISTIC CalRegn02Rt05GroupA.AssiMotTqWhlImbRejctnMaxX.Ary2D /end REF_CHARACTERISTIC /begin REF_MEASUREMENT /end REF_MEASUREMENT /end GROUP
/begin GROUP CalRegn02Rt05GroupA.AssiMotTqWhlImbRejctnMaxY.Ary2D "MICROSAR RTE" /begin SUB_GROUP /end SUB_GROUP /begin FUNCTION_LIST /end FUNCTION_LIST /begin REF_CHARACTERISTIC CalRegn02Rt05GroupA.AssiMotTqWhlImbRejctnMaxY.Ary2D /end REF_CHARACTERISTIC /begin REF_MEASUREMENT /end REF_MEASUREMENT /end GROUP
/begin GROUP CalRegn02Rt05GroupA.AssiMotTqWhlImbRejctnMinX.Ary2D "MICROSAR RTE" /begin SUB_GROUP /end SUB_GROUP /begin FUNCTION_LIST /end FUNCTION_LIST /begin REF_CHARACTERISTIC CalRegn02Rt05GroupA.AssiMotTqWhlImbRejctnMinX.Ary2D /end REF_CHARACTERISTIC /begin REF_MEASUREMENT /end REF_MEASUREMENT /end GROUP
/begin GROUP CalRegn02Rt05GroupA.AssiMotTqWhlImbRejctnMinY.Ary2D "MICROSAR RTE" /begin SUB_GROUP /end SUB_GROUP /begin FUNCTION_LIST /end FUNCTION_LIST /begin REF_CHARACTERISTIC CalRegn02Rt05GroupA.AssiMotTqWhlImbRejctnMinY.Ary2D /end REF_CHARACTERISTIC /begin REF_MEASUREMENT /end REF_MEASUREMENT /end GROUP
/begin GROUP CalRegn02Rt05GroupA.AssiWhlImbRejctnBlndScaX.Ary2D "MICROSAR RTE" /begin SUB_GROUP /end SUB_GROUP /begin FUNCTION_LIST /end FUNCTION_LIST /begin REF_CHARACTERISTIC CalRegn02Rt05GroupA.AssiWhlImbRejctnBlndScaX.Ary2D /end REF_CHARACTERISTIC /begin REF_MEASUREMENT /end REF_MEASUREMENT /end GROUP
/begin GROUP CalRegn02Rt05GroupA.AssiWhlImbRejctnBlndScaY.Ary2D "MICROSAR RTE" /begin SUB_GROUP /end SUB_GROUP /begin FUNCTION_LIST /end FUNCTION_LIST /begin REF_CHARACTERISTIC CalRegn02Rt05GroupA.AssiWhlImbRejctnBlndScaY.Ary2D /end REF_CHARACTERISTIC /begin REF_MEASUREMENT /end REF_MEASUREMENT /end GROUP
/begin GROUP CalRegn02Rt05GroupA.CalibrationPorts "MICROSAR RTE"
 /begin SUB_GROUP CalRegn02Rt05GroupA.AssiHiFrqGainY.Ary2D CalRegn02Rt05GroupA.AssiHiFrqHpFilFrqY.Ary1D CalRegn02Rt05GroupA.AssiHiFrqTqWhlImbRejctnTqX.Ary2D CalRegn02Rt05GroupA.AssiHiFrqTqX.Ary2D CalRegn02Rt05GroupA.AssiHiFrqWhlImbRejctnBlndX.Ary2D CalRegn02Rt05GroupA.AssiHiFrqWhlImbRejctnBlndY.Ary2D CalRegn02Rt05GroupA.AssiHiFrqWhlImbRejctnGainY.Ary2D CalRegn02Rt05GroupA.AssiMotTqWhlImbRejctnMaxX.Ary2D CalRegn02Rt05GroupA.AssiMotTqWhlImbRejctnMaxY.Ary2D CalRegn02Rt05GroupA.AssiMotTqWhlImbRejctnMinX.Ary2D CalRegn02Rt05GroupA.AssiMotTqWhlImbRejctnMinY.Ary2D CalRegn02Rt05GroupA.AssiWhlImbRejctnBlndScaX.Ary2D CalRegn02Rt05GroupA.AssiWhlImbRejctnBlndScaY.Ary2D CalRegn02Rt05GroupA.DampgHwTqX.Ary1D CalRegn02Rt05GroupA.DampgHwTqY.Ary1D CalRegn02Rt05GroupA.DampgHydCoeff1ScaY.Ary1D CalRegn02Rt05GroupA.DampgHydCoeff2ScaY.Ary1D CalRegn02Rt05GroupA.DampgHydCoeff3ScaY.Ary1D CalRegn02Rt05GroupA.DampgHydCoeff4ScaY.Ary1D CalRegn02Rt05GroupA.DampgMotVelX.Ary2D CalRegn02Rt05GroupA.DampgMotVelY.Ary2D CalRegn02Rt05GroupA.HysCmpEffLossY.Ary1D CalRegn02Rt05GroupA.HysCmpEffOffsY.Ary1D CalRegn02Rt05GroupA.HysCmpFricWhlImbRejctnBlndX.Ary1D CalRegn02Rt05GroupA.HysCmpFricWhlImbRejctnBlndY.Ary1D CalRegn02Rt05GroupA.HysCmpFricWhlImbRejctnOffY.Ary1D CalRegn02Rt05GroupA.HysCmpFricWhlImbRejctnOnY.Ary1D CalRegn02Rt05GroupA.HysCmpHwTqScaX.Ary2D CalRegn02Rt05GroupA.HysCmpHwTqScaY.Ary2D CalRegn02Rt05GroupA.HysCmpHysSatnY.Ary1D CalRegn02Rt05GroupA.HysCmpNegHysCmpScaX.Ary1D CalRegn02Rt05GroupA.HysCmpNegHysCmpScaY.Ary1D CalRegn02Rt05GroupA.HysCmpNegHysCmpX.Ary1D CalRegn02Rt05GroupA.HysCmpNegHysCmpY.Ary1D CalRegn02Rt05GroupA.HysCmpOutpLim.Val CalRegn02Rt05GroupA.HysCmpRevGain.Val CalRegn02Rt05GroupA.HysCmpRiseX.Ary1D CalRegn02Rt05GroupA.HysCmpRiseY.Ary1D CalRegn02Rt05GroupA.InertiaCmpVelAssiBasdDampgStatY.Ary1D CalRegn02Rt05GroupA.InertiaCmpVelDampgFilFrq.Ary1D CalRegn02Rt05GroupA.InertiaCmpVelDampgFilFrqWhlImbRejctnOn.Ary1D CalRegn02Rt05GroupA.InertiaCmpVelDampgSpdBlndY.Ary1D CalRegn02Rt05GroupA.InertiaCmpVelDampgWhlImbRejctnBlndX.Ary1D CalRegn02Rt05GroupA.InertiaCmpVelDampgWhlImbRejctnBlndY.Ary1D /end SUB_GROUP
 /begin FUNCTION_LIST /end FUNCTION_LIST
 /begin REF_CHARACTERISTIC /end REF_CHARACTERISTIC
 /begin REF_MEASUREMENT /end REF_MEASUREMENT
/end GROUP
/begin GROUP CalRegn02Rt05GroupA.DampgHwTqX.Ary1D "MICROSAR RTE" /begin SUB_GROUP /end SUB_GROUP /begin FUNCTION_LIST /end FUNCTION_LIST /begin REF_CHARACTERISTIC CalRegn02Rt05GroupA.DampgHwTqX.Ary1D /end REF_CHARACTERISTIC /begin REF_MEASUREMENT /end REF_MEASUREMENT /end GROUP
/begin GROUP CalRegn02Rt05GroupA.DampgHwTqY.Ary1D "MICROSAR RTE" /begin SUB_GROUP /end SUB_GROUP /begin FUNCTION_LIST /end FUNCTION_LIST /begin REF_CHARACTERISTIC CalRegn02Rt05GroupA.DampgHwTqY.Ary1D /end REF_CHARACTERISTIC /begin REF_MEASUREMENT /end REF_MEASUREMENT /end GROUP
/begin GROUP CalRegn02Rt05GroupA.DampgHydCoeff1ScaY.Ary1D "MICROSAR RTE" /begin SUB_GROUP /end SUB_GROUP /begin FUNCTION_LIST /end FUNCTION_LIST /begin REF_CHARACTERISTIC CalRegn02Rt05GroupA.DampgHydCoeff1ScaY.Ary1D /end REF_CHARACTERISTIC /begin REF_MEASUREMENT /end REF_MEASUREMENT /end GROUP
/begin GROUP CalRegn02Rt05GroupA.DampgHydCoeff2ScaY.Ary1D "MICROSAR RTE" /begin SUB_GROUP /end SUB_GROUP /begin FUNCTION_LIST /end FUNCTION_LIST /begin REF_CHARACTERISTIC CalRegn02Rt05GroupA.DampgHydCoeff2ScaY.Ary1D /end REF_CHARACTERISTIC /begin REF_MEASUREMENT /end REF_MEASUREMENT /end GROUP
/begin GROUP CalRegn02Rt05GroupA.DampgHydCoeff3ScaY.Ary1D "MICROSAR RTE" /begin SUB_GROUP /end SUB_GROUP /begin FUNCTION_LIST /end FUNCTION_LIST /begin REF_CHARACTERISTIC CalRegn02Rt05GroupA.DampgHydCoeff3ScaY.Ary1D /end REF_CHARACTERISTIC /begin REF_MEASUREMENT /end REF_MEASUREMENT /end GROUP
/begin GROUP CalRegn02Rt05GroupA.DampgHydCoeff4ScaY.Ary1D "MICROSAR RTE" /begin SUB_GROUP /end SUB_GROUP /begin FUNCTION_LIST /end FUNCTION_LIST /begin REF_CHARACTERISTIC CalRegn02Rt05GroupA.DampgHydCoeff4ScaY.Ary1D /end REF_CHARACTERISTIC /begin REF_MEASUREMENT /end REF_MEASUREMENT /end GROUP
/begin GROUP CalRegn02Rt05GroupA.DampgMotVelX.Ary2D "MICROSAR RTE" /begin SUB_GROUP /end SUB_GROUP /begin FUNCTION_LIST /end FUNCTION_LIST /begin REF_CHARACTERISTIC CalRegn02Rt05GroupA.DampgMotVelX.Ary2D /end REF_CHARACTERISTIC /begin REF_MEASUREMENT /end REF_MEASUREMENT /end GROUP
/begin GROUP CalRegn02Rt05GroupA.DampgMotVelY.Ary2D "MICROSAR RTE" /begin SUB_GROUP /end SUB_GROUP /begin FUNCTION_LIST /end FUNCTION_LIST /begin REF_CHARACTERISTIC CalRegn02Rt05GroupA.DampgMotVelY.Ary2D /end REF_CHARACTERISTIC /begin REF_MEASUREMENT /end REF_MEASUREMENT /end GROUP
/begin GROUP CalRegn02Rt05GroupA.HysCmpEffLossY.Ary1D "MICROSAR RTE" /begin SUB_GROUP /end SUB_GROUP /begin FUNCTION_LIST /end FUNCTION_LIST /begin REF_CHARACTERISTIC CalRegn02Rt05GroupA.HysCmpEffLossY.Ary1D /end REF_CHARACTERISTIC /begin REF_MEASUREMENT /end REF_MEASUREMENT /end GROUP
/begin GROUP CalRegn02Rt05GroupA.HysCmpEffOffsY.Ary1D "MICROSAR RTE" /begin SUB_GROUP /end SUB_GROUP /begin FUNCTION_LIST /end FUNCTION_LIST /begin REF_CHARACTERISTIC CalRegn02Rt05GroupA.HysCmpEffOffsY.Ary1D /end REF_CHARACTERISTIC /begin REF_MEASUREMENT /end REF_MEASUREMENT /end GROUP
/begin GROUP CalRegn02Rt05GroupA.HysCmpFricWhlImbRejctnBlndX.Ary1D "MICROSAR RTE" /begin SUB_GROUP /end SUB_GROUP /begin FUNCTION_LIST /end FUNCTION_LIST /begin REF_CHARACTERISTIC CalRegn02Rt05GroupA.HysCmpFricWhlImbRejctnBlndX.Ary1D /end REF_CHARACTERISTIC /begin REF_MEASUREMENT /end REF_MEASUREMENT /end GROUP
/begin GROUP CalRegn02Rt05GroupA.HysCmpFricWhlImbRejctnBlndY.Ary1D "MICROSAR RTE" /begin SUB_GROUP /end SUB_GROUP /begin FUNCTION_LIST /end FUNCTION_LIST /begin REF_CHARACTERISTIC CalRegn02Rt05GroupA.HysCmpFricWhlImbRejctnBlndY.Ary1D /end REF_CHARACTERISTIC /begin REF_MEASUREMENT /end REF_MEASUREMENT /end GROUP
/begin GROUP CalRegn02Rt05GroupA.HysCmpFricWhlImbRejctnOffY.Ary1D "MICROSAR RTE" /begin SUB_GROUP /end SUB_GROUP /begin FUNCTION_LIST /end FUNCTION_LIST /begin REF_CHARACTERISTIC CalRegn02Rt05GroupA.HysCmpFricWhlImbRejctnOffY.Ary1D /end REF_CHARACTERISTIC /begin REF_MEASUREMENT /end REF_MEASUREMENT /end GROUP
/begin GROUP CalRegn02Rt05GroupA.HysCmpFricWhlImbRejctnOnY.Ary1D "MICROSAR RTE" /begin SUB_GROUP /end SUB_GROUP /begin FUNCTION_LIST /end FUNCTION_LIST /begin REF_CHARACTERISTIC CalRegn02Rt05GroupA.HysCmpFricWhlImbRejctnOnY.Ary1D /end REF_CHARACTERISTIC /begin REF_MEASUREMENT /end REF_MEASUREMENT /end GROUP
/begin GROUP CalRegn02Rt05GroupA.HysCmpHwTqScaX.Ary2D "MICROSAR RTE" /begin SUB_GROUP /end SUB_GROUP /begin FUNCTION_LIST /end FUNCTION_LIST /begin REF_CHARACTERISTIC CalRegn02Rt05GroupA.HysCmpHwTqScaX.Ary2D /end REF_CHARACTERISTIC /begin REF_MEASUREMENT /end REF_MEASUREMENT /end GROUP
/begin GROUP CalRegn02Rt05GroupA.HysCmpHwTqScaY.Ary2D "MICROSAR RTE" /begin SUB_GROUP /end SUB_GROUP /begin FUNCTION_LIST /end FUNCTION_LIST /begin REF_CHARACTERISTIC CalRegn02Rt05GroupA.HysCmpHwTqScaY.Ary2D /end REF_CHARACTERISTIC /begin REF_MEASUREMENT /end REF_MEASUREMENT /end GROUP
/begin GROUP CalRegn02Rt05GroupA.HysCmpHysSatnY.Ary1D "MICROSAR RTE" /begin SUB_GROUP /end SUB_GROUP /begin FUNCTION_LIST /end FUNCTION_LIST /begin REF_CHARACTERISTIC CalRegn02Rt05GroupA.HysCmpHysSatnY.Ary1D /end REF_CHARACTERISTIC /begin REF_MEASUREMENT /end REF_MEASUREMENT /end GROUP
/begin GROUP CalRegn02Rt05GroupA.HysCmpNegHysCmpScaX.Ary1D "MICROSAR RTE" /begin SUB_GROUP /end SUB_GROUP /begin FUNCTION_LIST /end FUNCTION_LIST /begin REF_CHARACTERISTIC CalRegn02Rt05GroupA.HysCmpNegHysCmpScaX.Ary1D /end REF_CHARACTERISTIC /begin REF_MEASUREMENT /end REF_MEASUREMENT /end GROUP
/begin GROUP CalRegn02Rt05GroupA.HysCmpNegHysCmpScaY.Ary1D "MICROSAR RTE" /begin SUB_GROUP /end SUB_GROUP /begin FUNCTION_LIST /end FUNCTION_LIST /begin REF_CHARACTERISTIC CalRegn02Rt05GroupA.HysCmpNegHysCmpScaY.Ary1D /end REF_CHARACTERISTIC /begin REF_MEASUREMENT /end REF_MEASUREMENT /end GROUP
/begin GROUP CalRegn02Rt05GroupA.HysCmpNegHysCmpX.Ary1D "MICROSAR RTE" /begin SUB_GROUP /end SUB_GROUP /begin FUNCTION_LIST /end FUNCTION_LIST /begin REF_CHARACTERISTIC CalRegn02Rt05GroupA.HysCmpNegHysCmpX.Ary1D /end REF_CHARACTERISTIC /begin REF_MEASUREMENT /end REF_MEASUREMENT /end GROUP
/begin GROUP CalRegn02Rt05GroupA.HysCmpNegHysCmpY.Ary1D "MICROSAR RTE" /begin SUB_GROUP /end SUB_GROUP /begin FUNCTION_LIST /end FUNCTION_LIST /begin REF_CHARACTERISTIC CalRegn02Rt05GroupA.HysCmpNegHysCmpY.Ary1D /end REF_CHARACTERISTIC /begin REF_MEASUREMENT /end REF_MEASUREMENT /end GROUP
/begin GROUP CalRegn02Rt05GroupA.HysCmpOutpLim.Val "MICROSAR RTE" /begin SUB_GROUP /end SUB_GROUP /begin FUNCTION_LIST /end FUNCTION_LIST /begin REF_CHARACTERISTIC CalRegn02Rt05GroupA.HysCmpOutpLim.Val /end REF_CHARACTERISTIC /begin REF_MEASUREMENT /end REF_MEASUREMENT /end GROUP
/begin GROUP CalRegn02Rt05GroupA.HysCmpRevGain.Val "MICROSAR RTE" /begin SUB_GROUP /end SUB_GROUP /begin FUNCTION_LIST /end FUNCTION_LIST /begin REF_CHARACTERISTIC CalRegn02Rt05GroupA.HysCmpRevGain.Val /end REF_CHARACTERISTIC /begin REF_MEASUREMENT /end REF_MEASUREMENT /end GROUP
/begin GROUP CalRegn02Rt05GroupA.HysCmpRiseX.Ary1D "MICROSAR RTE" /begin SUB_GROUP /end SUB_GROUP /begin FUNCTION_LIST /end FUNCTION_LIST /begin REF_CHARACTERISTIC CalRegn02Rt05GroupA.HysCmpRiseX.Ary1D /end REF_CHARACTERISTIC /begin REF_MEASUREMENT /end REF_MEASUREMENT /end GROUP
/begin GROUP CalRegn02Rt05GroupA.HysCmpRiseY.Ary1D "MICROSAR RTE" /begin SUB_GROUP /end SUB_GROUP /begin FUNCTION_LIST /end FUNCTION_LIST /begin REF_CHARACTERISTIC CalRegn02Rt05GroupA.HysCmpRiseY.Ary1D /end REF_CHARACTERISTIC /begin REF_MEASUREMENT /end REF_MEASUREMENT /end GROUP
/begin GROUP CalRegn02Rt05GroupA.InertiaCmpVelAssiBasdDampgStatY.Ary1D "MICROSAR RTE" /begin SUB_GROUP /end SUB_GROUP /begin FUNCTION_LIST /end FUNCTION_LIST /begin REF_CHARACTERISTIC CalRegn02Rt05GroupA.InertiaCmpVelAssiBasdDampgStatY.Ary1D /end REF_CHARACTERISTIC /begin REF_MEASUREMENT /end REF_MEASUREMENT /end GROUP
/begin GROUP CalRegn02Rt05GroupA.InertiaCmpVelDampgFilFrq.Ary1D "MICROSAR RTE" /begin SUB_GROUP /end SUB_GROUP /begin FUNCTION_LIST /end FUNCTION_LIST /begin REF_CHARACTERISTIC CalRegn02Rt05GroupA.InertiaCmpVelDampgFilFrq.Ary1D /end REF_CHARACTERISTIC /begin REF_MEASUREMENT /end REF_MEASUREMENT /end GROUP
/begin GROUP CalRegn02Rt05GroupA.InertiaCmpVelDampgFilFrqWhlImbRejctnOn.Ary1D "MICROSAR RTE" /begin SUB_GROUP /end SUB_GROUP /begin FUNCTION_LIST /end FUNCTION_LIST
 /begin REF_CHARACTERISTIC CalRegn02Rt05GroupA.InertiaCmpVelDampgFilFrqWhlImbRejctnOn.Ary1D /end REF_CHARACTERISTIC
 /begin REF_MEASUREMENT /end REF_MEASUREMENT
/end GROUP
/begin GROUP CalRegn02Rt05GroupA.InertiaCmpVelDampgSpdBlndY.Ary1D "MICROSAR RTE" /begin SUB_GROUP /end SUB_GROUP /begin FUNCTION_LIST /end FUNCTION_LIST /begin REF_CHARACTERISTIC CalRegn02Rt05GroupA.InertiaCmpVelDampgSpdBlndY.Ary1D /end REF_CHARACTERISTIC /begin REF_MEASUREMENT /end REF_MEASUREMENT /end GROUP
/begin GROUP CalRegn02Rt05GroupA.InertiaCmpVelDampgWhlImbRejctnBlndX.Ary1D "MICROSAR RTE" /begin SUB_GROUP /end SUB_GROUP /begin FUNCTION_LIST /end FUNCTION_LIST
 /begin REF_CHARACTERISTIC CalRegn02Rt05GroupA.InertiaCmpVelDampgWhlImbRejctnBlndX.Ary1D /end REF_CHARACTERISTIC
 /begin REF_MEASUREMENT /end REF_MEASUREMENT
/end GROUP
/begin GROUP CalRegn02Rt05GroupA.InertiaCmpVelDampgWhlImbRejctnBlndY.Ary1D "MICROSAR RTE" /begin SUB_GROUP /end SUB_GROUP /begin FUNCTION_LIST /end FUNCTION_LIST
 /begin REF_CHARACTERISTIC CalRegn02Rt05GroupA.InertiaCmpVelDampgWhlImbRejctnBlndY.Ary1D /end REF_CHARACTERISTIC
 /begin REF_MEASUREMENT /end REF_MEASUREMENT
/end GROUP
/begin GROUP CalRegn02Rt05GroupB "MICROSAR RTE" /begin SUB_GROUP CalRegn02Rt05GroupB.CalibrationPorts /end SUB_GROUP /begin FUNCTION_LIST /end FUNCTION_LIST /begin REF_CHARACTERISTIC /end REF_CHARACTERISTIC /begin REF_MEASUREMENT /end REF_MEASUREMENT /end GROUP
/begin GROUP CalRegn02Rt05GroupB.CalibrationPorts "MICROSAR RTE"
 /begin SUB_GROUP CalRegn02Rt05GroupB.EotProtnDampgVehSpdTbl.Ary1D CalRegn02Rt05GroupB.EotProtnDeltaTqThd.Val CalRegn02Rt05GroupB.EotProtnEntrGainVehSpdTbl.Ary1D CalRegn02Rt05GroupB.EotProtnEntrGainY.Ary2D CalRegn02Rt05GroupB.EotProtnLoAuthyEntrGainY.Ary2D CalRegn02Rt05GroupB.EotProtnMotSpdIncptY.Ary1D CalRegn02Rt05GroupB.EotProtnNormDampgY.Ary2D CalRegn02Rt05GroupB.EotProtnSoftEndStopAuthyThd.Val CalRegn02Rt05GroupB.RtnHwAgOffsCalcdX.Ary2D CalRegn02Rt05GroupB.RtnHwAgOffsCalcdY.Ary2D CalRegn02Rt05GroupB.RtnScaTqX.Ary2D CalRegn02Rt05GroupB.RtnScaTqY.Ary2D CalRegn02Rt05GroupB.RtnScaVelX.Ary2D CalRegn02Rt05GroupB.RtnScaVelY.Ary2D CalRegn02Rt05GroupB.RtnVehSpdSeln.Ary1D /end SUB_GROUP
 /begin FUNCTION_LIST /end FUNCTION_LIST
 /begin REF_CHARACTERISTIC /end REF_CHARACTERISTIC
 /begin REF_MEASUREMENT /end REF_MEASUREMENT
/end GROUP
/begin GROUP CalRegn02Rt05GroupB.EotProtnDampgVehSpdTbl.Ary1D "MICROSAR RTE" /begin SUB_GROUP /end SUB_GROUP /begin FUNCTION_LIST /end FUNCTION_LIST /begin REF_CHARACTERISTIC CalRegn02Rt05GroupB.EotProtnDampgVehSpdTbl.Ary1D /end REF_CHARACTERISTIC /begin REF_MEASUREMENT /end REF_MEASUREMENT /end GROUP
/begin GROUP CalRegn02Rt05GroupB.EotProtnDeltaTqThd.Val "MICROSAR RTE" /begin SUB_GROUP /end SUB_GROUP /begin FUNCTION_LIST /end FUNCTION_LIST /begin REF_CHARACTERISTIC CalRegn02Rt05GroupB.EotProtnDeltaTqThd.Val /end REF_CHARACTERISTIC /begin REF_MEASUREMENT /end REF_MEASUREMENT /end GROUP
/begin GROUP CalRegn02Rt05GroupB.EotProtnEntrGainVehSpdTbl.Ary1D "MICROSAR RTE" /begin SUB_GROUP /end SUB_GROUP /begin FUNCTION_LIST /end FUNCTION_LIST /begin REF_CHARACTERISTIC CalRegn02Rt05GroupB.EotProtnEntrGainVehSpdTbl.Ary1D /end REF_CHARACTERISTIC /begin REF_MEASUREMENT /end REF_MEASUREMENT /end GROUP
/begin GROUP CalRegn02Rt05GroupB.EotProtnEntrGainY.Ary2D "MICROSAR RTE" /begin SUB_GROUP /end SUB_GROUP /begin FUNCTION_LIST /end FUNCTION_LIST /begin REF_CHARACTERISTIC CalRegn02Rt05GroupB.EotProtnEntrGainY.Ary2D /end REF_CHARACTERISTIC /begin REF_MEASUREMENT /end REF_MEASUREMENT /end GROUP
/begin GROUP CalRegn02Rt05GroupB.EotProtnLoAuthyEntrGainY.Ary2D "MICROSAR RTE" /begin SUB_GROUP /end SUB_GROUP /begin FUNCTION_LIST /end FUNCTION_LIST /begin REF_CHARACTERISTIC CalRegn02Rt05GroupB.EotProtnLoAuthyEntrGainY.Ary2D /end REF_CHARACTERISTIC /begin REF_MEASUREMENT /end REF_MEASUREMENT /end GROUP
/begin GROUP CalRegn02Rt05GroupB.EotProtnMotSpdIncptY.Ary1D "MICROSAR RTE" /begin SUB_GROUP /end SUB_GROUP /begin FUNCTION_LIST /end FUNCTION_LIST /begin REF_CHARACTERISTIC CalRegn02Rt05GroupB.EotProtnMotSpdIncptY.Ary1D /end REF_CHARACTERISTIC /begin REF_MEASUREMENT /end REF_MEASUREMENT /end GROUP
/begin GROUP CalRegn02Rt05GroupB.EotProtnNormDampgY.Ary2D "MICROSAR RTE" /begin SUB_GROUP /end SUB_GROUP /begin FUNCTION_LIST /end FUNCTION_LIST /begin REF_CHARACTERISTIC CalRegn02Rt05GroupB.EotProtnNormDampgY.Ary2D /end REF_CHARACTERISTIC /begin REF_MEASUREMENT /end REF_MEASUREMENT /end GROUP
/begin GROUP CalRegn02Rt05GroupB.EotProtnSoftEndStopAuthyThd.Val "MICROSAR RTE" /begin SUB_GROUP /end SUB_GROUP /begin FUNCTION_LIST /end FUNCTION_LIST /begin REF_CHARACTERISTIC CalRegn02Rt05GroupB.EotProtnSoftEndStopAuthyThd.Val /end REF_CHARACTERISTIC /begin REF_MEASUREMENT /end REF_MEASUREMENT /end GROUP
/begin GROUP CalRegn02Rt05GroupB.RtnHwAgOffsCalcdX.Ary2D "MICROSAR RTE" /begin SUB_GROUP /end SUB_GROUP /begin FUNCTION_LIST /end FUNCTION_LIST /begin REF_CHARACTERISTIC CalRegn02Rt05GroupB.RtnHwAgOffsCalcdX.Ary2D /end REF_CHARACTERISTIC /begin REF_MEASUREMENT /end REF_MEASUREMENT /end GROUP
/begin GROUP CalRegn02Rt05GroupB.RtnHwAgOffsCalcdY.Ary2D "MICROSAR RTE" /begin SUB_GROUP /end SUB_GROUP /begin FUNCTION_LIST /end FUNCTION_LIST /begin REF_CHARACTERISTIC CalRegn02Rt05GroupB.RtnHwAgOffsCalcdY.Ary2D /end REF_CHARACTERISTIC /begin REF_MEASUREMENT /end REF_MEASUREMENT /end GROUP
/begin GROUP CalRegn02Rt05GroupB.RtnScaTqX.Ary2D "MICROSAR RTE" /begin SUB_GROUP /end SUB_GROUP /begin FUNCTION_LIST /end FUNCTION_LIST /begin REF_CHARACTERISTIC CalRegn02Rt05GroupB.RtnScaTqX.Ary2D /end REF_CHARACTERISTIC /begin REF_MEASUREMENT /end REF_MEASUREMENT /end GROUP
/begin GROUP CalRegn02Rt05GroupB.RtnScaTqY.Ary2D "MICROSAR RTE" /begin SUB_GROUP /end SUB_GROUP /begin FUNCTION_LIST /end FUNCTION_LIST /begin REF_CHARACTERISTIC CalRegn02Rt05GroupB.RtnScaTqY.Ary2D /end REF_CHARACTERISTIC /begin REF_MEASUREMENT /end REF_MEASUREMENT /end GROUP
/begin GROUP CalRegn02Rt05GroupB.RtnScaVelX.Ary2D "MICROSAR RTE" /begin SUB_GROUP /end SUB_GROUP /begin FUNCTION_LIST /end FUNCTION_LIST /begin REF_CHARACTERISTIC CalRegn02Rt05GroupB.RtnScaVelX.Ary2D /end REF_CHARACTERISTIC /begin REF_MEASUREMENT /end REF_MEASUREMENT /end GROUP
/begin GROUP CalRegn02Rt05GroupB.RtnScaVelY.Ary2D "MICROSAR RTE" /begin SUB_GROUP /end SUB_GROUP /begin FUNCTION_LIST /end FUNCTION_LIST /begin REF_CHARACTERISTIC CalRegn02Rt05GroupB.RtnScaVelY.Ary2D /end REF_CHARACTERISTIC /begin REF_MEASUREMENT /end REF_MEASUREMENT /end GROUP
/begin GROUP CalRegn02Rt05GroupB.RtnVehSpdSeln.Ary1D "MICROSAR RTE" /begin SUB_GROUP /end SUB_GROUP /begin FUNCTION_LIST /end FUNCTION_LIST /begin REF_CHARACTERISTIC CalRegn02Rt05GroupB.RtnVehSpdSeln.Ary1D /end REF_CHARACTERISTIC /begin REF_MEASUREMENT /end REF_MEASUREMENT /end GROUP
/begin GROUP CmnMfgSrv "MICROSAR RTE"
 /begin SUB_GROUP CmnMfgSrv.CalibrationParameters CmnMfgSrv.CalibrationPorts CmnMfgSrv.PerInstanceMemories CmnMfgSrv.ReceiverPorts CmnMfgSrv.SenderPorts /end SUB_GROUP
 /begin FUNCTION_LIST /end FUNCTION_LIST
 /begin REF_CHARACTERISTIC /end REF_CHARACTERISTIC
 /begin REF_MEASUREMENT /end REF_MEASUREMENT
/end GROUP
/begin GROUP CmnMfgSrv.AssiLnrGain.Val "MICROSAR RTE" /begin SUB_GROUP /end SUB_GROUP /begin FUNCTION_LIST /end FUNCTION_LIST /begin REF_CHARACTERISTIC /end REF_CHARACTERISTIC /begin REF_MEASUREMENT CmnMfgSrv.AssiLnrGain.Val /end REF_MEASUREMENT /end GROUP
/begin GROUP CmnMfgSrv.AssiLnrGainEna.Logl "MICROSAR RTE" /begin SUB_GROUP /end SUB_GROUP /begin FUNCTION_LIST /end FUNCTION_LIST /begin REF_CHARACTERISTIC /end REF_CHARACTERISTIC /begin REF_MEASUREMENT CmnMfgSrv.AssiLnrGainEna.Logl /end REF_MEASUREMENT /end GROUP
/begin GROUP CmnMfgSrv.AssiMechTEstimnDi.Logl "MICROSAR RTE" /begin SUB_GROUP /end SUB_GROUP /begin FUNCTION_LIST /end FUNCTION_LIST /begin REF_CHARACTERISTIC /end REF_CHARACTERISTIC /begin REF_MEASUREMENT CmnMfgSrv.AssiMechTEstimnDi.Logl /end REF_MEASUREMENT /end GROUP
/begin GROUP CmnMfgSrv.BrdgVltg.Val "MICROSAR RTE" /begin SUB_GROUP /end SUB_GROUP /begin FUNCTION_LIST /end FUNCTION_LIST /begin REF_CHARACTERISTIC /end REF_CHARACTERISTIC /begin REF_MEASUREMENT CmnMfgSrv.BrdgVltg.Val /end REF_MEASUREMENT /end GROUP
/begin GROUP CmnMfgSrv.CalibrationParameters "MICROSAR RTE"
 /begin SUB_GROUP CmnMfgSrv.NvmIgnCntr_DefaultValue CmnMfgSrv.NvmMfgEnaCntr_DefaultValue CmnMfgSrv.NvmNxtrSeedKey_DefaultValue CmnMfgSrv.SeedKeyDft /end SUB_GROUP
 /begin FUNCTION_LIST /end FUNCTION_LIST
 /begin REF_CHARACTERISTIC /end REF_CHARACTERISTIC
 /begin REF_MEASUREMENT /end REF_MEASUREMENT
/end GROUP
/begin GROUP CmnMfgSrv.CalibrationPorts "MICROSAR RTE"
 /begin SUB_GROUP CmnMfgSrv.CmnMfgSrvSecuAcsAtmptTiOut.Val CmnMfgSrv.CmnMfgSrvSecuAcsMaxNrAtmpt.Val /end SUB_GROUP
 /begin FUNCTION_LIST /end FUNCTION_LIST
 /begin REF_CHARACTERISTIC /end REF_CHARACTERISTIC
 /begin REF_MEASUREMENT /end REF_MEASUREMENT
/end GROUP
/begin GROUP CmnMfgSrv.CcaHwPartNr "MICROSAR RTE" /begin SUB_GROUP /end SUB_GROUP /begin FUNCTION_LIST /end FUNCTION_LIST /begin REF_CHARACTERISTIC /end REF_CHARACTERISTIC /begin REF_MEASUREMENT CmnMfgSrv.CcaHwPartNr /end REF_MEASUREMENT /end GROUP
/begin GROUP CmnMfgSrv.CcaSerlNr "MICROSAR RTE" /begin SUB_GROUP /end SUB_GROUP /begin FUNCTION_LIST /end FUNCTION_LIST /begin REF_CHARACTERISTIC /end REF_CHARACTERISTIC /begin REF_MEASUREMENT CmnMfgSrv.CcaSerlNr /end REF_MEASUREMENT /end GROUP
/begin GROUP CmnMfgSrv.CmnMfgSrvSecuAcsAtmptTiOut.Val "MICROSAR RTE" /begin SUB_GROUP /end SUB_GROUP /begin FUNCTION_LIST /end FUNCTION_LIST /begin REF_CHARACTERISTIC CmnMfgSrv.CmnMfgSrvSecuAcsAtmptTiOut.Val /end REF_CHARACTERISTIC /begin REF_MEASUREMENT /end REF_MEASUREMENT /end GROUP
/begin GROUP CmnMfgSrv.CmnMfgSrvSecuAcsMaxNrAtmpt.Val "MICROSAR RTE" /begin SUB_GROUP /end SUB_GROUP /begin FUNCTION_LIST /end FUNCTION_LIST /begin REF_CHARACTERISTIC CmnMfgSrv.CmnMfgSrvSecuAcsMaxNrAtmpt.Val /end REF_CHARACTERISTIC /begin REF_MEASUREMENT /end REF_MEASUREMENT /end GROUP
/begin GROUP CmnMfgSrv.DampgCmdBasDi.Logl "MICROSAR RTE" /begin SUB_GROUP /end SUB_GROUP /begin FUNCTION_LIST /end FUNCTION_LIST /begin REF_CHARACTERISTIC /end REF_CHARACTERISTIC /begin REF_MEASUREMENT CmnMfgSrv.DampgCmdBasDi.Logl /end REF_MEASUREMENT /end GROUP
/begin GROUP CmnMfgSrv.DiAssiMechTEstimn "MICROSAR RTE" /begin SUB_GROUP /end SUB_GROUP /begin FUNCTION_LIST /end FUNCTION_LIST /begin REF_CHARACTERISTIC /end REF_CHARACTERISTIC /begin REF_MEASUREMENT CmnMfgSrv.DiAssiMechTEstimn /end REF_MEASUREMENT /end GROUP
/begin GROUP CmnMfgSrv.DiDampg "MICROSAR RTE" /begin SUB_GROUP /end SUB_GROUP /begin FUNCTION_LIST /end FUNCTION_LIST /begin REF_CHARACTERISTIC /end REF_CHARACTERISTIC /begin REF_MEASUREMENT CmnMfgSrv.DiDampg /end REF_MEASUREMENT /end GROUP
/begin GROUP CmnMfgSrv.DiDutyCycThermProtn "MICROSAR RTE" /begin SUB_GROUP /end SUB_GROUP /begin FUNCTION_LIST /end FUNCTION_LIST /begin REF_CHARACTERISTIC /end REF_CHARACTERISTIC /begin REF_MEASUREMENT CmnMfgSrv.DiDutyCycThermProtn /end REF_MEASUREMENT /end GROUP
/begin GROUP CmnMfgSrv.DiEotProtn "MICROSAR RTE" /begin SUB_GROUP /end SUB_GROUP /begin FUNCTION_LIST /end FUNCTION_LIST /begin REF_CHARACTERISTIC /end REF_CHARACTERISTIC /begin REF_MEASUREMENT CmnMfgSrv.DiEotProtn /end REF_MEASUREMENT /end GROUP
/begin GROUP CmnMfgSrv.DiHysCmp "MICROSAR RTE" /begin SUB_GROUP /end SUB_GROUP /begin FUNCTION_LIST /end FUNCTION_LIST /begin REF_CHARACTERISTIC /end REF_CHARACTERISTIC /begin REF_MEASUREMENT CmnMfgSrv.DiHysCmp /end REF_MEASUREMENT /end GROUP
/begin GROUP CmnMfgSrv.DiInertiaCmp "MICROSAR RTE" /begin SUB_GROUP /end SUB_GROUP /begin FUNCTION_LIST /end FUNCTION_LIST /begin REF_CHARACTERISTIC /end REF_CHARACTERISTIC /begin REF_MEASUREMENT CmnMfgSrv.DiInertiaCmp /end REF_MEASUREMENT /end GROUP
/begin GROUP CmnMfgSrv.DiLoaSca "MICROSAR RTE" /begin SUB_GROUP /end SUB_GROUP /begin FUNCTION_LIST /end FUNCTION_LIST /begin REF_CHARACTERISTIC /end REF_CHARACTERISTIC /begin REF_MEASUREMENT CmnMfgSrv.DiLoaSca /end REF_MEASUREMENT /end GROUP
/begin GROUP CmnMfgSrv.DiPullCmpActvCmd "MICROSAR RTE" /begin SUB_GROUP /end SUB_GROUP /begin FUNCTION_LIST /end FUNCTION_LIST /begin REF_CHARACTERISTIC /end REF_CHARACTERISTIC /begin REF_MEASUREMENT CmnMfgSrv.DiPullCmpActvCmd /end REF_MEASUREMENT /end GROUP
/begin GROUP CmnMfgSrv.DiPullCmpActvLrng "MICROSAR RTE" /begin SUB_GROUP /end SUB_GROUP /begin FUNCTION_LIST /end FUNCTION_LIST /begin REF_CHARACTERISTIC /end REF_CHARACTERISTIC /begin REF_MEASUREMENT CmnMfgSrv.DiPullCmpActvLrng /end REF_MEASUREMENT /end GROUP
/begin GROUP CmnMfgSrv.DiRestore "MICROSAR RTE" /begin SUB_GROUP /end SUB_GROUP /begin FUNCTION_LIST /end FUNCTION_LIST /begin REF_CHARACTERISTIC /end REF_CHARACTERISTIC /begin REF_MEASUREMENT CmnMfgSrv.DiRestore /end REF_MEASUREMENT /end GROUP
/begin GROUP CmnMfgSrv.DiRtn "MICROSAR RTE" /begin SUB_GROUP /end SUB_GROUP /begin FUNCTION_LIST /end FUNCTION_LIST /begin REF_CHARACTERISTIC /end REF_CHARACTERISTIC /begin REF_MEASUREMENT CmnMfgSrv.DiRtn /end REF_MEASUREMENT /end GROUP
/begin GROUP CmnMfgSrv.DiStallMotTqLim "MICROSAR RTE" /begin SUB_GROUP /end SUB_GROUP /begin FUNCTION_LIST /end FUNCTION_LIST /begin REF_CHARACTERISTIC /end REF_CHARACTERISTIC /begin REF_MEASUREMENT CmnMfgSrv.DiStallMotTqLim /end REF_MEASUREMENT /end GROUP
/begin GROUP CmnMfgSrv.DiSysFricLrng "MICROSAR RTE" /begin SUB_GROUP /end SUB_GROUP /begin FUNCTION_LIST /end FUNCTION_LIST /begin REF_CHARACTERISTIC /end REF_CHARACTERISTIC /begin REF_MEASUREMENT CmnMfgSrv.DiSysFricLrng /end REF_MEASUREMENT /end GROUP
/begin GROUP CmnMfgSrv.DiSysMotTqCmdRampRate "MICROSAR RTE" /begin SUB_GROUP /end SUB_GROUP /begin FUNCTION_LIST /end FUNCTION_LIST /begin REF_CHARACTERISTIC /end REF_CHARACTERISTIC /begin REF_MEASUREMENT CmnMfgSrv.DiSysMotTqCmdRampRate /end REF_MEASUREMENT /end GROUP
/begin GROUP CmnMfgSrv.DutyCycThermProtnDi.Logl "MICROSAR RTE" /begin SUB_GROUP /end SUB_GROUP /begin FUNCTION_LIST /end FUNCTION_LIST /begin REF_CHARACTERISTIC /end REF_CHARACTERISTIC /begin REF_MEASUREMENT CmnMfgSrv.DutyCycThermProtnDi.Logl /end REF_MEASUREMENT /end GROUP
/begin GROUP CmnMfgSrv.EcuTFild.Val "MICROSAR RTE" /begin SUB_GROUP /end SUB_GROUP /begin FUNCTION_LIST /end FUNCTION_LIST /begin REF_CHARACTERISTIC /end REF_CHARACTERISTIC /begin REF_MEASUREMENT CmnMfgSrv.EcuTFild.Val /end REF_MEASUREMENT /end GROUP
/begin GROUP CmnMfgSrv.EotProtnDi.Logl "MICROSAR RTE" /begin SUB_GROUP /end SUB_GROUP /begin FUNCTION_LIST /end FUNCTION_LIST /begin REF_CHARACTERISTIC /end REF_CHARACTERISTIC /begin REF_MEASUREMENT CmnMfgSrv.EotProtnDi.Logl /end REF_MEASUREMENT /end GROUP
/begin GROUP CmnMfgSrv.EpsSysSerlNr "MICROSAR RTE" /begin SUB_GROUP /end SUB_GROUP /begin FUNCTION_LIST /end FUNCTION_LIST /begin REF_CHARACTERISTIC /end REF_CHARACTERISTIC /begin REF_MEASUREMENT CmnMfgSrv.EpsSysSerlNr /end REF_MEASUREMENT /end GROUP
/begin GROUP CmnMfgSrv.FricLrngDi.Logl "MICROSAR RTE" /begin SUB_GROUP /end SUB_GROUP /begin FUNCTION_LIST /end FUNCTION_LIST /begin REF_CHARACTERISTIC /end REF_CHARACTERISTIC /begin REF_MEASUREMENT CmnMfgSrv.FricLrngDi.Logl /end REF_MEASUREMENT /end GROUP
/begin GROUP CmnMfgSrv.HwAg.Val "MICROSAR RTE" /begin SUB_GROUP /end SUB_GROUP /begin FUNCTION_LIST /end FUNCTION_LIST /begin REF_CHARACTERISTIC /end REF_CHARACTERISTIC /begin REF_MEASUREMENT CmnMfgSrv.HwAg.Val /end REF_MEASUREMENT /end GROUP
/begin GROUP CmnMfgSrv.HwAg0.Val "MICROSAR RTE" /begin SUB_GROUP /end SUB_GROUP /begin FUNCTION_LIST /end FUNCTION_LIST /begin REF_CHARACTERISTIC /end REF_CHARACTERISTIC /begin REF_MEASUREMENT CmnMfgSrv.HwAg0.Val /end REF_MEASUREMENT /end GROUP
/begin GROUP CmnMfgSrv.HwAg1.Val "MICROSAR RTE" /begin SUB_GROUP /end SUB_GROUP /begin FUNCTION_LIST /end FUNCTION_LIST /begin REF_CHARACTERISTIC /end REF_CHARACTERISTIC /begin REF_MEASUREMENT CmnMfgSrv.HwAg1.Val /end REF_MEASUREMENT /end GROUP
/begin GROUP CmnMfgSrv.HwTq.Val "MICROSAR RTE" /begin SUB_GROUP /end SUB_GROUP /begin FUNCTION_LIST /end FUNCTION_LIST /begin REF_CHARACTERISTIC /end REF_CHARACTERISTIC /begin REF_MEASUREMENT CmnMfgSrv.HwTq.Val /end REF_MEASUREMENT /end GROUP
/begin GROUP CmnMfgSrv.HwTq0.Val "MICROSAR RTE" /begin SUB_GROUP /end SUB_GROUP /begin FUNCTION_LIST /end FUNCTION_LIST /begin REF_CHARACTERISTIC /end REF_CHARACTERISTIC /begin REF_MEASUREMENT CmnMfgSrv.HwTq0.Val /end REF_MEASUREMENT /end GROUP
/begin GROUP CmnMfgSrv.HwTq1.Val "MICROSAR RTE" /begin SUB_GROUP /end SUB_GROUP /begin FUNCTION_LIST /end FUNCTION_LIST /begin REF_CHARACTERISTIC /end REF_CHARACTERISTIC /begin REF_MEASUREMENT CmnMfgSrv.HwTq1.Val /end REF_MEASUREMENT /end GROUP
/begin GROUP CmnMfgSrv.HwTq2.Val "MICROSAR RTE" /begin SUB_GROUP /end SUB_GROUP /begin FUNCTION_LIST /end FUNCTION_LIST /begin REF_CHARACTERISTIC /end REF_CHARACTERISTIC /begin REF_MEASUREMENT CmnMfgSrv.HwTq2.Val /end REF_MEASUREMENT /end GROUP
/begin GROUP CmnMfgSrv.HwTq3.Val "MICROSAR RTE" /begin SUB_GROUP /end SUB_GROUP /begin FUNCTION_LIST /end FUNCTION_LIST /begin REF_CHARACTERISTIC /end REF_CHARACTERISTIC /begin REF_MEASUREMENT CmnMfgSrv.HwTq3.Val /end REF_MEASUREMENT /end GROUP
/begin GROUP CmnMfgSrv.HysCmpCmdDi.Logl "MICROSAR RTE" /begin SUB_GROUP /end SUB_GROUP /begin FUNCTION_LIST /end FUNCTION_LIST /begin REF_CHARACTERISTIC /end REF_CHARACTERISTIC /begin REF_MEASUREMENT CmnMfgSrv.HysCmpCmdDi.Logl /end REF_MEASUREMENT /end GROUP
/begin GROUP CmnMfgSrv.IgnCntr "MICROSAR RTE" /begin SUB_GROUP /end SUB_GROUP /begin FUNCTION_LIST /end FUNCTION_LIST /begin REF_CHARACTERISTIC /end REF_CHARACTERISTIC /begin REF_MEASUREMENT CmnMfgSrv.IgnCntr /end REF_MEASUREMENT /end GROUP
/begin GROUP CmnMfgSrv.IgnCntr.Val "MICROSAR RTE" /begin SUB_GROUP /end SUB_GROUP /begin FUNCTION_LIST /end FUNCTION_LIST /begin REF_CHARACTERISTIC /end REF_CHARACTERISTIC /begin REF_MEASUREMENT CmnMfgSrv.IgnCntr.Val /end REF_MEASUREMENT /end GROUP
/begin GROUP CmnMfgSrv.InertiaCmpVelCmdDi.Logl "MICROSAR RTE" /begin SUB_GROUP /end SUB_GROUP /begin FUNCTION_LIST /end FUNCTION_LIST /begin REF_CHARACTERISTIC /end REF_CHARACTERISTIC /begin REF_MEASUREMENT CmnMfgSrv.InertiaCmpVelCmdDi.Logl /end REF_MEASUREMENT /end GROUP
/begin GROUP CmnMfgSrv.InpOutpCtrlAssiGain "MICROSAR RTE" /begin SUB_GROUP /end SUB_GROUP /begin FUNCTION_LIST /end FUNCTION_LIST /begin REF_CHARACTERISTIC /end REF_CHARACTERISTIC /begin REF_MEASUREMENT CmnMfgSrv.InpOutpCtrlAssiGain /end REF_MEASUREMENT /end GROUP
/begin GROUP CmnMfgSrv.InpOutpCtrlVehSpdOvrd "MICROSAR RTE" /begin SUB_GROUP /end SUB_GROUP /begin FUNCTION_LIST /end FUNCTION_LIST /begin REF_CHARACTERISTIC /end REF_CHARACTERISTIC /begin REF_MEASUREMENT CmnMfgSrv.InpOutpCtrlVehSpdOvrd /end REF_MEASUREMENT /end GROUP
/begin GROUP CmnMfgSrv.LoaScaDi.Logl "MICROSAR RTE" /begin SUB_GROUP /end SUB_GROUP /begin FUNCTION_LIST /end FUNCTION_LIST /begin REF_CHARACTERISTIC /end REF_CHARACTERISTIC /begin REF_MEASUREMENT CmnMfgSrv.LoaScaDi.Logl /end REF_MEASUREMENT /end GROUP
/begin GROUP CmnMfgSrv.MfgDiagcInhb "MICROSAR RTE" /begin SUB_GROUP /end SUB_GROUP /begin FUNCTION_LIST /end FUNCTION_LIST /begin REF_CHARACTERISTIC /end REF_CHARACTERISTIC /begin REF_MEASUREMENT CmnMfgSrv.MfgDiagcInhb /end REF_MEASUREMENT /end GROUP
/begin GROUP CmnMfgSrv.MfgDiagcInhb.Logl "MICROSAR RTE" /begin SUB_GROUP /end SUB_GROUP /begin FUNCTION_LIST /end FUNCTION_LIST /begin REF_CHARACTERISTIC /end REF_CHARACTERISTIC /begin REF_MEASUREMENT CmnMfgSrv.MfgDiagcInhb.Logl /end REF_MEASUREMENT /end GROUP
/begin GROUP CmnMfgSrv.MfgTmpBuf0 "MICROSAR RTE" /begin SUB_GROUP /end SUB_GROUP /begin FUNCTION_LIST /end FUNCTION_LIST /begin REF_CHARACTERISTIC /end REF_CHARACTERISTIC /begin REF_MEASUREMENT CmnMfgSrv.MfgTmpBuf0 /end REF_MEASUREMENT /end GROUP
/begin GROUP CmnMfgSrv.MfgTmpBuf1 "MICROSAR RTE" /begin SUB_GROUP /end SUB_GROUP /begin FUNCTION_LIST /end FUNCTION_LIST /begin REF_CHARACTERISTIC /end REF_CHARACTERISTIC /begin REF_MEASUREMENT CmnMfgSrv.MfgTmpBuf1 /end REF_MEASUREMENT /end GROUP
/begin GROUP CmnMfgSrv.MfgTmpBuf2 "MICROSAR RTE" /begin SUB_GROUP /end SUB_GROUP /begin FUNCTION_LIST /end FUNCTION_LIST /begin REF_CHARACTERISTIC /end REF_CHARACTERISTIC /begin REF_MEASUREMENT CmnMfgSrv.MfgTmpBuf2 /end REF_MEASUREMENT /end GROUP
/begin GROUP CmnMfgSrv.MfgTmpBuf3 "MICROSAR RTE" /begin SUB_GROUP /end SUB_GROUP /begin FUNCTION_LIST /end FUNCTION_LIST /begin REF_CHARACTERISTIC /end REF_CHARACTERISTIC /begin REF_MEASUREMENT CmnMfgSrv.MfgTmpBuf3 /end REF_MEASUREMENT /end GROUP
/begin GROUP CmnMfgSrv.MfgTmpBuf4 "MICROSAR RTE" /begin SUB_GROUP /end SUB_GROUP /begin FUNCTION_LIST /end FUNCTION_LIST /begin REF_CHARACTERISTIC /end REF_CHARACTERISTIC /begin REF_MEASUREMENT CmnMfgSrv.MfgTmpBuf4 /end REF_MEASUREMENT /end GROUP
/begin GROUP CmnMfgSrv.MotAg0Mecl.Val "MICROSAR RTE" /begin SUB_GROUP /end SUB_GROUP /begin FUNCTION_LIST /end FUNCTION_LIST /begin REF_CHARACTERISTIC /end REF_CHARACTERISTIC /begin REF_MEASUREMENT CmnMfgSrv.MotAg0Mecl.Val /end REF_MEASUREMENT /end GROUP
/begin GROUP CmnMfgSrv.MotAg1Mecl.Val "MICROSAR RTE" /begin SUB_GROUP /end SUB_GROUP /begin FUNCTION_LIST /end FUNCTION_LIST /begin REF_CHARACTERISTIC /end REF_CHARACTERISTIC /begin REF_MEASUREMENT CmnMfgSrv.MotAg1Mecl.Val /end REF_MEASUREMENT /end GROUP
/begin GROUP CmnMfgSrv.MotAg2Mecl.Val "MICROSAR RTE" /begin SUB_GROUP /end SUB_GROUP /begin FUNCTION_LIST /end FUNCTION_LIST /begin REF_CHARACTERISTIC /end REF_CHARACTERISTIC /begin REF_MEASUREMENT CmnMfgSrv.MotAg2Mecl.Val /end REF_MEASUREMENT /end GROUP
/begin GROUP CmnMfgSrv.MotAgCumvAlgndMrf.Val "MICROSAR RTE" /begin SUB_GROUP /end SUB_GROUP /begin FUNCTION_LIST /end FUNCTION_LIST /begin REF_CHARACTERISTIC /end REF_CHARACTERISTIC /begin REF_MEASUREMENT CmnMfgSrv.MotAgCumvAlgndMrf.Val /end REF_MEASUREMENT /end GROUP
/begin GROUP CmnMfgSrv.MotAgMecl.Val "MICROSAR RTE" /begin SUB_GROUP /end SUB_GROUP /begin FUNCTION_LIST /end FUNCTION_LIST /begin REF_CHARACTERISTIC /end REF_CHARACTERISTIC /begin REF_MEASUREMENT CmnMfgSrv.MotAgMecl.Val /end REF_MEASUREMENT /end GROUP
/begin GROUP CmnMfgSrv.MotCurrDax.Val "MICROSAR RTE" /begin SUB_GROUP /end SUB_GROUP /begin FUNCTION_LIST /end FUNCTION_LIST /begin REF_CHARACTERISTIC /end REF_CHARACTERISTIC /begin REF_MEASUREMENT CmnMfgSrv.MotCurrDax.Val /end REF_MEASUREMENT /end GROUP
/begin GROUP CmnMfgSrv.MotCurrQax.Val "MICROSAR RTE" /begin SUB_GROUP /end SUB_GROUP /begin FUNCTION_LIST /end FUNCTION_LIST /begin REF_CHARACTERISTIC /end REF_CHARACTERISTIC /begin REF_MEASUREMENT CmnMfgSrv.MotCurrQax.Val /end REF_MEASUREMENT /end GROUP
/begin GROUP CmnMfgSrv.MotTqCmd.Val "MICROSAR RTE" /begin SUB_GROUP /end SUB_GROUP /begin FUNCTION_LIST /end FUNCTION_LIST /begin REF_CHARACTERISTIC /end REF_CHARACTERISTIC /begin REF_MEASUREMENT CmnMfgSrv.MotTqCmd.Val /end REF_MEASUREMENT /end GROUP
/begin GROUP CmnMfgSrv.MotVelMrf.Val "MICROSAR RTE" /begin SUB_GROUP /end SUB_GROUP /begin FUNCTION_LIST /end FUNCTION_LIST /begin REF_CHARACTERISTIC /end REF_CHARACTERISTIC /begin REF_MEASUREMENT CmnMfgSrv.MotVelMrf.Val /end REF_MEASUREMENT /end GROUP
/begin GROUP CmnMfgSrv.NvmIgnCntr_DefaultValue "MICROSAR RTE" /begin SUB_GROUP /end SUB_GROUP /begin FUNCTION_LIST /end FUNCTION_LIST /begin REF_CHARACTERISTIC CmnMfgSrv.NvmIgnCntr_DefaultValue /end REF_CHARACTERISTIC /begin REF_MEASUREMENT /end REF_MEASUREMENT /end GROUP
/begin GROUP CmnMfgSrv.NvmMfgEnaCntr_DefaultValue "MICROSAR RTE" /begin SUB_GROUP /end SUB_GROUP /begin FUNCTION_LIST /end FUNCTION_LIST /begin REF_CHARACTERISTIC CmnMfgSrv.NvmMfgEnaCntr_DefaultValue /end REF_CHARACTERISTIC /begin REF_MEASUREMENT /end REF_MEASUREMENT /end GROUP
/begin GROUP CmnMfgSrv.NvmNxtrSeedKey_DefaultValue "MICROSAR RTE" /begin SUB_GROUP /end SUB_GROUP /begin FUNCTION_LIST /end FUNCTION_LIST /begin REF_CHARACTERISTIC CmnMfgSrv.NvmNxtrSeedKey_DefaultValue /end REF_CHARACTERISTIC /begin REF_MEASUREMENT /end REF_MEASUREMENT /end GROUP
/begin GROUP CmnMfgSrv.NxtrMfgEnaCntr "MICROSAR RTE" /begin SUB_GROUP /end SUB_GROUP /begin FUNCTION_LIST /end FUNCTION_LIST /begin REF_CHARACTERISTIC /end REF_CHARACTERISTIC /begin REF_MEASUREMENT CmnMfgSrv.NxtrMfgEnaCntr /end REF_MEASUREMENT /end GROUP
/begin GROUP CmnMfgSrv.PerCyc "MICROSAR RTE" /begin SUB_GROUP /end SUB_GROUP /begin FUNCTION_LIST /end FUNCTION_LIST /begin REF_CHARACTERISTIC /end REF_CHARACTERISTIC /begin REF_MEASUREMENT CmnMfgSrv.PerCyc /end REF_MEASUREMENT /end GROUP
/begin GROUP CmnMfgSrv.PerDivdr "MICROSAR RTE" /begin SUB_GROUP /end SUB_GROUP /begin FUNCTION_LIST /end FUNCTION_LIST /begin REF_CHARACTERISTIC /end REF_CHARACTERISTIC /begin REF_MEASUREMENT CmnMfgSrv.PerDivdr /end REF_MEASUREMENT /end GROUP
/begin GROUP CmnMfgSrv.PerInstanceMemories "MICROSAR RTE"
 /begin SUB_GROUP CmnMfgSrv.CcaHwPartNr CmnMfgSrv.CcaSerlNr CmnMfgSrv.DiAssiMechTEstimn CmnMfgSrv.DiDampg CmnMfgSrv.DiDutyCycThermProtn CmnMfgSrv.DiEotProtn CmnMfgSrv.DiHysCmp CmnMfgSrv.DiInertiaCmp CmnMfgSrv.DiLoaSca CmnMfgSrv.DiPullCmpActvCmd CmnMfgSrv.DiPullCmpActvLrng CmnMfgSrv.DiRestore CmnMfgSrv.DiRtn CmnMfgSrv.DiStallMotTqLim CmnMfgSrv.DiSysFricLrng CmnMfgSrv.DiSysMotTqCmdRampRate CmnMfgSrv.EpsSysSerlNr CmnMfgSrv.IgnCntr CmnMfgSrv.InpOutpCtrlAssiGain CmnMfgSrv.InpOutpCtrlVehSpdOvrd CmnMfgSrv.MfgDiagcInhb CmnMfgSrv.MfgTmpBuf0 CmnMfgSrv.MfgTmpBuf1 CmnMfgSrv.MfgTmpBuf2 CmnMfgSrv.MfgTmpBuf3 CmnMfgSrv.MfgTmpBuf4 CmnMfgSrv.NxtrMfgEnaCntr CmnMfgSrv.PerCyc CmnMfgSrv.PerDivdr CmnMfgSrv.PerPidTbl CmnMfgSrv.PerPidTblLen CmnMfgSrv.PerRunng CmnMfgSrv.ReqLen CmnMfgSrv.SecuAcsAtmptCntr CmnMfgSrv.SecuAcsAtmptTmr CmnMfgSrv.SecuAcsSeedReqCmpl CmnMfgSrv.SecuAcsUnlckd CmnMfgSrv.SeedKey CmnMfgSrv.SessionCurr CmnMfgSrv.SessionTiOut CmnMfgSrv.SysStReqEnaOvrd /end SUB_GROUP
 /begin FUNCTION_LIST /end FUNCTION_LIST
 /begin REF_CHARACTERISTIC /end REF_CHARACTERISTIC
 /begin REF_MEASUREMENT /end REF_MEASUREMENT
/end GROUP
/begin GROUP CmnMfgSrv.PerPidTbl "MICROSAR RTE" /begin SUB_GROUP /end SUB_GROUP /begin FUNCTION_LIST /end FUNCTION_LIST /begin REF_CHARACTERISTIC /end REF_CHARACTERISTIC /begin REF_MEASUREMENT CmnMfgSrv.PerPidTbl /end REF_MEASUREMENT /end GROUP
/begin GROUP CmnMfgSrv.PerPidTblLen "MICROSAR RTE" /begin SUB_GROUP /end SUB_GROUP /begin FUNCTION_LIST /end FUNCTION_LIST /begin REF_CHARACTERISTIC /end REF_CHARACTERISTIC /begin REF_MEASUREMENT CmnMfgSrv.PerPidTblLen /end REF_MEASUREMENT /end GROUP
/begin GROUP CmnMfgSrv.PerRunng "MICROSAR RTE" /begin SUB_GROUP /end SUB_GROUP /begin FUNCTION_LIST /end FUNCTION_LIST /begin REF_CHARACTERISTIC /end REF_CHARACTERISTIC /begin REF_MEASUREMENT CmnMfgSrv.PerRunng /end REF_MEASUREMENT /end GROUP
/begin GROUP CmnMfgSrv.PinionAg.Val "MICROSAR RTE" /begin SUB_GROUP /end SUB_GROUP /begin FUNCTION_LIST /end FUNCTION_LIST /begin REF_CHARACTERISTIC /end REF_CHARACTERISTIC /begin REF_MEASUREMENT CmnMfgSrv.PinionAg.Val /end REF_MEASUREMENT /end GROUP
/begin GROUP CmnMfgSrv.PullCmpCmdDi.Logl "MICROSAR RTE" /begin SUB_GROUP /end SUB_GROUP /begin FUNCTION_LIST /end FUNCTION_LIST /begin REF_CHARACTERISTIC /end REF_CHARACTERISTIC /begin REF_MEASUREMENT CmnMfgSrv.PullCmpCmdDi.Logl /end REF_MEASUREMENT /end GROUP
/begin GROUP CmnMfgSrv.PullCmpLrngDi.Logl "MICROSAR RTE" /begin SUB_GROUP /end SUB_GROUP /begin FUNCTION_LIST /end FUNCTION_LIST /begin REF_CHARACTERISTIC /end REF_CHARACTERISTIC /begin REF_MEASUREMENT CmnMfgSrv.PullCmpLrngDi.Logl /end REF_MEASUREMENT /end GROUP
/begin GROUP CmnMfgSrv.ReceiverPorts "MICROSAR RTE"
 /begin SUB_GROUP CmnMfgSrv.BrdgVltg.Val CmnMfgSrv.EcuTFild.Val CmnMfgSrv.HwAg.Val CmnMfgSrv.HwAg0.Val CmnMfgSrv.HwAg1.Val CmnMfgSrv.HwTq.Val CmnMfgSrv.HwTq0.Val CmnMfgSrv.HwTq1.Val CmnMfgSrv.HwTq2.Val CmnMfgSrv.HwTq3.Val CmnMfgSrv.MotAg0Mecl.Val CmnMfgSrv.MotAg1Mecl.Val CmnMfgSrv.MotAg2Mecl.Val CmnMfgSrv.MotAgCumvAlgndMrf.Val CmnMfgSrv.MotAgMecl.Val CmnMfgSrv.MotCurrDax.Val CmnMfgSrv.MotCurrQax.Val CmnMfgSrv.MotTqCmd.Val CmnMfgSrv.MotVelMrf.Val CmnMfgSrv.PinionAg.Val CmnMfgSrv.SysSt.Val /end SUB_GROUP
 /begin FUNCTION_LIST /end FUNCTION_LIST
 /begin REF_CHARACTERISTIC /end REF_CHARACTERISTIC
 /begin REF_MEASUREMENT /end REF_MEASUREMENT
/end GROUP
/begin GROUP CmnMfgSrv.ReqLen "MICROSAR RTE" /begin SUB_GROUP /end SUB_GROUP /begin FUNCTION_LIST /end FUNCTION_LIST /begin REF_CHARACTERISTIC /end REF_CHARACTERISTIC /begin REF_MEASUREMENT CmnMfgSrv.ReqLen /end REF_MEASUREMENT /end GROUP
/begin GROUP CmnMfgSrv.RtnCmdDi.Logl "MICROSAR RTE" /begin SUB_GROUP /end SUB_GROUP /begin FUNCTION_LIST /end FUNCTION_LIST /begin REF_CHARACTERISTIC /end REF_CHARACTERISTIC /begin REF_MEASUREMENT CmnMfgSrv.RtnCmdDi.Logl /end REF_MEASUREMENT /end GROUP
/begin GROUP CmnMfgSrv.SecuAcsAtmptCntr "MICROSAR RTE" /begin SUB_GROUP /end SUB_GROUP /begin FUNCTION_LIST /end FUNCTION_LIST /begin REF_CHARACTERISTIC /end REF_CHARACTERISTIC /begin REF_MEASUREMENT CmnMfgSrv.SecuAcsAtmptCntr /end REF_MEASUREMENT /end GROUP
/begin GROUP CmnMfgSrv.SecuAcsAtmptTmr "MICROSAR RTE" /begin SUB_GROUP /end SUB_GROUP /begin FUNCTION_LIST /end FUNCTION_LIST /begin REF_CHARACTERISTIC /end REF_CHARACTERISTIC /begin REF_MEASUREMENT CmnMfgSrv.SecuAcsAtmptTmr /end REF_MEASUREMENT /end GROUP
/begin GROUP CmnMfgSrv.SecuAcsSeedReqCmpl "MICROSAR RTE" /begin SUB_GROUP /end SUB_GROUP /begin FUNCTION_LIST /end FUNCTION_LIST /begin REF_CHARACTERISTIC /end REF_CHARACTERISTIC /begin REF_MEASUREMENT CmnMfgSrv.SecuAcsSeedReqCmpl /end REF_MEASUREMENT /end GROUP
/begin GROUP CmnMfgSrv.SecuAcsUnlckd "MICROSAR RTE" /begin SUB_GROUP /end SUB_GROUP /begin FUNCTION_LIST /end FUNCTION_LIST /begin REF_CHARACTERISTIC /end REF_CHARACTERISTIC /begin REF_MEASUREMENT CmnMfgSrv.SecuAcsUnlckd /end REF_MEASUREMENT /end GROUP
/begin GROUP CmnMfgSrv.SeedKey "MICROSAR RTE" /begin SUB_GROUP /end SUB_GROUP /begin FUNCTION_LIST /end FUNCTION_LIST /begin REF_CHARACTERISTIC /end REF_CHARACTERISTIC /begin REF_MEASUREMENT CmnMfgSrv.SeedKey /end REF_MEASUREMENT /end GROUP
/begin GROUP CmnMfgSrv.SeedKeyDft "MICROSAR RTE" /begin SUB_GROUP /end SUB_GROUP /begin FUNCTION_LIST /end FUNCTION_LIST /begin REF_CHARACTERISTIC CmnMfgSrv.SeedKeyDft /end REF_CHARACTERISTIC /begin REF_MEASUREMENT /end REF_MEASUREMENT /end GROUP
/begin GROUP CmnMfgSrv.SenderPorts "MICROSAR RTE"
 /begin SUB_GROUP CmnMfgSrv.AssiLnrGain.Val CmnMfgSrv.AssiLnrGainEna.Logl CmnMfgSrv.AssiMechTEstimnDi.Logl CmnMfgSrv.DampgCmdBasDi.Logl CmnMfgSrv.DutyCycThermProtnDi.Logl CmnMfgSrv.EotProtnDi.Logl CmnMfgSrv.FricLrngDi.Logl CmnMfgSrv.HysCmpCmdDi.Logl CmnMfgSrv.IgnCntr.Val CmnMfgSrv.InertiaCmpVelCmdDi.Logl CmnMfgSrv.LoaScaDi.Logl CmnMfgSrv.MfgDiagcInhb.Logl CmnMfgSrv.PullCmpCmdDi.Logl CmnMfgSrv.PullCmpLrngDi.Logl CmnMfgSrv.RtnCmdDi.Logl CmnMfgSrv.StallMotTqLimDi.Logl CmnMfgSrv.SysMotTqCmdRampRateDi.Logl CmnMfgSrv.SysStImdtTranReqOff.Logl CmnMfgSrv.SysStReqEnaOvrd.Logl CmnMfgSrv.VehSpdOvrd.Val CmnMfgSrv.VehSpdOvrdEna.Logl /end SUB_GROUP
 /begin FUNCTION_LIST /end FUNCTION_LIST
 /begin REF_CHARACTERISTIC /end REF_CHARACTERISTIC
 /begin REF_MEASUREMENT /end REF_MEASUREMENT
/end GROUP
/begin GROUP CmnMfgSrv.SessionCurr "MICROSAR RTE" /begin SUB_GROUP /end SUB_GROUP /begin FUNCTION_LIST /end FUNCTION_LIST /begin REF_CHARACTERISTIC /end REF_CHARACTERISTIC /begin REF_MEASUREMENT CmnMfgSrv.SessionCurr /end REF_MEASUREMENT /end GROUP
/begin GROUP CmnMfgSrv.SessionTiOut "MICROSAR RTE" /begin SUB_GROUP /end SUB_GROUP /begin FUNCTION_LIST /end FUNCTION_LIST /begin REF_CHARACTERISTIC /end REF_CHARACTERISTIC /begin REF_MEASUREMENT CmnMfgSrv.SessionTiOut /end REF_MEASUREMENT /end GROUP
/begin GROUP CmnMfgSrv.StallMotTqLimDi.Logl "MICROSAR RTE" /begin SUB_GROUP /end SUB_GROUP /begin FUNCTION_LIST /end FUNCTION_LIST /begin REF_CHARACTERISTIC /end REF_CHARACTERISTIC /begin REF_MEASUREMENT CmnMfgSrv.StallMotTqLimDi.Logl /end REF_MEASUREMENT /end GROUP
/begin GROUP CmnMfgSrv.SysMotTqCmdRampRateDi.Logl "MICROSAR RTE" /begin SUB_GROUP /end SUB_GROUP /begin FUNCTION_LIST /end FUNCTION_LIST /begin REF_CHARACTERISTIC /end REF_CHARACTERISTIC /begin REF_MEASUREMENT CmnMfgSrv.SysMotTqCmdRampRateDi.Logl /end REF_MEASUREMENT /end GROUP
/begin GROUP CmnMfgSrv.SysSt.Val "MICROSAR RTE" /begin SUB_GROUP /end SUB_GROUP /begin FUNCTION_LIST /end FUNCTION_LIST /begin REF_CHARACTERISTIC /end REF_CHARACTERISTIC /begin REF_MEASUREMENT CmnMfgSrv.SysSt.Val /end REF_MEASUREMENT /end GROUP
/begin GROUP CmnMfgSrv.SysStImdtTranReqOff.Logl "MICROSAR RTE" /begin SUB_GROUP /end SUB_GROUP /begin FUNCTION_LIST /end FUNCTION_LIST /begin REF_CHARACTERISTIC /end REF_CHARACTERISTIC /begin REF_MEASUREMENT CmnMfgSrv.SysStImdtTranReqOff.Logl /end REF_MEASUREMENT /end GROUP
/begin GROUP CmnMfgSrv.SysStReqEnaOvrd "MICROSAR RTE" /begin SUB_GROUP /end SUB_GROUP /begin FUNCTION_LIST /end FUNCTION_LIST /begin REF_CHARACTERISTIC /end REF_CHARACTERISTIC /begin REF_MEASUREMENT CmnMfgSrv.SysStReqEnaOvrd /end REF_MEASUREMENT /end GROUP
/begin GROUP CmnMfgSrv.SysStReqEnaOvrd.Logl "MICROSAR RTE" /begin SUB_GROUP /end SUB_GROUP /begin FUNCTION_LIST /end FUNCTION_LIST /begin REF_CHARACTERISTIC /end REF_CHARACTERISTIC /begin REF_MEASUREMENT CmnMfgSrv.SysStReqEnaOvrd.Logl /end REF_MEASUREMENT /end GROUP
/begin GROUP CmnMfgSrv.VehSpdOvrd.Val "MICROSAR RTE" /begin SUB_GROUP /end SUB_GROUP /begin FUNCTION_LIST /end FUNCTION_LIST /begin REF_CHARACTERISTIC /end REF_CHARACTERISTIC /begin REF_MEASUREMENT CmnMfgSrv.VehSpdOvrd.Val /end REF_MEASUREMENT /end GROUP
/begin GROUP CmnMfgSrv.VehSpdOvrdEna.Logl "MICROSAR RTE" /begin SUB_GROUP /end SUB_GROUP /begin FUNCTION_LIST /end FUNCTION_LIST /begin REF_CHARACTERISTIC /end REF_CHARACTERISTIC /begin REF_MEASUREMENT CmnMfgSrv.VehSpdOvrdEna.Logl /end REF_MEASUREMENT /end GROUP
/begin GROUP CmplncErr "MICROSAR RTE"
 /begin SUB_GROUP CmplncErr.CalibrationPorts CmplncErr.ReceiverPorts CmplncErr.SenderPorts /end SUB_GROUP
 /begin FUNCTION_LIST /end FUNCTION_LIST
 /begin REF_CHARACTERISTIC /end REF_CHARACTERISTIC
 /begin REF_MEASUREMENT /end REF_MEASUREMENT
/end GROUP
/begin GROUP CmplncErr.CalibrationPorts "MICROSAR RTE"
 /begin SUB_GROUP CmplncErr.CmplncErrHwAgNonLinCmplncDepTblY.Ary1D CmplncErr.CmplncErrHwAgNonLinCmplncIndTblX.Ary1D CmplncErr.CmplncErrMotAgNonLinCmplncDepTblY.Ary1D CmplncErr.CmplncErrMotAgNonLinCmplncIndTblX.Ary1D /end SUB_GROUP
 /begin FUNCTION_LIST /end FUNCTION_LIST
 /begin REF_CHARACTERISTIC /end REF_CHARACTERISTIC
 /begin REF_MEASUREMENT /end REF_MEASUREMENT
/end GROUP
/begin GROUP CmplncErr.CmplncErrHwAgNonLinCmplncDepTblY.Ary1D "MICROSAR RTE" /begin SUB_GROUP /end SUB_GROUP /begin FUNCTION_LIST /end FUNCTION_LIST /begin REF_CHARACTERISTIC CmplncErr.CmplncErrHwAgNonLinCmplncDepTblY.Ary1D /end REF_CHARACTERISTIC /begin REF_MEASUREMENT /end REF_MEASUREMENT /end GROUP
/begin GROUP CmplncErr.CmplncErrHwAgNonLinCmplncIndTblX.Ary1D "MICROSAR RTE" /begin SUB_GROUP /end SUB_GROUP /begin FUNCTION_LIST /end FUNCTION_LIST /begin REF_CHARACTERISTIC CmplncErr.CmplncErrHwAgNonLinCmplncIndTblX.Ary1D /end REF_CHARACTERISTIC /begin REF_MEASUREMENT /end REF_MEASUREMENT /end GROUP
/begin GROUP CmplncErr.CmplncErrMotAgNonLinCmplncDepTblY.Ary1D "MICROSAR RTE" /begin SUB_GROUP /end SUB_GROUP /begin FUNCTION_LIST /end FUNCTION_LIST /begin REF_CHARACTERISTIC CmplncErr.CmplncErrMotAgNonLinCmplncDepTblY.Ary1D /end REF_CHARACTERISTIC /begin REF_MEASUREMENT /end REF_MEASUREMENT /end GROUP
/begin GROUP CmplncErr.CmplncErrMotAgNonLinCmplncIndTblX.Ary1D "MICROSAR RTE" /begin SUB_GROUP /end SUB_GROUP /begin FUNCTION_LIST /end FUNCTION_LIST /begin REF_CHARACTERISTIC CmplncErr.CmplncErrMotAgNonLinCmplncIndTblX.Ary1D /end REF_CHARACTERISTIC /begin REF_MEASUREMENT /end REF_MEASUREMENT /end GROUP
/begin GROUP CmplncErr.CmplncErrMotToPinion.Val "MICROSAR RTE" /begin SUB_GROUP /end SUB_GROUP /begin FUNCTION_LIST /end FUNCTION_LIST /begin REF_CHARACTERISTIC /end REF_CHARACTERISTIC /begin REF_MEASUREMENT CmplncErr.CmplncErrMotToPinion.Val /end REF_MEASUREMENT /end GROUP
/begin GROUP CmplncErr.CmplncErrPinionToHw.Val "MICROSAR RTE" /begin SUB_GROUP /end SUB_GROUP /begin FUNCTION_LIST /end FUNCTION_LIST /begin REF_CHARACTERISTIC /end REF_CHARACTERISTIC /begin REF_MEASUREMENT CmplncErr.CmplncErrPinionToHw.Val /end REF_MEASUREMENT /end GROUP
/begin GROUP CmplncErr.HwTq.Val "MICROSAR RTE" /begin SUB_GROUP /end SUB_GROUP /begin FUNCTION_LIST /end FUNCTION_LIST /begin REF_CHARACTERISTIC /end REF_CHARACTERISTIC /begin REF_MEASUREMENT CmplncErr.HwTq.Val /end REF_MEASUREMENT /end GROUP
/begin GROUP CmplncErr.MotTqCmdCrf.Val "MICROSAR RTE" /begin SUB_GROUP /end SUB_GROUP /begin FUNCTION_LIST /end FUNCTION_LIST /begin REF_CHARACTERISTIC /end REF_CHARACTERISTIC /begin REF_MEASUREMENT CmplncErr.MotTqCmdCrf.Val /end REF_MEASUREMENT /end GROUP
/begin GROUP CmplncErr.ReceiverPorts "MICROSAR RTE" /begin SUB_GROUP CmplncErr.HwTq.Val CmplncErr.MotTqCmdCrf.Val /end SUB_GROUP /begin FUNCTION_LIST /end FUNCTION_LIST /begin REF_CHARACTERISTIC /end REF_CHARACTERISTIC /begin REF_MEASUREMENT /end REF_MEASUREMENT /end GROUP
/begin GROUP CmplncErr.SenderPorts "MICROSAR RTE"
 /begin SUB_GROUP CmplncErr.CmplncErrMotToPinion.Val CmplncErr.CmplncErrPinionToHw.Val /end SUB_GROUP
 /begin FUNCTION_LIST /end FUNCTION_LIST
 /begin REF_CHARACTERISTIC /end REF_CHARACTERISTIC
 /begin REF_MEASUREMENT /end REF_MEASUREMENT
/end GROUP
/begin GROUP CurrMeasCorrln "MICROSAR RTE"
 /begin SUB_GROUP CurrMeasCorrln.CalibrationPorts CurrMeasCorrln.PerInstanceMemories CurrMeasCorrln.ReceiverPorts CurrMeasCorrln.SenderPorts /end SUB_GROUP
 /begin FUNCTION_LIST /end FUNCTION_LIST
 /begin REF_CHARACTERISTIC /end REF_CHARACTERISTIC
 /begin REF_MEASUREMENT /end REF_MEASUREMENT
/end GROUP
/begin GROUP CurrMeasCorrln.CalibrationPorts "MICROSAR RTE"
 /begin SUB_GROUP CurrMeasCorrln.CurrMeasCorrlnMaxErrCurr.Val CurrMeasCorrln.CurrMeasCorrlnMaxStallCntr.Val CurrMeasCorrln.CurrMeasCorrlnNtc0x04DFailStep.Val CurrMeasCorrln.CurrMeasCorrlnNtc0x04DPassStep.Val /end SUB_GROUP
 /begin FUNCTION_LIST /end FUNCTION_LIST
 /begin REF_CHARACTERISTIC /end REF_CHARACTERISTIC
 /begin REF_MEASUREMENT /end REF_MEASUREMENT
/end GROUP
/begin GROUP CurrMeasCorrln.CurrMeasCorrlnMaxErrCurr.Val "MICROSAR RTE" /begin SUB_GROUP /end SUB_GROUP /begin FUNCTION_LIST /end FUNCTION_LIST /begin REF_CHARACTERISTIC CurrMeasCorrln.CurrMeasCorrlnMaxErrCurr.Val /end REF_CHARACTERISTIC /begin REF_MEASUREMENT /end REF_MEASUREMENT /end GROUP
/begin GROUP CurrMeasCorrln.CurrMeasCorrlnMaxStallCntr.Val "MICROSAR RTE" /begin SUB_GROUP /end SUB_GROUP /begin FUNCTION_LIST /end FUNCTION_LIST /begin REF_CHARACTERISTIC CurrMeasCorrln.CurrMeasCorrlnMaxStallCntr.Val /end REF_CHARACTERISTIC /begin REF_MEASUREMENT /end REF_MEASUREMENT /end GROUP
/begin GROUP CurrMeasCorrln.CurrMeasCorrlnNtc0x04DFailStep.Val "MICROSAR RTE" /begin SUB_GROUP /end SUB_GROUP /begin FUNCTION_LIST /end FUNCTION_LIST /begin REF_CHARACTERISTIC CurrMeasCorrln.CurrMeasCorrlnNtc0x04DFailStep.Val /end REF_CHARACTERISTIC /begin REF_MEASUREMENT /end REF_MEASUREMENT /end GROUP
/begin GROUP CurrMeasCorrln.CurrMeasCorrlnNtc0x04DPassStep.Val "MICROSAR RTE" /begin SUB_GROUP /end SUB_GROUP /begin FUNCTION_LIST /end FUNCTION_LIST /begin REF_CHARACTERISTIC CurrMeasCorrln.CurrMeasCorrlnNtc0x04DPassStep.Val /end REF_CHARACTERISTIC /begin REF_MEASUREMENT /end REF_MEASUREMENT /end GROUP
/begin GROUP CurrMeasCorrln.CurrMeasCorrlnSts.Val "MICROSAR RTE" /begin SUB_GROUP /end SUB_GROUP /begin FUNCTION_LIST /end FUNCTION_LIST /begin REF_CHARACTERISTIC /end REF_CHARACTERISTIC /begin REF_MEASUREMENT CurrMeasCorrln.CurrMeasCorrlnSts.Val /end REF_MEASUREMENT /end GROUP
/begin GROUP CurrMeasCorrln.CurrMeasIdptSig.Val "MICROSAR RTE" /begin SUB_GROUP /end SUB_GROUP /begin FUNCTION_LIST /end FUNCTION_LIST /begin REF_CHARACTERISTIC /end REF_CHARACTERISTIC /begin REF_MEASUREMENT CurrMeasCorrln.CurrMeasIdptSig.Val /end REF_MEASUREMENT /end GROUP
/begin GROUP CurrMeasCorrln.CurrMotSumABC.Val "MICROSAR RTE" /begin SUB_GROUP /end SUB_GROUP /begin FUNCTION_LIST /end FUNCTION_LIST /begin REF_CHARACTERISTIC /end REF_CHARACTERISTIC /begin REF_MEASUREMENT CurrMeasCorrln.CurrMotSumABC.Val /end REF_MEASUREMENT /end GROUP
/begin GROUP CurrMeasCorrln.DiagcStsIvtr1Inactv.Logl "MICROSAR RTE" /begin SUB_GROUP /end SUB_GROUP /begin FUNCTION_LIST /end FUNCTION_LIST /begin REF_CHARACTERISTIC /end REF_CHARACTERISTIC /begin REF_MEASUREMENT CurrMeasCorrln.DiagcStsIvtr1Inactv.Logl /end REF_MEASUREMENT /end GROUP
/begin GROUP CurrMeasCorrln.LongTermCorrlnStsABC "MICROSAR RTE" /begin SUB_GROUP /end SUB_GROUP /begin FUNCTION_LIST /end FUNCTION_LIST /begin REF_CHARACTERISTIC /end REF_CHARACTERISTIC /begin REF_MEASUREMENT CurrMeasCorrln.LongTermCorrlnStsABC /end REF_MEASUREMENT /end GROUP
/begin GROUP CurrMeasCorrln.MotCurrCorrdA.Val "MICROSAR RTE" /begin SUB_GROUP /end SUB_GROUP /begin FUNCTION_LIST /end FUNCTION_LIST /begin REF_CHARACTERISTIC /end REF_CHARACTERISTIC /begin REF_MEASUREMENT CurrMeasCorrln.MotCurrCorrdA.Val /end REF_MEASUREMENT /end GROUP
/begin GROUP CurrMeasCorrln.MotCurrCorrdB.Val "MICROSAR RTE" /begin SUB_GROUP /end SUB_GROUP /begin FUNCTION_LIST /end FUNCTION_LIST /begin REF_CHARACTERISTIC /end REF_CHARACTERISTIC /begin REF_MEASUREMENT CurrMeasCorrln.MotCurrCorrdB.Val /end REF_MEASUREMENT /end GROUP
/begin GROUP CurrMeasCorrln.MotCurrCorrdC.Val "MICROSAR RTE" /begin SUB_GROUP /end SUB_GROUP /begin FUNCTION_LIST /end FUNCTION_LIST /begin REF_CHARACTERISTIC /end REF_CHARACTERISTIC /begin REF_MEASUREMENT CurrMeasCorrln.MotCurrCorrdC.Val /end REF_MEASUREMENT /end GROUP
/begin GROUP CurrMeasCorrln.MotCurrEolCalSt.Val "MICROSAR RTE" /begin SUB_GROUP /end SUB_GROUP /begin FUNCTION_LIST /end FUNCTION_LIST /begin REF_CHARACTERISTIC /end REF_CHARACTERISTIC /begin REF_MEASUREMENT CurrMeasCorrln.MotCurrEolCalSt.Val /end REF_MEASUREMENT /end GROUP
/begin GROUP CurrMeasCorrln.MotCurrRollgCntr1.Val "MICROSAR RTE" /begin SUB_GROUP /end SUB_GROUP /begin FUNCTION_LIST /end FUNCTION_LIST /begin REF_CHARACTERISTIC /end REF_CHARACTERISTIC /begin REF_MEASUREMENT CurrMeasCorrln.MotCurrRollgCntr1.Val /end REF_MEASUREMENT /end GROUP
/begin GROUP CurrMeasCorrln.PerInstanceMemories "MICROSAR RTE"
 /begin SUB_GROUP CurrMeasCorrln.LongTermCorrlnStsABC CurrMeasCorrln.Snsr0RollgCntPrev CurrMeasCorrln.Snsr0StallCntPrev /end SUB_GROUP
 /begin FUNCTION_LIST /end FUNCTION_LIST
 /begin REF_CHARACTERISTIC /end REF_CHARACTERISTIC
 /begin REF_MEASUREMENT /end REF_MEASUREMENT
/end GROUP
/begin GROUP CurrMeasCorrln.ReceiverPorts "MICROSAR RTE"
 /begin SUB_GROUP CurrMeasCorrln.DiagcStsIvtr1Inactv.Logl CurrMeasCorrln.MotCurrCorrdA.Val CurrMeasCorrln.MotCurrCorrdB.Val CurrMeasCorrln.MotCurrCorrdC.Val CurrMeasCorrln.MotCurrEolCalSt.Val CurrMeasCorrln.MotCurrRollgCntr1.Val CurrMeasCorrln.SysSt.Val /end SUB_GROUP
 /begin FUNCTION_LIST /end FUNCTION_LIST
 /begin REF_CHARACTERISTIC /end REF_CHARACTERISTIC
 /begin REF_MEASUREMENT /end REF_MEASUREMENT
/end GROUP
/begin GROUP CurrMeasCorrln.SenderPorts "MICROSAR RTE"
 /begin SUB_GROUP CurrMeasCorrln.CurrMeasCorrlnSts.Val CurrMeasCorrln.CurrMeasIdptSig.Val CurrMeasCorrln.CurrMotSumABC.Val /end SUB_GROUP
 /begin FUNCTION_LIST /end FUNCTION_LIST
 /begin REF_CHARACTERISTIC /end REF_CHARACTERISTIC
 /begin REF_MEASUREMENT /end REF_MEASUREMENT
/end GROUP
/begin GROUP CurrMeasCorrln.Snsr0RollgCntPrev "MICROSAR RTE" /begin SUB_GROUP /end SUB_GROUP /begin FUNCTION_LIST /end FUNCTION_LIST /begin REF_CHARACTERISTIC /end REF_CHARACTERISTIC /begin REF_MEASUREMENT CurrMeasCorrln.Snsr0RollgCntPrev /end REF_MEASUREMENT /end GROUP
/begin GROUP CurrMeasCorrln.Snsr0StallCntPrev "MICROSAR RTE" /begin SUB_GROUP /end SUB_GROUP /begin FUNCTION_LIST /end FUNCTION_LIST /begin REF_CHARACTERISTIC /end REF_CHARACTERISTIC /begin REF_MEASUREMENT CurrMeasCorrln.Snsr0StallCntPrev /end REF_MEASUREMENT /end GROUP
/begin GROUP CurrMeasCorrln.SysSt.Val "MICROSAR RTE" /begin SUB_GROUP /end SUB_GROUP /begin FUNCTION_LIST /end FUNCTION_LIST /begin REF_CHARACTERISTIC /end REF_CHARACTERISTIC /begin REF_MEASUREMENT CurrMeasCorrln.SysSt.Val /end REF_MEASUREMENT /end GROUP
/begin GROUP CustDiag "MICROSAR RTE"
 /begin SUB_GROUP CustDiag.CalibrationParameters CustDiag.CalibrationPorts CustDiag.ModeProvidePorts CustDiag.PerInstanceMemories CustDiag.ReceiverPorts CustDiag.SenderPorts /end SUB_GROUP
 /begin FUNCTION_LIST /end FUNCTION_LIST
 /begin REF_CHARACTERISTIC /end REF_CHARACTERISTIC
 /begin REF_MEASUREMENT /end REF_MEASUREMENT
/end GROUP
/begin GROUP CustDiag.BswM_MSI_BswMEcuResetMod.BswM_MDGP_BswMEcuResetMod "MICROSAR RTE" /begin SUB_GROUP /end SUB_GROUP /begin FUNCTION_LIST /end FUNCTION_LIST /begin REF_CHARACTERISTIC /end REF_CHARACTERISTIC
 /begin REF_MEASUREMENT CustDiag.BswM_MSI_BswMEcuResetMod.BswM_MDGP_BswMEcuResetMod /end REF_MEASUREMENT
/end GROUP
/begin GROUP CustDiag.CalibrationParameters "MICROSAR RTE"
 /begin SUB_GROUP CustDiag.Did205ADft CustDiag.Did205BDft CustDiag.Did3003Dft CustDiag.Did301ADft CustDiag.Did630FChkDft CustDiag.Did630FDft CustDiag.DidDE00Dft CustDiag.DidDE01Dft CustDiag.DidDE02Dft CustDiag.DidDE03Dft CustDiag.DidDE04Dft CustDiag.DidDE05Dft CustDiag.DidEE00Dft CustDiag.DidEE01Dft CustDiag.DidEE02Dft CustDiag.DidEE21Dft CustDiag.DidEE22Dft CustDiag.DidEE23Dft CustDiag.DidEE40Dft CustDiag.DidEE41Dft CustDiag.DidEE81Dft CustDiag.DidEE82Dft CustDiag.DidEE83Dft CustDiag.DidEE84Dft CustDiag.DidEE85Dft CustDiag.DidEE86Dft CustDiag.DidEE87Dft CustDiag.DidEE88Dft CustDiag.DidEED0Dft CustDiag.DidF110Dft CustDiag.DidF111Dft CustDiag.DidF113Dft CustDiag.DidF15FDft CustDiag.DidF162Dft CustDiag.DidF163Dft CustDiag.DidF166Dft CustDiag.DidF18ADft CustDiag.DidF18CDft CustDiag.DidF190Dft /end SUB_GROUP
 /begin FUNCTION_LIST /end FUNCTION_LIST
 /begin REF_CHARACTERISTIC /end REF_CHARACTERISTIC
 /begin REF_MEASUREMENT /end REF_MEASUREMENT
/end GROUP
/begin GROUP CustDiag.CalibrationPorts "MICROSAR RTE"
 /begin SUB_GROUP CustDiag.NxtrCalIdsCal0DevlpDesc.Ary1D CustDiag.NxtrCalIdsCal1DevlpDesc.Ary1D /end SUB_GROUP
 /begin FUNCTION_LIST /end FUNCTION_LIST
 /begin REF_CHARACTERISTIC /end REF_CHARACTERISTIC
 /begin REF_MEASUREMENT /end REF_MEASUREMENT
/end GROUP
/begin GROUP CustDiag.ClrDiagcReq "MICROSAR RTE" /begin SUB_GROUP /end SUB_GROUP /begin FUNCTION_LIST /end FUNCTION_LIST /begin REF_CHARACTERISTIC /end REF_CHARACTERISTIC /begin REF_MEASUREMENT CustDiag.ClrDiagcReq /end REF_MEASUREMENT /end GROUP
/begin GROUP CustDiag.ClrDiagcReq.Val "MICROSAR RTE" /begin SUB_GROUP /end SUB_GROUP /begin FUNCTION_LIST /end FUNCTION_LIST /begin REF_CHARACTERISTIC /end REF_CHARACTERISTIC /begin REF_MEASUREMENT CustDiag.ClrDiagcReq.Val /end REF_MEASUREMENT /end GROUP
/begin GROUP CustDiag.CustXcpEna.Logl "MICROSAR RTE" /begin SUB_GROUP /end SUB_GROUP /begin FUNCTION_LIST /end FUNCTION_LIST /begin REF_CHARACTERISTIC /end REF_CHARACTERISTIC /begin REF_MEASUREMENT CustDiag.CustXcpEna.Logl /end REF_MEASUREMENT /end GROUP
/begin GROUP CustDiag.Did205A "MICROSAR RTE" /begin SUB_GROUP /end SUB_GROUP /begin FUNCTION_LIST /end FUNCTION_LIST /begin REF_CHARACTERISTIC /end REF_CHARACTERISTIC /begin REF_MEASUREMENT CustDiag.Did205A /end REF_MEASUREMENT /end GROUP
/begin GROUP CustDiag.Did205ADft "MICROSAR RTE" /begin SUB_GROUP /end SUB_GROUP /begin FUNCTION_LIST /end FUNCTION_LIST /begin REF_CHARACTERISTIC CustDiag.Did205ADft /end REF_CHARACTERISTIC /begin REF_MEASUREMENT /end REF_MEASUREMENT /end GROUP
/begin GROUP CustDiag.Did205B "MICROSAR RTE" /begin SUB_GROUP /end SUB_GROUP /begin FUNCTION_LIST /end FUNCTION_LIST /begin REF_CHARACTERISTIC /end REF_CHARACTERISTIC /begin REF_MEASUREMENT CustDiag.Did205B /end REF_MEASUREMENT /end GROUP
/begin GROUP CustDiag.Did205BDft "MICROSAR RTE" /begin SUB_GROUP /end SUB_GROUP /begin FUNCTION_LIST /end FUNCTION_LIST /begin REF_CHARACTERISTIC CustDiag.Did205BDft /end REF_CHARACTERISTIC /begin REF_MEASUREMENT /end REF_MEASUREMENT /end GROUP
/begin GROUP CustDiag.Did3003 "MICROSAR RTE" /begin SUB_GROUP /end SUB_GROUP /begin FUNCTION_LIST /end FUNCTION_LIST /begin REF_CHARACTERISTIC /end REF_CHARACTERISTIC /begin REF_MEASUREMENT CustDiag.Did3003 /end REF_MEASUREMENT /end GROUP
/begin GROUP CustDiag.Did3003Dft "MICROSAR RTE" /begin SUB_GROUP /end SUB_GROUP /begin FUNCTION_LIST /end FUNCTION_LIST /begin REF_CHARACTERISTIC CustDiag.Did3003Dft /end REF_CHARACTERISTIC /begin REF_MEASUREMENT /end REF_MEASUREMENT /end GROUP
/begin GROUP CustDiag.Did301A "MICROSAR RTE" /begin SUB_GROUP /end SUB_GROUP /begin FUNCTION_LIST /end FUNCTION_LIST /begin REF_CHARACTERISTIC /end REF_CHARACTERISTIC /begin REF_MEASUREMENT CustDiag.Did301A /end REF_MEASUREMENT /end GROUP
/begin GROUP CustDiag.Did301ADft "MICROSAR RTE" /begin SUB_GROUP /end SUB_GROUP /begin FUNCTION_LIST /end FUNCTION_LIST /begin REF_CHARACTERISTIC CustDiag.Did301ADft /end REF_CHARACTERISTIC /begin REF_MEASUREMENT /end REF_MEASUREMENT /end GROUP
/begin GROUP CustDiag.Did630F "MICROSAR RTE" /begin SUB_GROUP /end SUB_GROUP /begin FUNCTION_LIST /end FUNCTION_LIST /begin REF_CHARACTERISTIC /end REF_CHARACTERISTIC /begin REF_MEASUREMENT CustDiag.Did630F /end REF_MEASUREMENT /end GROUP
/begin GROUP CustDiag.Did630FChk "MICROSAR RTE" /begin SUB_GROUP /end SUB_GROUP /begin FUNCTION_LIST /end FUNCTION_LIST /begin REF_CHARACTERISTIC /end REF_CHARACTERISTIC /begin REF_MEASUREMENT CustDiag.Did630FChk /end REF_MEASUREMENT /end GROUP
/begin GROUP CustDiag.Did630FChkDft "MICROSAR RTE" /begin SUB_GROUP /end SUB_GROUP /begin FUNCTION_LIST /end FUNCTION_LIST /begin REF_CHARACTERISTIC CustDiag.Did630FChkDft /end REF_CHARACTERISTIC /begin REF_MEASUREMENT /end REF_MEASUREMENT /end GROUP
/begin GROUP CustDiag.Did630FDft "MICROSAR RTE" /begin SUB_GROUP /end SUB_GROUP /begin FUNCTION_LIST /end FUNCTION_LIST /begin REF_CHARACTERISTIC CustDiag.Did630FDft /end REF_CHARACTERISTIC /begin REF_MEASUREMENT /end REF_MEASUREMENT /end GROUP
/begin GROUP CustDiag.DidDE00 "MICROSAR RTE" /begin SUB_GROUP /end SUB_GROUP /begin FUNCTION_LIST /end FUNCTION_LIST /begin REF_CHARACTERISTIC /end REF_CHARACTERISTIC /begin REF_MEASUREMENT CustDiag.DidDE00 /end REF_MEASUREMENT /end GROUP
/begin GROUP CustDiag.DidDE00Dft "MICROSAR RTE" /begin SUB_GROUP /end SUB_GROUP /begin FUNCTION_LIST /end FUNCTION_LIST /begin REF_CHARACTERISTIC CustDiag.DidDE00Dft /end REF_CHARACTERISTIC /begin REF_MEASUREMENT /end REF_MEASUREMENT /end GROUP
/begin GROUP CustDiag.DidDE01 "MICROSAR RTE" /begin SUB_GROUP /end SUB_GROUP /begin FUNCTION_LIST /end FUNCTION_LIST /begin REF_CHARACTERISTIC /end REF_CHARACTERISTIC /begin REF_MEASUREMENT CustDiag.DidDE01 /end REF_MEASUREMENT /end GROUP
/begin GROUP CustDiag.DidDE01Dft "MICROSAR RTE" /begin SUB_GROUP /end SUB_GROUP /begin FUNCTION_LIST /end FUNCTION_LIST /begin REF_CHARACTERISTIC CustDiag.DidDE01Dft /end REF_CHARACTERISTIC /begin REF_MEASUREMENT /end REF_MEASUREMENT /end GROUP
/begin GROUP CustDiag.DidDE02 "MICROSAR RTE" /begin SUB_GROUP /end SUB_GROUP /begin FUNCTION_LIST /end FUNCTION_LIST /begin REF_CHARACTERISTIC /end REF_CHARACTERISTIC /begin REF_MEASUREMENT CustDiag.DidDE02 /end REF_MEASUREMENT /end GROUP
/begin GROUP CustDiag.DidDE02Dft "MICROSAR RTE" /begin SUB_GROUP /end SUB_GROUP /begin FUNCTION_LIST /end FUNCTION_LIST /begin REF_CHARACTERISTIC CustDiag.DidDE02Dft /end REF_CHARACTERISTIC /begin REF_MEASUREMENT /end REF_MEASUREMENT /end GROUP
/begin GROUP CustDiag.DidDE03 "MICROSAR RTE" /begin SUB_GROUP /end SUB_GROUP /begin FUNCTION_LIST /end FUNCTION_LIST /begin REF_CHARACTERISTIC /end REF_CHARACTERISTIC /begin REF_MEASUREMENT CustDiag.DidDE03 /end REF_MEASUREMENT /end GROUP
/begin GROUP CustDiag.DidDE03Dft "MICROSAR RTE" /begin SUB_GROUP /end SUB_GROUP /begin FUNCTION_LIST /end FUNCTION_LIST /begin REF_CHARACTERISTIC CustDiag.DidDE03Dft /end REF_CHARACTERISTIC /begin REF_MEASUREMENT /end REF_MEASUREMENT /end GROUP
/begin GROUP CustDiag.DidDE04 "MICROSAR RTE" /begin SUB_GROUP /end SUB_GROUP /begin FUNCTION_LIST /end FUNCTION_LIST /begin REF_CHARACTERISTIC /end REF_CHARACTERISTIC /begin REF_MEASUREMENT CustDiag.DidDE04 /end REF_MEASUREMENT /end GROUP
/begin GROUP CustDiag.DidDE04Dft "MICROSAR RTE" /begin SUB_GROUP /end SUB_GROUP /begin FUNCTION_LIST /end FUNCTION_LIST /begin REF_CHARACTERISTIC CustDiag.DidDE04Dft /end REF_CHARACTERISTIC /begin REF_MEASUREMENT /end REF_MEASUREMENT /end GROUP
/begin GROUP CustDiag.DidDE05 "MICROSAR RTE" /begin SUB_GROUP /end SUB_GROUP /begin FUNCTION_LIST /end FUNCTION_LIST /begin REF_CHARACTERISTIC /end REF_CHARACTERISTIC /begin REF_MEASUREMENT CustDiag.DidDE05 /end REF_MEASUREMENT /end GROUP
/begin GROUP CustDiag.DidDE05Dft "MICROSAR RTE" /begin SUB_GROUP /end SUB_GROUP /begin FUNCTION_LIST /end FUNCTION_LIST /begin REF_CHARACTERISTIC CustDiag.DidDE05Dft /end REF_CHARACTERISTIC /begin REF_MEASUREMENT /end REF_MEASUREMENT /end GROUP
/**********************************************************************************************************************
* RECORD_LAYOUT
*********************************************************************************************************************/
/begin RECORD_LAYOUT RTE_RL_UBYTE FNC_VALUES 1 UBYTE ROW_DIR DIRECT /end RECORD_LAYOUT
/begin RECORD_LAYOUT RTE_RL_UWORD FNC_VALUES 1 UWORD ROW_DIR DIRECT /end RECORD_LAYOUT
/begin RECORD_LAYOUT RTE_RL_ULONG FNC_VALUES 1 ULONG ROW_DIR DIRECT /end RECORD_LAYOUT
/begin RECORD_LAYOUT RTE_RL_SWORD FNC_VALUES 1 SWORD ROW_DIR DIRECT /end RECORD_LAYOUT
/begin RECORD_LAYOUT RTE_RL_FLOAT32_IEEE FNC_VALUES 1 FLOAT32_IEEE ROW_DIR DIRECT /end RECORD_LAYOUT
/begin RECORD_LAYOUT RTE_RL_BOOLEAN FNC_VALUES 1 UBYTE ROW_DIR DIRECT /end RECORD_LAYOUT
/**********************************************************************************************************************
* COMPU_METHOD / COMPU_VTAB_RANGE
*********************************************************************************************************************/
/begin COMPU_METHOD RTE_CM_BOOLEAN "" TAB_VERB "%3.1" "" COMPU_TAB_REF RTE_CM_BOOLEAN /end COMPU_METHOD
/begin COMPU_VTAB_RANGE RTE_CM_BOOLEAN "" 2 0 0 "false" 1 255 "true" /end COMPU_VTAB_RANGE
/begin COMPU_METHOD RTE_CM_ENUM_SysSt1 "" TAB_VERB "%.1" "" COMPU_TAB_REF RTE_CM_ENUM_SysSt1 /end COMPU_METHOD
/begin COMPU_VTAB_RANGE RTE_CM_ENUM_SysSt1 "" 4 0 0 "SYSST_DI" 1 1 "SYSST_OFF" 2 2 "SYSST_ENA" 3 3 "SYSST_WRMININ" /end COMPU_VTAB_RANGE
/begin COMPU_METHOD RTE_CM_ENUM_BswMEcuResetMod "" TAB_VERB "%.1" "" COMPU_TAB_REF RTE_CM_ENUM_BswMEcuResetMod /end COMPU_METHOD
/begin COMPU_VTAB_RANGE RTE_CM_ENUM_BswMEcuResetMod "" 4 0 0 "RTE_MODE_BswMEcuResetMod_EcuResetDisabled" 1 1 "RTE_MODE_BswMEcuResetMod_EcuResetEnabled" 2 2 "RTE_MODE_BswMEcuResetMod_EcuResetStarted" 3 3 "RTE_TRANSITION_BswMEcuResetMod" /end COMPU_VTAB_RANGE
/begin COMPU_METHOD RTE_CM_ENUM_MotCurrEolCalSt2 "" TAB_VERB "%.1" "" COMPU_TAB_REF RTE_CM_ENUM_MotCurrEolCalSt2 /end COMPU_METHOD
/begin COMPU_VTAB_RANGE RTE_CM_ENUM_MotCurrEolCalSt2 "" 9 0 0 "MCECS_OFFSCMDSTRT" 1 1 "MCECS_OFFSCMDHI" 2 2 "MCECS_OFFSCMDLO" 3 3 "MCECS_OFFSCMDZERO" 4 4 "MCECS_OFFSCMDEND" 5 5 "MCECS_GAINCMDAD" 6 6 "MCECS_GAINCMDBE" 7 7 "MCECS_GAINCMDCF" 8 8 "MCECS_CMDSAFEST" /end COMPU_VTAB_RANGE
