/begin CHARACTERISTIC FordMsg3B3BusHiSpd.FordMsg3B3BusHiSpdIgnStsVldFaildThd.Val "MICROSAR RTE" VALUE 0x0 RTE_RL_UWORD 0 NO_COMPU_METHOD 0 65535 SYMBOL_LINK "Rte_CalprmRom_CalRegn01Cmn_DEFAULT_RTE_CALPRM_GROUP.FordMsg3B3BusHiSpdIgnStsVldFaildThd_Val" 0 DISPLAY_IDENTIFIER FordMsg3B3BusHiSpd.CalibrationPorts.FordMsg3B3BusHiSpdIgnStsVldFaildThd.Val /end CHARACTERISTIC
/begin CHARACTERISTIC FordMsg3B3BusHiSpd.FordMsg3B3BusHiSpdIgnStsVldMissThd.Val "MICROSAR RTE" VALUE 0x0 RTE_RL_UWORD 0 NO_COMPU_METHOD 0 65535 SYMBOL_LINK "Rte_CalprmRom_CalRegn01Cmn_DEFAULT_RTE_CALPRM_GROUP.FordMsg3B3BusHiSpdIgnStsVldMissThd_Val" 0 DISPLAY_IDENTIFIER FordMsg3B3BusHiSpd.CalibrationPorts.FordMsg3B3BusHiSpdIgnStsVldMissThd.Val /end CHARACTERISTIC
/begin CHARACTERISTIC FordMsg3B3BusHiSpd.FordMsg3B3BusHiSpdIgnStsVldPassdThd.Val "MICROSAR RTE" VALUE 0x0 RTE_RL_UWORD 0 NO_COMPU_METHOD 0 65535 SYMBOL_LINK "Rte_CalprmRom_CalRegn01Cmn_DEFAULT_RTE_CALPRM_GROUP.FordMsg3B3BusHiSpdIgnStsVldPassdThd_Val" 0 DISPLAY_IDENTIFIER FordMsg3B3BusHiSpd.CalibrationPorts.FordMsg3B3BusHiSpdIgnStsVldPassdThd.Val /end CHARACTERISTIC
/begin CHARACTERISTIC FordMsg3B3BusHiSpd.FordMsg3B3BusHiSpdInvldSigFaildThd.Val "MICROSAR RTE" VALUE 0x0 RTE_RL_UWORD 0 NO_COMPU_METHOD 0 65535 SYMBOL_LINK "Rte_CalprmRom_CalRegn01Cmn_DEFAULT_RTE_CALPRM_GROUP.FordMsg3B3BusHiSpdInvldSigFaildThd_Val" 0 DISPLAY_IDENTIFIER FordMsg3B3BusHiSpd.CalibrationPorts.FordMsg3B3BusHiSpdInvldSigFaildThd.Val /end CHARACTERISTIC
/begin CHARACTERISTIC FordMsg3B3BusHiSpd.FordMsg3B3BusHiSpdInvldSigPassdThd.Val "MICROSAR RTE" VALUE 0x0 RTE_RL_UWORD 0 NO_COMPU_METHOD 0 65535 SYMBOL_LINK "Rte_CalprmRom_CalRegn01Cmn_DEFAULT_RTE_CALPRM_GROUP.FordMsg3B3BusHiSpdInvldSigPassdThd_Val" 0 DISPLAY_IDENTIFIER FordMsg3B3BusHiSpd.CalibrationPorts.FordMsg3B3BusHiSpdInvldSigPassdThd.Val /end CHARACTERISTIC
/begin CHARACTERISTIC FordMsg3B3BusHiSpd.FordMsg3B3BusHiSpdMissMsgFaildThd.Val "MICROSAR RTE" VALUE 0x0 RTE_RL_UWORD 0 NO_COMPU_METHOD 0 65535 SYMBOL_LINK "Rte_CalprmRom_CalRegn01Cmn_DEFAULT_RTE_CALPRM_GROUP.FordMsg3B3BusHiSpdMissMsgFaildThd_Val" 0 DISPLAY_IDENTIFIER FordMsg3B3BusHiSpd.CalibrationPorts.FordMsg3B3BusHiSpdMissMsgFaildThd.Val /end CHARACTERISTIC
/begin CHARACTERISTIC FordMsg3B3BusHiSpd.FordMsg3B3BusHiSpdMissMsgPassdThd.Val "MICROSAR RTE" VALUE 0x0 RTE_RL_UWORD 0 NO_COMPU_METHOD 0 65535 SYMBOL_LINK "Rte_CalprmRom_CalRegn01Cmn_DEFAULT_RTE_CALPRM_GROUP.FordMsg3B3BusHiSpdMissMsgPassdThd_Val" 0 DISPLAY_IDENTIFIER FordMsg3B3BusHiSpd.CalibrationPorts.FordMsg3B3BusHiSpdMissMsgPassdThd.Val /end CHARACTERISTIC
/begin CHARACTERISTIC FordMsg3CABusHiSpd.FordMsg3CABusHiSpdLaneAssiImgProcgModlAFaildCrvtTiThd.Val "MICROSAR RTE" VALUE 0x0 RTE_RL_UWORD 0 NO_COMPU_METHOD 0 65535 SYMBOL_LINK "Rte_CalprmRom_CalRegn01Cmn_DEFAULT_RTE_CALPRM_GROUP.FordMsg3CABusHiSpdLaneAssiImgProcgModlAFaildCrvtTiThd_Val" 0 DISPLAY_IDENTIFIER FordMsg3CABusHiSpd.CalibrationPorts.FordMsg3CABusHiSpdLaneAssiImgProcgModlAFaildCrvtTiThd.Val /end CHARACTERISTIC
/begin CHARACTERISTIC FordMsg3CABusHiSpd.FordMsg3CABusHiSpdLaneAssiImgProcgModlAFaildReqdAgTiThd.Val "MICROSAR RTE" VALUE 0x0 RTE_RL_UWORD 0 NO_COMPU_METHOD 0 65535 SYMBOL_LINK "Rte_CalprmRom_CalRegn01Cmn_DEFAULT_RTE_CALPRM_GROUP.FordMsg3CABusHiSpdLaneAssiImgProcgModlAFaildReqdAgTiThd_Val" 0 DISPLAY_IDENTIFIER FordMsg3CABusHiSpd.CalibrationPorts.FordMsg3CABusHiSpdLaneAssiImgProcgModlAFaildReqdAgTiThd.Val /end CHARACTERISTIC
/begin CHARACTERISTIC FordMsg3CABusHiSpd.FordMsg3CABusHiSpdLaneAssiImgProcgModlAPassdTiThd.Val "MICROSAR RTE" VALUE 0x0 RTE_RL_UWORD 0 NO_COMPU_METHOD 0 65535 SYMBOL_LINK "Rte_CalprmRom_CalRegn01Cmn_DEFAULT_RTE_CALPRM_GROUP.FordMsg3CABusHiSpdLaneAssiImgProcgModlAPassdTiThd_Val" 0 DISPLAY_IDENTIFIER FordMsg3CABusHiSpd.CalibrationPorts.FordMsg3CABusHiSpdLaneAssiImgProcgModlAPassdTiThd.Val /end CHARACTERISTIC
/begin CHARACTERISTIC FordMsg3CABusHiSpd.FordMsg3CABusHiSpdLaneAssiImgProcgModlAVldMissTiThd.Val "MICROSAR RTE" VALUE 0x0 RTE_RL_UWORD 0 NO_COMPU_METHOD 0 65535 SYMBOL_LINK "Rte_CalprmRom_CalRegn01Cmn_DEFAULT_RTE_CALPRM_GROUP.FordMsg3CABusHiSpdLaneAssiImgProcgModlAVldMissTiThd_Val" 0 DISPLAY_IDENTIFIER FordMsg3CABusHiSpd.CalibrationPorts.FordMsg3CABusHiSpdLaneAssiImgProcgModlAVldMissTiThd.Val /end CHARACTERISTIC
/begin CHARACTERISTIC FordMsg3CABusHiSpd.FordMsg3CABusHiSpdLaneKeepSysCrvtInvldFaildTiThd.Val "MICROSAR RTE" VALUE 0x0 RTE_RL_UWORD 0 NO_COMPU_METHOD 0 65535 SYMBOL_LINK "Rte_CalprmRom_CalRegn01Cmn_DEFAULT_RTE_CALPRM_GROUP.FordMsg3CABusHiSpdLaneKeepSysCrvtInvldFaildTiThd_Val" 0 DISPLAY_IDENTIFIER FordMsg3CABusHiSpd.CalibrationPorts.FordMsg3CABusHiSpdLaneKeepSysCrvtInvldFaildTiThd.Val /end CHARACTERISTIC
/begin CHARACTERISTIC FordMsg3CABusHiSpd.FordMsg3CABusHiSpdLaneKeepSysCrvtInvldPassdTiThd.Val "MICROSAR RTE" VALUE 0x0 RTE_RL_UWORD 0 NO_COMPU_METHOD 0 65535 SYMBOL_LINK "Rte_CalprmRom_CalRegn01Cmn_DEFAULT_RTE_CALPRM_GROUP.FordMsg3CABusHiSpdLaneKeepSysCrvtInvldPassdTiThd_Val" 0 DISPLAY_IDENTIFIER FordMsg3CABusHiSpd.CalibrationPorts.FordMsg3CABusHiSpdLaneKeepSysCrvtInvldPassdTiThd.Val /end CHARACTERISTIC
/begin CHARACTERISTIC FordMsg3CABusHiSpd.FordMsg3CABusHiSpdLaneKeepSysReqdAgInvldFaildTiThd.Val "MICROSAR RTE" VALUE 0x0 RTE_RL_UWORD 0 NO_COMPU_METHOD 0 65535 SYMBOL_LINK "Rte_CalprmRom_CalRegn01Cmn_DEFAULT_RTE_CALPRM_GROUP.FordMsg3CABusHiSpdLaneKeepSysReqdAgInvldFaildTiThd_Val" 0 DISPLAY_IDENTIFIER FordMsg3CABusHiSpd.CalibrationPorts.FordMsg3CABusHiSpdLaneKeepSysReqdAgInvldFaildTiThd.Val /end CHARACTERISTIC
/begin CHARACTERISTIC FordMsg3CABusHiSpd.FordMsg3CABusHiSpdLaneKeepSysReqdAgInvldPassdTiThd.Val "MICROSAR RTE" VALUE 0x0 RTE_RL_UWORD 0 NO_COMPU_METHOD 0 65535 SYMBOL_LINK "Rte_CalprmRom_CalRegn01Cmn_DEFAULT_RTE_CALPRM_GROUP.FordMsg3CABusHiSpdLaneKeepSysReqdAgInvldPassdTiThd_Val" 0 DISPLAY_IDENTIFIER FordMsg3CABusHiSpd.CalibrationPorts.FordMsg3CABusHiSpdLaneKeepSysReqdAgInvldPassdTiThd.Val /end CHARACTERISTIC
/begin CHARACTERISTIC FordMsg3CABusHiSpd.FordMsg3CABusHiSpdMissMsgFaildTiThd.Val "MICROSAR RTE" VALUE 0x0 RTE_RL_UWORD 0 NO_COMPU_METHOD 0 65535 SYMBOL_LINK "Rte_CalprmRom_CalRegn01Cmn_DEFAULT_RTE_CALPRM_GROUP.FordMsg3CABusHiSpdMissMsgFaildTiThd_Val" 0 DISPLAY_IDENTIFIER FordMsg3CABusHiSpd.CalibrationPorts.FordMsg3CABusHiSpdMissMsgFaildTiThd.Val /end CHARACTERISTIC
/begin CHARACTERISTIC FordMsg3CABusHiSpd.FordMsg3CABusHiSpdMissMsgPassdTiThd.Val "MICROSAR RTE" VALUE 0x0 RTE_RL_UWORD 0 NO_COMPU_METHOD 0 65535 SYMBOL_LINK "Rte_CalprmRom_CalRegn01Cmn_DEFAULT_RTE_CALPRM_GROUP.FordMsg3CABusHiSpdMissMsgPassdTiThd_Val" 0 DISPLAY_IDENTIFIER FordMsg3CABusHiSpd.CalibrationPorts.FordMsg3CABusHiSpdMissMsgPassdTiThd.Val /end CHARACTERISTIC
/begin CHARACTERISTIC FordMsg3D3BusHiSpd.FordMsg3D3BusHiSpdImgProcrModlAVldFaildThd.Val "MICROSAR RTE" VALUE 0x0 RTE_RL_UWORD 0 NO_COMPU_METHOD 0 65535 SYMBOL_LINK "Rte_CalprmRom_CalRegn01Cmn_DEFAULT_RTE_CALPRM_GROUP.FordMsg3D3BusHiSpdImgProcrModlAVldFaildThd_Val" 0 DISPLAY_IDENTIFIER FordMsg3D3BusHiSpd.CalibrationPorts.FordMsg3D3BusHiSpdImgProcrModlAVldFaildThd.Val /end CHARACTERISTIC
/begin CHARACTERISTIC FordMsg3D3BusHiSpd.FordMsg3D3BusHiSpdImgProcrModlAVldPassdThd.Val "MICROSAR RTE" VALUE 0x0 RTE_RL_UWORD 0 NO_COMPU_METHOD 0 65535 SYMBOL_LINK "Rte_CalprmRom_CalRegn01Cmn_DEFAULT_RTE_CALPRM_GROUP.FordMsg3D3BusHiSpdImgProcrModlAVldPassdThd_Val" 0 DISPLAY_IDENTIFIER FordMsg3D3BusHiSpd.CalibrationPorts.FordMsg3D3BusHiSpdImgProcrModlAVldPassdThd.Val /end CHARACTERISTIC
/begin CHARACTERISTIC FordMsg3D3BusHiSpd.FordMsg3D3BusHiSpdMissMsgFaildThd.Val "MICROSAR RTE" VALUE 0x0 RTE_RL_UWORD 0 NO_COMPU_METHOD 0 65535 SYMBOL_LINK "Rte_CalprmRom_CalRegn01Cmn_DEFAULT_RTE_CALPRM_GROUP.FordMsg3D3BusHiSpdMissMsgFaildThd_Val" 0 DISPLAY_IDENTIFIER FordMsg3D3BusHiSpd.CalibrationPorts.FordMsg3D3BusHiSpdMissMsgFaildThd.Val /end CHARACTERISTIC
/begin CHARACTERISTIC FordMsg3D3BusHiSpd.FordMsg3D3BusHiSpdMissMsgPassdThd.Val "MICROSAR RTE" VALUE 0x0 RTE_RL_UWORD 0 NO_COMPU_METHOD 0 65535 SYMBOL_LINK "Rte_CalprmRom_CalRegn01Cmn_DEFAULT_RTE_CALPRM_GROUP.FordMsg3D3BusHiSpdMissMsgPassdThd_Val" 0 DISPLAY_IDENTIFIER FordMsg3D3BusHiSpd.CalibrationPorts.FordMsg3D3BusHiSpdMissMsgPassdThd.Val /end CHARACTERISTIC
/begin CHARACTERISTIC FordMsg3D7BusHiSpd.FordMsg3D7BusHiSpdImgProcrModlAVldMissThd.Val "MICROSAR RTE" VALUE 0x0 RTE_RL_UWORD 0 NO_COMPU_METHOD 0 65535 SYMBOL_LINK "Rte_CalprmRom_CalRegn01Cmn_DEFAULT_RTE_CALPRM_GROUP.FordMsg3D7BusHiSpdImgProcrModlAVldMissThd_Val" 0 DISPLAY_IDENTIFIER FordMsg3D7BusHiSpd.CalibrationPorts.FordMsg3D7BusHiSpdImgProcrModlAVldMissThd.Val /end CHARACTERISTIC
/begin CHARACTERISTIC FordMsg3D7BusHiSpd.FordMsg3D7BusHiSpdImgProcrModlAVldPassdThd.Val "MICROSAR RTE" VALUE 0x0 RTE_RL_UWORD 0 NO_COMPU_METHOD 0 65535 SYMBOL_LINK "Rte_CalprmRom_CalRegn01Cmn_DEFAULT_RTE_CALPRM_GROUP.FordMsg3D7BusHiSpdImgProcrModlAVldPassdThd_Val" 0 DISPLAY_IDENTIFIER FordMsg3D7BusHiSpd.CalibrationPorts.FordMsg3D7BusHiSpdImgProcrModlAVldPassdThd.Val /end CHARACTERISTIC
/begin CHARACTERISTIC FordMsg3D7BusHiSpd.FordMsg3D7BusHiSpdLatDstInvldFaildThd.Val "MICROSAR RTE" VALUE 0x0 RTE_RL_UWORD 0 NO_COMPU_METHOD 0 65535 SYMBOL_LINK "Rte_CalprmRom_CalRegn01Cmn_DEFAULT_RTE_CALPRM_GROUP.FordMsg3D7BusHiSpdLatDstInvldFaildThd_Val" 0 DISPLAY_IDENTIFIER FordMsg3D7BusHiSpd.CalibrationPorts.FordMsg3D7BusHiSpdLatDstInvldFaildThd.Val /end CHARACTERISTIC
/begin CHARACTERISTIC FordMsg3D7BusHiSpd.FordMsg3D7BusHiSpdLatDstInvldPassdThd.Val "MICROSAR RTE" VALUE 0x0 RTE_RL_UWORD 0 NO_COMPU_METHOD 0 65535 SYMBOL_LINK "Rte_CalprmRom_CalRegn01Cmn_DEFAULT_RTE_CALPRM_GROUP.FordMsg3D7BusHiSpdLatDstInvldPassdThd_Val" 0 DISPLAY_IDENTIFIER FordMsg3D7BusHiSpd.CalibrationPorts.FordMsg3D7BusHiSpdLatDstInvldPassdThd.Val /end CHARACTERISTIC
/begin CHARACTERISTIC FordMsg3D7BusHiSpd.FordMsg3D7BusHiSpdLatDstRawVldFaildThd.Val "MICROSAR RTE" VALUE 0x0 RTE_RL_UWORD 0 NO_COMPU_METHOD 0 65535 SYMBOL_LINK "Rte_CalprmRom_CalRegn01Cmn_DEFAULT_RTE_CALPRM_GROUP.FordMsg3D7BusHiSpdLatDstRawVldFaildThd_Val" 0 DISPLAY_IDENTIFIER FordMsg3D7BusHiSpd.CalibrationPorts.FordMsg3D7BusHiSpdLatDstRawVldFaildThd.Val /end CHARACTERISTIC
/begin CHARACTERISTIC FordMsg3D7BusHiSpd.FordMsg3D7BusHiSpdLgtDstInvldFaildThd.Val "MICROSAR RTE" VALUE 0x0 RTE_RL_UWORD 0 NO_COMPU_METHOD 0 65535 SYMBOL_LINK "Rte_CalprmRom_CalRegn01Cmn_DEFAULT_RTE_CALPRM_GROUP.FordMsg3D7BusHiSpdLgtDstInvldFaildThd_Val" 0 DISPLAY_IDENTIFIER FordMsg3D7BusHiSpd.CalibrationPorts.FordMsg3D7BusHiSpdLgtDstInvldFaildThd.Val /end CHARACTERISTIC
/begin CHARACTERISTIC FordMsg3D7BusHiSpd.FordMsg3D7BusHiSpdLgtDstInvldPassdThd.Val "MICROSAR RTE" VALUE 0x0 RTE_RL_UWORD 0 NO_COMPU_METHOD 0 65535 SYMBOL_LINK "Rte_CalprmRom_CalRegn01Cmn_DEFAULT_RTE_CALPRM_GROUP.FordMsg3D7BusHiSpdLgtDstInvldPassdThd_Val" 0 DISPLAY_IDENTIFIER FordMsg3D7BusHiSpd.CalibrationPorts.FordMsg3D7BusHiSpdLgtDstInvldPassdThd.Val /end CHARACTERISTIC
/begin CHARACTERISTIC FordMsg3D7BusHiSpd.FordMsg3D7BusHiSpdLgtDstRawVldFaildThd.Val "MICROSAR RTE" VALUE 0x0 RTE_RL_UWORD 0 NO_COMPU_METHOD 0 65535 SYMBOL_LINK "Rte_CalprmRom_CalRegn01Cmn_DEFAULT_RTE_CALPRM_GROUP.FordMsg3D7BusHiSpdLgtDstRawVldFaildThd_Val" 0 DISPLAY_IDENTIFIER FordMsg3D7BusHiSpd.CalibrationPorts.FordMsg3D7BusHiSpdLgtDstRawVldFaildThd.Val /end CHARACTERISTIC
/begin CHARACTERISTIC FordMsg3D7BusHiSpd.FordMsg3D7BusHiSpdMissMsgFaildThd.Val "MICROSAR RTE" VALUE 0x0 RTE_RL_UWORD 0 NO_COMPU_METHOD 0 65535 SYMBOL_LINK "Rte_CalprmRom_CalRegn01Cmn_DEFAULT_RTE_CALPRM_GROUP.FordMsg3D7BusHiSpdMissMsgFaildThd_Val" 0 DISPLAY_IDENTIFIER FordMsg3D7BusHiSpd.CalibrationPorts.FordMsg3D7BusHiSpdMissMsgFaildThd.Val /end CHARACTERISTIC
/begin CHARACTERISTIC FordMsg3D7BusHiSpd.FordMsg3D7BusHiSpdMissMsgPassdThd.Val "MICROSAR RTE" VALUE 0x0 RTE_RL_UWORD 0 NO_COMPU_METHOD 0 65535 SYMBOL_LINK "Rte_CalprmRom_CalRegn01Cmn_DEFAULT_RTE_CALPRM_GROUP.FordMsg3D7BusHiSpdMissMsgPassdThd_Val" 0 DISPLAY_IDENTIFIER FordMsg3D7BusHiSpd.CalibrationPorts.FordMsg3D7BusHiSpdMissMsgPassdThd.Val /end CHARACTERISTIC
/begin CHARACTERISTIC FordMsg3D7BusHiSpd.FordMsg3D7BusHiSpdRelLatVelInvldFaildThd.Val "MICROSAR RTE" VALUE 0x0 RTE_RL_UWORD 0 NO_COMPU_METHOD 0 65535 SYMBOL_LINK "Rte_CalprmRom_CalRegn01Cmn_DEFAULT_RTE_CALPRM_GROUP.FordMsg3D7BusHiSpdRelLatVelInvldFaildThd_Val" 0 DISPLAY_IDENTIFIER FordMsg3D7BusHiSpd.CalibrationPorts.FordMsg3D7BusHiSpdRelLatVelInvldFaildThd.Val /end CHARACTERISTIC
/begin CHARACTERISTIC FordMsg3D7BusHiSpd.FordMsg3D7BusHiSpdRelLatVelInvldPassdThd.Val "MICROSAR RTE" VALUE 0x0 RTE_RL_UWORD 0 NO_COMPU_METHOD 0 65535 SYMBOL_LINK "Rte_CalprmRom_CalRegn01Cmn_DEFAULT_RTE_CALPRM_GROUP.FordMsg3D7BusHiSpdRelLatVelInvldPassdThd_Val" 0 DISPLAY_IDENTIFIER FordMsg3D7BusHiSpd.CalibrationPorts.FordMsg3D7BusHiSpdRelLatVelInvldPassdThd.Val /end CHARACTERISTIC
/begin CHARACTERISTIC FordMsg3D7BusHiSpd.FordMsg3D7BusHiSpdRelLatVelRawVldFaildThd.Val "MICROSAR RTE" VALUE 0x0 RTE_RL_UWORD 0 NO_COMPU_METHOD 0 65535 SYMBOL_LINK "Rte_CalprmRom_CalRegn01Cmn_DEFAULT_RTE_CALPRM_GROUP.FordMsg3D7BusHiSpdRelLatVelRawVldFaildThd_Val" 0 DISPLAY_IDENTIFIER FordMsg3D7BusHiSpd.CalibrationPorts.FordMsg3D7BusHiSpdRelLatVelRawVldFaildThd.Val /end CHARACTERISTIC
/begin CHARACTERISTIC FordMsg3D7BusHiSpd.FordMsg3D7BusHiSpdRelLgtVelInvldFaildThd.Val "MICROSAR RTE" VALUE 0x0 RTE_RL_UWORD 0 NO_COMPU_METHOD 0 65535 SYMBOL_LINK "Rte_CalprmRom_CalRegn01Cmn_DEFAULT_RTE_CALPRM_GROUP.FordMsg3D7BusHiSpdRelLgtVelInvldFaildThd_Val" 0 DISPLAY_IDENTIFIER FordMsg3D7BusHiSpd.CalibrationPorts.FordMsg3D7BusHiSpdRelLgtVelInvldFaildThd.Val /end CHARACTERISTIC
/begin CHARACTERISTIC FordMsg3D7BusHiSpd.FordMsg3D7BusHiSpdRelLgtVelInvldPassdThd.Val "MICROSAR RTE" VALUE 0x0 RTE_RL_UWORD 0 NO_COMPU_METHOD 0 65535 SYMBOL_LINK "Rte_CalprmRom_CalRegn01Cmn_DEFAULT_RTE_CALPRM_GROUP.FordMsg3D7BusHiSpdRelLgtVelInvldPassdThd_Val" 0 DISPLAY_IDENTIFIER FordMsg3D7BusHiSpd.CalibrationPorts.FordMsg3D7BusHiSpdRelLgtVelInvldPassdThd.Val /end CHARACTERISTIC
/begin CHARACTERISTIC FordMsg3D7BusHiSpd.FordMsg3D7BusHiSpdRelLgtVelRawVldFaildThd.Val "MICROSAR RTE" VALUE 0x0 RTE_RL_UWORD 0 NO_COMPU_METHOD 0 65535 SYMBOL_LINK "Rte_CalprmRom_CalRegn01Cmn_DEFAULT_RTE_CALPRM_GROUP.FordMsg3D7BusHiSpdRelLgtVelRawVldFaildThd_Val" 0 DISPLAY_IDENTIFIER FordMsg3D7BusHiSpd.CalibrationPorts.FordMsg3D7BusHiSpdRelLgtVelRawVldFaildThd.Val /end CHARACTERISTIC
/begin CHARACTERISTIC FordMsg3D7BusHiSpd.FordMsg3D7BusHiSpdTiToCllsnInvldFaildThd.Val "MICROSAR RTE" VALUE 0x0 RTE_RL_UWORD 0 NO_COMPU_METHOD 0 65535 SYMBOL_LINK "Rte_CalprmRom_CalRegn01Cmn_DEFAULT_RTE_CALPRM_GROUP.FordMsg3D7BusHiSpdTiToCllsnInvldFaildThd_Val" 0 DISPLAY_IDENTIFIER FordMsg3D7BusHiSpd.CalibrationPorts.FordMsg3D7BusHiSpdTiToCllsnInvldFaildThd.Val /end CHARACTERISTIC
/begin CHARACTERISTIC FordMsg3D7BusHiSpd.FordMsg3D7BusHiSpdTiToCllsnInvldPassdThd.Val "MICROSAR RTE" VALUE 0x0 RTE_RL_UWORD 0 NO_COMPU_METHOD 0 65535 SYMBOL_LINK "Rte_CalprmRom_CalRegn01Cmn_DEFAULT_RTE_CALPRM_GROUP.FordMsg3D7BusHiSpdTiToCllsnInvldPassdThd_Val" 0 DISPLAY_IDENTIFIER FordMsg3D7BusHiSpd.CalibrationPorts.FordMsg3D7BusHiSpdTiToCllsnInvldPassdThd.Val /end CHARACTERISTIC
/begin CHARACTERISTIC FordMsg3D7BusHiSpd.FordMsg3D7BusHiSpdTiToCllsnRawVldFaildThd.Val "MICROSAR RTE" VALUE 0x0 RTE_RL_UWORD 0 NO_COMPU_METHOD 0 65535 SYMBOL_LINK "Rte_CalprmRom_CalRegn01Cmn_DEFAULT_RTE_CALPRM_GROUP.FordMsg3D7BusHiSpdTiToCllsnRawVldFaildThd_Val" 0 DISPLAY_IDENTIFIER FordMsg3D7BusHiSpd.CalibrationPorts.FordMsg3D7BusHiSpdTiToCllsnRawVldFaildThd.Val /end CHARACTERISTIC
/begin CHARACTERISTIC FordMsg40ABusHiSpd.FordMsg40ABusHiSpdMissMsgFaildThd.Val "MICROSAR RTE" VALUE 0x0 RTE_RL_UWORD 0 NO_COMPU_METHOD 0 65535 SYMBOL_LINK "Rte_CalprmRom_CalRegn01Cmn_DEFAULT_RTE_CALPRM_GROUP.FordMsg40ABusHiSpdMissMsgFaildThd_Val" 0 DISPLAY_IDENTIFIER FordMsg40ABusHiSpd.CalibrationPorts.FordMsg40ABusHiSpdMissMsgFaildThd.Val /end CHARACTERISTIC
/begin CHARACTERISTIC FordMsg40ABusHiSpd.FordMsg40ABusHiSpdMissMsgPassdThd.Val "MICROSAR RTE" VALUE 0x0 RTE_RL_UWORD 0 NO_COMPU_METHOD 0 65535 SYMBOL_LINK "Rte_CalprmRom_CalRegn01Cmn_DEFAULT_RTE_CALPRM_GROUP.FordMsg40ABusHiSpdMissMsgPassdThd_Val" 0 DISPLAY_IDENTIFIER FordMsg40ABusHiSpd.CalibrationPorts.FordMsg40ABusHiSpdMissMsgPassdThd.Val /end CHARACTERISTIC
/begin CHARACTERISTIC FordMsg414BusHiSpd.FordMsg414BusHiSpdAgOffsVldFaildThd.Val "MICROSAR RTE" VALUE 0x0 RTE_RL_UWORD 0 NO_COMPU_METHOD 0 65535 SYMBOL_LINK "Rte_CalprmRom_CalRegn01Cmn_DEFAULT_RTE_CALPRM_GROUP.FordMsg414BusHiSpdAgOffsVldFaildThd_Val" 0 DISPLAY_IDENTIFIER FordMsg414BusHiSpd.CalibrationPorts.FordMsg414BusHiSpdAgOffsVldFaildThd.Val /end CHARACTERISTIC
/begin CHARACTERISTIC FordMsg414BusHiSpd.FordMsg414BusHiSpdAgOffsVldMissThd.Val "MICROSAR RTE" VALUE 0x0 RTE_RL_UWORD 0 NO_COMPU_METHOD 0 65535 SYMBOL_LINK "Rte_CalprmRom_CalRegn01Cmn_DEFAULT_RTE_CALPRM_GROUP.FordMsg414BusHiSpdAgOffsVldMissThd_Val" 0 DISPLAY_IDENTIFIER FordMsg414BusHiSpd.CalibrationPorts.FordMsg414BusHiSpdAgOffsVldMissThd.Val /end CHARACTERISTIC
/begin CHARACTERISTIC FordMsg414BusHiSpd.FordMsg414BusHiSpdAgOffsVldPassdThd.Val "MICROSAR RTE" VALUE 0x0 RTE_RL_UWORD 0 NO_COMPU_METHOD 0 65535 SYMBOL_LINK "Rte_CalprmRom_CalRegn01Cmn_DEFAULT_RTE_CALPRM_GROUP.FordMsg414BusHiSpdAgOffsVldPassdThd_Val" 0 DISPLAY_IDENTIFIER FordMsg414BusHiSpd.CalibrationPorts.FordMsg414BusHiSpdAgOffsVldPassdThd.Val /end CHARACTERISTIC
/begin CHARACTERISTIC FordMsg414BusHiSpd.FordMsg414BusHiSpdChksVldFaildThd.Val "MICROSAR RTE" VALUE 0x0 RTE_RL_UWORD 0 NO_COMPU_METHOD 0 65535 SYMBOL_LINK "Rte_CalprmRom_CalRegn01Cmn_DEFAULT_RTE_CALPRM_GROUP.FordMsg414BusHiSpdChksVldFaildThd_Val" 0 DISPLAY_IDENTIFIER FordMsg414BusHiSpd.CalibrationPorts.FordMsg414BusHiSpdChksVldFaildThd.Val /end CHARACTERISTIC
/begin CHARACTERISTIC FordMsg414BusHiSpd.FordMsg414BusHiSpdChksVldMissThd.Val "MICROSAR RTE" VALUE 0x0 RTE_RL_UWORD 0 NO_COMPU_METHOD 0 65535 SYMBOL_LINK "Rte_CalprmRom_CalRegn01Cmn_DEFAULT_RTE_CALPRM_GROUP.FordMsg414BusHiSpdChksVldMissThd_Val" 0 DISPLAY_IDENTIFIER FordMsg414BusHiSpd.CalibrationPorts.FordMsg414BusHiSpdChksVldMissThd.Val /end CHARACTERISTIC
/begin CHARACTERISTIC FordMsg414BusHiSpd.FordMsg414BusHiSpdCntrVldMissThd.Val "MICROSAR RTE" VALUE 0x0 RTE_RL_UWORD 0 NO_COMPU_METHOD 0 65535 SYMBOL_LINK "Rte_CalprmRom_CalRegn01Cmn_DEFAULT_RTE_CALPRM_GROUP.FordMsg414BusHiSpdCntrVldMissThd_Val" 0 DISPLAY_IDENTIFIER FordMsg414BusHiSpd.CalibrationPorts.FordMsg414BusHiSpdCntrVldMissThd.Val /end CHARACTERISTIC
/begin MEASUREMENT FordMsg3B3BusHiSpd.ClrDiagcFlgProxy.Val "MICROSAR RTE" UBYTE NO_COMPU_METHOD 0 0 0 255 ECU_ADDRESS 0 SYMBOL_LINK "Rte_DiagcMgr_ClrDiagcFlgProxy_Val" 0 DISPLAY_IDENTIFIER FordMsg3B3BusHiSpd.ReceiverPorts.ClrDiagcFlgProxy.Val /end MEASUREMENT
/begin MEASUREMENT FordMsg3B3BusHiSpd.ClrDiagcFlgProxyPrev "MICROSAR RTE" UBYTE NO_COMPU_METHOD 0 0 0 255 ECU_ADDRESS 0 SYMBOL_LINK "Rte_FordMsg3B3BusHiSpd_ClrDiagcFlgProxyPrev" 0 DISPLAY_IDENTIFIER FordMsg3B3BusHiSpd.PerInstanceMemories.ClrDiagcFlgProxyPrev /end MEASUREMENT
/begin MEASUREMENT FordMsg3B3BusHiSpd.FirstTranVldFlg "MICROSAR RTE" UBYTE RTE_CM_BOOLEAN 0 0 0 255 ECU_ADDRESS 0 SYMBOL_LINK "Rte_FordMsg3B3BusHiSpd_FirstTranVldFlg" 0 DISPLAY_IDENTIFIER FordMsg3B3BusHiSpd.PerInstanceMemories.FirstTranVldFlg /end MEASUREMENT
/begin MEASUREMENT FordMsg3B3BusHiSpd.FordCanDtcInhb.Val "MICROSAR RTE" UBYTE NO_COMPU_METHOD 0 0 0 255 ECU_ADDRESS 0 SYMBOL_LINK "Rte_FordCanDtcInhb_FordCanDtcInhb8_Val" 0 DISPLAY_IDENTIFIER FordMsg3B3BusHiSpd.ReceiverPorts.FordCanDtcInhb.Val /end MEASUREMENT
/begin MEASUREMENT FordMsg3B3BusHiSpd.FordEpsLifeCycMod.Val "MICROSAR RTE" UBYTE NO_COMPU_METHOD 0 0 0 255 ECU_ADDRESS 0 SYMBOL_LINK "Rte_FordCanDtcInhb_FordEpsLifeCycMod_Val" 0 DISPLAY_IDENTIFIER FordMsg3B3BusHiSpd.ReceiverPorts.FordEpsLifeCycMod.Val /end MEASUREMENT
/begin MEASUREMENT FordMsg3B3BusHiSpd.FordInvldMsgDiagcInhb.Val "MICROSAR RTE" UBYTE NO_COMPU_METHOD 0 0 0 255 ECU_ADDRESS 0 SYMBOL_LINK "Rte_FordMsg3B3BusHiSpd_FordInvldMsgDiagcInhb_Val" 0 DISPLAY_IDENTIFIER FordMsg3B3BusHiSpd.ReceiverPorts.FordInvldMsgDiagcInhb.Val /end MEASUREMENT
/begin MEASUREMENT FordMsg3B3BusHiSpd.FordMfgDiagcInhb.Val "MICROSAR RTE" UBYTE NO_COMPU_METHOD 0 0 0 255 ECU_ADDRESS 0 SYMBOL_LINK "Rte_FordMsg3B3BusHiSpd_FordMfgDiagcInhb_Val" 0 DISPLAY_IDENTIFIER FordMsg3B3BusHiSpd.ReceiverPorts.FordMfgDiagcInhb.Val /end MEASUREMENT
/begin MEASUREMENT FordMsg3B3BusHiSpd.FordMissMsgDiagcInhb.Val "MICROSAR RTE" UBYTE NO_COMPU_METHOD 0 0 0 255 ECU_ADDRESS 0 SYMBOL_LINK "Rte_FordMsg3B3BusHiSpd_FordMissMsgDiagcInhb_Val" 0 DISPLAY_IDENTIFIER FordMsg3B3BusHiSpd.ReceiverPorts.FordMissMsgDiagcInhb.Val /end MEASUREMENT
/begin MEASUREMENT FordMsg3B3BusHiSpd.FordTrlrBackUpAssiEnad.Logl "MICROSAR RTE" UBYTE RTE_CM_BOOLEAN 0 0 0 255 ECU_ADDRESS 0 SYMBOL_LINK "Rte_FordMsg3B3BusHiSpd_FordTrlrBackUpAssiEnad_Logl" 0 DISPLAY_IDENTIFIER FordMsg3B3BusHiSpd.ReceiverPorts.FordTrlrBackUpAssiEnad.Logl /end MEASUREMENT
/begin MEASUREMENT FordMsg3B3BusHiSpd.FordVehIgnSts.Ford_Ignition_Status "MICROSAR RTE" UBYTE RTE_CM_ENUM_Ford_Ignition_Status 0 0 0 15 ECU_ADDRESS 0 SYMBOL_LINK "Rte_FordMsg3B3BusHiSpd_FordVehIgnSts_Ford_Ignition_Status" 0 DISPLAY_IDENTIFIER FordMsg3B3BusHiSpd.SenderPorts.FordVehIgnSts.Ford_Ignition_Status /end MEASUREMENT
/begin MEASUREMENT FordMsg3B3BusHiSpd.FordVehIgnStsInvldSigFaildRefTi "MICROSAR RTE" ULONG NO_COMPU_METHOD 0 0 0 4294967295 ECU_ADDRESS 0 SYMBOL_LINK "Rte_FordMsg3B3BusHiSpd_FordVehIgnStsInvldSigFaildRefTi" 0 DISPLAY_IDENTIFIER FordMsg3B3BusHiSpd.PerInstanceMemories.FordVehIgnStsInvldSigFaildRefTi /end MEASUREMENT
/begin MEASUREMENT FordMsg3B3BusHiSpd.FordVehIgnStsInvldSigPassdRefTi "MICROSAR RTE" ULONG NO_COMPU_METHOD 0 0 0 4294967295 ECU_ADDRESS 0 SYMBOL_LINK "Rte_FordMsg3B3BusHiSpd_FordVehIgnStsInvldSigPassdRefTi" 0 DISPLAY_IDENTIFIER FordMsg3B3BusHiSpd.PerInstanceMemories.FordVehIgnStsInvldSigPassdRefTi /end MEASUREMENT
/begin MEASUREMENT FordMsg3B3BusHiSpd.FordVehIgnStsPrev "MICROSAR RTE" UBYTE RTE_CM_ENUM_Ford_Ignition_Status 0 0 0 15 ECU_ADDRESS 0 SYMBOL_LINK "Rte_FordMsg3B3BusHiSpd_FordVehIgnStsPrev" 0 DISPLAY_IDENTIFIER FordMsg3B3BusHiSpd.PerInstanceMemories.FordVehIgnStsPrev /end MEASUREMENT
/begin MEASUREMENT FordMsg3B3BusHiSpd.FordVehIgnStsVld.Logl "MICROSAR RTE" UBYTE RTE_CM_BOOLEAN 0 0 0 255 ECU_ADDRESS 0 SYMBOL_LINK "Rte_FordMsg3B3BusHiSpd_FordVehIgnStsVld_Logl" 0 DISPLAY_IDENTIFIER FordMsg3B3BusHiSpd.SenderPorts.FordVehIgnStsVld.Logl /end MEASUREMENT
/begin MEASUREMENT FordMsg3B3BusHiSpd.FordVehIgnStsVldPrev "MICROSAR RTE" UBYTE RTE_CM_BOOLEAN 0 0 0 255 ECU_ADDRESS 0 SYMBOL_LINK "Rte_FordMsg3B3BusHiSpd_FordVehIgnStsVldPrev" 0 DISPLAY_IDENTIFIER FordMsg3B3BusHiSpd.PerInstanceMemories.FordVehIgnStsVldPrev /end MEASUREMENT
/begin MEASUREMENT FordMsg3B3BusHiSpd.FordVehLifeCycMod.Ford_LifeCycMde_D_Actl "MICROSAR RTE" UBYTE RTE_CM_ENUM_Ford_LifeCycMde_D_Actl 0 0 0 15 ECU_ADDRESS 0 SYMBOL_LINK "Rte_FordMsg3B3BusHiSpd_FordVehLifeCycMod_Ford_LifeCycMde_D_Actl" 0 DISPLAY_IDENTIFIER FordMsg3B3BusHiSpd.SenderPorts.FordVehLifeCycMod.Ford_LifeCycMde_D_Actl /end MEASUREMENT
/begin MEASUREMENT FordMsg3B3BusHiSpd.FordVehLifeCycModPrev "MICROSAR RTE" UBYTE RTE_CM_ENUM_Ford_LifeCycMde_D_Actl 0 0 0 15 ECU_ADDRESS 0 SYMBOL_LINK "Rte_FordMsg3B3BusHiSpd_FordVehLifeCycModPrev" 0 DISPLAY_IDENTIFIER FordMsg3B3BusHiSpd.PerInstanceMemories.FordVehLifeCycModPrev /end MEASUREMENT
/begin MEASUREMENT FordMsg3B3BusHiSpd.FordVehMsg3B3Miss "MICROSAR RTE" UBYTE RTE_CM_BOOLEAN 0 0 0 255 ECU_ADDRESS 0 SYMBOL_LINK "Rte_FordMsg3B3BusHiSpd_FordVehMsg3B3Miss" 0 DISPLAY_IDENTIFIER FordMsg3B3BusHiSpd.PerInstanceMemories.FordVehMsg3B3Miss /end MEASUREMENT
/begin MEASUREMENT FordMsg3B3BusHiSpd.FordVehMsg3B3Rxd "MICROSAR RTE" UBYTE RTE_CM_BOOLEAN 0 0 0 255 ECU_ADDRESS 0 SYMBOL_LINK "Rte_FordMsg3B3BusHiSpd_FordVehMsg3B3Rxd" 0 DISPLAY_IDENTIFIER FordMsg3B3BusHiSpd.PerInstanceMemories.FordVehMsg3B3Rxd /end MEASUREMENT
/begin MEASUREMENT FordMsg3B3BusHiSpd.IgnStsVldFaildRefTi "MICROSAR RTE" ULONG NO_COMPU_METHOD 0 0 0 4294967295 ECU_ADDRESS 0 SYMBOL_LINK "Rte_FordMsg3B3BusHiSpd_IgnStsVldFaildRefTi" 0 DISPLAY_IDENTIFIER FordMsg3B3BusHiSpd.PerInstanceMemories.IgnStsVldFaildRefTi /end MEASUREMENT
/begin MEASUREMENT FordMsg3B3BusHiSpd.IgnStsVldMissRefTi "MICROSAR RTE" ULONG NO_COMPU_METHOD 0 0 0 4294967295 ECU_ADDRESS 0 SYMBOL_LINK "Rte_FordMsg3B3BusHiSpd_IgnStsVldMissRefTi" 0 DISPLAY_IDENTIFIER FordMsg3B3BusHiSpd.PerInstanceMemories.IgnStsVldMissRefTi /end MEASUREMENT
/begin MEASUREMENT FordMsg3B3BusHiSpd.IgnStsVldPassdRefTi "MICROSAR RTE" ULONG NO_COMPU_METHOD 0 0 0 4294967295 ECU_ADDRESS 0 SYMBOL_LINK "Rte_FordMsg3B3BusHiSpd_IgnStsVldPassdRefTi" 0 DISPLAY_IDENTIFIER FordMsg3B3BusHiSpd.PerInstanceMemories.IgnStsVldPassdRefTi /end MEASUREMENT
/begin MEASUREMENT FordMsg3B3BusHiSpd.MissMsgFaildRefTi "MICROSAR RTE" ULONG NO_COMPU_METHOD 0 0 0 4294967295 ECU_ADDRESS 0 SYMBOL_LINK "Rte_FordMsg3B3BusHiSpd_MissMsgFaildRefTi" 0 DISPLAY_IDENTIFIER FordMsg3B3BusHiSpd.PerInstanceMemories.MissMsgFaildRefTi /end MEASUREMENT
/begin MEASUREMENT FordMsg3B3BusHiSpd.MissMsgPassdRefTi "MICROSAR RTE" ULONG NO_COMPU_METHOD 0 0 0 4294967295 ECU_ADDRESS 0 SYMBOL_LINK "Rte_FordMsg3B3BusHiSpd_MissMsgPassdRefTi" 0 DISPLAY_IDENTIFIER FordMsg3B3BusHiSpd.PerInstanceMemories.MissMsgPassdRefTi /end MEASUREMENT
/begin MEASUREMENT FordMsg3CABusHiSpd.ClrDiagcFlgProxy.Val "MICROSAR RTE" UBYTE NO_COMPU_METHOD 0 0 0 255 ECU_ADDRESS 0 SYMBOL_LINK "Rte_DiagcMgr_ClrDiagcFlgProxy_Val" 0 DISPLAY_IDENTIFIER FordMsg3CABusHiSpd.ReceiverPorts.ClrDiagcFlgProxy.Val /end MEASUREMENT
/begin MEASUREMENT FordMsg3CABusHiSpd.ClrDiagcFlgProxyPrev "Clear Diagc Flag Proxy" UBYTE NO_COMPU_METHOD 0 0 0 255 ECU_ADDRESS 0 SYMBOL_LINK "Rte_FordMsg3CABusHiSpd_ClrDiagcFlgProxyPrev" 0 DISPLAY_IDENTIFIER FordMsg3CABusHiSpd.PerInstanceMemories.ClrDiagcFlgProxyPrev /end MEASUREMENT
/begin MEASUREMENT FordMsg3CABusHiSpd.FirstTranVldFlg "This flag is used to indicate the reception of first message" UBYTE RTE_CM_BOOLEAN 0 0 0 255 ECU_ADDRESS 0 SYMBOL_LINK "Rte_FordMsg3CABusHiSpd_FirstTranVldFlg" 0 DISPLAY_IDENTIFIER FordMsg3CABusHiSpd.PerInstanceMemories.FirstTranVldFlg /end MEASUREMENT
/begin MEASUREMENT FordMsg3CABusHiSpd.FordCanDtcInhb.Logl "MICROSAR RTE" UBYTE RTE_CM_BOOLEAN 0 0 0 255 ECU_ADDRESS 0 SYMBOL_LINK "Rte_FordCanDtcInhb_FordCanDtcInhb_Logl" 0 DISPLAY_IDENTIFIER FordMsg3CABusHiSpd.ReceiverPorts.FordCanDtcInhb.Logl /end MEASUREMENT
/begin MEASUREMENT FordMsg3CABusHiSpd.FordEpsLifeCycMod.Val "MICROSAR RTE" UBYTE NO_COMPU_METHOD 0 0 0 255 ECU_ADDRESS 0 SYMBOL_LINK "Rte_FordCanDtcInhb_FordEpsLifeCycMod_Val" 0 DISPLAY_IDENTIFIER FordMsg3CABusHiSpd.ReceiverPorts.FordEpsLifeCycMod.Val /end MEASUREMENT
/begin MEASUREMENT FordMsg3CABusHiSpd.FordLaneDetnWarnEnad.Logl "MICROSAR RTE" UBYTE RTE_CM_BOOLEAN 0 0 0 255 ECU_ADDRESS 0 SYMBOL_LINK "Rte_CustDiag_FordLaneDprtrWarnEnad_Logl" 0 DISPLAY_IDENTIFIER FordMsg3CABusHiSpd.ReceiverPorts.FordLaneDetnWarnEnad.Logl /end MEASUREMENT
/begin MEASUREMENT FordMsg3CABusHiSpd.FordLaneKeepAssiEnad.Logl "MICROSAR RTE" UBYTE RTE_CM_BOOLEAN 0 0 0 255 ECU_ADDRESS 0 SYMBOL_LINK "Rte_CustDiag_FordLaneKeepAssiEnad_Logl" 0 DISPLAY_IDENTIFIER FordMsg3CABusHiSpd.ReceiverPorts.FordLaneKeepAssiEnad.Logl /end MEASUREMENT
/begin MEASUREMENT FordMsg3CABusHiSpd.FordVehLaneAssiImgProcgModlAVld.Logl "MICROSAR RTE" UBYTE RTE_CM_BOOLEAN 0 0 0 255 ECU_ADDRESS 0 SYMBOL_LINK "Rte_FordMsg3CABusHiSpd_FordVehLaneAssiImgProcgModlAVld_Logl" 0 DISPLAY_IDENTIFIER FordMsg3CABusHiSpd.SenderPorts.FordVehLaneAssiImgProcgModlAVld.Logl /end MEASUREMENT
/begin MEASUREMENT FordMsg3CABusHiSpd.FordVehLaneAssiImgProcgModlAVldPrev "Holds previous value of FordVehLaneAssilmgProcgModlAVld when FOrdMsg3CA message is missing" UBYTE RTE_CM_BOOLEAN 0 0 0 255 ECU_ADDRESS 0 SYMBOL_LINK "Rte_FordMsg3CABusHiSpd_FordVehLaneAssiImgProcgModlAVldPrev" 0 DISPLAY_IDENTIFIER FordMsg3CABusHiSpd.PerInstanceMemories.FordVehLaneAssiImgProcgModlAVldPrev /end MEASUREMENT
/begin MEASUREMENT FordMsg3CABusHiSpd.FordVehLaneDetnWarnInten.Val "MICROSAR RTE" UBYTE NO_COMPU_METHOD 0 0 0 255 ECU_ADDRESS 0 SYMBOL_LINK "Rte_FordMsg3CABusHiSpd_FordVehLaneDetnWarnInten_Val" 0 DISPLAY_IDENTIFIER FordMsg3CABusHiSpd.SenderPorts.FordVehLaneDetnWarnInten.Val /end MEASUREMENT
/begin MEASUREMENT FordMsg3CABusHiSpd.FordVehLaneDetnWarnIntenPrev "Holds Previous value of FordVehLaneDetnWarnInten when FordMsg3CA message is missing" UBYTE NO_COMPU_METHOD 0 0 0 255 ECU_ADDRESS 0 SYMBOL_LINK "Rte_FordMsg3CABusHiSpd_FordVehLaneDetnWarnIntenPrev" 0 DISPLAY_IDENTIFIER FordMsg3CABusHiSpd.PerInstanceMemories.FordVehLaneDetnWarnIntenPrev /end MEASUREMENT
/begin MEASUREMENT FordMsg3CABusHiSpd.FordVehLaneDetnWarnSts.Val "MICROSAR RTE" UBYTE NO_COMPU_METHOD 0 0 0 255 ECU_ADDRESS 0 SYMBOL_LINK "Rte_FordMsg3CABusHiSpd_FordVehLaneDetnWarnSts_Val" 0 DISPLAY_IDENTIFIER FordMsg3CABusHiSpd.SenderPorts.FordVehLaneDetnWarnSts.Val /end MEASUREMENT
/begin MEASUREMENT FordMsg3CABusHiSpd.FordVehLaneDetnWarnStsPrev "Holds Previous value of FordVehLaneDetnWarnSts when FordMsg3Ca message is missing" UBYTE NO_COMPU_METHOD 0 0 0 255 ECU_ADDRESS 0 SYMBOL_LINK "Rte_FordMsg3CABusHiSpd_FordVehLaneDetnWarnStsPrev" 0 DISPLAY_IDENTIFIER FordMsg3CABusHiSpd.PerInstanceMemories.FordVehLaneDetnWarnStsPrev /end MEASUREMENT
/begin MEASUREMENT FordMsg3CABusHiSpd.FordVehLaneKeepSysCrvt.Val "MICROSAR RTE" FLOAT32_IEEE NO_COMPU_METHOD 0 0 -3.402823466e+38 3.402823466e+38 ECU_ADDRESS 0 SYMBOL_LINK "Rte_FordMsg3CABusHiSpd_FordVehLaneKeepSysCrvt_Val" 0 DISPLAY_IDENTIFIER FordMsg3CABusHiSpd.SenderPorts.FordVehLaneKeepSysCrvt.Val /end MEASUREMENT
/begin MEASUREMENT FordMsg3CABusHiSpd.FordVehLaneKeepSysCrvtInvldFaildRefTi "Timer for invalid message will increment or reset based on the conditions" ULONG NO_COMPU_METHOD 0 0 0 4294967295 ECU_ADDRESS 0 SYMBOL_LINK "Rte_FordMsg3CABusHiSpd_FordVehLaneKeepSysCrvtInvldFaildRefTi" 0 DISPLAY_IDENTIFIER FordMsg3CABusHiSpd.PerInstanceMemories.FordVehLaneKeepSysCrvtInvldFaildRefTi /end MEASUREMENT
/begin MEASUREMENT FordMsg3CABusHiSpd.FordVehLaneKeepSysCrvtInvldPassdRefTi "Timer for invalid message will increment or reset based on the conditions" ULONG NO_COMPU_METHOD 0 0 0 4294967295 ECU_ADDRESS 0 SYMBOL_LINK "Rte_FordMsg3CABusHiSpd_FordVehLaneKeepSysCrvtInvldPassdRefTi" 0 DISPLAY_IDENTIFIER FordMsg3CABusHiSpd.PerInstanceMemories.FordVehLaneKeepSysCrvtInvldPassdRefTi /end MEASUREMENT
/begin MEASUREMENT FordMsg3CABusHiSpd.FordVehLaneKeepSysCrvtPrev "Holds previous value of FordVehLaneKeepSysCrvt when FOrdMsg3CA message is missing" FLOAT32_IEEE NO_COMPU_METHOD 0 0 -3.402823466e+38 3.402823466e+38 ECU_ADDRESS 0 SYMBOL_LINK "Rte_FordMsg3CABusHiSpd_FordVehLaneKeepSysCrvtPrev" 0 DISPLAY_IDENTIFIER FordMsg3CABusHiSpd.PerInstanceMemories.FordVehLaneKeepSysCrvtPrev /end MEASUREMENT
/begin MEASUREMENT FordMsg3CABusHiSpd.FordVehLaneKeepSysCrvtRaw.Val "MICROSAR RTE" UWORD NO_COMPU_METHOD 0 0 0 65535 ECU_ADDRESS 0 SYMBOL_LINK "Rte_FordMsg3CABusHiSpd_FordVehLaneKeepSysCrvtRaw_Val" 0 DISPLAY_IDENTIFIER FordMsg3CABusHiSpd.SenderPorts.FordVehLaneKeepSysCrvtRaw.Val /end MEASUREMENT
/begin MEASUREMENT FordMsg3CABusHiSpd.FordVehLaneKeepSysCrvtRawPrev "Holds previous value of FordVehLaneKeepSysCrvtRaw when FOrdMsg3CA message is missing" UWORD NO_COMPU_METHOD 0 0 0 65535 ECU_ADDRESS 0 SYMBOL_LINK "Rte_FordMsg3CABusHiSpd_FordVehLaneKeepSysCrvtRawPrev" 0 DISPLAY_IDENTIFIER FordMsg3CABusHiSpd.PerInstanceMemories.FordVehLaneKeepSysCrvtRawPrev /end MEASUREMENT
/begin MEASUREMENT FordMsg3CABusHiSpd.FordVehLaneKeepSysRampTyp.Val "MICROSAR RTE" UBYTE NO_COMPU_METHOD 0 0 0 255 ECU_ADDRESS 0 SYMBOL_LINK "Rte_FordMsg3CABusHiSpd_FordVehLaneKeepSysRampTyp_Val" 0 DISPLAY_IDENTIFIER FordMsg3CABusHiSpd.SenderPorts.FordVehLaneKeepSysRampTyp.Val /end MEASUREMENT
/begin MEASUREMENT FordMsg3CABusHiSpd.FordVehLaneKeepSysRampTypPrev "Holds previous value of FordVehLaneKeepSysRamp when FOrdMsg3CA message is missing" UBYTE NO_COMPU_METHOD 0 0 0 255 ECU_ADDRESS 0 SYMBOL_LINK "Rte_FordMsg3CABusHiSpd_FordVehLaneKeepSysRampTypPrev" 0 DISPLAY_IDENTIFIER FordMsg3CABusHiSpd.PerInstanceMemories.FordVehLaneKeepSysRampTypPrev /end MEASUREMENT
/begin MEASUREMENT FordMsg3CABusHiSpd.FordVehLaneKeepSysReqdAg.Val "MICROSAR RTE" FLOAT32_IEEE NO_COMPU_METHOD 0 0 -3.402823466e+38 3.402823466e+38 ECU_ADDRESS 0 SYMBOL_LINK "Rte_FordMsg3CABusHiSpd_FordVehLaneKeepSysReqdAg_Val" 0 DISPLAY_IDENTIFIER FordMsg3CABusHiSpd.SenderPorts.FordVehLaneKeepSysReqdAg.Val /end MEASUREMENT
/begin MEASUREMENT FordMsg3CABusHiSpd.FordVehLaneKeepSysReqdAgInvldPassdRefTi "Timer for invalid message will increment or reset based on the conditions" ULONG NO_COMPU_METHOD 0 0 0 4294967295 ECU_ADDRESS 0 SYMBOL_LINK "Rte_FordMsg3CABusHiSpd_FordVehLaneKeepSysReqdAgInvldPassdRefTi" 0 DISPLAY_IDENTIFIER FordMsg3CABusHiSpd.PerInstanceMemories.FordVehLaneKeepSysReqdAgInvldPassdRefTi /end MEASUREMENT
/begin MEASUREMENT FordMsg3CABusHiSpd.FordVehLaneKeepSysReqdAgPrev "Holds previous value of FordVehLaneKeepSysReqdAg when FOrdMsg3CA message is missing" FLOAT32_IEEE NO_COMPU_METHOD 0 0 -3.402823466e+38 3.402823466e+38 ECU_ADDRESS 0 SYMBOL_LINK "Rte_FordMsg3CABusHiSpd_FordVehLaneKeepSysReqdAgPrev" 0 DISPLAY_IDENTIFIER FordMsg3CABusHiSpd.PerInstanceMemories.FordVehLaneKeepSysReqdAgPrev /end MEASUREMENT
/begin MEASUREMENT FordMsg3CABusHiSpd.FordVehLaneKeepSysReqdAgRaw.Val "MICROSAR RTE" UWORD NO_COMPU_METHOD 0 0 0 65535 ECU_ADDRESS 0 SYMBOL_LINK "Rte_FordMsg3CABusHiSpd_FordVehLaneKeepSysReqdAgRaw_Val" 0 DISPLAY_IDENTIFIER FordMsg3CABusHiSpd.SenderPorts.FordVehLaneKeepSysReqdAgRaw.Val /end MEASUREMENT
/begin MEASUREMENT FordMsg3CABusHiSpd.FordVehLaneKeepSysReqdAgRawPrev "Holds previous value of FordVehLaneKeepSysReqdAgRaw when FOrdMsg3CA message is missing" UWORD NO_COMPU_METHOD 0 0 0 65535 ECU_ADDRESS 0 SYMBOL_LINK "Rte_FordMsg3CABusHiSpd_FordVehLaneKeepSysReqdAgRawPrev" 0 DISPLAY_IDENTIFIER FordMsg3CABusHiSpd.PerInstanceMemories.FordVehLaneKeepSysReqdAgRawPrev /end MEASUREMENT
/begin MEASUREMENT FordMsg3CABusHiSpd.FordVehLaneKeepSysSts.Val "MICROSAR RTE" UBYTE NO_COMPU_METHOD 0 0 0 255 ECU_ADDRESS 0 SYMBOL_LINK "Rte_FordMsg3CABusHiSpd_FordVehLaneKeepSysSts_Val" 0 DISPLAY_IDENTIFIER FordMsg3CABusHiSpd.SenderPorts.FordVehLaneKeepSysSts.Val /end MEASUREMENT
/begin MEASUREMENT FordMsg3CABusHiSpd.FordVehLaneKeepSysStsPrev "Holds previous value of FordVehLaneKeepSysSts when FOrdMsg3CA message is missing" UBYTE NO_COMPU_METHOD 0 0 0 255 ECU_ADDRESS 0 SYMBOL_LINK "Rte_FordMsg3CABusHiSpd_FordVehLaneKeepSysStsPrev" 0 DISPLAY_IDENTIFIER FordMsg3CABusHiSpd.PerInstanceMemories.FordVehLaneKeepSysStsPrev /end MEASUREMENT
/begin MEASUREMENT FordMsg3CABusHiSpd.FordVehMsg3CAMiss "Flag for missing message diagnostics, it is true when message is missing" UBYTE RTE_CM_BOOLEAN 0 0 0 255 ECU_ADDRESS 0 SYMBOL_LINK "Rte_FordMsg3CABusHiSpd_FordVehMsg3CAMiss" 0 DISPLAY_IDENTIFIER FordMsg3CABusHiSpd.PerInstanceMemories.FordVehMsg3CAMiss /end MEASUREMENT
/begin MEASUREMENT FordMsg3CABusHiSpd.LaneAssiImgProcgModlAFaildCrvtTiThd "Timer to update Ford Vehicle Lane Assist Image Processing Module A Valid signal as true or false based on calibration" ULONG NO_COMPU_METHOD 0 0 0 4294967295 ECU_ADDRESS 0 SYMBOL_LINK "Rte_FordMsg3CABusHiSpd_LaneAssiImgProcgModlAFaildCrvtTiThd" 0 DISPLAY_IDENTIFIER FordMsg3CABusHiSpd.PerInstanceMemories.LaneAssiImgProcgModlAFaildCrvtTiThd /end MEASUREMENT
/begin MEASUREMENT FordMsg3CABusHiSpd.LaneAssiImgProcgModlAFaildReqdAgTiThd "Timer to update Ford Vehicle Lane Assist Image Processing Module A Valid signal as true or false based on calibration" ULONG NO_COMPU_METHOD 0 0 0 4294967295 ECU_ADDRESS 0 SYMBOL_LINK "Rte_FordMsg3CABusHiSpd_LaneAssiImgProcgModlAFaildReqdAgTiThd" 0 DISPLAY_IDENTIFIER FordMsg3CABusHiSpd.PerInstanceMemories.LaneAssiImgProcgModlAFaildReqdAgTiThd /end MEASUREMENT
/begin MEASUREMENT FordMsg3CABusHiSpd.LaneAssiImgProcgModlAVldMissRefTi "Timer for valid message will increment or reset based on the conditions" ULONG NO_COMPU_METHOD 0 0 0 4294967295 ECU_ADDRESS 0 SYMBOL_LINK "Rte_FordMsg3CABusHiSpd_LaneAssiImgProcgModlAVldMissRefTi" 0 DISPLAY_IDENTIFIER FordMsg3CABusHiSpd.PerInstanceMemories.LaneAssiImgProcgModlAVldMissRefTi /end MEASUREMENT
/begin MEASUREMENT FordMsg3CABusHiSpd.LaneAssiImgProcgModlAVldPassdRefTi "Timer for valid message will increment or reset based on the conditions" ULONG NO_COMPU_METHOD 0 0 0 4294967295 ECU_ADDRESS 0 SYMBOL_LINK "Rte_FordMsg3CABusHiSpd_LaneAssiImgProcgModlAVldPassdRefTi" 0 DISPLAY_IDENTIFIER FordMsg3CABusHiSpd.PerInstanceMemories.LaneAssiImgProcgModlAVldPassdRefTi /end MEASUREMENT
/begin MEASUREMENT FordMsg3CABusHiSpd.LaneKeepSysReqdAgInvldFaildRefTi "Timer for invalid message will increment or reset based on the conditions" ULONG NO_COMPU_METHOD 0 0 0 4294967295 ECU_ADDRESS 0 SYMBOL_LINK "Rte_FordMsg3CABusHiSpd_LaneKeepSysReqdAgInvldFaildRefTi" 0 DISPLAY_IDENTIFIER FordMsg3CABusHiSpd.PerInstanceMemories.LaneKeepSysReqdAgInvldFaildRefTi /end MEASUREMENT
/begin MEASUREMENT FordMsg3CABusHiSpd.MissMsgFaildRefTi "Timer for missing message will increment or reset based on the conditions" ULONG NO_COMPU_METHOD 0 0 0 4294967295 ECU_ADDRESS 0 SYMBOL_LINK "Rte_FordMsg3CABusHiSpd_MissMsgFaildRefTi" 0 DISPLAY_IDENTIFIER FordMsg3CABusHiSpd.PerInstanceMemories.MissMsgFaildRefTi /end MEASUREMENT
/begin MEASUREMENT FordMsg3CABusHiSpd.MissMsgPassdRefTi "Timer for missing message will increment or reset based on the conditions" ULONG NO_COMPU_METHOD 0 0 0 4294967295 ECU_ADDRESS 0 SYMBOL_LINK "Rte_FordMsg3CABusHiSpd_MissMsgPassdRefTi" 0 DISPLAY_IDENTIFIER FordMsg3CABusHiSpd.PerInstanceMemories.MissMsgPassdRefTi /end MEASUREMENT
/begin MEASUREMENT FordMsg3CCBusHiSpd.FordVehLaneAssiAvl.Val "MICROSAR RTE" UBYTE NO_COMPU_METHOD 0 0 0 255 ECU_ADDRESS 0 SYMBOL_LINK "Rte_CDD_FordBlaBoxIfCmp1_FordVehLaneAssiAvl_Val" 0 DISPLAY_IDENTIFIER FordMsg3CCBusHiSpd.ReceiverPorts.FordVehLaneAssiAvl.Val /end MEASUREMENT
/begin MEASUREMENT FordMsg3CCBusHiSpd.FordVehLaneAssiHandsOff.Val "MICROSAR RTE" UBYTE NO_COMPU_METHOD 0 0 0 255 ECU_ADDRESS 0 SYMBOL_LINK "Rte_CDD_FordBlaBoxIfCmp1_FordVehLaneAssiHandsOff_Val" 0 DISPLAY_IDENTIFIER FordMsg3CCBusHiSpd.ReceiverPorts.FordVehLaneAssiHandsOff.Val /end MEASUREMENT
/begin MEASUREMENT FordMsg3CCBusHiSpd.FordVehLaneAssiRejctn.Val "MICROSAR RTE" UBYTE NO_COMPU_METHOD 0 0 0 255 ECU_ADDRESS 0 SYMBOL_LINK "Rte_CDD_FordBlaBoxIfCmp1_FordVehLaneAssiRejctn_Val" 0 DISPLAY_IDENTIFIER FordMsg3CCBusHiSpd.ReceiverPorts.FordVehLaneAssiRejctn.Val /end MEASUREMENT
/begin MEASUREMENT FordMsg3CCBusHiSpd.FordVehLoSpdMtnCtrlBrkDecelEna.Val "MICROSAR RTE" UBYTE NO_COMPU_METHOD 0 0 0 255 ECU_ADDRESS 0 SYMBOL_LINK "Rte_CDD_FordBlaBoxIfCmp1_FordVehLoSpdMtnCtrlBrkDecelEnaReq_Val" 0 DISPLAY_IDENTIFIER FordMsg3CCBusHiSpd.ReceiverPorts.FordVehLoSpdMtnCtrlBrkDecelEna.Val /end MEASUREMENT
/begin MEASUREMENT FordMsg3CCBusHiSpd.FordVehLoSpdMtnCtrlBrkTqReq.Val "MICROSAR RTE" FLOAT32_IEEE NO_COMPU_METHOD 0 0 -3.402823466e+38 3.402823466e+38 ECU_ADDRESS 0 SYMBOL_LINK "Rte_FordMsg3CCBusHiSpd_FordVehLoSpdMtnCtrlBrkTqReq_Val" 0 DISPLAY_IDENTIFIER FordMsg3CCBusHiSpd.ReceiverPorts.FordVehLoSpdMtnCtrlBrkTqReq.Val /end MEASUREMENT
/begin MEASUREMENT FordMsg3CCBusHiSpd.FordVehTrfcJamAvdHandsOnConf.Val "MICROSAR RTE" UBYTE NO_COMPU_METHOD 0 0 0 255 ECU_ADDRESS 0 SYMBOL_LINK "Rte_CDD_FordBlaBoxIfCmp1_FordVehTrfcJamAvdHandsOnConf_Val" 0 DISPLAY_IDENTIFIER FordMsg3CCBusHiSpd.ReceiverPorts.FordVehTrfcJamAvdHandsOnConf.Val /end MEASUREMENT
/begin MEASUREMENT FordMsg3CCBusHiSpd.FordVehTrlrAgTarCalcn.Val "MICROSAR RTE" UBYTE NO_COMPU_METHOD 0 0 0 255 ECU_ADDRESS 0 SYMBOL_LINK "Rte_CDD_FordBlaBoxIfCmp1_FordVehTrlrAgTarCalcn_Val" 0 DISPLAY_IDENTIFIER FordMsg3CCBusHiSpd.ReceiverPorts.FordVehTrlrAgTarCalcn.Val /end MEASUREMENT
/begin MEASUREMENT FordMsg3D3BusHiSpd.ClrDiagcFlgProxy.Val "MICROSAR RTE" UBYTE NO_COMPU_METHOD 0 0 0 255 ECU_ADDRESS 0 SYMBOL_LINK "Rte_DiagcMgr_ClrDiagcFlgProxy_Val" 0 DISPLAY_IDENTIFIER FordMsg3D3BusHiSpd.ReceiverPorts.ClrDiagcFlgProxy.Val /end MEASUREMENT
/begin MEASUREMENT FordMsg3D3BusHiSpd.ClrDiagcFlgProxyPrev "Clear Diagc Flag Proxy" UBYTE NO_COMPU_METHOD 0 0 0 255 ECU_ADDRESS 0 SYMBOL_LINK "Rte_FordMsg3D3BusHiSpd_ClrDiagcFlgProxyPrev" 0 DISPLAY_IDENTIFIER FordMsg3D3BusHiSpd.PerInstanceMemories.ClrDiagcFlgProxyPrev /end MEASUREMENT
/begin MEASUREMENT FordMsg3D3BusHiSpd.FirstTranVldFlg "This flag is used to indicate the reception of first message\r\n" UBYTE RTE_CM_BOOLEAN 0 0 0 255 ECU_ADDRESS 0 SYMBOL_LINK "Rte_FordMsg3D3BusHiSpd_FirstTranVldFlg" 0 DISPLAY_IDENTIFIER FordMsg3D3BusHiSpd.PerInstanceMemories.FirstTranVldFlg /end MEASUREMENT
/begin MEASUREMENT FordMsg3D3BusHiSpd.FordCanDtcInhb.Logl "MICROSAR RTE" UBYTE RTE_CM_BOOLEAN 0 0 0 255 ECU_ADDRESS 0 SYMBOL_LINK "Rte_FordCanDtcInhb_FordCanDtcInhb_Logl" 0 DISPLAY_IDENTIFIER FordMsg3D3BusHiSpd.ReceiverPorts.FordCanDtcInhb.Logl /end MEASUREMENT
/begin MEASUREMENT FordMsg3D3BusHiSpd.FordEpsLifeCycMod.Val "MICROSAR RTE" UBYTE NO_COMPU_METHOD 0 0 0 255 ECU_ADDRESS 0 SYMBOL_LINK "Rte_FordCanDtcInhb_FordEpsLifeCycMod_Val" 0 DISPLAY_IDENTIFIER FordMsg3D3BusHiSpd.ReceiverPorts.FordEpsLifeCycMod.Val /end MEASUREMENT
/begin MEASUREMENT FordMsg3D3BusHiSpd.FordLaneCentrAssiEnad.Logl "MICROSAR RTE" UBYTE RTE_CM_BOOLEAN 0 0 0 255 ECU_ADDRESS 0 SYMBOL_LINK "Rte_CustDiag_FordLaneCentrAssiEnad_Logl" 0 DISPLAY_IDENTIFIER FordMsg3D3BusHiSpd.ReceiverPorts.FordLaneCentrAssiEnad.Logl /end MEASUREMENT
/begin MEASUREMENT FordMsg3D3BusHiSpd.FordTrfcJamAssiEnad.Logl "MICROSAR RTE" UBYTE RTE_CM_BOOLEAN 0 0 0 255 ECU_ADDRESS 0 SYMBOL_LINK "Rte_CustDiag_FordTrfcJamAssiEnad_Logl" 0 DISPLAY_IDENTIFIER FordMsg3D3BusHiSpd.ReceiverPorts.FordTrfcJamAssiEnad.Logl /end MEASUREMENT
/begin MEASUREMENT FordMsg3D3BusHiSpd.FordVehLatCtrlCrvt.Val "MICROSAR RTE" FLOAT32_IEEE NO_COMPU_METHOD 0 0 -3.402823466e+38 3.402823466e+38 ECU_ADDRESS 0 SYMBOL_LINK "Rte_FordMsg3D3BusHiSpd_FordVehLatCtrlCrvt_Val" 0 DISPLAY_IDENTIFIER FordMsg3D3BusHiSpd.SenderPorts.FordVehLatCtrlCrvt.Val /end MEASUREMENT
/begin MEASUREMENT FordMsg3D3BusHiSpd.FordVehLatCtrlCrvtPrev "It is used to hold the previous value of FordVehLatCtrlCrvt" FLOAT32_IEEE NO_COMPU_METHOD 0 0 -3.402823466e+38 3.402823466e+38 ECU_ADDRESS 0 SYMBOL_LINK "Rte_FordMsg3D3BusHiSpd_FordVehLatCtrlCrvtPrev" 0 DISPLAY_IDENTIFIER FordMsg3D3BusHiSpd.PerInstanceMemories.FordVehLatCtrlCrvtPrev /end MEASUREMENT
/begin MEASUREMENT FordMsg3D3BusHiSpd.FordVehLatCtrlCrvtRate.Val "MICROSAR RTE" FLOAT32_IEEE NO_COMPU_METHOD 0 0 -3.402823466e+38 3.402823466e+38 ECU_ADDRESS 0 SYMBOL_LINK "Rte_FordMsg3D3BusHiSpd_FordVehLatCtrlCrvtRate_Val" 0 DISPLAY_IDENTIFIER FordMsg3D3BusHiSpd.SenderPorts.FordVehLatCtrlCrvtRate.Val /end MEASUREMENT
/begin MEASUREMENT FordMsg3D3BusHiSpd.FordVehLatCtrlCrvtRatePrev "It is used to hold the previous value of FordVehLatCtrlCrvtRate" FLOAT32_IEEE NO_COMPU_METHOD 0 0 -3.402823466e+38 3.402823466e+38 ECU_ADDRESS 0 SYMBOL_LINK "Rte_FordMsg3D3BusHiSpd_FordVehLatCtrlCrvtRatePrev" 0 DISPLAY_IDENTIFIER FordMsg3D3BusHiSpd.PerInstanceMemories.FordVehLatCtrlCrvtRatePrev /end MEASUREMENT
/begin MEASUREMENT FordMsg3D3BusHiSpd.FordVehLatCtrlCrvtRateRaw.Val "MICROSAR RTE" UWORD NO_COMPU_METHOD 0 0 0 65535 ECU_ADDRESS 0 SYMBOL_LINK "Rte_FordMsg3D3BusHiSpd_FordVehLatCtrlCrvtRateRaw_Val" 0 DISPLAY_IDENTIFIER FordMsg3D3BusHiSpd.SenderPorts.FordVehLatCtrlCrvtRateRaw.Val /end MEASUREMENT
/begin MEASUREMENT FordMsg3D3BusHiSpd.FordVehLatCtrlCrvtRateRawPrev "It is used to hold the previous value of FordVehLatCtrlCrvtRateRaw" UWORD NO_COMPU_METHOD 0 0 0 65535 ECU_ADDRESS 0 SYMBOL_LINK "Rte_FordMsg3D3BusHiSpd_FordVehLatCtrlCrvtRateRawPrev" 0 DISPLAY_IDENTIFIER FordMsg3D3BusHiSpd.PerInstanceMemories.FordVehLatCtrlCrvtRateRawPrev /end MEASUREMENT
/begin MEASUREMENT FordMsg3D3BusHiSpd.FordVehLatCtrlCrvtRaw.Val "MICROSAR RTE" UWORD NO_COMPU_METHOD 0 0 0 65535 ECU_ADDRESS 0 SYMBOL_LINK "Rte_FordMsg3D3BusHiSpd_FordVehLatCtrlCrvtRaw_Val" 0 DISPLAY_IDENTIFIER FordMsg3D3BusHiSpd.SenderPorts.FordVehLatCtrlCrvtRaw.Val /end MEASUREMENT
/begin MEASUREMENT FordMsg3D3BusHiSpd.FordVehLatCtrlCrvtRawPrev "It is used to hold the previous value of FordVehLatCtrlCrvtRaw" UWORD NO_COMPU_METHOD 0 0 0 65535 ECU_ADDRESS 0 SYMBOL_LINK "Rte_FordMsg3D3BusHiSpd_FordVehLatCtrlCrvtRawPrev" 0 DISPLAY_IDENTIFIER FordMsg3D3BusHiSpd.PerInstanceMemories.FordVehLatCtrlCrvtRawPrev /end MEASUREMENT
/begin MEASUREMENT FordMsg3D3BusHiSpd.FordVehLatCtrlHandsOffDetnTqStimlsReq.Val "MICROSAR RTE" UBYTE NO_COMPU_METHOD 0 0 0 255 ECU_ADDRESS 0 SYMBOL_LINK "Rte_FordMsg3D3BusHiSpd_FordVehLatCtrlHandsOffDetnTqStimlsReq_Val" 0 DISPLAY_IDENTIFIER FordMsg3D3BusHiSpd.SenderPorts.FordVehLatCtrlHandsOffDetnTqStimlsReq.Val /end MEASUREMENT
/begin MEASUREMENT FordMsg3D3BusHiSpd.FordVehLatCtrlHandsOffDetnTqStimlsReqPrev "It is used to hold the previous value of FordVehLatCtrlHandsOffDetnTqStmlsReq" UBYTE RTE_CM_BOOLEAN 0 0 0 255 ECU_ADDRESS 0 SYMBOL_LINK "Rte_FordMsg3D3BusHiSpd_FordVehLatCtrlHandsOffDetnTqStimlsReqPrev" 0 DISPLAY_IDENTIFIER FordMsg3D3BusHiSpd.PerInstanceMemories.FordVehLatCtrlHandsOffDetnTqStimlsReqPrev /end MEASUREMENT
/begin MEASUREMENT FordMsg3D3BusHiSpd.FordVehLatCtrlImgProcrModlAVld.Logl "MICROSAR RTE" UBYTE RTE_CM_BOOLEAN 0 0 0 255 ECU_ADDRESS 0 SYMBOL_LINK "Rte_FordMsg3D3BusHiSpd_FordVehLatCtrlImgProcrModlAVld_Logl" 0 DISPLAY_IDENTIFIER FordMsg3D3BusHiSpd.SenderPorts.FordVehLatCtrlImgProcrModlAVld.Logl /end MEASUREMENT
/begin MEASUREMENT FordMsg3D3BusHiSpd.FordVehLatCtrlImgProcrModlAVldPrev "It is used to hold the previous value of FordVehLatCtrlImgProcrModlAVld" UBYTE RTE_CM_BOOLEAN 0 0 0 255 ECU_ADDRESS 0 SYMBOL_LINK "Rte_FordMsg3D3BusHiSpd_FordVehLatCtrlImgProcrModlAVldPrev" 0 DISPLAY_IDENTIFIER FordMsg3D3BusHiSpd.PerInstanceMemories.FordVehLatCtrlImgProcrModlAVldPrev /end MEASUREMENT
/begin MEASUREMENT FordMsg3D3BusHiSpd.FordVehLatCtrlPah.Val "MICROSAR RTE" FLOAT32_IEEE NO_COMPU_METHOD 0 0 -3.402823466e+38 3.402823466e+38 ECU_ADDRESS 0 SYMBOL_LINK "Rte_FordMsg3D3BusHiSpd_FordVehLatCtrlPah_Val" 0 DISPLAY_IDENTIFIER FordMsg3D3BusHiSpd.SenderPorts.FordVehLatCtrlPah.Val /end MEASUREMENT
/begin MEASUREMENT FordMsg3D3BusHiSpd.FordVehLatCtrlPahOffs.Val "MICROSAR RTE" FLOAT32_IEEE NO_COMPU_METHOD 0 0 -3.402823466e+38 3.402823466e+38 ECU_ADDRESS 0 SYMBOL_LINK "Rte_FordMsg3D3BusHiSpd_FordVehLatCtrlPahOffs_Val" 0 DISPLAY_IDENTIFIER FordMsg3D3BusHiSpd.SenderPorts.FordVehLatCtrlPahOffs.Val /end MEASUREMENT
/begin MEASUREMENT FordMsg3D3BusHiSpd.FordVehLatCtrlPahOffsPrev "It is used to hold the previous value of FordVehLatCtrlPahOffs" FLOAT32_IEEE NO_COMPU_METHOD 0 0 -3.402823466e+38 3.402823466e+38 ECU_ADDRESS 0 SYMBOL_LINK "Rte_FordMsg3D3BusHiSpd_FordVehLatCtrlPahOffsPrev" 0 DISPLAY_IDENTIFIER FordMsg3D3BusHiSpd.PerInstanceMemories.FordVehLatCtrlPahOffsPrev /end MEASUREMENT
/begin MEASUREMENT FordMsg3D3BusHiSpd.FordVehLatCtrlPahOffsRaw.Val "MICROSAR RTE" UWORD NO_COMPU_METHOD 0 0 0 65535 ECU_ADDRESS 0 SYMBOL_LINK "Rte_FordMsg3D3BusHiSpd_FordVehLatCtrlPahOffsRaw_Val" 0 DISPLAY_IDENTIFIER FordMsg3D3BusHiSpd.SenderPorts.FordVehLatCtrlPahOffsRaw.Val /end MEASUREMENT
/begin MEASUREMENT FordMsg3D3BusHiSpd.FordVehLatCtrlPahOffsRawPrev "It is used to hold the previous value of FordVehLatCtrlPahOffsRaw" UWORD NO_COMPU_METHOD 0 0 0 65535 ECU_ADDRESS 0 SYMBOL_LINK "Rte_FordMsg3D3BusHiSpd_FordVehLatCtrlPahOffsRawPrev" 0 DISPLAY_IDENTIFIER FordMsg3D3BusHiSpd.PerInstanceMemories.FordVehLatCtrlPahOffsRawPrev /end MEASUREMENT
/begin MEASUREMENT FordMsg3D3BusHiSpd.FordVehLatCtrlPahPrev "It is used to hold the previous value of FordVehLatCtrlPah" FLOAT32_IEEE NO_COMPU_METHOD 0 0 -3.402823466e+38 3.402823466e+38 ECU_ADDRESS 0 SYMBOL_LINK "Rte_FordMsg3D3BusHiSpd_FordVehLatCtrlPahPrev" 0 DISPLAY_IDENTIFIER FordMsg3D3BusHiSpd.PerInstanceMemories.FordVehLatCtrlPahPrev /end MEASUREMENT
/begin MEASUREMENT FordMsg3D3BusHiSpd.FordVehLatCtrlPahRaw.Val "MICROSAR RTE" UWORD NO_COMPU_METHOD 0 0 0 65535 ECU_ADDRESS 0 SYMBOL_LINK "Rte_FordMsg3D3BusHiSpd_FordVehLatCtrlPahRaw_Val" 0 DISPLAY_IDENTIFIER FordMsg3D3BusHiSpd.SenderPorts.FordVehLatCtrlPahRaw.Val /end MEASUREMENT
/begin MEASUREMENT FordMsg3D3BusHiSpd.FordVehLatCtrlPahRawPrev "It is used to hold the previous value of FordVehLatCtrlPahRaw" UWORD NO_COMPU_METHOD 0 0 0 65535 ECU_ADDRESS 0 SYMBOL_LINK "Rte_FordMsg3D3BusHiSpd_FordVehLatCtrlPahRawPrev" 0 DISPLAY_IDENTIFIER FordMsg3D3BusHiSpd.PerInstanceMemories.FordVehLatCtrlPahRawPrev /end MEASUREMENT
/begin MEASUREMENT FordMsg3D3BusHiSpd.FordVehLatCtrlPrcsn.Val "MICROSAR RTE" UBYTE NO_COMPU_METHOD 0 0 0 255 ECU_ADDRESS 0 SYMBOL_LINK "Rte_FordMsg3D3BusHiSpd_FordVehLatCtrlPrcsn_Val" 0 DISPLAY_IDENTIFIER FordMsg3D3BusHiSpd.SenderPorts.FordVehLatCtrlPrcsn.Val /end MEASUREMENT
/begin MEASUREMENT FordMsg3D3BusHiSpd.FordVehLatCtrlPrcsnPrev "It is used to hold the previous value of FordVehLatCtrlPrcsn" UBYTE RTE_CM_ENUM_Ford_LatCtlPrecision_D_Rq 0 0 0 3 ECU_ADDRESS 0 SYMBOL_LINK "Rte_FordMsg3D3BusHiSpd_FordVehLatCtrlPrcsnPrev" 0 DISPLAY_IDENTIFIER FordMsg3D3BusHiSpd.PerInstanceMemories.FordVehLatCtrlPrcsnPrev /end MEASUREMENT
/begin MEASUREMENT FordMsg3D3BusHiSpd.FordVehLatCtrlRampTyp.Val "MICROSAR RTE" UBYTE NO_COMPU_METHOD 0 0 0 255 ECU_ADDRESS 0 SYMBOL_LINK "Rte_FordMsg3D3BusHiSpd_FordVehLatCtrlRampTyp_Val" 0 DISPLAY_IDENTIFIER FordMsg3D3BusHiSpd.SenderPorts.FordVehLatCtrlRampTyp.Val /end MEASUREMENT
/begin MEASUREMENT FordMsg3D3BusHiSpd.FordVehLatCtrlRampTypPrev "It is used to hold the previous value of FordVehLatCtrlRampTyp" UBYTE RTE_CM_ENUM_Ford_LatCtlRampType_D_Rq 0 0 0 3 ECU_ADDRESS 0 SYMBOL_LINK "Rte_FordMsg3D3BusHiSpd_FordVehLatCtrlRampTypPrev" 0 DISPLAY_IDENTIFIER FordMsg3D3BusHiSpd.PerInstanceMemories.FordVehLatCtrlRampTypPrev /end MEASUREMENT
/begin MEASUREMENT FordMsg3D3BusHiSpd.FordVehLatCtrlReq.Val "MICROSAR RTE" UBYTE NO_COMPU_METHOD 0 0 0 255 ECU_ADDRESS 0 SYMBOL_LINK "Rte_FordMsg3D3BusHiSpd_FordVehLatCtrlReq_Val" 0 DISPLAY_IDENTIFIER FordMsg3D3BusHiSpd.SenderPorts.FordVehLatCtrlReq.Val /end MEASUREMENT
/begin MEASUREMENT FordMsg3D3BusHiSpd.FordVehLatCtrlReqPrev "It is used to hold the previous value of FordVehLatCtrlReq" UBYTE RTE_CM_ENUM_Ford_LatCtl_D_Rq 0 0 0 7 ECU_ADDRESS 0 SYMBOL_LINK "Rte_FordMsg3D3BusHiSpd_FordVehLatCtrlReqPrev" 0 DISPLAY_IDENTIFIER FordMsg3D3BusHiSpd.PerInstanceMemories.FordVehLatCtrlReqPrev /end MEASUREMENT
/begin MEASUREMENT FordMsg3D3BusHiSpd.FordVehLatCtrlRingMax.Val "MICROSAR RTE" UBYTE NO_COMPU_METHOD 0 0 0 255 ECU_ADDRESS 0 SYMBOL_LINK "Rte_FordMsg3D3BusHiSpd_FordVehLatCtrlRingMax_Val" 0 DISPLAY_IDENTIFIER FordMsg3D3BusHiSpd.SenderPorts.FordVehLatCtrlRingMax.Val /end MEASUREMENT
/begin MEASUREMENT FordMsg3D3BusHiSpd.FordVehLatCtrlRingMaxPrev "It is used to hold the previous value of FordVehLatCtrlRingMax" UBYTE NO_COMPU_METHOD 0 0 0 255 ECU_ADDRESS 0 SYMBOL_LINK "Rte_FordMsg3D3BusHiSpd_FordVehLatCtrlRingMaxPrev" 0 DISPLAY_IDENTIFIER FordMsg3D3BusHiSpd.PerInstanceMemories.FordVehLatCtrlRingMaxPrev /end MEASUREMENT
/begin MEASUREMENT FordMsg3D3BusHiSpd.FordVehMsg3D3Miss "Used to hold value of Ford Vehicle message 3D3 miss" UBYTE RTE_CM_BOOLEAN 0 0 0 255 ECU_ADDRESS 0 SYMBOL_LINK "Rte_FordMsg3D3BusHiSpd_FordVehMsg3D3Miss" 0 DISPLAY_IDENTIFIER FordMsg3D3BusHiSpd.PerInstanceMemories.FordVehMsg3D3Miss /end MEASUREMENT
/begin MEASUREMENT FordMsg3D3BusHiSpd.ImgProcrModlAVldFaildRefTi "Timer for Valid Failed Reference Time will increment or reset based on the conditions" ULONG NO_COMPU_METHOD 0 0 0 4294967295 ECU_ADDRESS 0 SYMBOL_LINK "Rte_FordMsg3D3BusHiSpd_ImgProcrModlAVldFaildRefTi" 0 DISPLAY_IDENTIFIER FordMsg3D3BusHiSpd.PerInstanceMemories.ImgProcrModlAVldFaildRefTi /end MEASUREMENT
/begin MEASUREMENT FordMsg3D3BusHiSpd.ImgProcrModlAVldPassdRefTi "Timer for Valid Passed Reference Time will increment or reset based on  the conditions" ULONG NO_COMPU_METHOD 0 0 0 4294967295 ECU_ADDRESS 0 SYMBOL_LINK "Rte_FordMsg3D3BusHiSpd_ImgProcrModlAVldPassdRefTi" 0 DISPLAY_IDENTIFIER FordMsg3D3BusHiSpd.PerInstanceMemories.ImgProcrModlAVldPassdRefTi /end MEASUREMENT
/begin MEASUREMENT FordMsg3D3BusHiSpd.MissMsgFaildRefTi "Timer for misisng message will increment or reset based on the conditi'ons'" ULONG NO_COMPU_METHOD 0 0 0 4294967295 ECU_ADDRESS 0 SYMBOL_LINK "Rte_FordMsg3D3BusHiSpd_MissMsgFaildRefTi" 0 DISPLAY_IDENTIFIER FordMsg3D3BusHiSpd.PerInstanceMemories.MissMsgFaildRefTi /end MEASUREMENT
/begin MEASUREMENT FordMsg3D3BusHiSpd.MissMsgPassdRefTi "Timer for misisng message will increment or reset based on the conditions" ULONG NO_COMPU_METHOD 0 0 0 4294967295 ECU_ADDRESS 0 SYMBOL_LINK "Rte_FordMsg3D3BusHiSpd_MissMsgPassdRefTi" 0 DISPLAY_IDENTIFIER FordMsg3D3BusHiSpd.PerInstanceMemories.MissMsgPassdRefTi /end MEASUREMENT
/begin MEASUREMENT FordMsg3D7BusHiSpd.ClrDiagcFlgProxy.Val "MICROSAR RTE" UBYTE NO_COMPU_METHOD 0 0 0 255 ECU_ADDRESS 0 SYMBOL_LINK "Rte_DiagcMgr_ClrDiagcFlgProxy_Val" 0 DISPLAY_IDENTIFIER FordMsg3D7BusHiSpd.ReceiverPorts.ClrDiagcFlgProxy.Val /end MEASUREMENT
/begin MEASUREMENT FordMsg3D7BusHiSpd.ClrDiagcFlgProxyPrev "MICROSAR RTE" UBYTE NO_COMPU_METHOD 0 0 0 255 ECU_ADDRESS 0 SYMBOL_LINK "Rte_FordMsg3D7BusHiSpd_ClrDiagcFlgProxyPrev" 0 DISPLAY_IDENTIFIER FordMsg3D7BusHiSpd.PerInstanceMemories.ClrDiagcFlgProxyPrev /end MEASUREMENT
/begin MEASUREMENT FordMsg3D7BusHiSpd.EvasSteerAssiImgProcrModlAVldPassdRefTi "MICROSAR RTE" ULONG NO_COMPU_METHOD 0 0 0 4294967295 ECU_ADDRESS 0 SYMBOL_LINK "Rte_FordMsg3D7BusHiSpd_EvasSteerAssiImgProcrModlAVldPassdRefTi" 0 DISPLAY_IDENTIFIER FordMsg3D7BusHiSpd.PerInstanceMemories.EvasSteerAssiImgProcrModlAVldPassdRefTi /end MEASUREMENT
/begin MEASUREMENT FordMsg3D7BusHiSpd.FirstTranVldFlg "MICROSAR RTE" UBYTE RTE_CM_BOOLEAN 0 0 0 255 ECU_ADDRESS 0 SYMBOL_LINK "Rte_FordMsg3D7BusHiSpd_FirstTranVldFlg" 0 DISPLAY_IDENTIFIER FordMsg3D7BusHiSpd.PerInstanceMemories.FirstTranVldFlg /end MEASUREMENT
/begin MEASUREMENT FordMsg3D7BusHiSpd.FordCanDtcInhb.Logl "MICROSAR RTE" UBYTE RTE_CM_BOOLEAN 0 0 0 255 ECU_ADDRESS 0 SYMBOL_LINK "Rte_FordCanDtcInhb_FordCanDtcInhb_Logl" 0 DISPLAY_IDENTIFIER FordMsg3D7BusHiSpd.ReceiverPorts.FordCanDtcInhb.Logl /end MEASUREMENT
/begin MEASUREMENT FordMsg3D7BusHiSpd.FordEpsLifeCycMod.Val "MICROSAR RTE" UBYTE NO_COMPU_METHOD 0 0 0 255 ECU_ADDRESS 0 SYMBOL_LINK "Rte_FordCanDtcInhb_FordEpsLifeCycMod_Val" 0 DISPLAY_IDENTIFIER FordMsg3D7BusHiSpd.ReceiverPorts.FordEpsLifeCycMod.Val /end MEASUREMENT
/begin MEASUREMENT FordMsg3D7BusHiSpd.FordEvasSteerAssiEnad.Logl "MICROSAR RTE" UBYTE RTE_CM_BOOLEAN 0 0 0 255 ECU_ADDRESS 0 SYMBOL_LINK "Rte_CustDiag_FordEvasSteerAssiEnad_Logl" 0 DISPLAY_IDENTIFIER FordMsg3D7BusHiSpd.ReceiverPorts.FordEvasSteerAssiEnad.Logl /end MEASUREMENT
/begin MEASUREMENT FordMsg3D7BusHiSpd.FordVehCllsnMtgtnByBrkgLatDstInvldFaildRefTi "MICROSAR RTE" ULONG NO_COMPU_METHOD 0 0 0 4294967295 ECU_ADDRESS 0 SYMBOL_LINK "Rte_FordMsg3D7BusHiSpd_FordVehCllsnMtgtnByBrkgLatDstInvldFaildRefTi" 0 DISPLAY_IDENTIFIER FordMsg3D7BusHiSpd.PerInstanceMemories.FordVehCllsnMtgtnByBrkgLatDstInvldFaildRefTi /end MEASUREMENT
/begin MEASUREMENT FordMsg3D7BusHiSpd.FordVehCllsnMtgtnByBrkgLatDstInvldPassdRefTi "MICROSAR RTE" ULONG NO_COMPU_METHOD 0 0 0 4294967295 ECU_ADDRESS 0 SYMBOL_LINK "Rte_FordMsg3D7BusHiSpd_FordVehCllsnMtgtnByBrkgLatDstInvldPassdRefTi" 0 DISPLAY_IDENTIFIER FordMsg3D7BusHiSpd.PerInstanceMemories.FordVehCllsnMtgtnByBrkgLatDstInvldPassdRefTi /end MEASUREMENT
/begin MEASUREMENT FordMsg3D7BusHiSpd.FordVehCllsnMtgtnByBrkgLatDstRaw.Val "MICROSAR RTE" UWORD NO_COMPU_METHOD 0 0 0 65535 ECU_ADDRESS 0 SYMBOL_LINK "Rte_FordMsg3D7BusHiSpd_FordVehCllsnMtgtnByBrkgLatDstRaw_Val" 0 DISPLAY_IDENTIFIER FordMsg3D7BusHiSpd.SenderPorts.FordVehCllsnMtgtnByBrkgLatDstRaw.Val /end MEASUREMENT
/begin MEASUREMENT FordMsg3D7BusHiSpd.FordVehCllsnMtgtnByBrkgLatDstRawPrev "MICROSAR RTE" UWORD NO_COMPU_METHOD 0 0 0 65535 ECU_ADDRESS 0 SYMBOL_LINK "Rte_FordMsg3D7BusHiSpd_FordVehCllsnMtgtnByBrkgLatDstRawPrev" 0 DISPLAY_IDENTIFIER FordMsg3D7BusHiSpd.PerInstanceMemories.FordVehCllsnMtgtnByBrkgLatDstRawPrev /end MEASUREMENT
/begin MEASUREMENT FordMsg3D7BusHiSpd.FordVehCllsnMtgtnByBrkgLgtDstInvldFaildRefTi "MICROSAR RTE" ULONG NO_COMPU_METHOD 0 0 0 4294967295 ECU_ADDRESS 0 SYMBOL_LINK "Rte_FordMsg3D7BusHiSpd_FordVehCllsnMtgtnByBrkgLgtDstInvldFaildRefTi" 0 DISPLAY_IDENTIFIER FordMsg3D7BusHiSpd.PerInstanceMemories.FordVehCllsnMtgtnByBrkgLgtDstInvldFaildRefTi /end MEASUREMENT
/begin MEASUREMENT FordMsg3D7BusHiSpd.FordVehCllsnMtgtnByBrkgLgtDstInvldPassdRefTi "MICROSAR RTE" ULONG NO_COMPU_METHOD 0 0 0 4294967295 ECU_ADDRESS 0 SYMBOL_LINK "Rte_FordMsg3D7BusHiSpd_FordVehCllsnMtgtnByBrkgLgtDstInvldPassdRefTi" 0 DISPLAY_IDENTIFIER FordMsg3D7BusHiSpd.PerInstanceMemories.FordVehCllsnMtgtnByBrkgLgtDstInvldPassdRefTi /end MEASUREMENT
/begin MEASUREMENT FordMsg3D7BusHiSpd.FordVehCllsnMtgtnByBrkgLgtDstRaw.Val "MICROSAR RTE" UWORD NO_COMPU_METHOD 0 0 0 65535 ECU_ADDRESS 0 SYMBOL_LINK "Rte_FordMsg3D7BusHiSpd_FordVehCllsnMtgtnByBrkgLgtDstRaw_Val" 0 DISPLAY_IDENTIFIER FordMsg3D7BusHiSpd.SenderPorts.FordVehCllsnMtgtnByBrkgLgtDstRaw.Val /end MEASUREMENT
/begin MEASUREMENT FordMsg3D7BusHiSpd.FordVehCllsnMtgtnByBrkgLgtDstRawPrev "MICROSAR RTE" UWORD NO_COMPU_METHOD 0 0 0 65535 ECU_ADDRESS 0 SYMBOL_LINK "Rte_FordMsg3D7BusHiSpd_FordVehCllsnMtgtnByBrkgLgtDstRawPrev" 0 DISPLAY_IDENTIFIER FordMsg3D7BusHiSpd.PerInstanceMemories.FordVehCllsnMtgtnByBrkgLgtDstRawPrev /end MEASUREMENT
/begin MEASUREMENT FordMsg3D7BusHiSpd.FordVehCllsnMtgtnByBrkgObjDataConfLvlRaw.Val "MICROSAR RTE" UBYTE NO_COMPU_METHOD 0 0 0 255 ECU_ADDRESS 0 SYMBOL_LINK "Rte_FordMsg3D7BusHiSpd_FordVehCllsnMtgtnByBrkgObjDataConfLvlRaw_Val" 0 DISPLAY_IDENTIFIER FordMsg3D7BusHiSpd.SenderPorts.FordVehCllsnMtgtnByBrkgObjDataConfLvlRaw.Val /end MEASUREMENT
/begin MEASUREMENT FordMsg3D7BusHiSpd.FordVehCllsnMtgtnByBrkgObjDataConfLvlRawPrev "MICROSAR RTE" UBYTE NO_COMPU_METHOD 0 0 0 255 ECU_ADDRESS 0 SYMBOL_LINK "Rte_FordMsg3D7BusHiSpd_FordVehCllsnMtgtnByBrkgObjDataConfLvlRawPrev" 0 DISPLAY_IDENTIFIER FordMsg3D7BusHiSpd.PerInstanceMemories.FordVehCllsnMtgtnByBrkgObjDataConfLvlRawPrev /end MEASUREMENT
/begin MEASUREMENT FordMsg3D7BusHiSpd.FordVehCllsnMtgtnByBrkgObjTypClassnRaw.Val "MICROSAR RTE" UBYTE NO_COMPU_METHOD 0 0 0 255 ECU_ADDRESS 0 SYMBOL_LINK "Rte_FordMsg3D7BusHiSpd_FordVehCllsnMtgtnByBrkgObjTypClassnRaw_Val" 0 DISPLAY_IDENTIFIER FordMsg3D7BusHiSpd.SenderPorts.FordVehCllsnMtgtnByBrkgObjTypClassnRaw.Val /end MEASUREMENT
/begin MEASUREMENT FordMsg3D7BusHiSpd.FordVehCllsnMtgtnByBrkgObjTypClassnRawPrev "MICROSAR RTE" UBYTE NO_COMPU_METHOD 0 0 0 255 ECU_ADDRESS 0 SYMBOL_LINK "Rte_FordMsg3D7BusHiSpd_FordVehCllsnMtgtnByBrkgObjTypClassnRawPrev" 0 DISPLAY_IDENTIFIER FordMsg3D7BusHiSpd.PerInstanceMemories.FordVehCllsnMtgtnByBrkgObjTypClassnRawPrev /end MEASUREMENT
/begin MEASUREMENT FordMsg3D7BusHiSpd.FordVehCllsnMtgtnByBrkgRelLatVelInvldFaildRefTi "MICROSAR RTE" ULONG NO_COMPU_METHOD 0 0 0 4294967295 ECU_ADDRESS 0 SYMBOL_LINK "Rte_FordMsg3D7BusHiSpd_FordVehCllsnMtgtnByBrkgRelLatVelInvldFaildRefTi" 0 DISPLAY_IDENTIFIER FordMsg3D7BusHiSpd.PerInstanceMemories.FordVehCllsnMtgtnByBrkgRelLatVelInvldFaildRefTi /end MEASUREMENT
/begin MEASUREMENT FordMsg3D7BusHiSpd.FordVehCllsnMtgtnByBrkgRelLatVelInvldPassdRefTi "MICROSAR RTE" ULONG NO_COMPU_METHOD 0 0 0 4294967295 ECU_ADDRESS 0 SYMBOL_LINK "Rte_FordMsg3D7BusHiSpd_FordVehCllsnMtgtnByBrkgRelLatVelInvldPassdRefTi" 0 DISPLAY_IDENTIFIER FordMsg3D7BusHiSpd.PerInstanceMemories.FordVehCllsnMtgtnByBrkgRelLatVelInvldPassdRefTi /end MEASUREMENT
/begin MEASUREMENT FordMsg3D7BusHiSpd.FordVehCllsnMtgtnByBrkgRelLatVelRaw.Val "MICROSAR RTE" UWORD NO_COMPU_METHOD 0 0 0 65535 ECU_ADDRESS 0 SYMBOL_LINK "Rte_FordMsg3D7BusHiSpd_FordVehCllsnMtgtnByBrkgRelLatVelRaw_Val" 0 DISPLAY_IDENTIFIER FordMsg3D7BusHiSpd.SenderPorts.FordVehCllsnMtgtnByBrkgRelLatVelRaw.Val /end MEASUREMENT
/begin MEASUREMENT FordMsg3D7BusHiSpd.FordVehCllsnMtgtnByBrkgRelLatVelRawPrev "MICROSAR RTE" UWORD NO_COMPU_METHOD 0 0 0 65535 ECU_ADDRESS 0 SYMBOL_LINK "Rte_FordMsg3D7BusHiSpd_FordVehCllsnMtgtnByBrkgRelLatVelRawPrev" 0 DISPLAY_IDENTIFIER FordMsg3D7BusHiSpd.PerInstanceMemories.FordVehCllsnMtgtnByBrkgRelLatVelRawPrev /end MEASUREMENT
/begin MEASUREMENT FordMsg3D7BusHiSpd.FordVehCllsnMtgtnByBrkgRelLgtVelInvldFaildRefTi "MICROSAR RTE" ULONG NO_COMPU_METHOD 0 0 0 4294967295 ECU_ADDRESS 0 SYMBOL_LINK "Rte_FordMsg3D7BusHiSpd_FordVehCllsnMtgtnByBrkgRelLgtVelInvldFaildRefTi" 0 DISPLAY_IDENTIFIER FordMsg3D7BusHiSpd.PerInstanceMemories.FordVehCllsnMtgtnByBrkgRelLgtVelInvldFaildRefTi /end MEASUREMENT
/begin MEASUREMENT FordMsg3D7BusHiSpd.FordVehCllsnMtgtnByBrkgRelLgtVelInvldPassdRefTi "MICROSAR RTE" ULONG NO_COMPU_METHOD 0 0 0 4294967295 ECU_ADDRESS 0 SYMBOL_LINK "Rte_FordMsg3D7BusHiSpd_FordVehCllsnMtgtnByBrkgRelLgtVelInvldPassdRefTi" 0 DISPLAY_IDENTIFIER FordMsg3D7BusHiSpd.PerInstanceMemories.FordVehCllsnMtgtnByBrkgRelLgtVelInvldPassdRefTi /end MEASUREMENT
/begin MEASUREMENT FordMsg3D7BusHiSpd.FordVehCllsnMtgtnByBrkgRelLgtVelRaw.Val "MICROSAR RTE" UWORD NO_COMPU_METHOD 0 0 0 65535 ECU_ADDRESS 0 SYMBOL_LINK "Rte_FordMsg3D7BusHiSpd_FordVehCllsnMtgtnByBrkgRelLgtVelRaw_Val" 0 DISPLAY_IDENTIFIER FordMsg3D7BusHiSpd.SenderPorts.FordVehCllsnMtgtnByBrkgRelLgtVelRaw.Val /end MEASUREMENT
/begin MEASUREMENT FordMsg3D7BusHiSpd.FordVehCllsnMtgtnByBrkgRelLgtVelRawPrev "MICROSAR RTE" UWORD NO_COMPU_METHOD 0 0 0 65535 ECU_ADDRESS 0 SYMBOL_LINK "Rte_FordMsg3D7BusHiSpd_FordVehCllsnMtgtnByBrkgRelLgtVelRawPrev" 0 DISPLAY_IDENTIFIER FordMsg3D7BusHiSpd.PerInstanceMemories.FordVehCllsnMtgtnByBrkgRelLgtVelRawPrev /end MEASUREMENT
/begin MEASUREMENT FordMsg3D7BusHiSpd.FordVehCllsnMtgtnByBrkgTiToCllsnInvldFaildRefTi "MICROSAR RTE" ULONG NO_COMPU_METHOD 0 0 0 4294967295 ECU_ADDRESS 0 SYMBOL_LINK "Rte_FordMsg3D7BusHiSpd_FordVehCllsnMtgtnByBrkgTiToCllsnInvldFaildRefTi" 0 DISPLAY_IDENTIFIER FordMsg3D7BusHiSpd.PerInstanceMemories.FordVehCllsnMtgtnByBrkgTiToCllsnInvldFaildRefTi /end MEASUREMENT
/begin MEASUREMENT FordMsg3D7BusHiSpd.FordVehCllsnMtgtnByBrkgTiToCllsnInvldPassdRefTi "MICROSAR RTE" ULONG NO_COMPU_METHOD 0 0 0 4294967295 ECU_ADDRESS 0 SYMBOL_LINK "Rte_FordMsg3D7BusHiSpd_FordVehCllsnMtgtnByBrkgTiToCllsnInvldPassdRefTi" 0 DISPLAY_IDENTIFIER FordMsg3D7BusHiSpd.PerInstanceMemories.FordVehCllsnMtgtnByBrkgTiToCllsnInvldPassdRefTi /end MEASUREMENT
/begin MEASUREMENT FordMsg3D7BusHiSpd.FordVehCllsnMtgtnByBrkgTiToCllsnRaw.Val "MICROSAR RTE" UBYTE NO_COMPU_METHOD 0 0 0 255 ECU_ADDRESS 0 SYMBOL_LINK "Rte_FordMsg3D7BusHiSpd_FordVehCllsnMtgtnByBrkgTiToCllsnRaw_Val" 0 DISPLAY_IDENTIFIER FordMsg3D7BusHiSpd.SenderPorts.FordVehCllsnMtgtnByBrkgTiToCllsnRaw.Val /end MEASUREMENT
/begin MEASUREMENT FordMsg3D7BusHiSpd.FordVehCllsnMtgtnByBrkgTiToCllsnRawPrev "MICROSAR RTE" UBYTE NO_COMPU_METHOD 0 0 0 255 ECU_ADDRESS 0 SYMBOL_LINK "Rte_FordMsg3D7BusHiSpd_FordVehCllsnMtgtnByBrkgTiToCllsnRawPrev" 0 DISPLAY_IDENTIFIER FordMsg3D7BusHiSpd.PerInstanceMemories.FordVehCllsnMtgtnByBrkgTiToCllsnRawPrev /end MEASUREMENT
/begin MEASUREMENT FordMsg3D7BusHiSpd.FordVehEvasSteerAssiEnadReqRaw.Val "MICROSAR RTE" UBYTE NO_COMPU_METHOD 0 0 0 255 ECU_ADDRESS 0 SYMBOL_LINK "Rte_FordMsg3D7BusHiSpd_FordVehEvasSteerAssiEnadReqRaw_Val" 0 DISPLAY_IDENTIFIER FordMsg3D7BusHiSpd.SenderPorts.FordVehEvasSteerAssiEnadReqRaw.Val /end MEASUREMENT
/begin MEASUREMENT FordMsg3D7BusHiSpd.FordVehEvasSteerAssiEnadReqRawPrev "MICROSAR RTE" UBYTE NO_COMPU_METHOD 0 0 0 255 ECU_ADDRESS 0 SYMBOL_LINK "Rte_FordMsg3D7BusHiSpd_FordVehEvasSteerAssiEnadReqRawPrev" 0 DISPLAY_IDENTIFIER FordMsg3D7BusHiSpd.PerInstanceMemories.FordVehEvasSteerAssiEnadReqRawPrev /end MEASUREMENT
/begin MEASUREMENT FordMsg3D7BusHiSpd.FordVehEvasSteerAssiImgProcrModlAVld.Logl "MICROSAR RTE" UBYTE RTE_CM_BOOLEAN 0 0 0 255 ECU_ADDRESS 0 SYMBOL_LINK "Rte_FordMsg3D7BusHiSpd_FordVehEvasSteerAssiImgProcrModlAVld_Logl" 0 DISPLAY_IDENTIFIER FordMsg3D7BusHiSpd.SenderPorts.FordVehEvasSteerAssiImgProcrModlAVld.Logl /end MEASUREMENT
/begin MEASUREMENT FordMsg3D7BusHiSpd.FordVehEvasSteerAssiImgProcrModlAVldPrev "MICROSAR RTE" UBYTE RTE_CM_BOOLEAN 0 0 0 255 ECU_ADDRESS 0 SYMBOL_LINK "Rte_FordMsg3D7BusHiSpd_FordVehEvasSteerAssiImgProcrModlAVldPrev" 0 DISPLAY_IDENTIFIER FordMsg3D7BusHiSpd.PerInstanceMemories.FordVehEvasSteerAssiImgProcrModlAVldPrev /end MEASUREMENT
/begin MEASUREMENT FordMsg3D7BusHiSpd.FordVehMsg3D7Miss "MICROSAR RTE" UBYTE RTE_CM_BOOLEAN 0 0 0 255 ECU_ADDRESS 0 SYMBOL_LINK "Rte_FordMsg3D7BusHiSpd_FordVehMsg3D7Miss" 0 DISPLAY_IDENTIFIER FordMsg3D7BusHiSpd.PerInstanceMemories.FordVehMsg3D7Miss /end MEASUREMENT
/begin MEASUREMENT FordMsg3D7BusHiSpd.ImgProcrModlAVldMissRefTi "MICROSAR RTE" ULONG NO_COMPU_METHOD 0 0 0 4294967295 ECU_ADDRESS 0 SYMBOL_LINK "Rte_FordMsg3D7BusHiSpd_ImgProcrModlAVldMissRefTi" 0 DISPLAY_IDENTIFIER FordMsg3D7BusHiSpd.PerInstanceMemories.ImgProcrModlAVldMissRefTi /end MEASUREMENT
/begin MEASUREMENT FordMsg3D7BusHiSpd.LatDstRawVldFaildRefTi "MICROSAR RTE" ULONG NO_COMPU_METHOD 0 0 0 4294967295 ECU_ADDRESS 0 SYMBOL_LINK "Rte_FordMsg3D7BusHiSpd_LatDstRawVldFaildRefTi" 0 DISPLAY_IDENTIFIER FordMsg3D7BusHiSpd.PerInstanceMemories.LatDstRawVldFaildRefTi /end MEASUREMENT
/begin MEASUREMENT FordMsg3D7BusHiSpd.LgtDstRawVldFaildRefTi "MICROSAR RTE" ULONG NO_COMPU_METHOD 0 0 0 4294967295 ECU_ADDRESS 0 SYMBOL_LINK "Rte_FordMsg3D7BusHiSpd_LgtDstRawVldFaildRefTi" 0 DISPLAY_IDENTIFIER FordMsg3D7BusHiSpd.PerInstanceMemories.LgtDstRawVldFaildRefTi /end MEASUREMENT
/begin MEASUREMENT FordMsg3D7BusHiSpd.MissMsgFaildRefTi "MICROSAR RTE" ULONG NO_COMPU_METHOD 0 0 0 4294967295 ECU_ADDRESS 0 SYMBOL_LINK "Rte_FordMsg3D7BusHiSpd_MissMsgFaildRefTi" 0 DISPLAY_IDENTIFIER FordMsg3D7BusHiSpd.PerInstanceMemories.MissMsgFaildRefTi /end MEASUREMENT
/begin MEASUREMENT FordMsg3D7BusHiSpd.MissMsgPassdRefTi "MICROSAR RTE" ULONG NO_COMPU_METHOD 0 0 0 4294967295 ECU_ADDRESS 0 SYMBOL_LINK "Rte_FordMsg3D7BusHiSpd_MissMsgPassdRefTi" 0 DISPLAY_IDENTIFIER FordMsg3D7BusHiSpd.PerInstanceMemories.MissMsgPassdRefTi /end MEASUREMENT
/begin MEASUREMENT FordMsg3D7BusHiSpd.RelLatVelRawVldFaildRefTi "MICROSAR RTE" ULONG NO_COMPU_METHOD 0 0 0 4294967295 ECU_ADDRESS 0 SYMBOL_LINK "Rte_FordMsg3D7BusHiSpd_RelLatVelRawVldFaildRefTi" 0 DISPLAY_IDENTIFIER FordMsg3D7BusHiSpd.PerInstanceMemories.RelLatVelRawVldFaildRefTi /end MEASUREMENT
/begin MEASUREMENT FordMsg3D7BusHiSpd.RelLgtVelRawVldFaildRefTi "MICROSAR RTE" ULONG NO_COMPU_METHOD 0 0 0 4294967295 ECU_ADDRESS 0 SYMBOL_LINK "Rte_FordMsg3D7BusHiSpd_RelLgtVelRawVldFaildRefTi" 0 DISPLAY_IDENTIFIER FordMsg3D7BusHiSpd.PerInstanceMemories.RelLgtVelRawVldFaildRefTi /end MEASUREMENT
/begin MEASUREMENT FordMsg3D7BusHiSpd.TiToCllsnRawVldFaildRefTi "MICROSAR RTE" ULONG NO_COMPU_METHOD 0 0 0 4294967295 ECU_ADDRESS 0 SYMBOL_LINK "Rte_FordMsg3D7BusHiSpd_TiToCllsnRawVldFaildRefTi" 0 DISPLAY_IDENTIFIER FordMsg3D7BusHiSpd.PerInstanceMemories.TiToCllsnRawVldFaildRefTi /end MEASUREMENT
/begin MEASUREMENT FordMsg40ABusHiSpd.ClrDiagcFlgProxy.Val "MICROSAR RTE" UBYTE NO_COMPU_METHOD 0 0 0 255 ECU_ADDRESS 0 SYMBOL_LINK "Rte_DiagcMgr_ClrDiagcFlgProxy_Val" 0 DISPLAY_IDENTIFIER FordMsg40ABusHiSpd.ReceiverPorts.ClrDiagcFlgProxy.Val /end MEASUREMENT
/begin MEASUREMENT FordMsg40ABusHiSpd.FordCanDtcInhb.Val "MICROSAR RTE" UBYTE NO_COMPU_METHOD 0 0 0 255 ECU_ADDRESS 0 SYMBOL_LINK "Rte_FordCanDtcInhb_FordCanDtcInhb8_Val" 0 DISPLAY_IDENTIFIER FordMsg40ABusHiSpd.ReceiverPorts.FordCanDtcInhb.Val /end MEASUREMENT
/begin MEASUREMENT FordMsg40ABusHiSpd.FordClrDiagcFlgProxyPrev "MICROSAR RTE" UBYTE NO_COMPU_METHOD 0 0 0 255 ECU_ADDRESS 0 SYMBOL_LINK "Rte_FordMsg40ABusHiSpd_FordClrDiagcFlgProxyPrev" 0 DISPLAY_IDENTIFIER FordMsg40ABusHiSpd.PerInstanceMemories.FordClrDiagcFlgProxyPrev /end MEASUREMENT
/begin MEASUREMENT FordMsg40ABusHiSpd.FordEpsLifeCycMod.Val "MICROSAR RTE" UBYTE NO_COMPU_METHOD 0 0 0 255 ECU_ADDRESS 0 SYMBOL_LINK "Rte_FordCanDtcInhb_FordEpsLifeCycMod_Val" 0 DISPLAY_IDENTIFIER FordMsg40ABusHiSpd.ReceiverPorts.FordEpsLifeCycMod.Val /end MEASUREMENT
/begin MEASUREMENT FordMsg40ABusHiSpd.FordMfgDiagcInhb.Val "MICROSAR RTE" UBYTE NO_COMPU_METHOD 0 0 0 255 ECU_ADDRESS 0 SYMBOL_LINK "Rte_FordMsg40ABusHiSpd_FordMfgDiagcInhb_Val" 0 DISPLAY_IDENTIFIER FordMsg40ABusHiSpd.ReceiverPorts.FordMfgDiagcInhb.Val /end MEASUREMENT
/begin MEASUREMENT FordMsg40ABusHiSpd.FordMissMsgDiagcInhb.Val "MICROSAR RTE" UBYTE NO_COMPU_METHOD 0 0 0 255 ECU_ADDRESS 0 SYMBOL_LINK "Rte_FordMsg40ABusHiSpd_FordMissMsgDiagcInhb_Val" 0 DISPLAY_IDENTIFIER FordMsg40ABusHiSpd.ReceiverPorts.FordMissMsgDiagcInhb.Val /end MEASUREMENT
/begin MEASUREMENT FordMsg40ABusHiSpd.FordVehGlbRealTi.Val "MICROSAR RTE" FLOAT32_IEEE NO_COMPU_METHOD 0 0 -3.402823466e+38 3.402823466e+38 ECU_ADDRESS 0 SYMBOL_LINK "Rte_FordMsg40ABusHiSpd_FordVehGlbRealTi_Val" 0 DISPLAY_IDENTIFIER FordMsg40ABusHiSpd.SenderPorts.FordVehGlbRealTi.Val /end MEASUREMENT
/begin MEASUREMENT FordMsg40ABusHiSpd.FordVehGlbRealTiPrev "MICROSAR RTE" FLOAT32_IEEE NO_COMPU_METHOD 0 0 -3.402823466e+38 3.402823466e+38 ECU_ADDRESS 0 SYMBOL_LINK "Rte_FordMsg40ABusHiSpd_FordVehGlbRealTiPrev" 0 DISPLAY_IDENTIFIER FordMsg40ABusHiSpd.PerInstanceMemories.FordVehGlbRealTiPrev /end MEASUREMENT
/begin MEASUREMENT FordMsg40ABusHiSpd.FordVehIdnNr.Ary1D "MICROSAR RTE" UBYTE NO_COMPU_METHOD 0 0 0 255 MATRIX_DIM 17 1 1 ECU_ADDRESS 0 SYMBOL_LINK "Rte_FordMsg40ABusHiSpd_FordVehIdnNr_Ary1D" 0 DISPLAY_IDENTIFIER FordMsg40ABusHiSpd.SenderPorts.FordVehIdnNr.Ary1D /end MEASUREMENT
/begin MEASUREMENT FordMsg40ABusHiSpd.FordVehIdnNrC100Prev "MICROSAR RTE" UBYTE NO_COMPU_METHOD 0 0 0 255 MATRIX_DIM 6 1 1 ECU_ADDRESS 0 SYMBOL_LINK "Rte_FordMsg40ABusHiSpd_FordVehIdnNrC100Prev" 0 DISPLAY_IDENTIFIER FordMsg40ABusHiSpd.PerInstanceMemories.FordVehIdnNrC100Prev /end MEASUREMENT
/begin MEASUREMENT FordMsg40ABusHiSpd.FordVehIdnNrC101Prev "MICROSAR RTE" UBYTE NO_COMPU_METHOD 0 0 0 255 MATRIX_DIM 6 1 1 ECU_ADDRESS 0 SYMBOL_LINK "Rte_FordMsg40ABusHiSpd_FordVehIdnNrC101Prev" 0 DISPLAY_IDENTIFIER FordMsg40ABusHiSpd.PerInstanceMemories.FordVehIdnNrC101Prev /end MEASUREMENT
/begin MEASUREMENT FordMsg40ABusHiSpd.FordVehIdnNrC102Prev "MICROSAR RTE" UBYTE NO_COMPU_METHOD 0 0 0 255 MATRIX_DIM 5 1 1 ECU_ADDRESS 0 SYMBOL_LINK "Rte_FordMsg40ABusHiSpd_FordVehIdnNrC102Prev" 0 DISPLAY_IDENTIFIER FordMsg40ABusHiSpd.PerInstanceMemories.FordVehIdnNrC102Prev /end MEASUREMENT
/begin MEASUREMENT FordMsg40ABusHiSpd.FordVehIdnNrPrev "MICROSAR RTE" UBYTE NO_COMPU_METHOD 0 0 0 255 MATRIX_DIM 17 1 1 ECU_ADDRESS 0 SYMBOL_LINK "Rte_FordMsg40ABusHiSpd_FordVehIdnNrPrev" 0 DISPLAY_IDENTIFIER FordMsg40ABusHiSpd.PerInstanceMemories.FordVehIdnNrPrev /end MEASUREMENT
/begin MEASUREMENT FordMsg40ABusHiSpd.FordVehMsg40AMiss "MICROSAR RTE" UBYTE RTE_CM_BOOLEAN 0 0 0 255 ECU_ADDRESS 0 SYMBOL_LINK "Rte_FordMsg40ABusHiSpd_FordVehMsg40AMiss" 0 DISPLAY_IDENTIFIER FordMsg40ABusHiSpd.PerInstanceMemories.FordVehMsg40AMiss /end MEASUREMENT
/begin MEASUREMENT FordMsg40ABusHiSpd.FordVehMsg40ARxd "MICROSAR RTE" UBYTE RTE_CM_BOOLEAN 0 0 0 255 ECU_ADDRESS 0 SYMBOL_LINK "Rte_FordMsg40ABusHiSpd_FordVehMsg40ARxd" 0 DISPLAY_IDENTIFIER FordMsg40ABusHiSpd.PerInstanceMemories.FordVehMsg40ARxd /end MEASUREMENT
/begin MEASUREMENT FordMsg40ABusHiSpd.FordVehTireCircum.Val "MICROSAR RTE" FLOAT32_IEEE NO_COMPU_METHOD 0 0 -3.402823466e+38 3.402823466e+38 ECU_ADDRESS 0 SYMBOL_LINK "Rte_FordMsg40ABusHiSpd_FordVehTireCircum_Val" 0 DISPLAY_IDENTIFIER FordMsg40ABusHiSpd.SenderPorts.FordVehTireCircum.Val /end MEASUREMENT
/begin MEASUREMENT FordMsg40ABusHiSpd.FordVehTireCircumPrev "MICROSAR RTE" FLOAT32_IEEE NO_COMPU_METHOD 0 0 -3.402823466e+38 3.402823466e+38 ECU_ADDRESS 0 SYMBOL_LINK "Rte_FordMsg40ABusHiSpd_FordVehTireCircumPrev" 0 DISPLAY_IDENTIFIER FordMsg40ABusHiSpd.PerInstanceMemories.FordVehTireCircumPrev /end MEASUREMENT
/begin MEASUREMENT FordMsg40ABusHiSpd.MissMsgFaildRefTi "MICROSAR RTE" ULONG NO_COMPU_METHOD 0 0 0 4294967295 ECU_ADDRESS 0 SYMBOL_LINK "Rte_FordMsg40ABusHiSpd_MissMsgFaildRefTi" 0 DISPLAY_IDENTIFIER FordMsg40ABusHiSpd.PerInstanceMemories.MissMsgFaildRefTi /end MEASUREMENT
/begin MEASUREMENT FordMsg40ABusHiSpd.MissMsgPassdRefTi "MICROSAR RTE" ULONG NO_COMPU_METHOD 0 0 0 4294967295 ECU_ADDRESS 0 SYMBOL_LINK "Rte_FordMsg40ABusHiSpd_MissMsgPassdRefTi" 0 DISPLAY_IDENTIFIER FordMsg40ABusHiSpd.PerInstanceMemories.MissMsgPassdRefTi /end MEASUREMENT
/begin MEASUREMENT FordMsg414BusHiSpd.AgOffsVldFaildRefTi "MICROSAR RTE" ULONG NO_COMPU_METHOD 0 0 0 4294967295 ECU_ADDRESS 0 SYMBOL_LINK "Rte_FordMsg414BusHiSpd_AgOffsVldFaildRefTi" 0 DISPLAY_IDENTIFIER FordMsg414BusHiSpd.PerInstanceMemories.AgOffsVldFaildRefTi /end MEASUREMENT
/begin MEASUREMENT FordMsg414BusHiSpd.AgOffsVldMissRefTi "MICROSAR RTE" ULONG NO_COMPU_METHOD 0 0 0 4294967295 ECU_ADDRESS 0 SYMBOL_LINK "Rte_FordMsg414BusHiSpd_AgOffsVldMissRefTi" 0 DISPLAY_IDENTIFIER FordMsg414BusHiSpd.PerInstanceMemories.AgOffsVldMissRefTi /end MEASUREMENT
/begin MEASUREMENT FordMsg414BusHiSpd.AgOffsVldPassdRefTi "MICROSAR RTE" ULONG NO_COMPU_METHOD 0 0 0 4294967295 ECU_ADDRESS 0 SYMBOL_LINK "Rte_FordMsg414BusHiSpd_AgOffsVldPassdRefTi" 0 DISPLAY_IDENTIFIER FordMsg414BusHiSpd.PerInstanceMemories.AgOffsVldPassdRefTi /end MEASUREMENT
/begin MEASUREMENT FordMsg414BusHiSpd.ChksVldFaildRefTi "MICROSAR RTE" ULONG NO_COMPU_METHOD 0 0 0 4294967295 ECU_ADDRESS 0 SYMBOL_LINK "Rte_FordMsg414BusHiSpd_ChksVldFaildRefTi" 0 DISPLAY_IDENTIFIER FordMsg414BusHiSpd.PerInstanceMemories.ChksVldFaildRefTi /end MEASUREMENT
/begin MEASUREMENT FordMsg414BusHiSpd.ChksVldMissRefTi "MICROSAR RTE" ULONG NO_COMPU_METHOD 0 0 0 4294967295 ECU_ADDRESS 0 SYMBOL_LINK "Rte_FordMsg414BusHiSpd_ChksVldMissRefTi" 0 DISPLAY_IDENTIFIER FordMsg414BusHiSpd.PerInstanceMemories.ChksVldMissRefTi /end MEASUREMENT
/begin MEASUREMENT FordMsg414BusHiSpd.CntrVldMissRefTi "MICROSAR RTE" ULONG NO_COMPU_METHOD 0 0 0 4294967295 ECU_ADDRESS 0 SYMBOL_LINK "Rte_FordMsg414BusHiSpd_CntrVldMissRefTi" 0 DISPLAY_IDENTIFIER FordMsg414BusHiSpd.PerInstanceMemories.CntrVldMissRefTi /end MEASUREMENT
/begin MEASUREMENT FordMsg414BusHiSpd.FirstTranVldFlg "MICROSAR RTE" UBYTE RTE_CM_BOOLEAN 0 0 0 255 ECU_ADDRESS 0 SYMBOL_LINK "Rte_FordMsg414BusHiSpd_FirstTranVldFlg" 0 DISPLAY_IDENTIFIER FordMsg414BusHiSpd.PerInstanceMemories.FirstTranVldFlg /end MEASUREMENT
/begin MEASUREMENT FordMsg414BusHiSpd.FordVehMsg414Miss "MICROSAR RTE" UBYTE RTE_CM_BOOLEAN 0 0 0 255 ECU_ADDRESS 0 SYMBOL_LINK "Rte_FordMsg414BusHiSpd_FordVehMsg414Miss" 0 DISPLAY_IDENTIFIER FordMsg414BusHiSpd.PerInstanceMemories.FordVehMsg414Miss /end MEASUREMENT
/begin MEASUREMENT FordMsg414BusHiSpd.FordVehSteerPinionAgOffs.Val "MICROSAR RTE" FLOAT32_IEEE NO_COMPU_METHOD 0 0 -3.402823466e+38 3.402823466e+38 ECU_ADDRESS 0 SYMBOL_LINK "Rte_FordMsg414BusHiSpd_FordVehSteerPinionAgOffs_Val" 0 DISPLAY_IDENTIFIER FordMsg414BusHiSpd.SenderPorts.FordVehSteerPinionAgOffs.Val /end MEASUREMENT
/begin MEASUREMENT FordMsg414BusHiSpd.FordVehSteerPinionAgOffsPrev "MICROSAR RTE" FLOAT32_IEEE NO_COMPU_METHOD 0 0 -3.402823466e+38 3.402823466e+38 ECU_ADDRESS 0 SYMBOL_LINK "Rte_FordMsg414BusHiSpd_FordVehSteerPinionAgOffsPrev" 0 DISPLAY_IDENTIFIER FordMsg414BusHiSpd.PerInstanceMemories.FordVehSteerPinionAgOffsPrev /end MEASUREMENT
/begin MEASUREMENT FordMsg414BusHiSpd.FordVehSteerPinionAgOffsRaw.Val "MICROSAR RTE" UWORD NO_COMPU_METHOD 0 0 0 65535 ECU_ADDRESS 0 SYMBOL_LINK "Rte_FordMsg414BusHiSpd_FordVehSteerPinionAgOffsRaw_Val" 0 DISPLAY_IDENTIFIER FordMsg414BusHiSpd.SenderPorts.FordVehSteerPinionAgOffsRaw.Val /end MEASUREMENT
/begin MEASUREMENT FordMsg414BusHiSpd.FordVehSteerPinionAgOffsRawPrev "MICROSAR RTE" UWORD NO_COMPU_METHOD 0 0 0 65535 ECU_ADDRESS 0 SYMBOL_LINK "Rte_FordMsg414BusHiSpd_FordVehSteerPinionAgOffsRawPrev" 0 DISPLAY_IDENTIFIER FordMsg414BusHiSpd.PerInstanceMemories.FordVehSteerPinionAgOffsRawPrev /end MEASUREMENT
/begin MEASUREMENT FordMsg414BusHiSpd.FordVehSteerPinionAgOffsVld.Logl "MICROSAR RTE" UBYTE RTE_CM_BOOLEAN 0 0 0 255 ECU_ADDRESS 0 SYMBOL_LINK "Rte_FordMsg414BusHiSpd_FordVehSteerPinionAgOffsVld_Logl" 0 DISPLAY_IDENTIFIER FordMsg414BusHiSpd.SenderPorts.FordVehSteerPinionAgOffsVld.Logl /end MEASUREMENT
/begin MEASUREMENT FordMsg414BusHiSpd.FordVehSteerPinionAgOffsVldPrev "MICROSAR RTE" UBYTE RTE_CM_BOOLEAN 0 0 0 255 ECU_ADDRESS 0 SYMBOL_LINK "Rte_FordMsg414BusHiSpd_FordVehSteerPinionAgOffsVldPrev" 0 DISPLAY_IDENTIFIER FordMsg414BusHiSpd.PerInstanceMemories.FordVehSteerPinionAgOffsVldPrev /end MEASUREMENT
/begin MEASUREMENT FordMsg414BusHiSpd.FordVehSteerPinionChksVld.Logl "MICROSAR RTE" UBYTE RTE_CM_BOOLEAN 0 0 0 255 ECU_ADDRESS 0 SYMBOL_LINK "Rte_FordMsg414BusHiSpd_FordVehSteerPinionChksVld_Logl" 0 DISPLAY_IDENTIFIER FordMsg414BusHiSpd.SenderPorts.FordVehSteerPinionChksVld.Logl /end MEASUREMENT
/begin MEASUREMENT FordMsg414BusHiSpd.FordVehSteerPinionChksVldPrev "MICROSAR RTE" UBYTE RTE_CM_BOOLEAN 0 0 0 255 ECU_ADDRESS 0 SYMBOL_LINK "Rte_FordMsg414BusHiSpd_FordVehSteerPinionChksVldPrev" 0 DISPLAY_IDENTIFIER FordMsg414BusHiSpd.PerInstanceMemories.FordVehSteerPinionChksVldPrev /end MEASUREMENT
/begin MEASUREMENT FordMsg414BusHiSpd.FordVehSteerPinionCntrVld.Logl "MICROSAR RTE" UBYTE RTE_CM_BOOLEAN 0 0 0 255 ECU_ADDRESS 0 SYMBOL_LINK "Rte_FordMsg414BusHiSpd_FordVehSteerPinionCntrVld_Logl" 0 DISPLAY_IDENTIFIER FordMsg414BusHiSpd.SenderPorts.FordVehSteerPinionCntrVld.Logl /end MEASUREMENT
/begin MEASUREMENT FordMsg414BusHiSpd.FordVehSteerPinionCntrVldPrev "MICROSAR RTE" UBYTE RTE_CM_BOOLEAN 0 0 0 255 ECU_ADDRESS 0 SYMBOL_LINK "Rte_FordMsg414BusHiSpd_FordVehSteerPinionCntrVldPrev" 0 DISPLAY_IDENTIFIER FordMsg414BusHiSpd.PerInstanceMemories.FordVehSteerPinionCntrVldPrev /end MEASUREMENT
/begin MEASUREMENT FordMsg414BusHiSpd.FordVehSteerPinionOffsChks.Val "MICROSAR RTE" UBYTE NO_COMPU_METHOD 0 0 0 255 ECU_ADDRESS 0 SYMBOL_LINK "Rte_FordMsg414BusHiSpd_FordVehSteerPinionOffsChks_Val" 0 DISPLAY_IDENTIFIER FordMsg414BusHiSpd.SenderPorts.FordVehSteerPinionOffsChks.Val /end MEASUREMENT
/begin MEASUREMENT FordMsg414BusHiSpd.FordVehSteerPinionOffsChksPrev "MICROSAR RTE" UBYTE NO_COMPU_METHOD 0 0 0 255 ECU_ADDRESS 0 SYMBOL_LINK "Rte_FordMsg414BusHiSpd_FordVehSteerPinionOffsChksPrev" 0 DISPLAY_IDENTIFIER FordMsg414BusHiSpd.PerInstanceMemories.FordVehSteerPinionOffsChksPrev /end MEASUREMENT
/begin MEASUREMENT FordMsg414BusHiSpd.FordVehSteerPinionOffsCnt.Val "MICROSAR RTE" UBYTE NO_COMPU_METHOD 0 0 0 255 ECU_ADDRESS 0 SYMBOL_LINK "Rte_FordMsg414BusHiSpd_FordVehSteerPinionOffsCnt_Val" 0 DISPLAY_IDENTIFIER FordMsg414BusHiSpd.SenderPorts.FordVehSteerPinionOffsCnt.Val /end MEASUREMENT
/begin MEASUREMENT FordMsg414BusHiSpd.FordVehSteerPinionOffsCntPrev "MICROSAR RTE" UBYTE NO_COMPU_METHOD 0 0 0 255 ECU_ADDRESS 0 SYMBOL_LINK "Rte_FordMsg414BusHiSpd_FordVehSteerPinionOffsCntPrev" 0 DISPLAY_IDENTIFIER FordMsg414BusHiSpd.PerInstanceMemories.FordVehSteerPinionOffsCntPrev /end MEASUREMENT
/begin MEASUREMENT FordMsg414BusHiSpd.FordVehSteerPinionOffsSts.Ford_StePinOffst_D_Stat "MICROSAR RTE" UBYTE RTE_CM_ENUM_Ford_StePinOffst_D_Stat 0 0 0 3 ECU_ADDRESS 0 SYMBOL_LINK "Rte_FordMsg414BusHiSpd_FordVehSteerPinionOffsSts_Ford_StePinOffst_D_Stat" 0 DISPLAY_IDENTIFIER FordMsg414BusHiSpd.SenderPorts.FordVehSteerPinionOffsSts.Ford_StePinOffst_D_Stat /end MEASUREMENT
/begin MEASUREMENT FordMsg414BusHiSpd.FordVehSteerPinionOffsStsPrev "MICROSAR RTE" UBYTE RTE_CM_ENUM_Ford_StePinOffst_D_Stat 0 0 0 3 ECU_ADDRESS 0 SYMBOL_LINK "Rte_FordMsg414BusHiSpd_FordVehSteerPinionOffsStsPrev" 0 DISPLAY_IDENTIFIER FordMsg414BusHiSpd.PerInstanceMemories.FordVehSteerPinionOffsStsPrev /end MEASUREMENT
/begin MEASUREMENT FordMsg414BusHiSpd.FordVehSteerPinionOffsStsRaw.Val "MICROSAR RTE" UBYTE NO_COMPU_METHOD 0 0 0 255 ECU_ADDRESS 0 SYMBOL_LINK "Rte_FordMsg414BusHiSpd_FordVehSteerPinionOffsStsRaw_Val" 0 DISPLAY_IDENTIFIER FordMsg414BusHiSpd.SenderPorts.FordVehSteerPinionOffsStsRaw.Val /end MEASUREMENT
/begin MEASUREMENT FordMsg414BusHiSpd.FordVehSteerPinionOffsStsRawPrev "MICROSAR RTE" UBYTE NO_COMPU_METHOD 0 0 0 255 ECU_ADDRESS 0 SYMBOL_LINK "Rte_FordMsg414BusHiSpd_FordVehSteerPinionOffsStsRawPrev" 0 DISPLAY_IDENTIFIER FordMsg414BusHiSpd.PerInstanceMemories.FordVehSteerPinionOffsStsRawPrev /end MEASUREMENT
/begin MEASUREMENT FordMsg415BusHiSpd.BrkModlLoQlyVldFaildRefTi "MICROSAR RTE" ULONG NO_COMPU_METHOD 0 0 0 4294967295 ECU_ADDRESS 0 SYMBOL_LINK "Rte_FordMsg415BusHiSpd_BrkModlLoQlyVldFaildRefTi" 0 DISPLAY_IDENTIFIER FordMsg415BusHiSpd.PerInstanceMemories.BrkModlLoQlyVldFaildRefTi /end MEASUREMENT
/begin MEASUREMENT FordMsg415BusHiSpd.BrkModlLoQlyVldMissRefTi "MICROSAR RTE" ULONG NO_COMPU_METHOD 0 0 0 4294967295 ECU_ADDRESS 0 SYMBOL_LINK "Rte_FordMsg415BusHiSpd_BrkModlLoQlyVldMissRefTi" 0 DISPLAY_IDENTIFIER FordMsg415BusHiSpd.PerInstanceMemories.BrkModlLoQlyVldMissRefTi /end MEASUREMENT
/begin MEASUREMENT FordMsg415BusHiSpd.BrkModlLoQlyVldPassdRefTi "MICROSAR RTE" ULONG NO_COMPU_METHOD 0 0 0 4294967295 ECU_ADDRESS 0 SYMBOL_LINK "Rte_FordMsg415BusHiSpd_BrkModlLoQlyVldPassdRefTi" 0 DISPLAY_IDENTIFIER FordMsg415BusHiSpd.PerInstanceMemories.BrkModlLoQlyVldPassdRefTi /end MEASUREMENT
/begin MEASUREMENT FordMsg415BusHiSpd.BrkModlVldFaildRefTi "MICROSAR RTE" ULONG NO_COMPU_METHOD 0 0 0 4294967295 ECU_ADDRESS 0 SYMBOL_LINK "Rte_FordMsg415BusHiSpd_BrkModlVldFaildRefTi" 0 DISPLAY_IDENTIFIER FordMsg415BusHiSpd.PerInstanceMemories.BrkModlVldFaildRefTi /end MEASUREMENT
/begin MEASUREMENT FordMsg415BusHiSpd.BrkModlVldMissRefTi "MICROSAR RTE" ULONG NO_COMPU_METHOD 0 0 0 4294967295 ECU_ADDRESS 0 SYMBOL_LINK "Rte_FordMsg415BusHiSpd_BrkModlVldMissRefTi" 0 DISPLAY_IDENTIFIER FordMsg415BusHiSpd.PerInstanceMemories.BrkModlVldMissRefTi /end MEASUREMENT
/begin MEASUREMENT FordMsg415BusHiSpd.BrkModlVldPassdRefTi "MICROSAR RTE" ULONG NO_COMPU_METHOD 0 0 0 4294967295 ECU_ADDRESS 0 SYMBOL_LINK "Rte_FordMsg415BusHiSpd_BrkModlVldPassdRefTi" 0 DISPLAY_IDENTIFIER FordMsg415BusHiSpd.PerInstanceMemories.BrkModlVldPassdRefTi /end MEASUREMENT
/begin MEASUREMENT FordMsg415BusHiSpd.BrkSprtVldMissRefTi "MICROSAR RTE" ULONG NO_COMPU_METHOD 0 0 0 4294967295 ECU_ADDRESS 0 SYMBOL_LINK "Rte_FordMsg415BusHiSpd_BrkSprtVldMissRefTi" 0 DISPLAY_IDENTIFIER FordMsg415BusHiSpd.PerInstanceMemories.BrkSprtVldMissRefTi /end MEASUREMENT
/begin MEASUREMENT FordMsg415BusHiSpd.BrkSprtVldPassdRefTi "MICROSAR RTE" ULONG NO_COMPU_METHOD 0 0 0 4294967295 ECU_ADDRESS 0 SYMBOL_LINK "Rte_FordMsg415BusHiSpd_BrkSprtVldPassdRefTi" 0 DISPLAY_IDENTIFIER FordMsg415BusHiSpd.PerInstanceMemories.BrkSprtVldPassdRefTi /end MEASUREMENT
/begin GROUP FordMsg2FDBusHiSpd.ReceiverPorts "MICROSAR RTE"
 /begin SUB_GROUP FordMsg2FDBusHiSpd.ClrDiagcFlgProxy.Val FordMsg2FDBusHiSpd.FordCanDtcInhb.Logl FordMsg2FDBusHiSpd.FordEpsLifeCycMod.Val FordMsg2FDBusHiSpd.FordEvasSteerAssiEnad.Logl /end SUB_GROUP
 /begin FUNCTION_LIST /end FUNCTION_LIST
 /begin REF_CHARACTERISTIC /end REF_CHARACTERISTIC
 /begin REF_MEASUREMENT /end REF_MEASUREMENT
/end GROUP
/begin GROUP FordMsg2FDBusHiSpd.SenderPorts "MICROSAR RTE"
 /begin SUB_GROUP FordMsg2FDBusHiSpd.FordVehEvasSteerAssiReq.Val FordMsg2FDBusHiSpd.FordVehEvasSteerAssiReqVld.Logl /end SUB_GROUP
 /begin FUNCTION_LIST /end FUNCTION_LIST
 /begin REF_CHARACTERISTIC /end REF_CHARACTERISTIC
 /begin REF_MEASUREMENT /end REF_MEASUREMENT
/end GROUP
/begin GROUP FordMsg3B3BusHiSpd "MICROSAR RTE"
 /begin SUB_GROUP FordMsg3B3BusHiSpd.CalibrationPorts FordMsg3B3BusHiSpd.PerInstanceMemories FordMsg3B3BusHiSpd.ReceiverPorts FordMsg3B3BusHiSpd.SenderPorts /end SUB_GROUP
 /begin FUNCTION_LIST /end FUNCTION_LIST
 /begin REF_CHARACTERISTIC /end REF_CHARACTERISTIC
 /begin REF_MEASUREMENT /end REF_MEASUREMENT
/end GROUP
/begin GROUP FordMsg3B3BusHiSpd.CalibrationPorts "MICROSAR RTE"
 /begin SUB_GROUP FordMsg3B3BusHiSpd.FordMsg3B3BusHiSpdIgnStsVldFaildThd.Val FordMsg3B3BusHiSpd.FordMsg3B3BusHiSpdIgnStsVldMissThd.Val FordMsg3B3BusHiSpd.FordMsg3B3BusHiSpdIgnStsVldPassdThd.Val FordMsg3B3BusHiSpd.FordMsg3B3BusHiSpdInvldSigFaildThd.Val FordMsg3B3BusHiSpd.FordMsg3B3BusHiSpdInvldSigPassdThd.Val FordMsg3B3BusHiSpd.FordMsg3B3BusHiSpdMissMsgFaildThd.Val FordMsg3B3BusHiSpd.FordMsg3B3BusHiSpdMissMsgPassdThd.Val /end SUB_GROUP
 /begin FUNCTION_LIST /end FUNCTION_LIST
 /begin REF_CHARACTERISTIC /end REF_CHARACTERISTIC
 /begin REF_MEASUREMENT /end REF_MEASUREMENT
/end GROUP
/begin GROUP FordMsg3B3BusHiSpd.ClrDiagcFlgProxy.Val "MICROSAR RTE" /begin SUB_GROUP /end SUB_GROUP /begin FUNCTION_LIST /end FUNCTION_LIST /begin REF_CHARACTERISTIC /end REF_CHARACTERISTIC /begin REF_MEASUREMENT FordMsg3B3BusHiSpd.ClrDiagcFlgProxy.Val /end REF_MEASUREMENT /end GROUP
/begin GROUP FordMsg3B3BusHiSpd.ClrDiagcFlgProxyPrev "MICROSAR RTE" /begin SUB_GROUP /end SUB_GROUP /begin FUNCTION_LIST /end FUNCTION_LIST /begin REF_CHARACTERISTIC /end REF_CHARACTERISTIC /begin REF_MEASUREMENT FordMsg3B3BusHiSpd.ClrDiagcFlgProxyPrev /end REF_MEASUREMENT /end GROUP
/begin GROUP FordMsg3B3BusHiSpd.FirstTranVldFlg "MICROSAR RTE" /begin SUB_GROUP /end SUB_GROUP /begin FUNCTION_LIST /end FUNCTION_LIST /begin REF_CHARACTERISTIC /end REF_CHARACTERISTIC /begin REF_MEASUREMENT FordMsg3B3BusHiSpd.FirstTranVldFlg /end REF_MEASUREMENT /end GROUP
/begin GROUP FordMsg3B3BusHiSpd.FordCanDtcInhb.Val "MICROSAR RTE" /begin SUB_GROUP /end SUB_GROUP /begin FUNCTION_LIST /end FUNCTION_LIST /begin REF_CHARACTERISTIC /end REF_CHARACTERISTIC /begin REF_MEASUREMENT FordMsg3B3BusHiSpd.FordCanDtcInhb.Val /end REF_MEASUREMENT /end GROUP
/begin GROUP FordMsg3B3BusHiSpd.FordEpsLifeCycMod.Val "MICROSAR RTE" /begin SUB_GROUP /end SUB_GROUP /begin FUNCTION_LIST /end FUNCTION_LIST /begin REF_CHARACTERISTIC /end REF_CHARACTERISTIC /begin REF_MEASUREMENT FordMsg3B3BusHiSpd.FordEpsLifeCycMod.Val /end REF_MEASUREMENT /end GROUP
/begin GROUP FordMsg3B3BusHiSpd.FordInvldMsgDiagcInhb.Val "MICROSAR RTE" /begin SUB_GROUP /end SUB_GROUP /begin FUNCTION_LIST /end FUNCTION_LIST /begin REF_CHARACTERISTIC /end REF_CHARACTERISTIC /begin REF_MEASUREMENT FordMsg3B3BusHiSpd.FordInvldMsgDiagcInhb.Val /end REF_MEASUREMENT /end GROUP
/begin GROUP FordMsg3B3BusHiSpd.FordMfgDiagcInhb.Val "MICROSAR RTE" /begin SUB_GROUP /end SUB_GROUP /begin FUNCTION_LIST /end FUNCTION_LIST /begin REF_CHARACTERISTIC /end REF_CHARACTERISTIC /begin REF_MEASUREMENT FordMsg3B3BusHiSpd.FordMfgDiagcInhb.Val /end REF_MEASUREMENT /end GROUP
/begin GROUP FordMsg3B3BusHiSpd.FordMissMsgDiagcInhb.Val "MICROSAR RTE" /begin SUB_GROUP /end SUB_GROUP /begin FUNCTION_LIST /end FUNCTION_LIST /begin REF_CHARACTERISTIC /end REF_CHARACTERISTIC /begin REF_MEASUREMENT FordMsg3B3BusHiSpd.FordMissMsgDiagcInhb.Val /end REF_MEASUREMENT /end GROUP
/begin GROUP FordMsg3B3BusHiSpd.FordMsg3B3BusHiSpdIgnStsVldFaildThd.Val "MICROSAR RTE" /begin SUB_GROUP /end SUB_GROUP /begin FUNCTION_LIST /end FUNCTION_LIST /begin REF_CHARACTERISTIC FordMsg3B3BusHiSpd.FordMsg3B3BusHiSpdIgnStsVldFaildThd.Val /end REF_CHARACTERISTIC /begin REF_MEASUREMENT /end REF_MEASUREMENT /end GROUP
/begin GROUP FordMsg3B3BusHiSpd.FordMsg3B3BusHiSpdIgnStsVldMissThd.Val "MICROSAR RTE" /begin SUB_GROUP /end SUB_GROUP /begin FUNCTION_LIST /end FUNCTION_LIST /begin REF_CHARACTERISTIC FordMsg3B3BusHiSpd.FordMsg3B3BusHiSpdIgnStsVldMissThd.Val /end REF_CHARACTERISTIC /begin REF_MEASUREMENT /end REF_MEASUREMENT /end GROUP
/begin GROUP FordMsg3B3BusHiSpd.FordMsg3B3BusHiSpdIgnStsVldPassdThd.Val "MICROSAR RTE" /begin SUB_GROUP /end SUB_GROUP /begin FUNCTION_LIST /end FUNCTION_LIST /begin REF_CHARACTERISTIC FordMsg3B3BusHiSpd.FordMsg3B3BusHiSpdIgnStsVldPassdThd.Val /end REF_CHARACTERISTIC /begin REF_MEASUREMENT /end REF_MEASUREMENT /end GROUP
/begin GROUP FordMsg3B3BusHiSpd.FordMsg3B3BusHiSpdInvldSigFaildThd.Val "MICROSAR RTE" /begin SUB_GROUP /end SUB_GROUP /begin FUNCTION_LIST /end FUNCTION_LIST /begin REF_CHARACTERISTIC FordMsg3B3BusHiSpd.FordMsg3B3BusHiSpdInvldSigFaildThd.Val /end REF_CHARACTERISTIC /begin REF_MEASUREMENT /end REF_MEASUREMENT /end GROUP
/begin GROUP FordMsg3B3BusHiSpd.FordMsg3B3BusHiSpdInvldSigPassdThd.Val "MICROSAR RTE" /begin SUB_GROUP /end SUB_GROUP /begin FUNCTION_LIST /end FUNCTION_LIST /begin REF_CHARACTERISTIC FordMsg3B3BusHiSpd.FordMsg3B3BusHiSpdInvldSigPassdThd.Val /end REF_CHARACTERISTIC /begin REF_MEASUREMENT /end REF_MEASUREMENT /end GROUP
/begin GROUP FordMsg3B3BusHiSpd.FordMsg3B3BusHiSpdMissMsgFaildThd.Val "MICROSAR RTE" /begin SUB_GROUP /end SUB_GROUP /begin FUNCTION_LIST /end FUNCTION_LIST /begin REF_CHARACTERISTIC FordMsg3B3BusHiSpd.FordMsg3B3BusHiSpdMissMsgFaildThd.Val /end REF_CHARACTERISTIC /begin REF_MEASUREMENT /end REF_MEASUREMENT /end GROUP
/begin GROUP FordMsg3B3BusHiSpd.FordMsg3B3BusHiSpdMissMsgPassdThd.Val "MICROSAR RTE" /begin SUB_GROUP /end SUB_GROUP /begin FUNCTION_LIST /end FUNCTION_LIST /begin REF_CHARACTERISTIC FordMsg3B3BusHiSpd.FordMsg3B3BusHiSpdMissMsgPassdThd.Val /end REF_CHARACTERISTIC /begin REF_MEASUREMENT /end REF_MEASUREMENT /end GROUP
/begin GROUP FordMsg3B3BusHiSpd.FordTrlrBackUpAssiEnad.Logl "MICROSAR RTE" /begin SUB_GROUP /end SUB_GROUP /begin FUNCTION_LIST /end FUNCTION_LIST /begin REF_CHARACTERISTIC /end REF_CHARACTERISTIC /begin REF_MEASUREMENT FordMsg3B3BusHiSpd.FordTrlrBackUpAssiEnad.Logl /end REF_MEASUREMENT /end GROUP
/begin GROUP FordMsg3B3BusHiSpd.FordVehIgnSts.Ford_Ignition_Status "MICROSAR RTE" /begin SUB_GROUP /end SUB_GROUP /begin FUNCTION_LIST /end FUNCTION_LIST /begin REF_CHARACTERISTIC /end REF_CHARACTERISTIC /begin REF_MEASUREMENT FordMsg3B3BusHiSpd.FordVehIgnSts.Ford_Ignition_Status /end REF_MEASUREMENT /end GROUP
/begin GROUP FordMsg3B3BusHiSpd.FordVehIgnStsInvldSigFaildRefTi "MICROSAR RTE" /begin SUB_GROUP /end SUB_GROUP /begin FUNCTION_LIST /end FUNCTION_LIST /begin REF_CHARACTERISTIC /end REF_CHARACTERISTIC /begin REF_MEASUREMENT FordMsg3B3BusHiSpd.FordVehIgnStsInvldSigFaildRefTi /end REF_MEASUREMENT /end GROUP
/begin GROUP FordMsg3B3BusHiSpd.FordVehIgnStsInvldSigPassdRefTi "MICROSAR RTE" /begin SUB_GROUP /end SUB_GROUP /begin FUNCTION_LIST /end FUNCTION_LIST /begin REF_CHARACTERISTIC /end REF_CHARACTERISTIC /begin REF_MEASUREMENT FordMsg3B3BusHiSpd.FordVehIgnStsInvldSigPassdRefTi /end REF_MEASUREMENT /end GROUP
/begin GROUP FordMsg3B3BusHiSpd.FordVehIgnStsPrev "MICROSAR RTE" /begin SUB_GROUP /end SUB_GROUP /begin FUNCTION_LIST /end FUNCTION_LIST /begin REF_CHARACTERISTIC /end REF_CHARACTERISTIC /begin REF_MEASUREMENT FordMsg3B3BusHiSpd.FordVehIgnStsPrev /end REF_MEASUREMENT /end GROUP
/begin GROUP FordMsg3B3BusHiSpd.FordVehIgnStsVld.Logl "MICROSAR RTE" /begin SUB_GROUP /end SUB_GROUP /begin FUNCTION_LIST /end FUNCTION_LIST /begin REF_CHARACTERISTIC /end REF_CHARACTERISTIC /begin REF_MEASUREMENT FordMsg3B3BusHiSpd.FordVehIgnStsVld.Logl /end REF_MEASUREMENT /end GROUP
/begin GROUP FordMsg3B3BusHiSpd.FordVehIgnStsVldPrev "MICROSAR RTE" /begin SUB_GROUP /end SUB_GROUP /begin FUNCTION_LIST /end FUNCTION_LIST /begin REF_CHARACTERISTIC /end REF_CHARACTERISTIC /begin REF_MEASUREMENT FordMsg3B3BusHiSpd.FordVehIgnStsVldPrev /end REF_MEASUREMENT /end GROUP
/begin GROUP FordMsg3B3BusHiSpd.FordVehLifeCycMod.Ford_LifeCycMde_D_Actl "MICROSAR RTE" /begin SUB_GROUP /end SUB_GROUP /begin FUNCTION_LIST /end FUNCTION_LIST /begin REF_CHARACTERISTIC /end REF_CHARACTERISTIC
 /begin REF_MEASUREMENT FordMsg3B3BusHiSpd.FordVehLifeCycMod.Ford_LifeCycMde_D_Actl /end REF_MEASUREMENT
/end GROUP
/begin GROUP FordMsg3B3BusHiSpd.FordVehLifeCycModPrev "MICROSAR RTE" /begin SUB_GROUP /end SUB_GROUP /begin FUNCTION_LIST /end FUNCTION_LIST /begin REF_CHARACTERISTIC /end REF_CHARACTERISTIC /begin REF_MEASUREMENT FordMsg3B3BusHiSpd.FordVehLifeCycModPrev /end REF_MEASUREMENT /end GROUP
/begin GROUP FordMsg3B3BusHiSpd.FordVehMsg3B3Miss "MICROSAR RTE" /begin SUB_GROUP /end SUB_GROUP /begin FUNCTION_LIST /end FUNCTION_LIST /begin REF_CHARACTERISTIC /end REF_CHARACTERISTIC /begin REF_MEASUREMENT FordMsg3B3BusHiSpd.FordVehMsg3B3Miss /end REF_MEASUREMENT /end GROUP
/begin GROUP FordMsg3B3BusHiSpd.FordVehMsg3B3Rxd "MICROSAR RTE" /begin SUB_GROUP /end SUB_GROUP /begin FUNCTION_LIST /end FUNCTION_LIST /begin REF_CHARACTERISTIC /end REF_CHARACTERISTIC /begin REF_MEASUREMENT FordMsg3B3BusHiSpd.FordVehMsg3B3Rxd /end REF_MEASUREMENT /end GROUP
/begin GROUP FordMsg3B3BusHiSpd.IgnStsVldFaildRefTi "MICROSAR RTE" /begin SUB_GROUP /end SUB_GROUP /begin FUNCTION_LIST /end FUNCTION_LIST /begin REF_CHARACTERISTIC /end REF_CHARACTERISTIC /begin REF_MEASUREMENT FordMsg3B3BusHiSpd.IgnStsVldFaildRefTi /end REF_MEASUREMENT /end GROUP
/begin GROUP FordMsg3B3BusHiSpd.IgnStsVldMissRefTi "MICROSAR RTE" /begin SUB_GROUP /end SUB_GROUP /begin FUNCTION_LIST /end FUNCTION_LIST /begin REF_CHARACTERISTIC /end REF_CHARACTERISTIC /begin REF_MEASUREMENT FordMsg3B3BusHiSpd.IgnStsVldMissRefTi /end REF_MEASUREMENT /end GROUP
/begin GROUP FordMsg3B3BusHiSpd.IgnStsVldPassdRefTi "MICROSAR RTE" /begin SUB_GROUP /end SUB_GROUP /begin FUNCTION_LIST /end FUNCTION_LIST /begin REF_CHARACTERISTIC /end REF_CHARACTERISTIC /begin REF_MEASUREMENT FordMsg3B3BusHiSpd.IgnStsVldPassdRefTi /end REF_MEASUREMENT /end GROUP
/begin GROUP FordMsg3B3BusHiSpd.MissMsgFaildRefTi "MICROSAR RTE" /begin SUB_GROUP /end SUB_GROUP /begin FUNCTION_LIST /end FUNCTION_LIST /begin REF_CHARACTERISTIC /end REF_CHARACTERISTIC /begin REF_MEASUREMENT FordMsg3B3BusHiSpd.MissMsgFaildRefTi /end REF_MEASUREMENT /end GROUP
/begin GROUP FordMsg3B3BusHiSpd.MissMsgPassdRefTi "MICROSAR RTE" /begin SUB_GROUP /end SUB_GROUP /begin FUNCTION_LIST /end FUNCTION_LIST /begin REF_CHARACTERISTIC /end REF_CHARACTERISTIC /begin REF_MEASUREMENT FordMsg3B3BusHiSpd.MissMsgPassdRefTi /end REF_MEASUREMENT /end GROUP
/begin GROUP FordMsg3B3BusHiSpd.PerInstanceMemories "MICROSAR RTE"
 /begin SUB_GROUP FordMsg3B3BusHiSpd.ClrDiagcFlgProxyPrev FordMsg3B3BusHiSpd.FirstTranVldFlg FordMsg3B3BusHiSpd.FordVehIgnStsInvldSigFaildRefTi FordMsg3B3BusHiSpd.FordVehIgnStsInvldSigPassdRefTi FordMsg3B3BusHiSpd.FordVehIgnStsPrev FordMsg3B3BusHiSpd.FordVehIgnStsVldPrev FordMsg3B3BusHiSpd.FordVehLifeCycModPrev FordMsg3B3BusHiSpd.FordVehMsg3B3Miss FordMsg3B3BusHiSpd.FordVehMsg3B3Rxd FordMsg3B3BusHiSpd.IgnStsVldFaildRefTi FordMsg3B3BusHiSpd.IgnStsVldMissRefTi FordMsg3B3BusHiSpd.IgnStsVldPassdRefTi FordMsg3B3BusHiSpd.MissMsgFaildRefTi FordMsg3B3BusHiSpd.MissMsgPassdRefTi /end SUB_GROUP
 /begin FUNCTION_LIST /end FUNCTION_LIST
 /begin REF_CHARACTERISTIC /end REF_CHARACTERISTIC
 /begin REF_MEASUREMENT /end REF_MEASUREMENT
/end GROUP
/begin GROUP FordMsg3B3BusHiSpd.ReceiverPorts "MICROSAR RTE"
 /begin SUB_GROUP FordMsg3B3BusHiSpd.ClrDiagcFlgProxy.Val FordMsg3B3BusHiSpd.FordCanDtcInhb.Val FordMsg3B3BusHiSpd.FordEpsLifeCycMod.Val FordMsg3B3BusHiSpd.FordInvldMsgDiagcInhb.Val FordMsg3B3BusHiSpd.FordMfgDiagcInhb.Val FordMsg3B3BusHiSpd.FordMissMsgDiagcInhb.Val FordMsg3B3BusHiSpd.FordTrlrBackUpAssiEnad.Logl /end SUB_GROUP
 /begin FUNCTION_LIST /end FUNCTION_LIST
 /begin REF_CHARACTERISTIC /end REF_CHARACTERISTIC
 /begin REF_MEASUREMENT /end REF_MEASUREMENT
/end GROUP
/begin GROUP FordMsg3B3BusHiSpd.SenderPorts "MICROSAR RTE"
 /begin SUB_GROUP FordMsg3B3BusHiSpd.FordVehIgnSts.Ford_Ignition_Status FordMsg3B3BusHiSpd.FordVehIgnStsVld.Logl FordMsg3B3BusHiSpd.FordVehLifeCycMod.Ford_LifeCycMde_D_Actl /end SUB_GROUP
 /begin FUNCTION_LIST /end FUNCTION_LIST
 /begin REF_CHARACTERISTIC /end REF_CHARACTERISTIC
 /begin REF_MEASUREMENT /end REF_MEASUREMENT
/end GROUP
/begin GROUP FordMsg3CABusHiSpd "MICROSAR RTE"
 /begin SUB_GROUP FordMsg3CABusHiSpd.CalibrationPorts FordMsg3CABusHiSpd.PerInstanceMemories FordMsg3CABusHiSpd.ReceiverPorts FordMsg3CABusHiSpd.SenderPorts /end SUB_GROUP
 /begin FUNCTION_LIST /end FUNCTION_LIST
 /begin REF_CHARACTERISTIC /end REF_CHARACTERISTIC
 /begin REF_MEASUREMENT /end REF_MEASUREMENT
/end GROUP
/begin GROUP FordMsg3CABusHiSpd.CalibrationPorts "MICROSAR RTE"
 /begin SUB_GROUP FordMsg3CABusHiSpd.FordMsg3CABusHiSpdLaneAssiImgProcgModlAFaildCrvtTiThd.Val FordMsg3CABusHiSpd.FordMsg3CABusHiSpdLaneAssiImgProcgModlAFaildReqdAgTiThd.Val FordMsg3CABusHiSpd.FordMsg3CABusHiSpdLaneAssiImgProcgModlAPassdTiThd.Val FordMsg3CABusHiSpd.FordMsg3CABusHiSpdLaneAssiImgProcgModlAVldMissTiThd.Val FordMsg3CABusHiSpd.FordMsg3CABusHiSpdLaneKeepSysCrvtInvldFaildTiThd.Val FordMsg3CABusHiSpd.FordMsg3CABusHiSpdLaneKeepSysCrvtInvldPassdTiThd.Val FordMsg3CABusHiSpd.FordMsg3CABusHiSpdLaneKeepSysReqdAgInvldFaildTiThd.Val FordMsg3CABusHiSpd.FordMsg3CABusHiSpdLaneKeepSysReqdAgInvldPassdTiThd.Val FordMsg3CABusHiSpd.FordMsg3CABusHiSpdMissMsgFaildTiThd.Val FordMsg3CABusHiSpd.FordMsg3CABusHiSpdMissMsgPassdTiThd.Val /end SUB_GROUP
 /begin FUNCTION_LIST /end FUNCTION_LIST
 /begin REF_CHARACTERISTIC /end REF_CHARACTERISTIC
 /begin REF_MEASUREMENT /end REF_MEASUREMENT
/end GROUP
/begin GROUP FordMsg3CABusHiSpd.ClrDiagcFlgProxy.Val "MICROSAR RTE" /begin SUB_GROUP /end SUB_GROUP /begin FUNCTION_LIST /end FUNCTION_LIST /begin REF_CHARACTERISTIC /end REF_CHARACTERISTIC /begin REF_MEASUREMENT FordMsg3CABusHiSpd.ClrDiagcFlgProxy.Val /end REF_MEASUREMENT /end GROUP
/begin GROUP FordMsg3CABusHiSpd.ClrDiagcFlgProxyPrev "MICROSAR RTE" /begin SUB_GROUP /end SUB_GROUP /begin FUNCTION_LIST /end FUNCTION_LIST /begin REF_CHARACTERISTIC /end REF_CHARACTERISTIC /begin REF_MEASUREMENT FordMsg3CABusHiSpd.ClrDiagcFlgProxyPrev /end REF_MEASUREMENT /end GROUP
/begin GROUP FordMsg3CABusHiSpd.FirstTranVldFlg "MICROSAR RTE" /begin SUB_GROUP /end SUB_GROUP /begin FUNCTION_LIST /end FUNCTION_LIST /begin REF_CHARACTERISTIC /end REF_CHARACTERISTIC /begin REF_MEASUREMENT FordMsg3CABusHiSpd.FirstTranVldFlg /end REF_MEASUREMENT /end GROUP
/begin GROUP FordMsg3CABusHiSpd.FordCanDtcInhb.Logl "MICROSAR RTE" /begin SUB_GROUP /end SUB_GROUP /begin FUNCTION_LIST /end FUNCTION_LIST /begin REF_CHARACTERISTIC /end REF_CHARACTERISTIC /begin REF_MEASUREMENT FordMsg3CABusHiSpd.FordCanDtcInhb.Logl /end REF_MEASUREMENT /end GROUP
/begin GROUP FordMsg3CABusHiSpd.FordEpsLifeCycMod.Val "MICROSAR RTE" /begin SUB_GROUP /end SUB_GROUP /begin FUNCTION_LIST /end FUNCTION_LIST /begin REF_CHARACTERISTIC /end REF_CHARACTERISTIC /begin REF_MEASUREMENT FordMsg3CABusHiSpd.FordEpsLifeCycMod.Val /end REF_MEASUREMENT /end GROUP
/begin GROUP FordMsg3CABusHiSpd.FordLaneDetnWarnEnad.Logl "MICROSAR RTE" /begin SUB_GROUP /end SUB_GROUP /begin FUNCTION_LIST /end FUNCTION_LIST /begin REF_CHARACTERISTIC /end REF_CHARACTERISTIC /begin REF_MEASUREMENT FordMsg3CABusHiSpd.FordLaneDetnWarnEnad.Logl /end REF_MEASUREMENT /end GROUP
/begin GROUP FordMsg3CABusHiSpd.FordLaneKeepAssiEnad.Logl "MICROSAR RTE" /begin SUB_GROUP /end SUB_GROUP /begin FUNCTION_LIST /end FUNCTION_LIST /begin REF_CHARACTERISTIC /end REF_CHARACTERISTIC /begin REF_MEASUREMENT FordMsg3CABusHiSpd.FordLaneKeepAssiEnad.Logl /end REF_MEASUREMENT /end GROUP
/begin GROUP FordMsg3CABusHiSpd.FordMsg3CABusHiSpdLaneAssiImgProcgModlAFaildCrvtTiThd.Val "MICROSAR RTE" /begin SUB_GROUP /end SUB_GROUP /begin FUNCTION_LIST /end FUNCTION_LIST
 /begin REF_CHARACTERISTIC FordMsg3CABusHiSpd.FordMsg3CABusHiSpdLaneAssiImgProcgModlAFaildCrvtTiThd.Val /end REF_CHARACTERISTIC
 /begin REF_MEASUREMENT /end REF_MEASUREMENT
/end GROUP
/begin GROUP FordMsg3CABusHiSpd.FordMsg3CABusHiSpdLaneAssiImgProcgModlAFaildReqdAgTiThd.Val "MICROSAR RTE" /begin SUB_GROUP /end SUB_GROUP /begin FUNCTION_LIST /end FUNCTION_LIST
 /begin REF_CHARACTERISTIC FordMsg3CABusHiSpd.FordMsg3CABusHiSpdLaneAssiImgProcgModlAFaildReqdAgTiThd.Val /end REF_CHARACTERISTIC
 /begin REF_MEASUREMENT /end REF_MEASUREMENT
/end GROUP
/begin GROUP FordMsg3CABusHiSpd.FordMsg3CABusHiSpdLaneAssiImgProcgModlAPassdTiThd.Val "MICROSAR RTE" /begin SUB_GROUP /end SUB_GROUP /begin FUNCTION_LIST /end FUNCTION_LIST
 /begin REF_CHARACTERISTIC FordMsg3CABusHiSpd.FordMsg3CABusHiSpdLaneAssiImgProcgModlAPassdTiThd.Val /end REF_CHARACTERISTIC
 /begin REF_MEASUREMENT /end REF_MEASUREMENT
/end GROUP
/begin GROUP FordMsg3CABusHiSpd.FordMsg3CABusHiSpdLaneAssiImgProcgModlAVldMissTiThd.Val "MICROSAR RTE" /begin SUB_GROUP /end SUB_GROUP /begin FUNCTION_LIST /end FUNCTION_LIST
 /begin REF_CHARACTERISTIC FordMsg3CABusHiSpd.FordMsg3CABusHiSpdLaneAssiImgProcgModlAVldMissTiThd.Val /end REF_CHARACTERISTIC
 /begin REF_MEASUREMENT /end REF_MEASUREMENT
/end GROUP
/begin GROUP FordMsg3CABusHiSpd.FordMsg3CABusHiSpdLaneKeepSysCrvtInvldFaildTiThd.Val "MICROSAR RTE" /begin SUB_GROUP /end SUB_GROUP /begin FUNCTION_LIST /end FUNCTION_LIST
 /begin REF_CHARACTERISTIC FordMsg3CABusHiSpd.FordMsg3CABusHiSpdLaneKeepSysCrvtInvldFaildTiThd.Val /end REF_CHARACTERISTIC
 /begin REF_MEASUREMENT /end REF_MEASUREMENT
/end GROUP
/begin GROUP FordMsg3CABusHiSpd.FordMsg3CABusHiSpdLaneKeepSysCrvtInvldPassdTiThd.Val "MICROSAR RTE" /begin SUB_GROUP /end SUB_GROUP /begin FUNCTION_LIST /end FUNCTION_LIST
 /begin REF_CHARACTERISTIC FordMsg3CABusHiSpd.FordMsg3CABusHiSpdLaneKeepSysCrvtInvldPassdTiThd.Val /end REF_CHARACTERISTIC
 /begin REF_MEASUREMENT /end REF_MEASUREMENT
/end GROUP
/begin GROUP FordMsg3CABusHiSpd.FordMsg3CABusHiSpdLaneKeepSysReqdAgInvldFaildTiThd.Val "MICROSAR RTE" /begin SUB_GROUP /end SUB_GROUP /begin FUNCTION_LIST /end FUNCTION_LIST
 /begin REF_CHARACTERISTIC FordMsg3CABusHiSpd.FordMsg3CABusHiSpdLaneKeepSysReqdAgInvldFaildTiThd.Val /end REF_CHARACTERISTIC
 /begin REF_MEASUREMENT /end REF_MEASUREMENT
/end GROUP
/begin GROUP FordMsg3CABusHiSpd.FordMsg3CABusHiSpdLaneKeepSysReqdAgInvldPassdTiThd.Val "MICROSAR RTE" /begin SUB_GROUP /end SUB_GROUP /begin FUNCTION_LIST /end FUNCTION_LIST
 /begin REF_CHARACTERISTIC FordMsg3CABusHiSpd.FordMsg3CABusHiSpdLaneKeepSysReqdAgInvldPassdTiThd.Val /end REF_CHARACTERISTIC
 /begin REF_MEASUREMENT /end REF_MEASUREMENT
/end GROUP
/begin GROUP FordMsg3CABusHiSpd.FordMsg3CABusHiSpdMissMsgFaildTiThd.Val "MICROSAR RTE" /begin SUB_GROUP /end SUB_GROUP /begin FUNCTION_LIST /end FUNCTION_LIST /begin REF_CHARACTERISTIC FordMsg3CABusHiSpd.FordMsg3CABusHiSpdMissMsgFaildTiThd.Val /end REF_CHARACTERISTIC /begin REF_MEASUREMENT /end REF_MEASUREMENT /end GROUP
/begin GROUP FordMsg3CABusHiSpd.FordMsg3CABusHiSpdMissMsgPassdTiThd.Val "MICROSAR RTE" /begin SUB_GROUP /end SUB_GROUP /begin FUNCTION_LIST /end FUNCTION_LIST /begin REF_CHARACTERISTIC FordMsg3CABusHiSpd.FordMsg3CABusHiSpdMissMsgPassdTiThd.Val /end REF_CHARACTERISTIC /begin REF_MEASUREMENT /end REF_MEASUREMENT /end GROUP
/begin GROUP FordMsg3CABusHiSpd.FordVehLaneAssiImgProcgModlAVld.Logl "MICROSAR RTE" /begin SUB_GROUP /end SUB_GROUP /begin FUNCTION_LIST /end FUNCTION_LIST /begin REF_CHARACTERISTIC /end REF_CHARACTERISTIC /begin REF_MEASUREMENT FordMsg3CABusHiSpd.FordVehLaneAssiImgProcgModlAVld.Logl /end REF_MEASUREMENT /end GROUP
/begin GROUP FordMsg3CABusHiSpd.FordVehLaneAssiImgProcgModlAVldPrev "MICROSAR RTE" /begin SUB_GROUP /end SUB_GROUP /begin FUNCTION_LIST /end FUNCTION_LIST /begin REF_CHARACTERISTIC /end REF_CHARACTERISTIC /begin REF_MEASUREMENT FordMsg3CABusHiSpd.FordVehLaneAssiImgProcgModlAVldPrev /end REF_MEASUREMENT /end GROUP
/begin GROUP FordMsg3CABusHiSpd.FordVehLaneDetnWarnInten.Val "MICROSAR RTE" /begin SUB_GROUP /end SUB_GROUP /begin FUNCTION_LIST /end FUNCTION_LIST /begin REF_CHARACTERISTIC /end REF_CHARACTERISTIC /begin REF_MEASUREMENT FordMsg3CABusHiSpd.FordVehLaneDetnWarnInten.Val /end REF_MEASUREMENT /end GROUP
/begin GROUP FordMsg3CABusHiSpd.FordVehLaneDetnWarnIntenPrev "MICROSAR RTE" /begin SUB_GROUP /end SUB_GROUP /begin FUNCTION_LIST /end FUNCTION_LIST /begin REF_CHARACTERISTIC /end REF_CHARACTERISTIC /begin REF_MEASUREMENT FordMsg3CABusHiSpd.FordVehLaneDetnWarnIntenPrev /end REF_MEASUREMENT /end GROUP
/begin GROUP FordMsg3CABusHiSpd.FordVehLaneDetnWarnSts.Val "MICROSAR RTE" /begin SUB_GROUP /end SUB_GROUP /begin FUNCTION_LIST /end FUNCTION_LIST /begin REF_CHARACTERISTIC /end REF_CHARACTERISTIC /begin REF_MEASUREMENT FordMsg3CABusHiSpd.FordVehLaneDetnWarnSts.Val /end REF_MEASUREMENT /end GROUP
/begin GROUP FordMsg3CABusHiSpd.FordVehLaneDetnWarnStsPrev "MICROSAR RTE" /begin SUB_GROUP /end SUB_GROUP /begin FUNCTION_LIST /end FUNCTION_LIST /begin REF_CHARACTERISTIC /end REF_CHARACTERISTIC /begin REF_MEASUREMENT FordMsg3CABusHiSpd.FordVehLaneDetnWarnStsPrev /end REF_MEASUREMENT /end GROUP
/begin GROUP FordMsg3CABusHiSpd.FordVehLaneKeepSysCrvt.Val "MICROSAR RTE" /begin SUB_GROUP /end SUB_GROUP /begin FUNCTION_LIST /end FUNCTION_LIST /begin REF_CHARACTERISTIC /end REF_CHARACTERISTIC /begin REF_MEASUREMENT FordMsg3CABusHiSpd.FordVehLaneKeepSysCrvt.Val /end REF_MEASUREMENT /end GROUP
/begin GROUP FordMsg3CABusHiSpd.FordVehLaneKeepSysCrvtInvldFaildRefTi "MICROSAR RTE" /begin SUB_GROUP /end SUB_GROUP /begin FUNCTION_LIST /end FUNCTION_LIST /begin REF_CHARACTERISTIC /end REF_CHARACTERISTIC /begin REF_MEASUREMENT FordMsg3CABusHiSpd.FordVehLaneKeepSysCrvtInvldFaildRefTi /end REF_MEASUREMENT /end GROUP
/begin GROUP FordMsg3CABusHiSpd.FordVehLaneKeepSysCrvtInvldPassdRefTi "MICROSAR RTE" /begin SUB_GROUP /end SUB_GROUP /begin FUNCTION_LIST /end FUNCTION_LIST /begin REF_CHARACTERISTIC /end REF_CHARACTERISTIC /begin REF_MEASUREMENT FordMsg3CABusHiSpd.FordVehLaneKeepSysCrvtInvldPassdRefTi /end REF_MEASUREMENT /end GROUP
/begin GROUP FordMsg3CABusHiSpd.FordVehLaneKeepSysCrvtPrev "MICROSAR RTE" /begin SUB_GROUP /end SUB_GROUP /begin FUNCTION_LIST /end FUNCTION_LIST /begin REF_CHARACTERISTIC /end REF_CHARACTERISTIC /begin REF_MEASUREMENT FordMsg3CABusHiSpd.FordVehLaneKeepSysCrvtPrev /end REF_MEASUREMENT /end GROUP
/begin GROUP FordMsg3CABusHiSpd.FordVehLaneKeepSysCrvtRaw.Val "MICROSAR RTE" /begin SUB_GROUP /end SUB_GROUP /begin FUNCTION_LIST /end FUNCTION_LIST /begin REF_CHARACTERISTIC /end REF_CHARACTERISTIC /begin REF_MEASUREMENT FordMsg3CABusHiSpd.FordVehLaneKeepSysCrvtRaw.Val /end REF_MEASUREMENT /end GROUP
/begin GROUP FordMsg3CABusHiSpd.FordVehLaneKeepSysCrvtRawPrev "MICROSAR RTE" /begin SUB_GROUP /end SUB_GROUP /begin FUNCTION_LIST /end FUNCTION_LIST /begin REF_CHARACTERISTIC /end REF_CHARACTERISTIC /begin REF_MEASUREMENT FordMsg3CABusHiSpd.FordVehLaneKeepSysCrvtRawPrev /end REF_MEASUREMENT /end GROUP
/begin GROUP FordMsg3CABusHiSpd.FordVehLaneKeepSysRampTyp.Val "MICROSAR RTE" /begin SUB_GROUP /end SUB_GROUP /begin FUNCTION_LIST /end FUNCTION_LIST /begin REF_CHARACTERISTIC /end REF_CHARACTERISTIC /begin REF_MEASUREMENT FordMsg3CABusHiSpd.FordVehLaneKeepSysRampTyp.Val /end REF_MEASUREMENT /end GROUP
/begin GROUP FordMsg3CABusHiSpd.FordVehLaneKeepSysRampTypPrev "MICROSAR RTE" /begin SUB_GROUP /end SUB_GROUP /begin FUNCTION_LIST /end FUNCTION_LIST /begin REF_CHARACTERISTIC /end REF_CHARACTERISTIC /begin REF_MEASUREMENT FordMsg3CABusHiSpd.FordVehLaneKeepSysRampTypPrev /end REF_MEASUREMENT /end GROUP
/begin GROUP FordMsg3CABusHiSpd.FordVehLaneKeepSysReqdAg.Val "MICROSAR RTE" /begin SUB_GROUP /end SUB_GROUP /begin FUNCTION_LIST /end FUNCTION_LIST /begin REF_CHARACTERISTIC /end REF_CHARACTERISTIC /begin REF_MEASUREMENT FordMsg3CABusHiSpd.FordVehLaneKeepSysReqdAg.Val /end REF_MEASUREMENT /end GROUP
/begin GROUP FordMsg3CABusHiSpd.FordVehLaneKeepSysReqdAgInvldPassdRefTi "MICROSAR RTE" /begin SUB_GROUP /end SUB_GROUP /begin FUNCTION_LIST /end FUNCTION_LIST /begin REF_CHARACTERISTIC /end REF_CHARACTERISTIC /begin REF_MEASUREMENT FordMsg3CABusHiSpd.FordVehLaneKeepSysReqdAgInvldPassdRefTi /end REF_MEASUREMENT /end GROUP
/begin GROUP FordMsg3CABusHiSpd.FordVehLaneKeepSysReqdAgPrev "MICROSAR RTE" /begin SUB_GROUP /end SUB_GROUP /begin FUNCTION_LIST /end FUNCTION_LIST /begin REF_CHARACTERISTIC /end REF_CHARACTERISTIC /begin REF_MEASUREMENT FordMsg3CABusHiSpd.FordVehLaneKeepSysReqdAgPrev /end REF_MEASUREMENT /end GROUP
/begin GROUP FordMsg3CABusHiSpd.FordVehLaneKeepSysReqdAgRaw.Val "MICROSAR RTE" /begin SUB_GROUP /end SUB_GROUP /begin FUNCTION_LIST /end FUNCTION_LIST /begin REF_CHARACTERISTIC /end REF_CHARACTERISTIC /begin REF_MEASUREMENT FordMsg3CABusHiSpd.FordVehLaneKeepSysReqdAgRaw.Val /end REF_MEASUREMENT /end GROUP
/begin GROUP FordMsg3CABusHiSpd.FordVehLaneKeepSysReqdAgRawPrev "MICROSAR RTE" /begin SUB_GROUP /end SUB_GROUP /begin FUNCTION_LIST /end FUNCTION_LIST /begin REF_CHARACTERISTIC /end REF_CHARACTERISTIC /begin REF_MEASUREMENT FordMsg3CABusHiSpd.FordVehLaneKeepSysReqdAgRawPrev /end REF_MEASUREMENT /end GROUP
/begin GROUP FordMsg3CABusHiSpd.FordVehLaneKeepSysSts.Val "MICROSAR RTE" /begin SUB_GROUP /end SUB_GROUP /begin FUNCTION_LIST /end FUNCTION_LIST /begin REF_CHARACTERISTIC /end REF_CHARACTERISTIC /begin REF_MEASUREMENT FordMsg3CABusHiSpd.FordVehLaneKeepSysSts.Val /end REF_MEASUREMENT /end GROUP
/begin GROUP FordMsg3CABusHiSpd.FordVehLaneKeepSysStsPrev "MICROSAR RTE" /begin SUB_GROUP /end SUB_GROUP /begin FUNCTION_LIST /end FUNCTION_LIST /begin REF_CHARACTERISTIC /end REF_CHARACTERISTIC /begin REF_MEASUREMENT FordMsg3CABusHiSpd.FordVehLaneKeepSysStsPrev /end REF_MEASUREMENT /end GROUP
/begin GROUP FordMsg3CABusHiSpd.FordVehMsg3CAMiss "MICROSAR RTE" /begin SUB_GROUP /end SUB_GROUP /begin FUNCTION_LIST /end FUNCTION_LIST /begin REF_CHARACTERISTIC /end REF_CHARACTERISTIC /begin REF_MEASUREMENT FordMsg3CABusHiSpd.FordVehMsg3CAMiss /end REF_MEASUREMENT /end GROUP
/begin GROUP FordMsg3CABusHiSpd.LaneAssiImgProcgModlAFaildCrvtTiThd "MICROSAR RTE" /begin SUB_GROUP /end SUB_GROUP /begin FUNCTION_LIST /end FUNCTION_LIST /begin REF_CHARACTERISTIC /end REF_CHARACTERISTIC /begin REF_MEASUREMENT FordMsg3CABusHiSpd.LaneAssiImgProcgModlAFaildCrvtTiThd /end REF_MEASUREMENT /end GROUP
/begin GROUP FordMsg3CABusHiSpd.LaneAssiImgProcgModlAFaildReqdAgTiThd "MICROSAR RTE" /begin SUB_GROUP /end SUB_GROUP /begin FUNCTION_LIST /end FUNCTION_LIST /begin REF_CHARACTERISTIC /end REF_CHARACTERISTIC /begin REF_MEASUREMENT FordMsg3CABusHiSpd.LaneAssiImgProcgModlAFaildReqdAgTiThd /end REF_MEASUREMENT /end GROUP
/begin GROUP FordMsg3CABusHiSpd.LaneAssiImgProcgModlAVldMissRefTi "MICROSAR RTE" /begin SUB_GROUP /end SUB_GROUP /begin FUNCTION_LIST /end FUNCTION_LIST /begin REF_CHARACTERISTIC /end REF_CHARACTERISTIC /begin REF_MEASUREMENT FordMsg3CABusHiSpd.LaneAssiImgProcgModlAVldMissRefTi /end REF_MEASUREMENT /end GROUP
/begin GROUP FordMsg3CABusHiSpd.LaneAssiImgProcgModlAVldPassdRefTi "MICROSAR RTE" /begin SUB_GROUP /end SUB_GROUP /begin FUNCTION_LIST /end FUNCTION_LIST /begin REF_CHARACTERISTIC /end REF_CHARACTERISTIC /begin REF_MEASUREMENT FordMsg3CABusHiSpd.LaneAssiImgProcgModlAVldPassdRefTi /end REF_MEASUREMENT /end GROUP
/begin GROUP FordMsg3CABusHiSpd.LaneKeepSysReqdAgInvldFaildRefTi "MICROSAR RTE" /begin SUB_GROUP /end SUB_GROUP /begin FUNCTION_LIST /end FUNCTION_LIST /begin REF_CHARACTERISTIC /end REF_CHARACTERISTIC /begin REF_MEASUREMENT FordMsg3CABusHiSpd.LaneKeepSysReqdAgInvldFaildRefTi /end REF_MEASUREMENT /end GROUP
/begin GROUP FordMsg3CABusHiSpd.MissMsgFaildRefTi "MICROSAR RTE" /begin SUB_GROUP /end SUB_GROUP /begin FUNCTION_LIST /end FUNCTION_LIST /begin REF_CHARACTERISTIC /end REF_CHARACTERISTIC /begin REF_MEASUREMENT FordMsg3CABusHiSpd.MissMsgFaildRefTi /end REF_MEASUREMENT /end GROUP
/begin GROUP FordMsg3CABusHiSpd.MissMsgPassdRefTi "MICROSAR RTE" /begin SUB_GROUP /end SUB_GROUP /begin FUNCTION_LIST /end FUNCTION_LIST /begin REF_CHARACTERISTIC /end REF_CHARACTERISTIC /begin REF_MEASUREMENT FordMsg3CABusHiSpd.MissMsgPassdRefTi /end REF_MEASUREMENT /end GROUP
/begin GROUP FordMsg3CABusHiSpd.PerInstanceMemories "MICROSAR RTE"
 /begin SUB_GROUP FordMsg3CABusHiSpd.ClrDiagcFlgProxyPrev FordMsg3CABusHiSpd.FirstTranVldFlg FordMsg3CABusHiSpd.FordVehLaneAssiImgProcgModlAVldPrev FordMsg3CABusHiSpd.FordVehLaneDetnWarnIntenPrev FordMsg3CABusHiSpd.FordVehLaneDetnWarnStsPrev FordMsg3CABusHiSpd.FordVehLaneKeepSysCrvtInvldFaildRefTi FordMsg3CABusHiSpd.FordVehLaneKeepSysCrvtInvldPassdRefTi FordMsg3CABusHiSpd.FordVehLaneKeepSysCrvtPrev FordMsg3CABusHiSpd.FordVehLaneKeepSysCrvtRawPrev FordMsg3CABusHiSpd.FordVehLaneKeepSysRampTypPrev FordMsg3CABusHiSpd.FordVehLaneKeepSysReqdAgInvldPassdRefTi FordMsg3CABusHiSpd.FordVehLaneKeepSysReqdAgPrev FordMsg3CABusHiSpd.FordVehLaneKeepSysReqdAgRawPrev FordMsg3CABusHiSpd.FordVehLaneKeepSysStsPrev FordMsg3CABusHiSpd.FordVehMsg3CAMiss FordMsg3CABusHiSpd.LaneAssiImgProcgModlAFaildCrvtTiThd FordMsg3CABusHiSpd.LaneAssiImgProcgModlAFaildReqdAgTiThd FordMsg3CABusHiSpd.LaneAssiImgProcgModlAVldMissRefTi FordMsg3CABusHiSpd.LaneAssiImgProcgModlAVldPassdRefTi FordMsg3CABusHiSpd.LaneKeepSysReqdAgInvldFaildRefTi FordMsg3CABusHiSpd.MissMsgFaildRefTi FordMsg3CABusHiSpd.MissMsgPassdRefTi /end SUB_GROUP
 /begin FUNCTION_LIST /end FUNCTION_LIST
 /begin REF_CHARACTERISTIC /end REF_CHARACTERISTIC
 /begin REF_MEASUREMENT /end REF_MEASUREMENT
/end GROUP
/begin GROUP FordMsg3CABusHiSpd.ReceiverPorts "MICROSAR RTE"
 /begin SUB_GROUP FordMsg3CABusHiSpd.ClrDiagcFlgProxy.Val FordMsg3CABusHiSpd.FordCanDtcInhb.Logl FordMsg3CABusHiSpd.FordEpsLifeCycMod.Val FordMsg3CABusHiSpd.FordLaneDetnWarnEnad.Logl FordMsg3CABusHiSpd.FordLaneKeepAssiEnad.Logl /end SUB_GROUP
 /begin FUNCTION_LIST /end FUNCTION_LIST
 /begin REF_CHARACTERISTIC /end REF_CHARACTERISTIC
 /begin REF_MEASUREMENT /end REF_MEASUREMENT
/end GROUP
/begin GROUP FordMsg3CABusHiSpd.SenderPorts "MICROSAR RTE"
 /begin SUB_GROUP FordMsg3CABusHiSpd.FordVehLaneAssiImgProcgModlAVld.Logl FordMsg3CABusHiSpd.FordVehLaneDetnWarnInten.Val FordMsg3CABusHiSpd.FordVehLaneDetnWarnSts.Val FordMsg3CABusHiSpd.FordVehLaneKeepSysCrvt.Val FordMsg3CABusHiSpd.FordVehLaneKeepSysCrvtRaw.Val FordMsg3CABusHiSpd.FordVehLaneKeepSysRampTyp.Val FordMsg3CABusHiSpd.FordVehLaneKeepSysReqdAg.Val FordMsg3CABusHiSpd.FordVehLaneKeepSysReqdAgRaw.Val FordMsg3CABusHiSpd.FordVehLaneKeepSysSts.Val /end SUB_GROUP
 /begin FUNCTION_LIST /end FUNCTION_LIST
 /begin REF_CHARACTERISTIC /end REF_CHARACTERISTIC
 /begin REF_MEASUREMENT /end REF_MEASUREMENT
/end GROUP
/begin GROUP FordMsg3CCBusHiSpd "MICROSAR RTE" /begin SUB_GROUP FordMsg3CCBusHiSpd.ReceiverPorts /end SUB_GROUP /begin FUNCTION_LIST /end FUNCTION_LIST /begin REF_CHARACTERISTIC /end REF_CHARACTERISTIC /begin REF_MEASUREMENT /end REF_MEASUREMENT /end GROUP
/begin GROUP FordMsg3CCBusHiSpd.FordVehLaneAssiAvl.Val "MICROSAR RTE" /begin SUB_GROUP /end SUB_GROUP /begin FUNCTION_LIST /end FUNCTION_LIST /begin REF_CHARACTERISTIC /end REF_CHARACTERISTIC /begin REF_MEASUREMENT FordMsg3CCBusHiSpd.FordVehLaneAssiAvl.Val /end REF_MEASUREMENT /end GROUP
/begin GROUP FordMsg3CCBusHiSpd.FordVehLaneAssiHandsOff.Val "MICROSAR RTE" /begin SUB_GROUP /end SUB_GROUP /begin FUNCTION_LIST /end FUNCTION_LIST /begin REF_CHARACTERISTIC /end REF_CHARACTERISTIC /begin REF_MEASUREMENT FordMsg3CCBusHiSpd.FordVehLaneAssiHandsOff.Val /end REF_MEASUREMENT /end GROUP
/begin GROUP FordMsg3CCBusHiSpd.FordVehLaneAssiRejctn.Val "MICROSAR RTE" /begin SUB_GROUP /end SUB_GROUP /begin FUNCTION_LIST /end FUNCTION_LIST /begin REF_CHARACTERISTIC /end REF_CHARACTERISTIC /begin REF_MEASUREMENT FordMsg3CCBusHiSpd.FordVehLaneAssiRejctn.Val /end REF_MEASUREMENT /end GROUP
/begin GROUP FordMsg3CCBusHiSpd.FordVehLoSpdMtnCtrlBrkDecelEna.Val "MICROSAR RTE" /begin SUB_GROUP /end SUB_GROUP /begin FUNCTION_LIST /end FUNCTION_LIST /begin REF_CHARACTERISTIC /end REF_CHARACTERISTIC /begin REF_MEASUREMENT FordMsg3CCBusHiSpd.FordVehLoSpdMtnCtrlBrkDecelEna.Val /end REF_MEASUREMENT /end GROUP
/begin GROUP FordMsg3CCBusHiSpd.FordVehLoSpdMtnCtrlBrkTqReq.Val "MICROSAR RTE" /begin SUB_GROUP /end SUB_GROUP /begin FUNCTION_LIST /end FUNCTION_LIST /begin REF_CHARACTERISTIC /end REF_CHARACTERISTIC /begin REF_MEASUREMENT FordMsg3CCBusHiSpd.FordVehLoSpdMtnCtrlBrkTqReq.Val /end REF_MEASUREMENT /end GROUP
/begin GROUP FordMsg3CCBusHiSpd.FordVehTrfcJamAvdHandsOnConf.Val "MICROSAR RTE" /begin SUB_GROUP /end SUB_GROUP /begin FUNCTION_LIST /end FUNCTION_LIST /begin REF_CHARACTERISTIC /end REF_CHARACTERISTIC /begin REF_MEASUREMENT FordMsg3CCBusHiSpd.FordVehTrfcJamAvdHandsOnConf.Val /end REF_MEASUREMENT /end GROUP
/begin GROUP FordMsg3CCBusHiSpd.FordVehTrlrAgTarCalcn.Val "MICROSAR RTE" /begin SUB_GROUP /end SUB_GROUP /begin FUNCTION_LIST /end FUNCTION_LIST /begin REF_CHARACTERISTIC /end REF_CHARACTERISTIC /begin REF_MEASUREMENT FordMsg3CCBusHiSpd.FordVehTrlrAgTarCalcn.Val /end REF_MEASUREMENT /end GROUP
/begin GROUP FordMsg3CCBusHiSpd.ReceiverPorts "MICROSAR RTE"
 /begin SUB_GROUP FordMsg3CCBusHiSpd.FordVehLaneAssiAvl.Val FordMsg3CCBusHiSpd.FordVehLaneAssiHandsOff.Val FordMsg3CCBusHiSpd.FordVehLaneAssiRejctn.Val FordMsg3CCBusHiSpd.FordVehLoSpdMtnCtrlBrkDecelEna.Val FordMsg3CCBusHiSpd.FordVehLoSpdMtnCtrlBrkTqReq.Val FordMsg3CCBusHiSpd.FordVehTrfcJamAvdHandsOnConf.Val FordMsg3CCBusHiSpd.FordVehTrlrAgTarCalcn.Val /end SUB_GROUP
 /begin FUNCTION_LIST /end FUNCTION_LIST
 /begin REF_CHARACTERISTIC /end REF_CHARACTERISTIC
 /begin REF_MEASUREMENT /end REF_MEASUREMENT
/end GROUP
/begin GROUP FordMsg3D3BusHiSpd "MICROSAR RTE"
 /begin SUB_GROUP FordMsg3D3BusHiSpd.CalibrationPorts FordMsg3D3BusHiSpd.PerInstanceMemories FordMsg3D3BusHiSpd.ReceiverPorts FordMsg3D3BusHiSpd.SenderPorts /end SUB_GROUP
 /begin FUNCTION_LIST /end FUNCTION_LIST
 /begin REF_CHARACTERISTIC /end REF_CHARACTERISTIC
 /begin REF_MEASUREMENT /end REF_MEASUREMENT
/end GROUP
/begin GROUP FordMsg3D3BusHiSpd.CalibrationPorts "MICROSAR RTE"
 /begin SUB_GROUP FordMsg3D3BusHiSpd.FordMsg3D3BusHiSpdImgProcrModlAVldFaildThd.Val FordMsg3D3BusHiSpd.FordMsg3D3BusHiSpdImgProcrModlAVldPassdThd.Val FordMsg3D3BusHiSpd.FordMsg3D3BusHiSpdMissMsgFaildThd.Val FordMsg3D3BusHiSpd.FordMsg3D3BusHiSpdMissMsgPassdThd.Val /end SUB_GROUP
 /begin FUNCTION_LIST /end FUNCTION_LIST
 /begin REF_CHARACTERISTIC /end REF_CHARACTERISTIC
 /begin REF_MEASUREMENT /end REF_MEASUREMENT
/end GROUP
/begin GROUP FordMsg3D3BusHiSpd.ClrDiagcFlgProxy.Val "MICROSAR RTE" /begin SUB_GROUP /end SUB_GROUP /begin FUNCTION_LIST /end FUNCTION_LIST /begin REF_CHARACTERISTIC /end REF_CHARACTERISTIC /begin REF_MEASUREMENT FordMsg3D3BusHiSpd.ClrDiagcFlgProxy.Val /end REF_MEASUREMENT /end GROUP
/begin GROUP FordMsg3D3BusHiSpd.ClrDiagcFlgProxyPrev "MICROSAR RTE" /begin SUB_GROUP /end SUB_GROUP /begin FUNCTION_LIST /end FUNCTION_LIST /begin REF_CHARACTERISTIC /end REF_CHARACTERISTIC /begin REF_MEASUREMENT FordMsg3D3BusHiSpd.ClrDiagcFlgProxyPrev /end REF_MEASUREMENT /end GROUP
/begin GROUP FordMsg3D3BusHiSpd.FirstTranVldFlg "MICROSAR RTE" /begin SUB_GROUP /end SUB_GROUP /begin FUNCTION_LIST /end FUNCTION_LIST /begin REF_CHARACTERISTIC /end REF_CHARACTERISTIC /begin REF_MEASUREMENT FordMsg3D3BusHiSpd.FirstTranVldFlg /end REF_MEASUREMENT /end GROUP
/begin GROUP FordMsg3D3BusHiSpd.FordCanDtcInhb.Logl "MICROSAR RTE" /begin SUB_GROUP /end SUB_GROUP /begin FUNCTION_LIST /end FUNCTION_LIST /begin REF_CHARACTERISTIC /end REF_CHARACTERISTIC /begin REF_MEASUREMENT FordMsg3D3BusHiSpd.FordCanDtcInhb.Logl /end REF_MEASUREMENT /end GROUP
/begin GROUP FordMsg3D3BusHiSpd.FordEpsLifeCycMod.Val "MICROSAR RTE" /begin SUB_GROUP /end SUB_GROUP /begin FUNCTION_LIST /end FUNCTION_LIST /begin REF_CHARACTERISTIC /end REF_CHARACTERISTIC /begin REF_MEASUREMENT FordMsg3D3BusHiSpd.FordEpsLifeCycMod.Val /end REF_MEASUREMENT /end GROUP
/begin GROUP FordMsg3D3BusHiSpd.FordLaneCentrAssiEnad.Logl "MICROSAR RTE" /begin SUB_GROUP /end SUB_GROUP /begin FUNCTION_LIST /end FUNCTION_LIST /begin REF_CHARACTERISTIC /end REF_CHARACTERISTIC /begin REF_MEASUREMENT FordMsg3D3BusHiSpd.FordLaneCentrAssiEnad.Logl /end REF_MEASUREMENT /end GROUP
/begin GROUP FordMsg3D3BusHiSpd.FordMsg3D3BusHiSpdImgProcrModlAVldFaildThd.Val "MICROSAR RTE" /begin SUB_GROUP /end SUB_GROUP /begin FUNCTION_LIST /end FUNCTION_LIST
 /begin REF_CHARACTERISTIC FordMsg3D3BusHiSpd.FordMsg3D3BusHiSpdImgProcrModlAVldFaildThd.Val /end REF_CHARACTERISTIC
 /begin REF_MEASUREMENT /end REF_MEASUREMENT
/end GROUP
/begin GROUP FordMsg3D3BusHiSpd.FordMsg3D3BusHiSpdImgProcrModlAVldPassdThd.Val "MICROSAR RTE" /begin SUB_GROUP /end SUB_GROUP /begin FUNCTION_LIST /end FUNCTION_LIST
 /begin REF_CHARACTERISTIC FordMsg3D3BusHiSpd.FordMsg3D3BusHiSpdImgProcrModlAVldPassdThd.Val /end REF_CHARACTERISTIC
 /begin REF_MEASUREMENT /end REF_MEASUREMENT
/end GROUP
/begin GROUP FordMsg3D3BusHiSpd.FordMsg3D3BusHiSpdMissMsgFaildThd.Val "MICROSAR RTE" /begin SUB_GROUP /end SUB_GROUP /begin FUNCTION_LIST /end FUNCTION_LIST /begin REF_CHARACTERISTIC FordMsg3D3BusHiSpd.FordMsg3D3BusHiSpdMissMsgFaildThd.Val /end REF_CHARACTERISTIC /begin REF_MEASUREMENT /end REF_MEASUREMENT /end GROUP
/begin GROUP FordMsg3D3BusHiSpd.FordMsg3D3BusHiSpdMissMsgPassdThd.Val "MICROSAR RTE" /begin SUB_GROUP /end SUB_GROUP /begin FUNCTION_LIST /end FUNCTION_LIST /begin REF_CHARACTERISTIC FordMsg3D3BusHiSpd.FordMsg3D3BusHiSpdMissMsgPassdThd.Val /end REF_CHARACTERISTIC /begin REF_MEASUREMENT /end REF_MEASUREMENT /end GROUP
/begin GROUP FordMsg3D3BusHiSpd.FordTrfcJamAssiEnad.Logl "MICROSAR RTE" /begin SUB_GROUP /end SUB_GROUP /begin FUNCTION_LIST /end FUNCTION_LIST /begin REF_CHARACTERISTIC /end REF_CHARACTERISTIC /begin REF_MEASUREMENT FordMsg3D3BusHiSpd.FordTrfcJamAssiEnad.Logl /end REF_MEASUREMENT /end GROUP
/begin GROUP FordMsg3D3BusHiSpd.FordVehLatCtrlCrvt.Val "MICROSAR RTE" /begin SUB_GROUP /end SUB_GROUP /begin FUNCTION_LIST /end FUNCTION_LIST /begin REF_CHARACTERISTIC /end REF_CHARACTERISTIC /begin REF_MEASUREMENT FordMsg3D3BusHiSpd.FordVehLatCtrlCrvt.Val /end REF_MEASUREMENT /end GROUP
/begin GROUP FordMsg3D3BusHiSpd.FordVehLatCtrlCrvtPrev "MICROSAR RTE" /begin SUB_GROUP /end SUB_GROUP /begin FUNCTION_LIST /end FUNCTION_LIST /begin REF_CHARACTERISTIC /end REF_CHARACTERISTIC /begin REF_MEASUREMENT FordMsg3D3BusHiSpd.FordVehLatCtrlCrvtPrev /end REF_MEASUREMENT /end GROUP
/begin GROUP FordMsg3D3BusHiSpd.FordVehLatCtrlCrvtRate.Val "MICROSAR RTE" /begin SUB_GROUP /end SUB_GROUP /begin FUNCTION_LIST /end FUNCTION_LIST /begin REF_CHARACTERISTIC /end REF_CHARACTERISTIC /begin REF_MEASUREMENT FordMsg3D3BusHiSpd.FordVehLatCtrlCrvtRate.Val /end REF_MEASUREMENT /end GROUP
/begin GROUP FordMsg3D3BusHiSpd.FordVehLatCtrlCrvtRatePrev "MICROSAR RTE" /begin SUB_GROUP /end SUB_GROUP /begin FUNCTION_LIST /end FUNCTION_LIST /begin REF_CHARACTERISTIC /end REF_CHARACTERISTIC /begin REF_MEASUREMENT FordMsg3D3BusHiSpd.FordVehLatCtrlCrvtRatePrev /end REF_MEASUREMENT /end GROUP
/begin GROUP FordMsg3D3BusHiSpd.FordVehLatCtrlCrvtRateRaw.Val "MICROSAR RTE" /begin SUB_GROUP /end SUB_GROUP /begin FUNCTION_LIST /end FUNCTION_LIST /begin REF_CHARACTERISTIC /end REF_CHARACTERISTIC /begin REF_MEASUREMENT FordMsg3D3BusHiSpd.FordVehLatCtrlCrvtRateRaw.Val /end REF_MEASUREMENT /end GROUP
/begin GROUP FordMsg3D3BusHiSpd.FordVehLatCtrlCrvtRateRawPrev "MICROSAR RTE" /begin SUB_GROUP /end SUB_GROUP /begin FUNCTION_LIST /end FUNCTION_LIST /begin REF_CHARACTERISTIC /end REF_CHARACTERISTIC /begin REF_MEASUREMENT FordMsg3D3BusHiSpd.FordVehLatCtrlCrvtRateRawPrev /end REF_MEASUREMENT /end GROUP
/begin GROUP FordMsg3D3BusHiSpd.FordVehLatCtrlCrvtRaw.Val "MICROSAR RTE" /begin SUB_GROUP /end SUB_GROUP /begin FUNCTION_LIST /end FUNCTION_LIST /begin REF_CHARACTERISTIC /end REF_CHARACTERISTIC /begin REF_MEASUREMENT FordMsg3D3BusHiSpd.FordVehLatCtrlCrvtRaw.Val /end REF_MEASUREMENT /end GROUP
/begin GROUP FordMsg3D3BusHiSpd.FordVehLatCtrlCrvtRawPrev "MICROSAR RTE" /begin SUB_GROUP /end SUB_GROUP /begin FUNCTION_LIST /end FUNCTION_LIST /begin REF_CHARACTERISTIC /end REF_CHARACTERISTIC /begin REF_MEASUREMENT FordMsg3D3BusHiSpd.FordVehLatCtrlCrvtRawPrev /end REF_MEASUREMENT /end GROUP
/begin GROUP FordMsg3D3BusHiSpd.FordVehLatCtrlHandsOffDetnTqStimlsReq.Val "MICROSAR RTE" /begin SUB_GROUP /end SUB_GROUP /begin FUNCTION_LIST /end FUNCTION_LIST /begin REF_CHARACTERISTIC /end REF_CHARACTERISTIC
 /begin REF_MEASUREMENT FordMsg3D3BusHiSpd.FordVehLatCtrlHandsOffDetnTqStimlsReq.Val /end REF_MEASUREMENT
/end GROUP
/begin GROUP FordMsg3D3BusHiSpd.FordVehLatCtrlHandsOffDetnTqStimlsReqPrev "MICROSAR RTE" /begin SUB_GROUP /end SUB_GROUP /begin FUNCTION_LIST /end FUNCTION_LIST /begin REF_CHARACTERISTIC /end REF_CHARACTERISTIC
 /begin REF_MEASUREMENT FordMsg3D3BusHiSpd.FordVehLatCtrlHandsOffDetnTqStimlsReqPrev /end REF_MEASUREMENT
/end GROUP
/begin GROUP FordMsg3D3BusHiSpd.FordVehLatCtrlImgProcrModlAVld.Logl "MICROSAR RTE" /begin SUB_GROUP /end SUB_GROUP /begin FUNCTION_LIST /end FUNCTION_LIST /begin REF_CHARACTERISTIC /end REF_CHARACTERISTIC /begin REF_MEASUREMENT FordMsg3D3BusHiSpd.FordVehLatCtrlImgProcrModlAVld.Logl /end REF_MEASUREMENT /end GROUP
/begin GROUP FordMsg3D3BusHiSpd.FordVehLatCtrlImgProcrModlAVldPrev "MICROSAR RTE" /begin SUB_GROUP /end SUB_GROUP /begin FUNCTION_LIST /end FUNCTION_LIST /begin REF_CHARACTERISTIC /end REF_CHARACTERISTIC /begin REF_MEASUREMENT FordMsg3D3BusHiSpd.FordVehLatCtrlImgProcrModlAVldPrev /end REF_MEASUREMENT /end GROUP
/begin GROUP FordMsg3D3BusHiSpd.FordVehLatCtrlPah.Val "MICROSAR RTE" /begin SUB_GROUP /end SUB_GROUP /begin FUNCTION_LIST /end FUNCTION_LIST /begin REF_CHARACTERISTIC /end REF_CHARACTERISTIC /begin REF_MEASUREMENT FordMsg3D3BusHiSpd.FordVehLatCtrlPah.Val /end REF_MEASUREMENT /end GROUP
/begin GROUP FordMsg3D3BusHiSpd.FordVehLatCtrlPahOffs.Val "MICROSAR RTE" /begin SUB_GROUP /end SUB_GROUP /begin FUNCTION_LIST /end FUNCTION_LIST /begin REF_CHARACTERISTIC /end REF_CHARACTERISTIC /begin REF_MEASUREMENT FordMsg3D3BusHiSpd.FordVehLatCtrlPahOffs.Val /end REF_MEASUREMENT /end GROUP
/begin GROUP FordMsg3D3BusHiSpd.FordVehLatCtrlPahOffsPrev "MICROSAR RTE" /begin SUB_GROUP /end SUB_GROUP /begin FUNCTION_LIST /end FUNCTION_LIST /begin REF_CHARACTERISTIC /end REF_CHARACTERISTIC /begin REF_MEASUREMENT FordMsg3D3BusHiSpd.FordVehLatCtrlPahOffsPrev /end REF_MEASUREMENT /end GROUP
/begin GROUP FordMsg3D3BusHiSpd.FordVehLatCtrlPahOffsRaw.Val "MICROSAR RTE" /begin SUB_GROUP /end SUB_GROUP /begin FUNCTION_LIST /end FUNCTION_LIST /begin REF_CHARACTERISTIC /end REF_CHARACTERISTIC /begin REF_MEASUREMENT FordMsg3D3BusHiSpd.FordVehLatCtrlPahOffsRaw.Val /end REF_MEASUREMENT /end GROUP
/begin GROUP FordMsg3D3BusHiSpd.FordVehLatCtrlPahOffsRawPrev "MICROSAR RTE" /begin SUB_GROUP /end SUB_GROUP /begin FUNCTION_LIST /end FUNCTION_LIST /begin REF_CHARACTERISTIC /end REF_CHARACTERISTIC /begin REF_MEASUREMENT FordMsg3D3BusHiSpd.FordVehLatCtrlPahOffsRawPrev /end REF_MEASUREMENT /end GROUP
/begin GROUP FordMsg3D3BusHiSpd.FordVehLatCtrlPahPrev "MICROSAR RTE" /begin SUB_GROUP /end SUB_GROUP /begin FUNCTION_LIST /end FUNCTION_LIST /begin REF_CHARACTERISTIC /end REF_CHARACTERISTIC /begin REF_MEASUREMENT FordMsg3D3BusHiSpd.FordVehLatCtrlPahPrev /end REF_MEASUREMENT /end GROUP
/begin GROUP FordMsg3D3BusHiSpd.FordVehLatCtrlPahRaw.Val "MICROSAR RTE" /begin SUB_GROUP /end SUB_GROUP /begin FUNCTION_LIST /end FUNCTION_LIST /begin REF_CHARACTERISTIC /end REF_CHARACTERISTIC /begin REF_MEASUREMENT FordMsg3D3BusHiSpd.FordVehLatCtrlPahRaw.Val /end REF_MEASUREMENT /end GROUP
/begin GROUP FordMsg3D3BusHiSpd.FordVehLatCtrlPahRawPrev "MICROSAR RTE" /begin SUB_GROUP /end SUB_GROUP /begin FUNCTION_LIST /end FUNCTION_LIST /begin REF_CHARACTERISTIC /end REF_CHARACTERISTIC /begin REF_MEASUREMENT FordMsg3D3BusHiSpd.FordVehLatCtrlPahRawPrev /end REF_MEASUREMENT /end GROUP
/begin GROUP FordMsg3D3BusHiSpd.FordVehLatCtrlPrcsn.Val "MICROSAR RTE" /begin SUB_GROUP /end SUB_GROUP /begin FUNCTION_LIST /end FUNCTION_LIST /begin REF_CHARACTERISTIC /end REF_CHARACTERISTIC /begin REF_MEASUREMENT FordMsg3D3BusHiSpd.FordVehLatCtrlPrcsn.Val /end REF_MEASUREMENT /end GROUP
/begin GROUP FordMsg3D3BusHiSpd.FordVehLatCtrlPrcsnPrev "MICROSAR RTE" /begin SUB_GROUP /end SUB_GROUP /begin FUNCTION_LIST /end FUNCTION_LIST /begin REF_CHARACTERISTIC /end REF_CHARACTERISTIC /begin REF_MEASUREMENT FordMsg3D3BusHiSpd.FordVehLatCtrlPrcsnPrev /end REF_MEASUREMENT /end GROUP
/begin GROUP FordMsg3D3BusHiSpd.FordVehLatCtrlRampTyp.Val "MICROSAR RTE" /begin SUB_GROUP /end SUB_GROUP /begin FUNCTION_LIST /end FUNCTION_LIST /begin REF_CHARACTERISTIC /end REF_CHARACTERISTIC /begin REF_MEASUREMENT FordMsg3D3BusHiSpd.FordVehLatCtrlRampTyp.Val /end REF_MEASUREMENT /end GROUP
/begin GROUP FordMsg3D3BusHiSpd.FordVehLatCtrlRampTypPrev "MICROSAR RTE" /begin SUB_GROUP /end SUB_GROUP /begin FUNCTION_LIST /end FUNCTION_LIST /begin REF_CHARACTERISTIC /end REF_CHARACTERISTIC /begin REF_MEASUREMENT FordMsg3D3BusHiSpd.FordVehLatCtrlRampTypPrev /end REF_MEASUREMENT /end GROUP
/begin GROUP FordMsg3D3BusHiSpd.FordVehLatCtrlReq.Val "MICROSAR RTE" /begin SUB_GROUP /end SUB_GROUP /begin FUNCTION_LIST /end FUNCTION_LIST /begin REF_CHARACTERISTIC /end REF_CHARACTERISTIC /begin REF_MEASUREMENT FordMsg3D3BusHiSpd.FordVehLatCtrlReq.Val /end REF_MEASUREMENT /end GROUP
/begin GROUP FordMsg3D3BusHiSpd.FordVehLatCtrlReqPrev "MICROSAR RTE" /begin SUB_GROUP /end SUB_GROUP /begin FUNCTION_LIST /end FUNCTION_LIST /begin REF_CHARACTERISTIC /end REF_CHARACTERISTIC /begin REF_MEASUREMENT FordMsg3D3BusHiSpd.FordVehLatCtrlReqPrev /end REF_MEASUREMENT /end GROUP
/begin GROUP FordMsg3D3BusHiSpd.FordVehLatCtrlRingMax.Val "MICROSAR RTE" /begin SUB_GROUP /end SUB_GROUP /begin FUNCTION_LIST /end FUNCTION_LIST /begin REF_CHARACTERISTIC /end REF_CHARACTERISTIC /begin REF_MEASUREMENT FordMsg3D3BusHiSpd.FordVehLatCtrlRingMax.Val /end REF_MEASUREMENT /end GROUP
/begin GROUP FordMsg3D3BusHiSpd.FordVehLatCtrlRingMaxPrev "MICROSAR RTE" /begin SUB_GROUP /end SUB_GROUP /begin FUNCTION_LIST /end FUNCTION_LIST /begin REF_CHARACTERISTIC /end REF_CHARACTERISTIC /begin REF_MEASUREMENT FordMsg3D3BusHiSpd.FordVehLatCtrlRingMaxPrev /end REF_MEASUREMENT /end GROUP
/begin GROUP FordMsg3D3BusHiSpd.FordVehMsg3D3Miss "MICROSAR RTE" /begin SUB_GROUP /end SUB_GROUP /begin FUNCTION_LIST /end FUNCTION_LIST /begin REF_CHARACTERISTIC /end REF_CHARACTERISTIC /begin REF_MEASUREMENT FordMsg3D3BusHiSpd.FordVehMsg3D3Miss /end REF_MEASUREMENT /end GROUP
/begin GROUP FordMsg3D3BusHiSpd.ImgProcrModlAVldFaildRefTi "MICROSAR RTE" /begin SUB_GROUP /end SUB_GROUP /begin FUNCTION_LIST /end FUNCTION_LIST /begin REF_CHARACTERISTIC /end REF_CHARACTERISTIC /begin REF_MEASUREMENT FordMsg3D3BusHiSpd.ImgProcrModlAVldFaildRefTi /end REF_MEASUREMENT /end GROUP
/begin GROUP FordMsg3D3BusHiSpd.ImgProcrModlAVldPassdRefTi "MICROSAR RTE" /begin SUB_GROUP /end SUB_GROUP /begin FUNCTION_LIST /end FUNCTION_LIST /begin REF_CHARACTERISTIC /end REF_CHARACTERISTIC /begin REF_MEASUREMENT FordMsg3D3BusHiSpd.ImgProcrModlAVldPassdRefTi /end REF_MEASUREMENT /end GROUP
/begin GROUP FordMsg3D3BusHiSpd.MissMsgFaildRefTi "MICROSAR RTE" /begin SUB_GROUP /end SUB_GROUP /begin FUNCTION_LIST /end FUNCTION_LIST /begin REF_CHARACTERISTIC /end REF_CHARACTERISTIC /begin REF_MEASUREMENT FordMsg3D3BusHiSpd.MissMsgFaildRefTi /end REF_MEASUREMENT /end GROUP
/begin GROUP FordMsg3D3BusHiSpd.MissMsgPassdRefTi "MICROSAR RTE" /begin SUB_GROUP /end SUB_GROUP /begin FUNCTION_LIST /end FUNCTION_LIST /begin REF_CHARACTERISTIC /end REF_CHARACTERISTIC /begin REF_MEASUREMENT FordMsg3D3BusHiSpd.MissMsgPassdRefTi /end REF_MEASUREMENT /end GROUP
/begin GROUP FordMsg3D3BusHiSpd.PerInstanceMemories "MICROSAR RTE"
 /begin SUB_GROUP FordMsg3D3BusHiSpd.ClrDiagcFlgProxyPrev FordMsg3D3BusHiSpd.FirstTranVldFlg FordMsg3D3BusHiSpd.FordVehLatCtrlCrvtPrev FordMsg3D3BusHiSpd.FordVehLatCtrlCrvtRatePrev FordMsg3D3BusHiSpd.FordVehLatCtrlCrvtRateRawPrev FordMsg3D3BusHiSpd.FordVehLatCtrlCrvtRawPrev FordMsg3D3BusHiSpd.FordVehLatCtrlHandsOffDetnTqStimlsReqPrev FordMsg3D3BusHiSpd.FordVehLatCtrlImgProcrModlAVldPrev FordMsg3D3BusHiSpd.FordVehLatCtrlPahOffsPrev FordMsg3D3BusHiSpd.FordVehLatCtrlPahOffsRawPrev FordMsg3D3BusHiSpd.FordVehLatCtrlPahPrev FordMsg3D3BusHiSpd.FordVehLatCtrlPahRawPrev FordMsg3D3BusHiSpd.FordVehLatCtrlPrcsnPrev FordMsg3D3BusHiSpd.FordVehLatCtrlRampTypPrev FordMsg3D3BusHiSpd.FordVehLatCtrlReqPrev FordMsg3D3BusHiSpd.FordVehLatCtrlRingMaxPrev FordMsg3D3BusHiSpd.FordVehMsg3D3Miss FordMsg3D3BusHiSpd.ImgProcrModlAVldFaildRefTi FordMsg3D3BusHiSpd.ImgProcrModlAVldPassdRefTi FordMsg3D3BusHiSpd.MissMsgFaildRefTi FordMsg3D3BusHiSpd.MissMsgPassdRefTi /end SUB_GROUP
 /begin FUNCTION_LIST /end FUNCTION_LIST
 /begin REF_CHARACTERISTIC /end REF_CHARACTERISTIC
 /begin REF_MEASUREMENT /end REF_MEASUREMENT
/end GROUP
/begin GROUP FordMsg3D3BusHiSpd.ReceiverPorts "MICROSAR RTE"
 /begin SUB_GROUP FordMsg3D3BusHiSpd.ClrDiagcFlgProxy.Val FordMsg3D3BusHiSpd.FordCanDtcInhb.Logl FordMsg3D3BusHiSpd.FordEpsLifeCycMod.Val FordMsg3D3BusHiSpd.FordLaneCentrAssiEnad.Logl FordMsg3D3BusHiSpd.FordTrfcJamAssiEnad.Logl /end SUB_GROUP
 /begin FUNCTION_LIST /end FUNCTION_LIST
 /begin REF_CHARACTERISTIC /end REF_CHARACTERISTIC
 /begin REF_MEASUREMENT /end REF_MEASUREMENT
/end GROUP
/begin GROUP FordMsg3D3BusHiSpd.SenderPorts "MICROSAR RTE"
 /begin SUB_GROUP FordMsg3D3BusHiSpd.FordVehLatCtrlCrvt.Val FordMsg3D3BusHiSpd.FordVehLatCtrlCrvtRate.Val FordMsg3D3BusHiSpd.FordVehLatCtrlCrvtRateRaw.Val FordMsg3D3BusHiSpd.FordVehLatCtrlCrvtRaw.Val FordMsg3D3BusHiSpd.FordVehLatCtrlHandsOffDetnTqStimlsReq.Val FordMsg3D3BusHiSpd.FordVehLatCtrlImgProcrModlAVld.Logl FordMsg3D3BusHiSpd.FordVehLatCtrlPah.Val FordMsg3D3BusHiSpd.FordVehLatCtrlPahOffs.Val FordMsg3D3BusHiSpd.FordVehLatCtrlPahOffsRaw.Val FordMsg3D3BusHiSpd.FordVehLatCtrlPahRaw.Val FordMsg3D3BusHiSpd.FordVehLatCtrlPrcsn.Val FordMsg3D3BusHiSpd.FordVehLatCtrlRampTyp.Val FordMsg3D3BusHiSpd.FordVehLatCtrlReq.Val FordMsg3D3BusHiSpd.FordVehLatCtrlRingMax.Val /end SUB_GROUP
 /begin FUNCTION_LIST /end FUNCTION_LIST
 /begin REF_CHARACTERISTIC /end REF_CHARACTERISTIC
 /begin REF_MEASUREMENT /end REF_MEASUREMENT
/end GROUP
/begin GROUP FordMsg3D7BusHiSpd "MICROSAR RTE"
 /begin SUB_GROUP FordMsg3D7BusHiSpd.CalibrationPorts FordMsg3D7BusHiSpd.PerInstanceMemories FordMsg3D7BusHiSpd.ReceiverPorts FordMsg3D7BusHiSpd.SenderPorts /end SUB_GROUP
 /begin FUNCTION_LIST /end FUNCTION_LIST
 /begin REF_CHARACTERISTIC /end REF_CHARACTERISTIC
 /begin REF_MEASUREMENT /end REF_MEASUREMENT
/end GROUP
/begin GROUP FordMsg3D7BusHiSpd.CalibrationPorts "MICROSAR RTE"
 /begin SUB_GROUP FordMsg3D7BusHiSpd.FordMsg3D7BusHiSpdImgProcrModlAVldMissThd.Val FordMsg3D7BusHiSpd.FordMsg3D7BusHiSpdImgProcrModlAVldPassdThd.Val FordMsg3D7BusHiSpd.FordMsg3D7BusHiSpdLatDstInvldFaildThd.Val FordMsg3D7BusHiSpd.FordMsg3D7BusHiSpdLatDstInvldPassdThd.Val FordMsg3D7BusHiSpd.FordMsg3D7BusHiSpdLatDstRawVldFaildThd.Val FordMsg3D7BusHiSpd.FordMsg3D7BusHiSpdLgtDstInvldFaildThd.Val FordMsg3D7BusHiSpd.FordMsg3D7BusHiSpdLgtDstInvldPassdThd.Val FordMsg3D7BusHiSpd.FordMsg3D7BusHiSpdLgtDstRawVldFaildThd.Val FordMsg3D7BusHiSpd.FordMsg3D7BusHiSpdMissMsgFaildThd.Val FordMsg3D7BusHiSpd.FordMsg3D7BusHiSpdMissMsgPassdThd.Val FordMsg3D7BusHiSpd.FordMsg3D7BusHiSpdRelLatVelInvldFaildThd.Val FordMsg3D7BusHiSpd.FordMsg3D7BusHiSpdRelLatVelInvldPassdThd.Val FordMsg3D7BusHiSpd.FordMsg3D7BusHiSpdRelLatVelRawVldFaildThd.Val FordMsg3D7BusHiSpd.FordMsg3D7BusHiSpdRelLgtVelInvldFaildThd.Val FordMsg3D7BusHiSpd.FordMsg3D7BusHiSpdRelLgtVelInvldPassdThd.Val FordMsg3D7BusHiSpd.FordMsg3D7BusHiSpdRelLgtVelRawVldFaildThd.Val FordMsg3D7BusHiSpd.FordMsg3D7BusHiSpdTiToCllsnInvldFaildThd.Val FordMsg3D7BusHiSpd.FordMsg3D7BusHiSpdTiToCllsnInvldPassdThd.Val FordMsg3D7BusHiSpd.FordMsg3D7BusHiSpdTiToCllsnRawVldFaildThd.Val /end SUB_GROUP
 /begin FUNCTION_LIST /end FUNCTION_LIST
 /begin REF_CHARACTERISTIC /end REF_CHARACTERISTIC
 /begin REF_MEASUREMENT /end REF_MEASUREMENT
/end GROUP
/begin GROUP FordMsg3D7BusHiSpd.ClrDiagcFlgProxy.Val "MICROSAR RTE" /begin SUB_GROUP /end SUB_GROUP /begin FUNCTION_LIST /end FUNCTION_LIST /begin REF_CHARACTERISTIC /end REF_CHARACTERISTIC /begin REF_MEASUREMENT FordMsg3D7BusHiSpd.ClrDiagcFlgProxy.Val /end REF_MEASUREMENT /end GROUP
/begin GROUP FordMsg3D7BusHiSpd.ClrDiagcFlgProxyPrev "MICROSAR RTE" /begin SUB_GROUP /end SUB_GROUP /begin FUNCTION_LIST /end FUNCTION_LIST /begin REF_CHARACTERISTIC /end REF_CHARACTERISTIC /begin REF_MEASUREMENT FordMsg3D7BusHiSpd.ClrDiagcFlgProxyPrev /end REF_MEASUREMENT /end GROUP
/begin GROUP FordMsg3D7BusHiSpd.EvasSteerAssiImgProcrModlAVldPassdRefTi "MICROSAR RTE" /begin SUB_GROUP /end SUB_GROUP /begin FUNCTION_LIST /end FUNCTION_LIST /begin REF_CHARACTERISTIC /end REF_CHARACTERISTIC /begin REF_MEASUREMENT FordMsg3D7BusHiSpd.EvasSteerAssiImgProcrModlAVldPassdRefTi /end REF_MEASUREMENT /end GROUP
/begin GROUP FordMsg3D7BusHiSpd.FirstTranVldFlg "MICROSAR RTE" /begin SUB_GROUP /end SUB_GROUP /begin FUNCTION_LIST /end FUNCTION_LIST /begin REF_CHARACTERISTIC /end REF_CHARACTERISTIC /begin REF_MEASUREMENT FordMsg3D7BusHiSpd.FirstTranVldFlg /end REF_MEASUREMENT /end GROUP
/begin GROUP FordMsg3D7BusHiSpd.FordCanDtcInhb.Logl "MICROSAR RTE" /begin SUB_GROUP /end SUB_GROUP /begin FUNCTION_LIST /end FUNCTION_LIST /begin REF_CHARACTERISTIC /end REF_CHARACTERISTIC /begin REF_MEASUREMENT FordMsg3D7BusHiSpd.FordCanDtcInhb.Logl /end REF_MEASUREMENT /end GROUP
/begin GROUP FordMsg3D7BusHiSpd.FordEpsLifeCycMod.Val "MICROSAR RTE" /begin SUB_GROUP /end SUB_GROUP /begin FUNCTION_LIST /end FUNCTION_LIST /begin REF_CHARACTERISTIC /end REF_CHARACTERISTIC /begin REF_MEASUREMENT FordMsg3D7BusHiSpd.FordEpsLifeCycMod.Val /end REF_MEASUREMENT /end GROUP
/begin GROUP FordMsg3D7BusHiSpd.FordEvasSteerAssiEnad.Logl "MICROSAR RTE" /begin SUB_GROUP /end SUB_GROUP /begin FUNCTION_LIST /end FUNCTION_LIST /begin REF_CHARACTERISTIC /end REF_CHARACTERISTIC /begin REF_MEASUREMENT FordMsg3D7BusHiSpd.FordEvasSteerAssiEnad.Logl /end REF_MEASUREMENT /end GROUP
/begin GROUP FordMsg3D7BusHiSpd.FordMsg3D7BusHiSpdImgProcrModlAVldMissThd.Val "MICROSAR RTE" /begin SUB_GROUP /end SUB_GROUP /begin FUNCTION_LIST /end FUNCTION_LIST
 /begin REF_CHARACTERISTIC FordMsg3D7BusHiSpd.FordMsg3D7BusHiSpdImgProcrModlAVldMissThd.Val /end REF_CHARACTERISTIC
 /begin REF_MEASUREMENT /end REF_MEASUREMENT
/end GROUP
/begin GROUP FordMsg3D7BusHiSpd.FordMsg3D7BusHiSpdImgProcrModlAVldPassdThd.Val "MICROSAR RTE" /begin SUB_GROUP /end SUB_GROUP /begin FUNCTION_LIST /end FUNCTION_LIST
 /begin REF_CHARACTERISTIC FordMsg3D7BusHiSpd.FordMsg3D7BusHiSpdImgProcrModlAVldPassdThd.Val /end REF_CHARACTERISTIC
 /begin REF_MEASUREMENT /end REF_MEASUREMENT
/end GROUP
/begin GROUP FordMsg3D7BusHiSpd.FordMsg3D7BusHiSpdLatDstInvldFaildThd.Val "MICROSAR RTE" /begin SUB_GROUP /end SUB_GROUP /begin FUNCTION_LIST /end FUNCTION_LIST
 /begin REF_CHARACTERISTIC FordMsg3D7BusHiSpd.FordMsg3D7BusHiSpdLatDstInvldFaildThd.Val /end REF_CHARACTERISTIC
 /begin REF_MEASUREMENT /end REF_MEASUREMENT
/end GROUP
/begin GROUP FordMsg3D7BusHiSpd.FordMsg3D7BusHiSpdLatDstInvldPassdThd.Val "MICROSAR RTE" /begin SUB_GROUP /end SUB_GROUP /begin FUNCTION_LIST /end FUNCTION_LIST
 /begin REF_CHARACTERISTIC FordMsg3D7BusHiSpd.FordMsg3D7BusHiSpdLatDstInvldPassdThd.Val /end REF_CHARACTERISTIC
 /begin REF_MEASUREMENT /end REF_MEASUREMENT
/end GROUP
/begin GROUP FordMsg3D7BusHiSpd.FordMsg3D7BusHiSpdLatDstRawVldFaildThd.Val "MICROSAR RTE" /begin SUB_GROUP /end SUB_GROUP /begin FUNCTION_LIST /end FUNCTION_LIST
 /begin REF_CHARACTERISTIC FordMsg3D7BusHiSpd.FordMsg3D7BusHiSpdLatDstRawVldFaildThd.Val /end REF_CHARACTERISTIC
 /begin REF_MEASUREMENT /end REF_MEASUREMENT
/end GROUP
/begin GROUP FordMsg3D7BusHiSpd.FordMsg3D7BusHiSpdLgtDstInvldFaildThd.Val "MICROSAR RTE" /begin SUB_GROUP /end SUB_GROUP /begin FUNCTION_LIST /end FUNCTION_LIST
 /begin REF_CHARACTERISTIC FordMsg3D7BusHiSpd.FordMsg3D7BusHiSpdLgtDstInvldFaildThd.Val /end REF_CHARACTERISTIC
 /begin REF_MEASUREMENT /end REF_MEASUREMENT
/end GROUP
/begin GROUP FordMsg3D7BusHiSpd.FordMsg3D7BusHiSpdLgtDstInvldPassdThd.Val "MICROSAR RTE" /begin SUB_GROUP /end SUB_GROUP /begin FUNCTION_LIST /end FUNCTION_LIST
 /begin REF_CHARACTERISTIC FordMsg3D7BusHiSpd.FordMsg3D7BusHiSpdLgtDstInvldPassdThd.Val /end REF_CHARACTERISTIC
 /begin REF_MEASUREMENT /end REF_MEASUREMENT
/end GROUP
/begin GROUP FordMsg3D7BusHiSpd.FordMsg3D7BusHiSpdLgtDstRawVldFaildThd.Val "MICROSAR RTE" /begin SUB_GROUP /end SUB_GROUP /begin FUNCTION_LIST /end FUNCTION_LIST
 /begin REF_CHARACTERISTIC FordMsg3D7BusHiSpd.FordMsg3D7BusHiSpdLgtDstRawVldFaildThd.Val /end REF_CHARACTERISTIC
 /begin REF_MEASUREMENT /end REF_MEASUREMENT
/end GROUP
/begin GROUP FordMsg3D7BusHiSpd.FordMsg3D7BusHiSpdMissMsgFaildThd.Val "MICROSAR RTE" /begin SUB_GROUP /end SUB_GROUP /begin FUNCTION_LIST /end FUNCTION_LIST /begin REF_CHARACTERISTIC FordMsg3D7BusHiSpd.FordMsg3D7BusHiSpdMissMsgFaildThd.Val /end REF_CHARACTERISTIC /begin REF_MEASUREMENT /end REF_MEASUREMENT /end GROUP
/begin GROUP FordMsg3D7BusHiSpd.FordMsg3D7BusHiSpdMissMsgPassdThd.Val "MICROSAR RTE" /begin SUB_GROUP /end SUB_GROUP /begin FUNCTION_LIST /end FUNCTION_LIST /begin REF_CHARACTERISTIC FordMsg3D7BusHiSpd.FordMsg3D7BusHiSpdMissMsgPassdThd.Val /end REF_CHARACTERISTIC /begin REF_MEASUREMENT /end REF_MEASUREMENT /end GROUP
/begin GROUP FordMsg3D7BusHiSpd.FordMsg3D7BusHiSpdRelLatVelInvldFaildThd.Val "MICROSAR RTE" /begin SUB_GROUP /end SUB_GROUP /begin FUNCTION_LIST /end FUNCTION_LIST
 /begin REF_CHARACTERISTIC FordMsg3D7BusHiSpd.FordMsg3D7BusHiSpdRelLatVelInvldFaildThd.Val /end REF_CHARACTERISTIC
 /begin REF_MEASUREMENT /end REF_MEASUREMENT
/end GROUP
/begin GROUP FordMsg3D7BusHiSpd.FordMsg3D7BusHiSpdRelLatVelInvldPassdThd.Val "MICROSAR RTE" /begin SUB_GROUP /end SUB_GROUP /begin FUNCTION_LIST /end FUNCTION_LIST
 /begin REF_CHARACTERISTIC FordMsg3D7BusHiSpd.FordMsg3D7BusHiSpdRelLatVelInvldPassdThd.Val /end REF_CHARACTERISTIC
 /begin REF_MEASUREMENT /end REF_MEASUREMENT
/end GROUP
/begin GROUP FordMsg3D7BusHiSpd.FordMsg3D7BusHiSpdRelLatVelRawVldFaildThd.Val "MICROSAR RTE" /begin SUB_GROUP /end SUB_GROUP /begin FUNCTION_LIST /end FUNCTION_LIST
 /begin REF_CHARACTERISTIC FordMsg3D7BusHiSpd.FordMsg3D7BusHiSpdRelLatVelRawVldFaildThd.Val /end REF_CHARACTERISTIC
 /begin REF_MEASUREMENT /end REF_MEASUREMENT
/end GROUP
/begin GROUP FordMsg3D7BusHiSpd.FordMsg3D7BusHiSpdRelLgtVelInvldFaildThd.Val "MICROSAR RTE" /begin SUB_GROUP /end SUB_GROUP /begin FUNCTION_LIST /end FUNCTION_LIST
 /begin REF_CHARACTERISTIC FordMsg3D7BusHiSpd.FordMsg3D7BusHiSpdRelLgtVelInvldFaildThd.Val /end REF_CHARACTERISTIC
 /begin REF_MEASUREMENT /end REF_MEASUREMENT
/end GROUP
/begin GROUP FordMsg3D7BusHiSpd.FordMsg3D7BusHiSpdRelLgtVelInvldPassdThd.Val "MICROSAR RTE" /begin SUB_GROUP /end SUB_GROUP /begin FUNCTION_LIST /end FUNCTION_LIST
 /begin REF_CHARACTERISTIC FordMsg3D7BusHiSpd.FordMsg3D7BusHiSpdRelLgtVelInvldPassdThd.Val /end REF_CHARACTERISTIC
 /begin REF_MEASUREMENT /end REF_MEASUREMENT
/end GROUP
/begin GROUP FordMsg3D7BusHiSpd.FordMsg3D7BusHiSpdRelLgtVelRawVldFaildThd.Val "MICROSAR RTE" /begin SUB_GROUP /end SUB_GROUP /begin FUNCTION_LIST /end FUNCTION_LIST
 /begin REF_CHARACTERISTIC FordMsg3D7BusHiSpd.FordMsg3D7BusHiSpdRelLgtVelRawVldFaildThd.Val /end REF_CHARACTERISTIC
 /begin REF_MEASUREMENT /end REF_MEASUREMENT
/end GROUP
/begin GROUP FordMsg3D7BusHiSpd.FordMsg3D7BusHiSpdTiToCllsnInvldFaildThd.Val "MICROSAR RTE" /begin SUB_GROUP /end SUB_GROUP /begin FUNCTION_LIST /end FUNCTION_LIST
 /begin REF_CHARACTERISTIC FordMsg3D7BusHiSpd.FordMsg3D7BusHiSpdTiToCllsnInvldFaildThd.Val /end REF_CHARACTERISTIC
 /begin REF_MEASUREMENT /end REF_MEASUREMENT
/end GROUP
/begin GROUP FordMsg3D7BusHiSpd.FordMsg3D7BusHiSpdTiToCllsnInvldPassdThd.Val "MICROSAR RTE" /begin SUB_GROUP /end SUB_GROUP /begin FUNCTION_LIST /end FUNCTION_LIST
 /begin REF_CHARACTERISTIC FordMsg3D7BusHiSpd.FordMsg3D7BusHiSpdTiToCllsnInvldPassdThd.Val /end REF_CHARACTERISTIC
 /begin REF_MEASUREMENT /end REF_MEASUREMENT
/end GROUP
/begin GROUP FordMsg3D7BusHiSpd.FordMsg3D7BusHiSpdTiToCllsnRawVldFaildThd.Val "MICROSAR RTE" /begin SUB_GROUP /end SUB_GROUP /begin FUNCTION_LIST /end FUNCTION_LIST
 /begin REF_CHARACTERISTIC FordMsg3D7BusHiSpd.FordMsg3D7BusHiSpdTiToCllsnRawVldFaildThd.Val /end REF_CHARACTERISTIC
 /begin REF_MEASUREMENT /end REF_MEASUREMENT
/end GROUP
/begin GROUP FordMsg3D7BusHiSpd.FordVehCllsnMtgtnByBrkgLatDstInvldFaildRefTi "MICROSAR RTE" /begin SUB_GROUP /end SUB_GROUP /begin FUNCTION_LIST /end FUNCTION_LIST /begin REF_CHARACTERISTIC /end REF_CHARACTERISTIC
 /begin REF_MEASUREMENT FordMsg3D7BusHiSpd.FordVehCllsnMtgtnByBrkgLatDstInvldFaildRefTi /end REF_MEASUREMENT
/end GROUP
/begin GROUP FordMsg3D7BusHiSpd.FordVehCllsnMtgtnByBrkgLatDstInvldPassdRefTi "MICROSAR RTE" /begin SUB_GROUP /end SUB_GROUP /begin FUNCTION_LIST /end FUNCTION_LIST /begin REF_CHARACTERISTIC /end REF_CHARACTERISTIC
 /begin REF_MEASUREMENT FordMsg3D7BusHiSpd.FordVehCllsnMtgtnByBrkgLatDstInvldPassdRefTi /end REF_MEASUREMENT
/end GROUP
/begin GROUP FordMsg3D7BusHiSpd.FordVehCllsnMtgtnByBrkgLatDstRaw.Val "MICROSAR RTE" /begin SUB_GROUP /end SUB_GROUP /begin FUNCTION_LIST /end FUNCTION_LIST /begin REF_CHARACTERISTIC /end REF_CHARACTERISTIC /begin REF_MEASUREMENT FordMsg3D7BusHiSpd.FordVehCllsnMtgtnByBrkgLatDstRaw.Val /end REF_MEASUREMENT /end GROUP
/begin GROUP FordMsg3D7BusHiSpd.FordVehCllsnMtgtnByBrkgLatDstRawPrev "MICROSAR RTE" /begin SUB_GROUP /end SUB_GROUP /begin FUNCTION_LIST /end FUNCTION_LIST /begin REF_CHARACTERISTIC /end REF_CHARACTERISTIC /begin REF_MEASUREMENT FordMsg3D7BusHiSpd.FordVehCllsnMtgtnByBrkgLatDstRawPrev /end REF_MEASUREMENT /end GROUP
/begin GROUP FordMsg3D7BusHiSpd.FordVehCllsnMtgtnByBrkgLgtDstInvldFaildRefTi "MICROSAR RTE" /begin SUB_GROUP /end SUB_GROUP /begin FUNCTION_LIST /end FUNCTION_LIST /begin REF_CHARACTERISTIC /end REF_CHARACTERISTIC
 /begin REF_MEASUREMENT FordMsg3D7BusHiSpd.FordVehCllsnMtgtnByBrkgLgtDstInvldFaildRefTi /end REF_MEASUREMENT
/end GROUP
/begin GROUP FordMsg3D7BusHiSpd.FordVehCllsnMtgtnByBrkgLgtDstInvldPassdRefTi "MICROSAR RTE" /begin SUB_GROUP /end SUB_GROUP /begin FUNCTION_LIST /end FUNCTION_LIST /begin REF_CHARACTERISTIC /end REF_CHARACTERISTIC
 /begin REF_MEASUREMENT FordMsg3D7BusHiSpd.FordVehCllsnMtgtnByBrkgLgtDstInvldPassdRefTi /end REF_MEASUREMENT
/end GROUP
/begin GROUP FordMsg3D7BusHiSpd.FordVehCllsnMtgtnByBrkgLgtDstRaw.Val "MICROSAR RTE" /begin SUB_GROUP /end SUB_GROUP /begin FUNCTION_LIST /end FUNCTION_LIST /begin REF_CHARACTERISTIC /end REF_CHARACTERISTIC /begin REF_MEASUREMENT FordMsg3D7BusHiSpd.FordVehCllsnMtgtnByBrkgLgtDstRaw.Val /end REF_MEASUREMENT /end GROUP
/begin GROUP FordMsg3D7BusHiSpd.FordVehCllsnMtgtnByBrkgLgtDstRawPrev "MICROSAR RTE" /begin SUB_GROUP /end SUB_GROUP /begin FUNCTION_LIST /end FUNCTION_LIST /begin REF_CHARACTERISTIC /end REF_CHARACTERISTIC /begin REF_MEASUREMENT FordMsg3D7BusHiSpd.FordVehCllsnMtgtnByBrkgLgtDstRawPrev /end REF_MEASUREMENT /end GROUP
/begin GROUP FordMsg3D7BusHiSpd.FordVehCllsnMtgtnByBrkgObjDataConfLvlRaw.Val "MICROSAR RTE" /begin SUB_GROUP /end SUB_GROUP /begin FUNCTION_LIST /end FUNCTION_LIST /begin REF_CHARACTERISTIC /end REF_CHARACTERISTIC
 /begin REF_MEASUREMENT FordMsg3D7BusHiSpd.FordVehCllsnMtgtnByBrkgObjDataConfLvlRaw.Val /end REF_MEASUREMENT
/end GROUP
/begin GROUP FordMsg3D7BusHiSpd.FordVehCllsnMtgtnByBrkgObjDataConfLvlRawPrev "MICROSAR RTE" /begin SUB_GROUP /end SUB_GROUP /begin FUNCTION_LIST /end FUNCTION_LIST /begin REF_CHARACTERISTIC /end REF_CHARACTERISTIC
 /begin REF_MEASUREMENT FordMsg3D7BusHiSpd.FordVehCllsnMtgtnByBrkgObjDataConfLvlRawPrev /end REF_MEASUREMENT
/end GROUP
/begin GROUP FordMsg3D7BusHiSpd.FordVehCllsnMtgtnByBrkgObjTypClassnRaw.Val "MICROSAR RTE" /begin SUB_GROUP /end SUB_GROUP /begin FUNCTION_LIST /end FUNCTION_LIST /begin REF_CHARACTERISTIC /end REF_CHARACTERISTIC
 /begin REF_MEASUREMENT FordMsg3D7BusHiSpd.FordVehCllsnMtgtnByBrkgObjTypClassnRaw.Val /end REF_MEASUREMENT
/end GROUP
/begin GROUP FordMsg3D7BusHiSpd.FordVehCllsnMtgtnByBrkgObjTypClassnRawPrev "MICROSAR RTE" /begin SUB_GROUP /end SUB_GROUP /begin FUNCTION_LIST /end FUNCTION_LIST /begin REF_CHARACTERISTIC /end REF_CHARACTERISTIC
 /begin REF_MEASUREMENT FordMsg3D7BusHiSpd.FordVehCllsnMtgtnByBrkgObjTypClassnRawPrev /end REF_MEASUREMENT
/end GROUP
/begin GROUP FordMsg3D7BusHiSpd.FordVehCllsnMtgtnByBrkgRelLatVelInvldFaildRefTi "MICROSAR RTE" /begin SUB_GROUP /end SUB_GROUP /begin FUNCTION_LIST /end FUNCTION_LIST /begin REF_CHARACTERISTIC /end REF_CHARACTERISTIC
 /begin REF_MEASUREMENT FordMsg3D7BusHiSpd.FordVehCllsnMtgtnByBrkgRelLatVelInvldFaildRefTi /end REF_MEASUREMENT
/end GROUP
/begin GROUP FordMsg3D7BusHiSpd.FordVehCllsnMtgtnByBrkgRelLatVelInvldPassdRefTi "MICROSAR RTE" /begin SUB_GROUP /end SUB_GROUP /begin FUNCTION_LIST /end FUNCTION_LIST /begin REF_CHARACTERISTIC /end REF_CHARACTERISTIC
 /begin REF_MEASUREMENT FordMsg3D7BusHiSpd.FordVehCllsnMtgtnByBrkgRelLatVelInvldPassdRefTi /end REF_MEASUREMENT
/end GROUP
/begin GROUP FordMsg3D7BusHiSpd.FordVehCllsnMtgtnByBrkgRelLatVelRaw.Val "MICROSAR RTE" /begin SUB_GROUP /end SUB_GROUP /begin FUNCTION_LIST /end FUNCTION_LIST /begin REF_CHARACTERISTIC /end REF_CHARACTERISTIC /begin REF_MEASUREMENT FordMsg3D7BusHiSpd.FordVehCllsnMtgtnByBrkgRelLatVelRaw.Val /end REF_MEASUREMENT /end GROUP
/begin GROUP FordMsg3D7BusHiSpd.FordVehCllsnMtgtnByBrkgRelLatVelRawPrev "MICROSAR RTE" /begin SUB_GROUP /end SUB_GROUP /begin FUNCTION_LIST /end FUNCTION_LIST /begin REF_CHARACTERISTIC /end REF_CHARACTERISTIC /begin REF_MEASUREMENT FordMsg3D7BusHiSpd.FordVehCllsnMtgtnByBrkgRelLatVelRawPrev /end REF_MEASUREMENT /end GROUP
/begin GROUP FordMsg3D7BusHiSpd.FordVehCllsnMtgtnByBrkgRelLgtVelInvldFaildRefTi "MICROSAR RTE" /begin SUB_GROUP /end SUB_GROUP /begin FUNCTION_LIST /end FUNCTION_LIST /begin REF_CHARACTERISTIC /end REF_CHARACTERISTIC
 /begin REF_MEASUREMENT FordMsg3D7BusHiSpd.FordVehCllsnMtgtnByBrkgRelLgtVelInvldFaildRefTi /end REF_MEASUREMENT
/end GROUP
/begin GROUP FordMsg3D7BusHiSpd.FordVehCllsnMtgtnByBrkgRelLgtVelInvldPassdRefTi "MICROSAR RTE" /begin SUB_GROUP /end SUB_GROUP /begin FUNCTION_LIST /end FUNCTION_LIST /begin REF_CHARACTERISTIC /end REF_CHARACTERISTIC
 /begin REF_MEASUREMENT FordMsg3D7BusHiSpd.FordVehCllsnMtgtnByBrkgRelLgtVelInvldPassdRefTi /end REF_MEASUREMENT
/end GROUP
/begin GROUP FordMsg3D7BusHiSpd.FordVehCllsnMtgtnByBrkgRelLgtVelRaw.Val "MICROSAR RTE" /begin SUB_GROUP /end SUB_GROUP /begin FUNCTION_LIST /end FUNCTION_LIST /begin REF_CHARACTERISTIC /end REF_CHARACTERISTIC /begin REF_MEASUREMENT FordMsg3D7BusHiSpd.FordVehCllsnMtgtnByBrkgRelLgtVelRaw.Val /end REF_MEASUREMENT /end GROUP
/begin GROUP FordMsg3D7BusHiSpd.FordVehCllsnMtgtnByBrkgRelLgtVelRawPrev "MICROSAR RTE" /begin SUB_GROUP /end SUB_GROUP /begin FUNCTION_LIST /end FUNCTION_LIST /begin REF_CHARACTERISTIC /end REF_CHARACTERISTIC /begin REF_MEASUREMENT FordMsg3D7BusHiSpd.FordVehCllsnMtgtnByBrkgRelLgtVelRawPrev /end REF_MEASUREMENT /end GROUP
/begin GROUP FordMsg3D7BusHiSpd.FordVehCllsnMtgtnByBrkgTiToCllsnInvldFaildRefTi "MICROSAR RTE" /begin SUB_GROUP /end SUB_GROUP /begin FUNCTION_LIST /end FUNCTION_LIST /begin REF_CHARACTERISTIC /end REF_CHARACTERISTIC
 /begin REF_MEASUREMENT FordMsg3D7BusHiSpd.FordVehCllsnMtgtnByBrkgTiToCllsnInvldFaildRefTi /end REF_MEASUREMENT
/end GROUP
/begin GROUP FordMsg3D7BusHiSpd.FordVehCllsnMtgtnByBrkgTiToCllsnInvldPassdRefTi "MICROSAR RTE" /begin SUB_GROUP /end SUB_GROUP /begin FUNCTION_LIST /end FUNCTION_LIST /begin REF_CHARACTERISTIC /end REF_CHARACTERISTIC
 /begin REF_MEASUREMENT FordMsg3D7BusHiSpd.FordVehCllsnMtgtnByBrkgTiToCllsnInvldPassdRefTi /end REF_MEASUREMENT
/end GROUP
/begin GROUP FordMsg3D7BusHiSpd.FordVehCllsnMtgtnByBrkgTiToCllsnRaw.Val "MICROSAR RTE" /begin SUB_GROUP /end SUB_GROUP /begin FUNCTION_LIST /end FUNCTION_LIST /begin REF_CHARACTERISTIC /end REF_CHARACTERISTIC /begin REF_MEASUREMENT FordMsg3D7BusHiSpd.FordVehCllsnMtgtnByBrkgTiToCllsnRaw.Val /end REF_MEASUREMENT /end GROUP
/begin GROUP FordMsg3D7BusHiSpd.FordVehCllsnMtgtnByBrkgTiToCllsnRawPrev "MICROSAR RTE" /begin SUB_GROUP /end SUB_GROUP /begin FUNCTION_LIST /end FUNCTION_LIST /begin REF_CHARACTERISTIC /end REF_CHARACTERISTIC /begin REF_MEASUREMENT FordMsg3D7BusHiSpd.FordVehCllsnMtgtnByBrkgTiToCllsnRawPrev /end REF_MEASUREMENT /end GROUP
/begin GROUP FordMsg3D7BusHiSpd.FordVehEvasSteerAssiEnadReqRaw.Val "MICROSAR RTE" /begin SUB_GROUP /end SUB_GROUP /begin FUNCTION_LIST /end FUNCTION_LIST /begin REF_CHARACTERISTIC /end REF_CHARACTERISTIC /begin REF_MEASUREMENT FordMsg3D7BusHiSpd.FordVehEvasSteerAssiEnadReqRaw.Val /end REF_MEASUREMENT /end GROUP
/begin GROUP FordMsg3D7BusHiSpd.FordVehEvasSteerAssiEnadReqRawPrev "MICROSAR RTE" /begin SUB_GROUP /end SUB_GROUP /begin FUNCTION_LIST /end FUNCTION_LIST /begin REF_CHARACTERISTIC /end REF_CHARACTERISTIC /begin REF_MEASUREMENT FordMsg3D7BusHiSpd.FordVehEvasSteerAssiEnadReqRawPrev /end REF_MEASUREMENT /end GROUP
/begin GROUP FordMsg3D7BusHiSpd.FordVehEvasSteerAssiImgProcrModlAVld.Logl "MICROSAR RTE" /begin SUB_GROUP /end SUB_GROUP /begin FUNCTION_LIST /end FUNCTION_LIST /begin REF_CHARACTERISTIC /end REF_CHARACTERISTIC
 /begin REF_MEASUREMENT FordMsg3D7BusHiSpd.FordVehEvasSteerAssiImgProcrModlAVld.Logl /end REF_MEASUREMENT
/end GROUP
/begin GROUP FordMsg3D7BusHiSpd.FordVehEvasSteerAssiImgProcrModlAVldPrev "MICROSAR RTE" /begin SUB_GROUP /end SUB_GROUP /begin FUNCTION_LIST /end FUNCTION_LIST /begin REF_CHARACTERISTIC /end REF_CHARACTERISTIC
 /begin REF_MEASUREMENT FordMsg3D7BusHiSpd.FordVehEvasSteerAssiImgProcrModlAVldPrev /end REF_MEASUREMENT
/end GROUP
/begin GROUP FordMsg3D7BusHiSpd.FordVehMsg3D7Miss "MICROSAR RTE" /begin SUB_GROUP /end SUB_GROUP /begin FUNCTION_LIST /end FUNCTION_LIST /begin REF_CHARACTERISTIC /end REF_CHARACTERISTIC /begin REF_MEASUREMENT FordMsg3D7BusHiSpd.FordVehMsg3D7Miss /end REF_MEASUREMENT /end GROUP
/begin GROUP FordMsg3D7BusHiSpd.ImgProcrModlAVldMissRefTi "MICROSAR RTE" /begin SUB_GROUP /end SUB_GROUP /begin FUNCTION_LIST /end FUNCTION_LIST /begin REF_CHARACTERISTIC /end REF_CHARACTERISTIC /begin REF_MEASUREMENT FordMsg3D7BusHiSpd.ImgProcrModlAVldMissRefTi /end REF_MEASUREMENT /end GROUP
/begin GROUP FordMsg3D7BusHiSpd.LatDstRawVldFaildRefTi "MICROSAR RTE" /begin SUB_GROUP /end SUB_GROUP /begin FUNCTION_LIST /end FUNCTION_LIST /begin REF_CHARACTERISTIC /end REF_CHARACTERISTIC /begin REF_MEASUREMENT FordMsg3D7BusHiSpd.LatDstRawVldFaildRefTi /end REF_MEASUREMENT /end GROUP
/begin GROUP FordMsg3D7BusHiSpd.LgtDstRawVldFaildRefTi "MICROSAR RTE" /begin SUB_GROUP /end SUB_GROUP /begin FUNCTION_LIST /end FUNCTION_LIST /begin REF_CHARACTERISTIC /end REF_CHARACTERISTIC /begin REF_MEASUREMENT FordMsg3D7BusHiSpd.LgtDstRawVldFaildRefTi /end REF_MEASUREMENT /end GROUP
/begin GROUP FordMsg3D7BusHiSpd.MissMsgFaildRefTi "MICROSAR RTE" /begin SUB_GROUP /end SUB_GROUP /begin FUNCTION_LIST /end FUNCTION_LIST /begin REF_CHARACTERISTIC /end REF_CHARACTERISTIC /begin REF_MEASUREMENT FordMsg3D7BusHiSpd.MissMsgFaildRefTi /end REF_MEASUREMENT /end GROUP
/begin GROUP FordMsg3D7BusHiSpd.MissMsgPassdRefTi "MICROSAR RTE" /begin SUB_GROUP /end SUB_GROUP /begin FUNCTION_LIST /end FUNCTION_LIST /begin REF_CHARACTERISTIC /end REF_CHARACTERISTIC /begin REF_MEASUREMENT FordMsg3D7BusHiSpd.MissMsgPassdRefTi /end REF_MEASUREMENT /end GROUP
/begin GROUP FordMsg3D7BusHiSpd.PerInstanceMemories "MICROSAR RTE"
 /begin SUB_GROUP FordMsg3D7BusHiSpd.ClrDiagcFlgProxyPrev FordMsg3D7BusHiSpd.EvasSteerAssiImgProcrModlAVldPassdRefTi FordMsg3D7BusHiSpd.FirstTranVldFlg FordMsg3D7BusHiSpd.FordVehCllsnMtgtnByBrkgLatDstInvldFaildRefTi FordMsg3D7BusHiSpd.FordVehCllsnMtgtnByBrkgLatDstInvldPassdRefTi FordMsg3D7BusHiSpd.FordVehCllsnMtgtnByBrkgLatDstRawPrev FordMsg3D7BusHiSpd.FordVehCllsnMtgtnByBrkgLgtDstInvldFaildRefTi FordMsg3D7BusHiSpd.FordVehCllsnMtgtnByBrkgLgtDstInvldPassdRefTi FordMsg3D7BusHiSpd.FordVehCllsnMtgtnByBrkgLgtDstRawPrev FordMsg3D7BusHiSpd.FordVehCllsnMtgtnByBrkgObjDataConfLvlRawPrev FordMsg3D7BusHiSpd.FordVehCllsnMtgtnByBrkgObjTypClassnRawPrev FordMsg3D7BusHiSpd.FordVehCllsnMtgtnByBrkgRelLatVelInvldFaildRefTi FordMsg3D7BusHiSpd.FordVehCllsnMtgtnByBrkgRelLatVelInvldPassdRefTi FordMsg3D7BusHiSpd.FordVehCllsnMtgtnByBrkgRelLatVelRawPrev FordMsg3D7BusHiSpd.FordVehCllsnMtgtnByBrkgRelLgtVelInvldFaildRefTi FordMsg3D7BusHiSpd.FordVehCllsnMtgtnByBrkgRelLgtVelInvldPassdRefTi FordMsg3D7BusHiSpd.FordVehCllsnMtgtnByBrkgRelLgtVelRawPrev FordMsg3D7BusHiSpd.FordVehCllsnMtgtnByBrkgTiToCllsnInvldFaildRefTi FordMsg3D7BusHiSpd.FordVehCllsnMtgtnByBrkgTiToCllsnInvldPassdRefTi FordMsg3D7BusHiSpd.FordVehCllsnMtgtnByBrkgTiToCllsnRawPrev FordMsg3D7BusHiSpd.FordVehEvasSteerAssiEnadReqRawPrev FordMsg3D7BusHiSpd.FordVehEvasSteerAssiImgProcrModlAVldPrev FordMsg3D7BusHiSpd.FordVehMsg3D7Miss FordMsg3D7BusHiSpd.ImgProcrModlAVldMissRefTi FordMsg3D7BusHiSpd.LatDstRawVldFaildRefTi FordMsg3D7BusHiSpd.LgtDstRawVldFaildRefTi FordMsg3D7BusHiSpd.MissMsgFaildRefTi FordMsg3D7BusHiSpd.MissMsgPassdRefTi FordMsg3D7BusHiSpd.RelLatVelRawVldFaildRefTi FordMsg3D7BusHiSpd.RelLgtVelRawVldFaildRefTi FordMsg3D7BusHiSpd.TiToCllsnRawVldFaildRefTi /end SUB_GROUP
 /begin FUNCTION_LIST /end FUNCTION_LIST
 /begin REF_CHARACTERISTIC /end REF_CHARACTERISTIC
 /begin REF_MEASUREMENT /end REF_MEASUREMENT
/end GROUP
/begin GROUP FordMsg3D7BusHiSpd.ReceiverPorts "MICROSAR RTE"
 /begin SUB_GROUP FordMsg3D7BusHiSpd.ClrDiagcFlgProxy.Val FordMsg3D7BusHiSpd.FordCanDtcInhb.Logl FordMsg3D7BusHiSpd.FordEpsLifeCycMod.Val FordMsg3D7BusHiSpd.FordEvasSteerAssiEnad.Logl /end SUB_GROUP
 /begin FUNCTION_LIST /end FUNCTION_LIST
 /begin REF_CHARACTERISTIC /end REF_CHARACTERISTIC
 /begin REF_MEASUREMENT /end REF_MEASUREMENT
/end GROUP
/begin GROUP FordMsg3D7BusHiSpd.RelLatVelRawVldFaildRefTi "MICROSAR RTE" /begin SUB_GROUP /end SUB_GROUP /begin FUNCTION_LIST /end FUNCTION_LIST /begin REF_CHARACTERISTIC /end REF_CHARACTERISTIC /begin REF_MEASUREMENT FordMsg3D7BusHiSpd.RelLatVelRawVldFaildRefTi /end REF_MEASUREMENT /end GROUP
/begin GROUP FordMsg3D7BusHiSpd.RelLgtVelRawVldFaildRefTi "MICROSAR RTE" /begin SUB_GROUP /end SUB_GROUP /begin FUNCTION_LIST /end FUNCTION_LIST /begin REF_CHARACTERISTIC /end REF_CHARACTERISTIC /begin REF_MEASUREMENT FordMsg3D7BusHiSpd.RelLgtVelRawVldFaildRefTi /end REF_MEASUREMENT /end GROUP
/begin GROUP FordMsg3D7BusHiSpd.SenderPorts "MICROSAR RTE"
 /begin SUB_GROUP FordMsg3D7BusHiSpd.FordVehCllsnMtgtnByBrkgLatDstRaw.Val FordMsg3D7BusHiSpd.FordVehCllsnMtgtnByBrkgLgtDstRaw.Val FordMsg3D7BusHiSpd.FordVehCllsnMtgtnByBrkgObjDataConfLvlRaw.Val FordMsg3D7BusHiSpd.FordVehCllsnMtgtnByBrkgObjTypClassnRaw.Val FordMsg3D7BusHiSpd.FordVehCllsnMtgtnByBrkgRelLatVelRaw.Val FordMsg3D7BusHiSpd.FordVehCllsnMtgtnByBrkgRelLgtVelRaw.Val FordMsg3D7BusHiSpd.FordVehCllsnMtgtnByBrkgTiToCllsnRaw.Val FordMsg3D7BusHiSpd.FordVehEvasSteerAssiEnadReqRaw.Val FordMsg3D7BusHiSpd.FordVehEvasSteerAssiImgProcrModlAVld.Logl /end SUB_GROUP
 /begin FUNCTION_LIST /end FUNCTION_LIST
 /begin REF_CHARACTERISTIC /end REF_CHARACTERISTIC
 /begin REF_MEASUREMENT /end REF_MEASUREMENT
/end GROUP
/begin GROUP FordMsg3D7BusHiSpd.TiToCllsnRawVldFaildRefTi "MICROSAR RTE" /begin SUB_GROUP /end SUB_GROUP /begin FUNCTION_LIST /end FUNCTION_LIST /begin REF_CHARACTERISTIC /end REF_CHARACTERISTIC /begin REF_MEASUREMENT FordMsg3D7BusHiSpd.TiToCllsnRawVldFaildRefTi /end REF_MEASUREMENT /end GROUP
/begin GROUP FordMsg40ABusHiSpd "MICROSAR RTE"
 /begin SUB_GROUP FordMsg40ABusHiSpd.CalibrationPorts FordMsg40ABusHiSpd.PerInstanceMemories FordMsg40ABusHiSpd.ReceiverPorts FordMsg40ABusHiSpd.SenderPorts /end SUB_GROUP
 /begin FUNCTION_LIST /end FUNCTION_LIST
 /begin REF_CHARACTERISTIC /end REF_CHARACTERISTIC
 /begin REF_MEASUREMENT /end REF_MEASUREMENT
/end GROUP
/begin GROUP FordMsg40ABusHiSpd.CalibrationPorts "MICROSAR RTE"
 /begin SUB_GROUP FordMsg40ABusHiSpd.FordMsg40ABusHiSpdMissMsgFaildThd.Val FordMsg40ABusHiSpd.FordMsg40ABusHiSpdMissMsgPassdThd.Val /end SUB_GROUP
 /begin FUNCTION_LIST /end FUNCTION_LIST
 /begin REF_CHARACTERISTIC /end REF_CHARACTERISTIC
 /begin REF_MEASUREMENT /end REF_MEASUREMENT
/end GROUP
/begin GROUP FordMsg40ABusHiSpd.ClrDiagcFlgProxy.Val "MICROSAR RTE" /begin SUB_GROUP /end SUB_GROUP /begin FUNCTION_LIST /end FUNCTION_LIST /begin REF_CHARACTERISTIC /end REF_CHARACTERISTIC /begin REF_MEASUREMENT FordMsg40ABusHiSpd.ClrDiagcFlgProxy.Val /end REF_MEASUREMENT /end GROUP
/begin GROUP FordMsg40ABusHiSpd.FordCanDtcInhb.Val "MICROSAR RTE" /begin SUB_GROUP /end SUB_GROUP /begin FUNCTION_LIST /end FUNCTION_LIST /begin REF_CHARACTERISTIC /end REF_CHARACTERISTIC /begin REF_MEASUREMENT FordMsg40ABusHiSpd.FordCanDtcInhb.Val /end REF_MEASUREMENT /end GROUP
/begin GROUP FordMsg40ABusHiSpd.FordClrDiagcFlgProxyPrev "MICROSAR RTE" /begin SUB_GROUP /end SUB_GROUP /begin FUNCTION_LIST /end FUNCTION_LIST /begin REF_CHARACTERISTIC /end REF_CHARACTERISTIC /begin REF_MEASUREMENT FordMsg40ABusHiSpd.FordClrDiagcFlgProxyPrev /end REF_MEASUREMENT /end GROUP
/begin GROUP FordMsg40ABusHiSpd.FordEpsLifeCycMod.Val "MICROSAR RTE" /begin SUB_GROUP /end SUB_GROUP /begin FUNCTION_LIST /end FUNCTION_LIST /begin REF_CHARACTERISTIC /end REF_CHARACTERISTIC /begin REF_MEASUREMENT FordMsg40ABusHiSpd.FordEpsLifeCycMod.Val /end REF_MEASUREMENT /end GROUP
/begin GROUP FordMsg40ABusHiSpd.FordMfgDiagcInhb.Val "MICROSAR RTE" /begin SUB_GROUP /end SUB_GROUP /begin FUNCTION_LIST /end FUNCTION_LIST /begin REF_CHARACTERISTIC /end REF_CHARACTERISTIC /begin REF_MEASUREMENT FordMsg40ABusHiSpd.FordMfgDiagcInhb.Val /end REF_MEASUREMENT /end GROUP
/begin GROUP FordMsg40ABusHiSpd.FordMissMsgDiagcInhb.Val "MICROSAR RTE" /begin SUB_GROUP /end SUB_GROUP /begin FUNCTION_LIST /end FUNCTION_LIST /begin REF_CHARACTERISTIC /end REF_CHARACTERISTIC /begin REF_MEASUREMENT FordMsg40ABusHiSpd.FordMissMsgDiagcInhb.Val /end REF_MEASUREMENT /end GROUP
/begin GROUP FordMsg40ABusHiSpd.FordMsg40ABusHiSpdMissMsgFaildThd.Val "MICROSAR RTE" /begin SUB_GROUP /end SUB_GROUP /begin FUNCTION_LIST /end FUNCTION_LIST /begin REF_CHARACTERISTIC FordMsg40ABusHiSpd.FordMsg40ABusHiSpdMissMsgFaildThd.Val /end REF_CHARACTERISTIC /begin REF_MEASUREMENT /end REF_MEASUREMENT /end GROUP
/begin GROUP FordMsg40ABusHiSpd.FordMsg40ABusHiSpdMissMsgPassdThd.Val "MICROSAR RTE" /begin SUB_GROUP /end SUB_GROUP /begin FUNCTION_LIST /end FUNCTION_LIST /begin REF_CHARACTERISTIC FordMsg40ABusHiSpd.FordMsg40ABusHiSpdMissMsgPassdThd.Val /end REF_CHARACTERISTIC /begin REF_MEASUREMENT /end REF_MEASUREMENT /end GROUP
/begin GROUP FordMsg40ABusHiSpd.FordVehGlbRealTi.Val "MICROSAR RTE" /begin SUB_GROUP /end SUB_GROUP /begin FUNCTION_LIST /end FUNCTION_LIST /begin REF_CHARACTERISTIC /end REF_CHARACTERISTIC /begin REF_MEASUREMENT FordMsg40ABusHiSpd.FordVehGlbRealTi.Val /end REF_MEASUREMENT /end GROUP
/begin GROUP FordMsg40ABusHiSpd.FordVehGlbRealTiPrev "MICROSAR RTE" /begin SUB_GROUP /end SUB_GROUP /begin FUNCTION_LIST /end FUNCTION_LIST /begin REF_CHARACTERISTIC /end REF_CHARACTERISTIC /begin REF_MEASUREMENT FordMsg40ABusHiSpd.FordVehGlbRealTiPrev /end REF_MEASUREMENT /end GROUP
/begin GROUP FordMsg40ABusHiSpd.FordVehIdnNr.Ary1D "MICROSAR RTE" /begin SUB_GROUP /end SUB_GROUP /begin FUNCTION_LIST /end FUNCTION_LIST /begin REF_CHARACTERISTIC /end REF_CHARACTERISTIC /begin REF_MEASUREMENT FordMsg40ABusHiSpd.FordVehIdnNr.Ary1D /end REF_MEASUREMENT /end GROUP
/begin GROUP FordMsg40ABusHiSpd.FordVehIdnNrC100Prev "MICROSAR RTE" /begin SUB_GROUP /end SUB_GROUP /begin FUNCTION_LIST /end FUNCTION_LIST /begin REF_CHARACTERISTIC /end REF_CHARACTERISTIC /begin REF_MEASUREMENT FordMsg40ABusHiSpd.FordVehIdnNrC100Prev /end REF_MEASUREMENT /end GROUP
/begin GROUP FordMsg40ABusHiSpd.FordVehIdnNrC101Prev "MICROSAR RTE" /begin SUB_GROUP /end SUB_GROUP /begin FUNCTION_LIST /end FUNCTION_LIST /begin REF_CHARACTERISTIC /end REF_CHARACTERISTIC /begin REF_MEASUREMENT FordMsg40ABusHiSpd.FordVehIdnNrC101Prev /end REF_MEASUREMENT /end GROUP
/begin GROUP FordMsg40ABusHiSpd.FordVehIdnNrC102Prev "MICROSAR RTE" /begin SUB_GROUP /end SUB_GROUP /begin FUNCTION_LIST /end FUNCTION_LIST /begin REF_CHARACTERISTIC /end REF_CHARACTERISTIC /begin REF_MEASUREMENT FordMsg40ABusHiSpd.FordVehIdnNrC102Prev /end REF_MEASUREMENT /end GROUP
/begin GROUP FordMsg40ABusHiSpd.FordVehIdnNrPrev "MICROSAR RTE" /begin SUB_GROUP /end SUB_GROUP /begin FUNCTION_LIST /end FUNCTION_LIST /begin REF_CHARACTERISTIC /end REF_CHARACTERISTIC /begin REF_MEASUREMENT FordMsg40ABusHiSpd.FordVehIdnNrPrev /end REF_MEASUREMENT /end GROUP
/begin GROUP FordMsg40ABusHiSpd.FordVehMsg40AMiss "MICROSAR RTE" /begin SUB_GROUP /end SUB_GROUP /begin FUNCTION_LIST /end FUNCTION_LIST /begin REF_CHARACTERISTIC /end REF_CHARACTERISTIC /begin REF_MEASUREMENT FordMsg40ABusHiSpd.FordVehMsg40AMiss /end REF_MEASUREMENT /end GROUP
/begin GROUP FordMsg40ABusHiSpd.FordVehMsg40ARxd "MICROSAR RTE" /begin SUB_GROUP /end SUB_GROUP /begin FUNCTION_LIST /end FUNCTION_LIST /begin REF_CHARACTERISTIC /end REF_CHARACTERISTIC /begin REF_MEASUREMENT FordMsg40ABusHiSpd.FordVehMsg40ARxd /end REF_MEASUREMENT /end GROUP
/begin GROUP FordMsg40ABusHiSpd.FordVehTireCircum.Val "MICROSAR RTE" /begin SUB_GROUP /end SUB_GROUP /begin FUNCTION_LIST /end FUNCTION_LIST /begin REF_CHARACTERISTIC /end REF_CHARACTERISTIC /begin REF_MEASUREMENT FordMsg40ABusHiSpd.FordVehTireCircum.Val /end REF_MEASUREMENT /end GROUP
/begin GROUP FordMsg40ABusHiSpd.FordVehTireCircumPrev "MICROSAR RTE" /begin SUB_GROUP /end SUB_GROUP /begin FUNCTION_LIST /end FUNCTION_LIST /begin REF_CHARACTERISTIC /end REF_CHARACTERISTIC /begin REF_MEASUREMENT FordMsg40ABusHiSpd.FordVehTireCircumPrev /end REF_MEASUREMENT /end GROUP
/begin GROUP FordMsg40ABusHiSpd.MissMsgFaildRefTi "MICROSAR RTE" /begin SUB_GROUP /end SUB_GROUP /begin FUNCTION_LIST /end FUNCTION_LIST /begin REF_CHARACTERISTIC /end REF_CHARACTERISTIC /begin REF_MEASUREMENT FordMsg40ABusHiSpd.MissMsgFaildRefTi /end REF_MEASUREMENT /end GROUP
/begin GROUP FordMsg40ABusHiSpd.MissMsgPassdRefTi "MICROSAR RTE" /begin SUB_GROUP /end SUB_GROUP /begin FUNCTION_LIST /end FUNCTION_LIST /begin REF_CHARACTERISTIC /end REF_CHARACTERISTIC /begin REF_MEASUREMENT FordMsg40ABusHiSpd.MissMsgPassdRefTi /end REF_MEASUREMENT /end GROUP
/begin GROUP FordMsg40ABusHiSpd.PerInstanceMemories "MICROSAR RTE"
 /begin SUB_GROUP FordMsg40ABusHiSpd.FordClrDiagcFlgProxyPrev FordMsg40ABusHiSpd.FordVehGlbRealTiPrev FordMsg40ABusHiSpd.FordVehIdnNrC100Prev FordMsg40ABusHiSpd.FordVehIdnNrC101Prev FordMsg40ABusHiSpd.FordVehIdnNrC102Prev FordMsg40ABusHiSpd.FordVehIdnNrPrev FordMsg40ABusHiSpd.FordVehMsg40AMiss FordMsg40ABusHiSpd.FordVehMsg40ARxd FordMsg40ABusHiSpd.FordVehTireCircumPrev FordMsg40ABusHiSpd.MissMsgFaildRefTi FordMsg40ABusHiSpd.MissMsgPassdRefTi /end SUB_GROUP
 /begin FUNCTION_LIST /end FUNCTION_LIST
 /begin REF_CHARACTERISTIC /end REF_CHARACTERISTIC
 /begin REF_MEASUREMENT /end REF_MEASUREMENT
/end GROUP
/begin GROUP FordMsg40ABusHiSpd.ReceiverPorts "MICROSAR RTE"
 /begin SUB_GROUP FordMsg40ABusHiSpd.ClrDiagcFlgProxy.Val FordMsg40ABusHiSpd.FordCanDtcInhb.Val FordMsg40ABusHiSpd.FordEpsLifeCycMod.Val FordMsg40ABusHiSpd.FordMfgDiagcInhb.Val FordMsg40ABusHiSpd.FordMissMsgDiagcInhb.Val /end SUB_GROUP
 /begin FUNCTION_LIST /end FUNCTION_LIST
 /begin REF_CHARACTERISTIC /end REF_CHARACTERISTIC
 /begin REF_MEASUREMENT /end REF_MEASUREMENT
/end GROUP
/begin GROUP FordMsg40ABusHiSpd.SenderPorts "MICROSAR RTE"
 /begin SUB_GROUP FordMsg40ABusHiSpd.FordVehGlbRealTi.Val FordMsg40ABusHiSpd.FordVehIdnNr.Ary1D FordMsg40ABusHiSpd.FordVehTireCircum.Val /end SUB_GROUP
 /begin FUNCTION_LIST /end FUNCTION_LIST
 /begin REF_CHARACTERISTIC /end REF_CHARACTERISTIC
 /begin REF_MEASUREMENT /end REF_MEASUREMENT
/end GROUP
/begin GROUP FordMsg414BusHiSpd "MICROSAR RTE"
 /begin SUB_GROUP FordMsg414BusHiSpd.CalibrationPorts FordMsg414BusHiSpd.PerInstanceMemories FordMsg414BusHiSpd.SenderPorts /end SUB_GROUP
 /begin FUNCTION_LIST /end FUNCTION_LIST
 /begin REF_CHARACTERISTIC /end REF_CHARACTERISTIC
 /begin REF_MEASUREMENT /end REF_MEASUREMENT
/end GROUP
/begin GROUP FordMsg414BusHiSpd.AgOffsVldFaildRefTi "MICROSAR RTE" /begin SUB_GROUP /end SUB_GROUP /begin FUNCTION_LIST /end FUNCTION_LIST /begin REF_CHARACTERISTIC /end REF_CHARACTERISTIC /begin REF_MEASUREMENT FordMsg414BusHiSpd.AgOffsVldFaildRefTi /end REF_MEASUREMENT /end GROUP
/begin GROUP FordMsg414BusHiSpd.AgOffsVldMissRefTi "MICROSAR RTE" /begin SUB_GROUP /end SUB_GROUP /begin FUNCTION_LIST /end FUNCTION_LIST /begin REF_CHARACTERISTIC /end REF_CHARACTERISTIC /begin REF_MEASUREMENT FordMsg414BusHiSpd.AgOffsVldMissRefTi /end REF_MEASUREMENT /end GROUP
/begin GROUP FordMsg414BusHiSpd.AgOffsVldPassdRefTi "MICROSAR RTE" /begin SUB_GROUP /end SUB_GROUP /begin FUNCTION_LIST /end FUNCTION_LIST /begin REF_CHARACTERISTIC /end REF_CHARACTERISTIC /begin REF_MEASUREMENT FordMsg414BusHiSpd.AgOffsVldPassdRefTi /end REF_MEASUREMENT /end GROUP
/begin GROUP FordMsg414BusHiSpd.CalibrationPorts "MICROSAR RTE"
 /begin SUB_GROUP FordMsg414BusHiSpd.FordMsg414BusHiSpdAgOffsVldFaildThd.Val FordMsg414BusHiSpd.FordMsg414BusHiSpdAgOffsVldMissThd.Val FordMsg414BusHiSpd.FordMsg414BusHiSpdAgOffsVldPassdThd.Val FordMsg414BusHiSpd.FordMsg414BusHiSpdChksVldFaildThd.Val FordMsg414BusHiSpd.FordMsg414BusHiSpdChksVldMissThd.Val FordMsg414BusHiSpd.FordMsg414BusHiSpdCntrVldMissThd.Val /end SUB_GROUP
 /begin FUNCTION_LIST /end FUNCTION_LIST
 /begin REF_CHARACTERISTIC /end REF_CHARACTERISTIC
 /begin REF_MEASUREMENT /end REF_MEASUREMENT
/end GROUP
/begin GROUP FordMsg414BusHiSpd.ChksVldFaildRefTi "MICROSAR RTE" /begin SUB_GROUP /end SUB_GROUP /begin FUNCTION_LIST /end FUNCTION_LIST /begin REF_CHARACTERISTIC /end REF_CHARACTERISTIC /begin REF_MEASUREMENT FordMsg414BusHiSpd.ChksVldFaildRefTi /end REF_MEASUREMENT /end GROUP
/begin GROUP FordMsg414BusHiSpd.ChksVldMissRefTi "MICROSAR RTE" /begin SUB_GROUP /end SUB_GROUP /begin FUNCTION_LIST /end FUNCTION_LIST /begin REF_CHARACTERISTIC /end REF_CHARACTERISTIC /begin REF_MEASUREMENT FordMsg414BusHiSpd.ChksVldMissRefTi /end REF_MEASUREMENT /end GROUP
/begin GROUP FordMsg414BusHiSpd.CntrVldMissRefTi "MICROSAR RTE" /begin SUB_GROUP /end SUB_GROUP /begin FUNCTION_LIST /end FUNCTION_LIST /begin REF_CHARACTERISTIC /end REF_CHARACTERISTIC /begin REF_MEASUREMENT FordMsg414BusHiSpd.CntrVldMissRefTi /end REF_MEASUREMENT /end GROUP
/begin GROUP FordMsg414BusHiSpd.FirstTranVldFlg "MICROSAR RTE" /begin SUB_GROUP /end SUB_GROUP /begin FUNCTION_LIST /end FUNCTION_LIST /begin REF_CHARACTERISTIC /end REF_CHARACTERISTIC /begin REF_MEASUREMENT FordMsg414BusHiSpd.FirstTranVldFlg /end REF_MEASUREMENT /end GROUP
/begin GROUP FordMsg414BusHiSpd.FordMsg414BusHiSpdAgOffsVldFaildThd.Val "MICROSAR RTE" /begin SUB_GROUP /end SUB_GROUP /begin FUNCTION_LIST /end FUNCTION_LIST /begin REF_CHARACTERISTIC FordMsg414BusHiSpd.FordMsg414BusHiSpdAgOffsVldFaildThd.Val /end REF_CHARACTERISTIC /begin REF_MEASUREMENT /end REF_MEASUREMENT /end GROUP
/begin GROUP FordMsg414BusHiSpd.FordMsg414BusHiSpdAgOffsVldMissThd.Val "MICROSAR RTE" /begin SUB_GROUP /end SUB_GROUP /begin FUNCTION_LIST /end FUNCTION_LIST /begin REF_CHARACTERISTIC FordMsg414BusHiSpd.FordMsg414BusHiSpdAgOffsVldMissThd.Val /end REF_CHARACTERISTIC /begin REF_MEASUREMENT /end REF_MEASUREMENT /end GROUP
/begin GROUP FordMsg414BusHiSpd.FordMsg414BusHiSpdAgOffsVldPassdThd.Val "MICROSAR RTE" /begin SUB_GROUP /end SUB_GROUP /begin FUNCTION_LIST /end FUNCTION_LIST /begin REF_CHARACTERISTIC FordMsg414BusHiSpd.FordMsg414BusHiSpdAgOffsVldPassdThd.Val /end REF_CHARACTERISTIC /begin REF_MEASUREMENT /end REF_MEASUREMENT /end GROUP
/begin GROUP FordMsg414BusHiSpd.FordMsg414BusHiSpdChksVldFaildThd.Val "MICROSAR RTE" /begin SUB_GROUP /end SUB_GROUP /begin FUNCTION_LIST /end FUNCTION_LIST /begin REF_CHARACTERISTIC FordMsg414BusHiSpd.FordMsg414BusHiSpdChksVldFaildThd.Val /end REF_CHARACTERISTIC /begin REF_MEASUREMENT /end REF_MEASUREMENT /end GROUP
/begin GROUP FordMsg414BusHiSpd.FordMsg414BusHiSpdChksVldMissThd.Val "MICROSAR RTE" /begin SUB_GROUP /end SUB_GROUP /begin FUNCTION_LIST /end FUNCTION_LIST /begin REF_CHARACTERISTIC FordMsg414BusHiSpd.FordMsg414BusHiSpdChksVldMissThd.Val /end REF_CHARACTERISTIC /begin REF_MEASUREMENT /end REF_MEASUREMENT /end GROUP
/begin GROUP FordMsg414BusHiSpd.FordMsg414BusHiSpdCntrVldMissThd.Val "MICROSAR RTE" /begin SUB_GROUP /end SUB_GROUP /begin FUNCTION_LIST /end FUNCTION_LIST /begin REF_CHARACTERISTIC FordMsg414BusHiSpd.FordMsg414BusHiSpdCntrVldMissThd.Val /end REF_CHARACTERISTIC /begin REF_MEASUREMENT /end REF_MEASUREMENT /end GROUP
/begin GROUP FordMsg414BusHiSpd.FordVehMsg414Miss "MICROSAR RTE" /begin SUB_GROUP /end SUB_GROUP /begin FUNCTION_LIST /end FUNCTION_LIST /begin REF_CHARACTERISTIC /end REF_CHARACTERISTIC /begin REF_MEASUREMENT FordMsg414BusHiSpd.FordVehMsg414Miss /end REF_MEASUREMENT /end GROUP
/begin GROUP FordMsg414BusHiSpd.FordVehSteerPinionAgOffs.Val "MICROSAR RTE" /begin SUB_GROUP /end SUB_GROUP /begin FUNCTION_LIST /end FUNCTION_LIST /begin REF_CHARACTERISTIC /end REF_CHARACTERISTIC /begin REF_MEASUREMENT FordMsg414BusHiSpd.FordVehSteerPinionAgOffs.Val /end REF_MEASUREMENT /end GROUP
/begin GROUP FordMsg414BusHiSpd.FordVehSteerPinionAgOffsPrev "MICROSAR RTE" /begin SUB_GROUP /end SUB_GROUP /begin FUNCTION_LIST /end FUNCTION_LIST /begin REF_CHARACTERISTIC /end REF_CHARACTERISTIC /begin REF_MEASUREMENT FordMsg414BusHiSpd.FordVehSteerPinionAgOffsPrev /end REF_MEASUREMENT /end GROUP
/begin GROUP FordMsg414BusHiSpd.FordVehSteerPinionAgOffsRaw.Val "MICROSAR RTE" /begin SUB_GROUP /end SUB_GROUP /begin FUNCTION_LIST /end FUNCTION_LIST /begin REF_CHARACTERISTIC /end REF_CHARACTERISTIC /begin REF_MEASUREMENT FordMsg414BusHiSpd.FordVehSteerPinionAgOffsRaw.Val /end REF_MEASUREMENT /end GROUP
/begin GROUP FordMsg414BusHiSpd.FordVehSteerPinionAgOffsRawPrev "MICROSAR RTE" /begin SUB_GROUP /end SUB_GROUP /begin FUNCTION_LIST /end FUNCTION_LIST /begin REF_CHARACTERISTIC /end REF_CHARACTERISTIC /begin REF_MEASUREMENT FordMsg414BusHiSpd.FordVehSteerPinionAgOffsRawPrev /end REF_MEASUREMENT /end GROUP
/begin GROUP FordMsg414BusHiSpd.FordVehSteerPinionAgOffsVld.Logl "MICROSAR RTE" /begin SUB_GROUP /end SUB_GROUP /begin FUNCTION_LIST /end FUNCTION_LIST /begin REF_CHARACTERISTIC /end REF_CHARACTERISTIC /begin REF_MEASUREMENT FordMsg414BusHiSpd.FordVehSteerPinionAgOffsVld.Logl /end REF_MEASUREMENT /end GROUP
/begin GROUP FordMsg414BusHiSpd.FordVehSteerPinionAgOffsVldPrev "MICROSAR RTE" /begin SUB_GROUP /end SUB_GROUP /begin FUNCTION_LIST /end FUNCTION_LIST /begin REF_CHARACTERISTIC /end REF_CHARACTERISTIC /begin REF_MEASUREMENT FordMsg414BusHiSpd.FordVehSteerPinionAgOffsVldPrev /end REF_MEASUREMENT /end GROUP
/begin GROUP FordMsg414BusHiSpd.FordVehSteerPinionChksVld.Logl "MICROSAR RTE" /begin SUB_GROUP /end SUB_GROUP /begin FUNCTION_LIST /end FUNCTION_LIST /begin REF_CHARACTERISTIC /end REF_CHARACTERISTIC /begin REF_MEASUREMENT FordMsg414BusHiSpd.FordVehSteerPinionChksVld.Logl /end REF_MEASUREMENT /end GROUP
/begin GROUP FordMsg414BusHiSpd.FordVehSteerPinionChksVldPrev "MICROSAR RTE" /begin SUB_GROUP /end SUB_GROUP /begin FUNCTION_LIST /end FUNCTION_LIST /begin REF_CHARACTERISTIC /end REF_CHARACTERISTIC /begin REF_MEASUREMENT FordMsg414BusHiSpd.FordVehSteerPinionChksVldPrev /end REF_MEASUREMENT /end GROUP
/begin GROUP FordMsg414BusHiSpd.FordVehSteerPinionCntrVld.Logl "MICROSAR RTE" /begin SUB_GROUP /end SUB_GROUP /begin FUNCTION_LIST /end FUNCTION_LIST /begin REF_CHARACTERISTIC /end REF_CHARACTERISTIC /begin REF_MEASUREMENT FordMsg414BusHiSpd.FordVehSteerPinionCntrVld.Logl /end REF_MEASUREMENT /end GROUP
/begin GROUP FordMsg414BusHiSpd.FordVehSteerPinionCntrVldPrev "MICROSAR RTE" /begin SUB_GROUP /end SUB_GROUP /begin FUNCTION_LIST /end FUNCTION_LIST /begin REF_CHARACTERISTIC /end REF_CHARACTERISTIC /begin REF_MEASUREMENT FordMsg414BusHiSpd.FordVehSteerPinionCntrVldPrev /end REF_MEASUREMENT /end GROUP
/begin GROUP FordMsg414BusHiSpd.FordVehSteerPinionOffsChks.Val "MICROSAR RTE" /begin SUB_GROUP /end SUB_GROUP /begin FUNCTION_LIST /end FUNCTION_LIST /begin REF_CHARACTERISTIC /end REF_CHARACTERISTIC /begin REF_MEASUREMENT FordMsg414BusHiSpd.FordVehSteerPinionOffsChks.Val /end REF_MEASUREMENT /end GROUP
/begin GROUP FordMsg414BusHiSpd.FordVehSteerPinionOffsChksPrev "MICROSAR RTE" /begin SUB_GROUP /end SUB_GROUP /begin FUNCTION_LIST /end FUNCTION_LIST /begin REF_CHARACTERISTIC /end REF_CHARACTERISTIC /begin REF_MEASUREMENT FordMsg414BusHiSpd.FordVehSteerPinionOffsChksPrev /end REF_MEASUREMENT /end GROUP
/begin GROUP FordMsg414BusHiSpd.FordVehSteerPinionOffsCnt.Val "MICROSAR RTE" /begin SUB_GROUP /end SUB_GROUP /begin FUNCTION_LIST /end FUNCTION_LIST /begin REF_CHARACTERISTIC /end REF_CHARACTERISTIC /begin REF_MEASUREMENT FordMsg414BusHiSpd.FordVehSteerPinionOffsCnt.Val /end REF_MEASUREMENT /end GROUP
/begin GROUP FordMsg414BusHiSpd.FordVehSteerPinionOffsCntPrev "MICROSAR RTE" /begin SUB_GROUP /end SUB_GROUP /begin FUNCTION_LIST /end FUNCTION_LIST /begin REF_CHARACTERISTIC /end REF_CHARACTERISTIC /begin REF_MEASUREMENT FordMsg414BusHiSpd.FordVehSteerPinionOffsCntPrev /end REF_MEASUREMENT /end GROUP
/begin GROUP FordMsg414BusHiSpd.FordVehSteerPinionOffsSts.Ford_StePinOffst_D_Stat "MICROSAR RTE" /begin SUB_GROUP /end SUB_GROUP /begin FUNCTION_LIST /end FUNCTION_LIST /begin REF_CHARACTERISTIC /end REF_CHARACTERISTIC
 /begin REF_MEASUREMENT FordMsg414BusHiSpd.FordVehSteerPinionOffsSts.Ford_StePinOffst_D_Stat /end REF_MEASUREMENT
/end GROUP
/begin GROUP FordMsg414BusHiSpd.FordVehSteerPinionOffsStsPrev "MICROSAR RTE" /begin SUB_GROUP /end SUB_GROUP /begin FUNCTION_LIST /end FUNCTION_LIST /begin REF_CHARACTERISTIC /end REF_CHARACTERISTIC /begin REF_MEASUREMENT FordMsg414BusHiSpd.FordVehSteerPinionOffsStsPrev /end REF_MEASUREMENT /end GROUP
/begin GROUP FordMsg414BusHiSpd.FordVehSteerPinionOffsStsRaw.Val "MICROSAR RTE" /begin SUB_GROUP /end SUB_GROUP /begin FUNCTION_LIST /end FUNCTION_LIST /begin REF_CHARACTERISTIC /end REF_CHARACTERISTIC /begin REF_MEASUREMENT FordMsg414BusHiSpd.FordVehSteerPinionOffsStsRaw.Val /end REF_MEASUREMENT /end GROUP
/begin GROUP FordMsg414BusHiSpd.FordVehSteerPinionOffsStsRawPrev "MICROSAR RTE" /begin SUB_GROUP /end SUB_GROUP /begin FUNCTION_LIST /end FUNCTION_LIST /begin REF_CHARACTERISTIC /end REF_CHARACTERISTIC /begin REF_MEASUREMENT FordMsg414BusHiSpd.FordVehSteerPinionOffsStsRawPrev /end REF_MEASUREMENT /end GROUP
/begin GROUP FordMsg414BusHiSpd.PerInstanceMemories "MICROSAR RTE"
 /begin SUB_GROUP FordMsg414BusHiSpd.AgOffsVldFaildRefTi FordMsg414BusHiSpd.AgOffsVldMissRefTi FordMsg414BusHiSpd.AgOffsVldPassdRefTi FordMsg414BusHiSpd.ChksVldFaildRefTi FordMsg414BusHiSpd.ChksVldMissRefTi FordMsg414BusHiSpd.CntrVldMissRefTi FordMsg414BusHiSpd.FirstTranVldFlg FordMsg414BusHiSpd.FordVehMsg414Miss FordMsg414BusHiSpd.FordVehSteerPinionAgOffsPrev FordMsg414BusHiSpd.FordVehSteerPinionAgOffsRawPrev FordMsg414BusHiSpd.FordVehSteerPinionAgOffsVldPrev FordMsg414BusHiSpd.FordVehSteerPinionChksVldPrev FordMsg414BusHiSpd.FordVehSteerPinionCntrVldPrev FordMsg414BusHiSpd.FordVehSteerPinionOffsChksPrev FordMsg414BusHiSpd.FordVehSteerPinionOffsCntPrev FordMsg414BusHiSpd.FordVehSteerPinionOffsStsPrev FordMsg414BusHiSpd.FordVehSteerPinionOffsStsRawPrev /end SUB_GROUP
 /begin FUNCTION_LIST /end FUNCTION_LIST
 /begin REF_CHARACTERISTIC /end REF_CHARACTERISTIC
 /begin REF_MEASUREMENT /end REF_MEASUREMENT
/end GROUP
/begin GROUP FordMsg414BusHiSpd.SenderPorts "MICROSAR RTE"
 /begin SUB_GROUP FordMsg414BusHiSpd.FordVehSteerPinionAgOffs.Val FordMsg414BusHiSpd.FordVehSteerPinionAgOffsRaw.Val FordMsg414BusHiSpd.FordVehSteerPinionAgOffsVld.Logl FordMsg414BusHiSpd.FordVehSteerPinionChksVld.Logl FordMsg414BusHiSpd.FordVehSteerPinionCntrVld.Logl FordMsg414BusHiSpd.FordVehSteerPinionOffsChks.Val FordMsg414BusHiSpd.FordVehSteerPinionOffsCnt.Val FordMsg414BusHiSpd.FordVehSteerPinionOffsSts.Ford_StePinOffst_D_Stat FordMsg414BusHiSpd.FordVehSteerPinionOffsStsRaw.Val /end SUB_GROUP
 /begin FUNCTION_LIST /end FUNCTION_LIST
 /begin REF_CHARACTERISTIC /end REF_CHARACTERISTIC
 /begin REF_MEASUREMENT /end REF_MEASUREMENT
/end GROUP
/begin GROUP FordMsg415BusHiSpd "MICROSAR RTE"
 /begin SUB_GROUP FordMsg415BusHiSpd.CalibrationPorts FordMsg415BusHiSpd.PerInstanceMemories FordMsg415BusHiSpd.ReceiverPorts FordMsg415BusHiSpd.SenderPorts /end SUB_GROUP
 /begin FUNCTION_LIST /end FUNCTION_LIST
 /begin REF_CHARACTERISTIC /end REF_CHARACTERISTIC
 /begin REF_MEASUREMENT /end REF_MEASUREMENT
/end GROUP
/begin GROUP FordMsg415BusHiSpd.BrkModlLoQlyVldFaildRefTi "MICROSAR RTE" /begin SUB_GROUP /end SUB_GROUP /begin FUNCTION_LIST /end FUNCTION_LIST /begin REF_CHARACTERISTIC /end REF_CHARACTERISTIC /begin REF_MEASUREMENT FordMsg415BusHiSpd.BrkModlLoQlyVldFaildRefTi /end REF_MEASUREMENT /end GROUP
/begin GROUP FordMsg415BusHiSpd.BrkModlLoQlyVldMissRefTi "MICROSAR RTE" /begin SUB_GROUP /end SUB_GROUP /begin FUNCTION_LIST /end FUNCTION_LIST /begin REF_CHARACTERISTIC /end REF_CHARACTERISTIC /begin REF_MEASUREMENT FordMsg415BusHiSpd.BrkModlLoQlyVldMissRefTi /end REF_MEASUREMENT /end GROUP
/begin GROUP FordMsg415BusHiSpd.BrkModlLoQlyVldPassdRefTi "MICROSAR RTE" /begin SUB_GROUP /end SUB_GROUP /begin FUNCTION_LIST /end FUNCTION_LIST /begin REF_CHARACTERISTIC /end REF_CHARACTERISTIC /begin REF_MEASUREMENT FordMsg415BusHiSpd.BrkModlLoQlyVldPassdRefTi /end REF_MEASUREMENT /end GROUP
/begin GROUP FordMsg415BusHiSpd.BrkModlVldFaildRefTi "MICROSAR RTE" /begin SUB_GROUP /end SUB_GROUP /begin FUNCTION_LIST /end FUNCTION_LIST /begin REF_CHARACTERISTIC /end REF_CHARACTERISTIC /begin REF_MEASUREMENT FordMsg415BusHiSpd.BrkModlVldFaildRefTi /end REF_MEASUREMENT /end GROUP
/begin GROUP FordMsg415BusHiSpd.BrkModlVldMissRefTi "MICROSAR RTE" /begin SUB_GROUP /end SUB_GROUP /begin FUNCTION_LIST /end FUNCTION_LIST /begin REF_CHARACTERISTIC /end REF_CHARACTERISTIC /begin REF_MEASUREMENT FordMsg415BusHiSpd.BrkModlVldMissRefTi /end REF_MEASUREMENT /end GROUP
/begin GROUP FordMsg415BusHiSpd.BrkModlVldPassdRefTi "MICROSAR RTE" /begin SUB_GROUP /end SUB_GROUP /begin FUNCTION_LIST /end FUNCTION_LIST /begin REF_CHARACTERISTIC /end REF_CHARACTERISTIC /begin REF_MEASUREMENT FordMsg415BusHiSpd.BrkModlVldPassdRefTi /end REF_MEASUREMENT /end GROUP
/begin GROUP FordMsg415BusHiSpd.BrkSprtVldMissRefTi "MICROSAR RTE" /begin SUB_GROUP /end SUB_GROUP /begin FUNCTION_LIST /end FUNCTION_LIST /begin REF_CHARACTERISTIC /end REF_CHARACTERISTIC /begin REF_MEASUREMENT FordMsg415BusHiSpd.BrkSprtVldMissRefTi /end REF_MEASUREMENT /end GROUP
/begin GROUP FordMsg415BusHiSpd.BrkSprtVldPassdRefTi "MICROSAR RTE" /begin SUB_GROUP /end SUB_GROUP /begin FUNCTION_LIST /end FUNCTION_LIST /begin REF_CHARACTERISTIC /end REF_CHARACTERISTIC /begin REF_MEASUREMENT FordMsg415BusHiSpd.BrkSprtVldPassdRefTi /end REF_MEASUREMENT /end GROUP
/begin RECORD_LAYOUT RTE_RL_UWORD FNC_VALUES 1 UWORD ROW_DIR DIRECT /end RECORD_LAYOUT
/begin RECORD_LAYOUT RTE_RL_FLOAT64_IEEE FNC_VALUES 1 FLOAT64_IEEE ROW_DIR DIRECT /end RECORD_LAYOUT
/**********************************************************************************************************************
* COMPU_METHOD / COMPU_VTAB_RANGE
*********************************************************************************************************************/
/begin COMPU_METHOD RTE_CM_BOOLEAN "" TAB_VERB "%3.1" "" COMPU_TAB_REF RTE_CM_BOOLEAN /end COMPU_METHOD
/begin COMPU_VTAB_RANGE RTE_CM_BOOLEAN "" 2 0 0 "false" 1 255 "true" /end COMPU_VTAB_RANGE
/begin COMPU_METHOD RTE_CM_ENUM_Ford_Ignition_Status "" TAB_VERB "%.1" "" COMPU_TAB_REF RTE_CM_ENUM_Ford_Ignition_Status /end COMPU_METHOD
/begin COMPU_VTAB_RANGE RTE_CM_ENUM_Ford_Ignition_Status "" 7 0 15 "RANGE" 0 0 "Cx0_Unknown" 1 1 "Cx1_Off" 2 2 "Cx2_Accessory" 4 4 "Cx4_Run" 8 8 "Cx8_Start" 15 15 "CxF_Invalid" /end COMPU_VTAB_RANGE
/begin COMPU_METHOD RTE_CM_ENUM_Ford_LifeCycMde_D_Actl "" TAB_VERB "%.1" "" COMPU_TAB_REF RTE_CM_ENUM_Ford_LifeCycMde_D_Actl /end COMPU_METHOD
/begin COMPU_VTAB_RANGE RTE_CM_ENUM_Ford_LifeCycMde_D_Actl "" 5 0 15 "RANGE" 0 0 "Cx0_Normal" 1 1 "Cx1_Factory" 2 2 "Cx2_NotUsed" 3 3 "Cx3_Transport" /end COMPU_VTAB_RANGE
/begin COMPU_METHOD RTE_CM_ENUM_Ford_StePinOffst_D_Stat "" TAB_VERB "%.1" "" COMPU_TAB_REF RTE_CM_ENUM_Ford_StePinOffst_D_Stat /end COMPU_METHOD
/begin COMPU_VTAB_RANGE RTE_CM_ENUM_Ford_StePinOffst_D_Stat "" 5 0 3 "RANGE" 0 0 "Cx0_OffsetNotCalculated" 1 1 "Cx1_StoredOffset" 2 2 "Cx2_CoarseOffset" 3 3 "Cx3_FineOffset" /end COMPU_VTAB_RANGE
/begin COMPU_METHOD RTE_CM_ENUM_Ford_LatCtlPrecision_D_Rq "" TAB_VERB "%.1" "" COMPU_TAB_REF RTE_CM_ENUM_Ford_LatCtlPrecision_D_Rq /end COMPU_METHOD
/begin COMPU_VTAB_RANGE RTE_CM_ENUM_Ford_LatCtlPrecision_D_Rq "" 5 0 3 "RANGE" 0 0 "Cx0_Comfortable" 1 1 "Cx1_Precise" 2 2 "Cx2_NotUsed1" 3 3 "Cx3_NotUsed2" /end COMPU_VTAB_RANGE
/begin COMPU_METHOD RTE_CM_ENUM_Ford_LatCtlRampType_D_Rq "" TAB_VERB "%.1" "" COMPU_TAB_REF RTE_CM_ENUM_Ford_LatCtlRampType_D_Rq /end COMPU_METHOD
/begin COMPU_VTAB_RANGE RTE_CM_ENUM_Ford_LatCtlRampType_D_Rq "" 5 0 3 "RANGE" 0 0 "Cx0_Slow" 1 1 "Cx1_Medium" 2 2 "Cx2_Fast" 3 3 "Cx3_Immediately" /end COMPU_VTAB_RANGE
/begin COMPU_METHOD RTE_CM_ENUM_Ford_LatCtl_D_Rq "" TAB_VERB "%.1" "" COMPU_TAB_REF RTE_CM_ENUM_Ford_LatCtl_D_Rq /end COMPU_METHOD
/begin COMPU_VTAB_RANGE RTE_CM_ENUM_Ford_LatCtl_D_Rq "" 9 0 7 "RANGE" 0 0 "Cx0_NoLateralControl" 1 1 "Cx1_ContinuousPathFollowing" 2 2 "Cx2_InterventionLeft" 3 3 "Cx3_InterventionRight" 4 4 "Cx4_NotUsed1" 5 5 "Cx5_NotUsed2" 6 6 "Cx6_NotUsed3" 7 7 "Cx7_NotUsed4" /end COMPU_VTAB_RANGE
