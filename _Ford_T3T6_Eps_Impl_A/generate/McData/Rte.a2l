/begin CHARACTERISTIC FordMsg213BusHiSpd.FordMsg213BusHiSpdAbsActvVldFaildThd.Val "MICROSAR RTE" VALUE 0x0 RTE_RL_UWORD 0 NO_COMPU_METHOD 0 65535 SYMBOL_LINK "Rte_CalprmRom_CalRegn01Cmn_DEFAULT_RTE_CALPRM_GROUP.FordMsg213BusHiSpdAbsActvVldFaildThd_Val" 0 DISPLAY_IDENTIFIER FordMsg213BusHiSpd.CalibrationPorts.FordMsg213BusHiSpdAbsActvVldFaildThd.Val /end CHARACTERISTIC
/begin CHARACTERISTIC FordMsg213BusHiSpd.FordMsg213BusHiSpdAbsActvVldPassdThd.Val "MICROSAR RTE" VALUE 0x0 RTE_RL_UWORD 0 NO_COMPU_METHOD 0 65535 SYMBOL_LINK "Rte_CalprmRom_CalRegn01Cmn_DEFAULT_RTE_CALPRM_GROUP.FordMsg213BusHiSpdAbsActvVldPassdThd_Val" 0 DISPLAY_IDENTIFIER FordMsg213BusHiSpd.CalibrationPorts.FordMsg213BusHiSpdAbsActvVldPassdThd.Val /end CHARACTERISTIC
/begin CHARACTERISTIC FordMsg213BusHiSpd.FordMsg213BusHiSpdEvasSteerAssiEnadThd.Val "MICROSAR RTE" VALUE 0x0 RTE_RL_UWORD 0 NO_COMPU_METHOD 0 65535 SYMBOL_LINK "Rte_CalprmRom_CalRegn01Cmn_DEFAULT_RTE_CALPRM_GROUP.FordMsg213BusHiSpdEvasSteerAssiEnadThd_Val" 0 DISPLAY_IDENTIFIER FordMsg213BusHiSpd.CalibrationPorts.FordMsg213BusHiSpdEvasSteerAssiEnadThd.Val /end CHARACTERISTIC
/begin CHARACTERISTIC FordMsg213BusHiSpd.FordMsg213BusHiSpdMissMsgFaildThd.Val "MICROSAR RTE" VALUE 0x0 RTE_RL_UWORD 0 NO_COMPU_METHOD 0 65535 SYMBOL_LINK "Rte_CalprmRom_CalRegn01Cmn_DEFAULT_RTE_CALPRM_GROUP.FordMsg213BusHiSpdMissMsgFaildThd_Val" 0 DISPLAY_IDENTIFIER FordMsg213BusHiSpd.CalibrationPorts.FordMsg213BusHiSpdMissMsgFaildThd.Val /end CHARACTERISTIC
/begin CHARACTERISTIC FordMsg213BusHiSpd.FordMsg213BusHiSpdMissMsgPassdThd.Val "MICROSAR RTE" VALUE 0x0 RTE_RL_UWORD 0 NO_COMPU_METHOD 0 65535 SYMBOL_LINK "Rte_CalprmRom_CalRegn01Cmn_DEFAULT_RTE_CALPRM_GROUP.FordMsg213BusHiSpdMissMsgPassdThd_Val" 0 DISPLAY_IDENTIFIER FordMsg213BusHiSpd.CalibrationPorts.FordMsg213BusHiSpdMissMsgPassdThd.Val /end CHARACTERISTIC
/begin CHARACTERISTIC FordMsg215BusHiSpd.FordMsg215BusHiSpdFordVehTrlrAidModReqVldNotRxdTiThd.Val "MICROSAR RTE" VALUE 0x0 RTE_RL_UWORD 0 NO_COMPU_METHOD 0 65535 SYMBOL_LINK "Rte_CalprmRom_CalRegn01Cmn_DEFAULT_RTE_CALPRM_GROUP.FordMsg215BusHiSpdFordVehTrlrAidModReqVldNotRxdTiThd_Val" 0 DISPLAY_IDENTIFIER FordMsg215BusHiSpd.CalibrationPorts.FordMsg215BusHiSpdFordVehTrlrAidModReqVldNotRxdTiThd.Val /end CHARACTERISTIC
/begin CHARACTERISTIC FordMsg215BusHiSpd.FordMsg215BusHiSpdFordVehTrlrAidModReqVldRxdTiThd.Val "MICROSAR RTE" VALUE 0x0 RTE_RL_UWORD 0 NO_COMPU_METHOD 0 65535 SYMBOL_LINK "Rte_CalprmRom_CalRegn01Cmn_DEFAULT_RTE_CALPRM_GROUP.FordMsg215BusHiSpdFordVehTrlrAidModReqVldRxdTiThd_Val" 0 DISPLAY_IDENTIFIER FordMsg215BusHiSpd.CalibrationPorts.FordMsg215BusHiSpdFordVehTrlrAidModReqVldRxdTiThd.Val /end CHARACTERISTIC
/begin CHARACTERISTIC FordMsg215BusHiSpd.FordMsg215BusHiSpdMissMsgFaildTiThd.Val "MICROSAR RTE" VALUE 0x0 RTE_RL_UWORD 0 NO_COMPU_METHOD 0 65535 SYMBOL_LINK "Rte_CalprmRom_CalRegn01Cmn_DEFAULT_RTE_CALPRM_GROUP.FordMsg215BusHiSpdMissMsgFaildTiThd_Val" 0 DISPLAY_IDENTIFIER FordMsg215BusHiSpd.CalibrationPorts.FordMsg215BusHiSpdMissMsgFaildTiThd.Val /end CHARACTERISTIC
/begin CHARACTERISTIC FordMsg215BusHiSpd.FordMsg215BusHiSpdMissMsgPassdTiThd.Val "MICROSAR RTE" VALUE 0x0 RTE_RL_UWORD 0 NO_COMPU_METHOD 0 65535 SYMBOL_LINK "Rte_CalprmRom_CalRegn01Cmn_DEFAULT_RTE_CALPRM_GROUP.FordMsg215BusHiSpdMissMsgPassdTiThd_Val" 0 DISPLAY_IDENTIFIER FordMsg215BusHiSpd.CalibrationPorts.FordMsg215BusHiSpdMissMsgPassdTiThd.Val /end CHARACTERISTIC
/begin CHARACTERISTIC FordMsg216BusHiSpd.FordMsg216BusHiSpdFrntLeWhlCntrDirFaildTiThd.Val "MICROSAR RTE" VALUE 0x0 RTE_RL_UWORD 0 NO_COMPU_METHOD 0 65535 SYMBOL_LINK "Rte_CalprmRom_CalRegn01Cmn_DEFAULT_RTE_CALPRM_GROUP.FordMsg216BusHiSpdFrntLeWhlCntrDirFaildTiThd_Val" 0 DISPLAY_IDENTIFIER FordMsg216BusHiSpd.CalibrationPorts.FordMsg216BusHiSpdFrntLeWhlCntrDirFaildTiThd.Val /end CHARACTERISTIC
/begin CHARACTERISTIC FordMsg216BusHiSpd.FordMsg216BusHiSpdFrntLeWhlCntrDirPassdTiThd.Val "MICROSAR RTE" VALUE 0x0 RTE_RL_UWORD 0 NO_COMPU_METHOD 0 65535 SYMBOL_LINK "Rte_CalprmRom_CalRegn01Cmn_DEFAULT_RTE_CALPRM_GROUP.FordMsg216BusHiSpdFrntLeWhlCntrDirPassdTiThd_Val" 0 DISPLAY_IDENTIFIER FordMsg216BusHiSpd.CalibrationPorts.FordMsg216BusHiSpdFrntLeWhlCntrDirPassdTiThd.Val /end CHARACTERISTIC
/begin CHARACTERISTIC FordMsg216BusHiSpd.FordMsg216BusHiSpdFrntLeWhlVldMissMsgThd.Val "MICROSAR RTE" VALUE 0x0 RTE_RL_UWORD 0 NO_COMPU_METHOD 0 65535 SYMBOL_LINK "Rte_CalprmRom_CalRegn01Cmn_DEFAULT_RTE_CALPRM_GROUP.FordMsg216BusHiSpdFrntLeWhlVldMissMsgThd_Val" 0 DISPLAY_IDENTIFIER FordMsg216BusHiSpd.CalibrationPorts.FordMsg216BusHiSpdFrntLeWhlVldMissMsgThd.Val /end CHARACTERISTIC
/begin CHARACTERISTIC FordMsg216BusHiSpd.FordMsg216BusHiSpdFrntRiWhlCntrDirFaildTiThd.Val "MICROSAR RTE" VALUE 0x0 RTE_RL_UWORD 0 NO_COMPU_METHOD 0 65535 SYMBOL_LINK "Rte_CalprmRom_CalRegn01Cmn_DEFAULT_RTE_CALPRM_GROUP.FordMsg216BusHiSpdFrntRiWhlCntrDirFaildTiThd_Val" 0 DISPLAY_IDENTIFIER FordMsg216BusHiSpd.CalibrationPorts.FordMsg216BusHiSpdFrntRiWhlCntrDirFaildTiThd.Val /end CHARACTERISTIC
/begin CHARACTERISTIC FordMsg216BusHiSpd.FordMsg216BusHiSpdFrntRiWhlCntrDirPassdTiThd.Val "MICROSAR RTE" VALUE 0x0 RTE_RL_UWORD 0 NO_COMPU_METHOD 0 65535 SYMBOL_LINK "Rte_CalprmRom_CalRegn01Cmn_DEFAULT_RTE_CALPRM_GROUP.FordMsg216BusHiSpdFrntRiWhlCntrDirPassdTiThd_Val" 0 DISPLAY_IDENTIFIER FordMsg216BusHiSpd.CalibrationPorts.FordMsg216BusHiSpdFrntRiWhlCntrDirPassdTiThd.Val /end CHARACTERISTIC
/begin CHARACTERISTIC FordMsg216BusHiSpd.FordMsg216BusHiSpdFrntRiWhlVldMissMsgThd.Val "MICROSAR RTE" VALUE 0x0 RTE_RL_UWORD 0 NO_COMPU_METHOD 0 65535 SYMBOL_LINK "Rte_CalprmRom_CalRegn01Cmn_DEFAULT_RTE_CALPRM_GROUP.FordMsg216BusHiSpdFrntRiWhlVldMissMsgThd_Val" 0 DISPLAY_IDENTIFIER FordMsg216BusHiSpd.CalibrationPorts.FordMsg216BusHiSpdFrntRiWhlVldMissMsgThd.Val /end CHARACTERISTIC
/begin CHARACTERISTIC FordMsg216BusHiSpd.FordMsg216BusHiSpdMissMsgFaildTiThd.Val "MICROSAR RTE" VALUE 0x0 RTE_RL_UWORD 0 NO_COMPU_METHOD 0 65535 SYMBOL_LINK "Rte_CalprmRom_CalRegn01Cmn_DEFAULT_RTE_CALPRM_GROUP.FordMsg216BusHiSpdMissMsgFaildTiThd_Val" 0 DISPLAY_IDENTIFIER FordMsg216BusHiSpd.CalibrationPorts.FordMsg216BusHiSpdMissMsgFaildTiThd.Val /end CHARACTERISTIC
/begin CHARACTERISTIC FordMsg216BusHiSpd.FordMsg216BusHiSpdMissMsgPassdTiThd.Val "MICROSAR RTE" VALUE 0x0 RTE_RL_UWORD 0 NO_COMPU_METHOD 0 65535 SYMBOL_LINK "Rte_CalprmRom_CalRegn01Cmn_DEFAULT_RTE_CALPRM_GROUP.FordMsg216BusHiSpdMissMsgPassdTiThd_Val" 0 DISPLAY_IDENTIFIER FordMsg216BusHiSpd.CalibrationPorts.FordMsg216BusHiSpdMissMsgPassdTiThd.Val /end CHARACTERISTIC
/begin CHARACTERISTIC FordMsg216BusHiSpd.FordMsg216BusHiSpdReLeWhlCntrDirFaildTiThd.Val "MICROSAR RTE" VALUE 0x0 RTE_RL_UWORD 0 NO_COMPU_METHOD 0 65535 SYMBOL_LINK "Rte_CalprmRom_CalRegn01Cmn_DEFAULT_RTE_CALPRM_GROUP.FordMsg216BusHiSpdReLeWhlCntrDirFaildTiThd_Val" 0 DISPLAY_IDENTIFIER FordMsg216BusHiSpd.CalibrationPorts.FordMsg216BusHiSpdReLeWhlCntrDirFaildTiThd.Val /end CHARACTERISTIC
/begin CHARACTERISTIC FordMsg216BusHiSpd.FordMsg216BusHiSpdReLeWhlCntrDirPassdTiThd.Val "MICROSAR RTE" VALUE 0x0 RTE_RL_UWORD 0 NO_COMPU_METHOD 0 65535 SYMBOL_LINK "Rte_CalprmRom_CalRegn01Cmn_DEFAULT_RTE_CALPRM_GROUP.FordMsg216BusHiSpdReLeWhlCntrDirPassdTiThd_Val" 0 DISPLAY_IDENTIFIER FordMsg216BusHiSpd.CalibrationPorts.FordMsg216BusHiSpdReLeWhlCntrDirPassdTiThd.Val /end CHARACTERISTIC
/begin CHARACTERISTIC FordMsg216BusHiSpd.FordMsg216BusHiSpdReLeWhlVldMissMsgThd.Val "MICROSAR RTE" VALUE 0x0 RTE_RL_UWORD 0 NO_COMPU_METHOD 0 65535 SYMBOL_LINK "Rte_CalprmRom_CalRegn01Cmn_DEFAULT_RTE_CALPRM_GROUP.FordMsg216BusHiSpdReLeWhlVldMissMsgThd_Val" 0 DISPLAY_IDENTIFIER FordMsg216BusHiSpd.CalibrationPorts.FordMsg216BusHiSpdReLeWhlVldMissMsgThd.Val /end CHARACTERISTIC
/begin CHARACTERISTIC FordMsg216BusHiSpd.FordMsg216BusHiSpdReRiWhlCntrDirFaildTiThd.Val "MICROSAR RTE" VALUE 0x0 RTE_RL_UWORD 0 NO_COMPU_METHOD 0 65535 SYMBOL_LINK "Rte_CalprmRom_CalRegn01Cmn_DEFAULT_RTE_CALPRM_GROUP.FordMsg216BusHiSpdReRiWhlCntrDirFaildTiThd_Val" 0 DISPLAY_IDENTIFIER FordMsg216BusHiSpd.CalibrationPorts.FordMsg216BusHiSpdReRiWhlCntrDirFaildTiThd.Val /end CHARACTERISTIC
/begin CHARACTERISTIC FordMsg216BusHiSpd.FordMsg216BusHiSpdReRiWhlCntrDirPassdTiThd.Val "MICROSAR RTE" VALUE 0x0 RTE_RL_UWORD 0 NO_COMPU_METHOD 0 65535 SYMBOL_LINK "Rte_CalprmRom_CalRegn01Cmn_DEFAULT_RTE_CALPRM_GROUP.FordMsg216BusHiSpdReRiWhlCntrDirPassdTiThd_Val" 0 DISPLAY_IDENTIFIER FordMsg216BusHiSpd.CalibrationPorts.FordMsg216BusHiSpdReRiWhlCntrDirPassdTiThd.Val /end CHARACTERISTIC
/begin CHARACTERISTIC FordMsg216BusHiSpd.FordMsg216BusHiSpdReRiWhlVldMissMsgThd.Val "MICROSAR RTE" VALUE 0x0 RTE_RL_UWORD 0 NO_COMPU_METHOD 0 65535 SYMBOL_LINK "Rte_CalprmRom_CalRegn01Cmn_DEFAULT_RTE_CALPRM_GROUP.FordMsg216BusHiSpdReRiWhlVldMissMsgThd_Val" 0 DISPLAY_IDENTIFIER FordMsg216BusHiSpd.CalibrationPorts.FordMsg216BusHiSpdReRiWhlVldMissMsgThd.Val /end CHARACTERISTIC
/begin CHARACTERISTIC FordMsg217BusHiSpd.FordMsg217BusHiSpdFrntLeWhlSpdInvldFaildThd.Val "MICROSAR RTE" VALUE 0x0 RTE_RL_UWORD 0 NO_COMPU_METHOD 0 65535 SYMBOL_LINK "Rte_CalprmRom_CalRegn01Cmn_DEFAULT_RTE_CALPRM_GROUP.FordMsg217BusHiSpdFrntLeWhlSpdInvldFaildThd_Val" 0 DISPLAY_IDENTIFIER FordMsg217BusHiSpd.CalibrationPorts.FordMsg217BusHiSpdFrntLeWhlSpdInvldFaildThd.Val /end CHARACTERISTIC
/begin CHARACTERISTIC FordMsg217BusHiSpd.FordMsg217BusHiSpdFrntLeWhlSpdInvldPassdThd.Val "MICROSAR RTE" VALUE 0x0 RTE_RL_UWORD 0 NO_COMPU_METHOD 0 65535 SYMBOL_LINK "Rte_CalprmRom_CalRegn01Cmn_DEFAULT_RTE_CALPRM_GROUP.FordMsg217BusHiSpdFrntLeWhlSpdInvldPassdThd_Val" 0 DISPLAY_IDENTIFIER FordMsg217BusHiSpd.CalibrationPorts.FordMsg217BusHiSpdFrntLeWhlSpdInvldPassdThd.Val /end CHARACTERISTIC
/begin CHARACTERISTIC FordMsg217BusHiSpd.FordMsg217BusHiSpdFrntLeWhlVldFaildThd.Val "MICROSAR RTE" VALUE 0x0 RTE_RL_UWORD 0 NO_COMPU_METHOD 0 65535 SYMBOL_LINK "Rte_CalprmRom_CalRegn01Cmn_DEFAULT_RTE_CALPRM_GROUP.FordMsg217BusHiSpdFrntLeWhlVldFaildThd_Val" 0 DISPLAY_IDENTIFIER FordMsg217BusHiSpd.CalibrationPorts.FordMsg217BusHiSpdFrntLeWhlVldFaildThd.Val /end CHARACTERISTIC
/begin CHARACTERISTIC FordMsg217BusHiSpd.FordMsg217BusHiSpdFrntLeWhlVldMissThd.Val "MICROSAR RTE" VALUE 0x0 RTE_RL_UWORD 0 NO_COMPU_METHOD 0 65535 SYMBOL_LINK "Rte_CalprmRom_CalRegn01Cmn_DEFAULT_RTE_CALPRM_GROUP.FordMsg217BusHiSpdFrntLeWhlVldMissThd_Val" 0 DISPLAY_IDENTIFIER FordMsg217BusHiSpd.CalibrationPorts.FordMsg217BusHiSpdFrntLeWhlVldMissThd.Val /end CHARACTERISTIC
/begin CHARACTERISTIC FordMsg217BusHiSpd.FordMsg217BusHiSpdFrntLeWhlVldPassdThd.Val "MICROSAR RTE" VALUE 0x0 RTE_RL_UWORD 0 NO_COMPU_METHOD 0 65535 SYMBOL_LINK "Rte_CalprmRom_CalRegn01Cmn_DEFAULT_RTE_CALPRM_GROUP.FordMsg217BusHiSpdFrntLeWhlVldPassdThd_Val" 0 DISPLAY_IDENTIFIER FordMsg217BusHiSpd.CalibrationPorts.FordMsg217BusHiSpdFrntLeWhlVldPassdThd.Val /end CHARACTERISTIC
/begin CHARACTERISTIC FordMsg217BusHiSpd.FordMsg217BusHiSpdFrntRiWhlSpdInvldFaildThd.Val "MICROSAR RTE" VALUE 0x0 RTE_RL_UWORD 0 NO_COMPU_METHOD 0 65535 SYMBOL_LINK "Rte_CalprmRom_CalRegn01Cmn_DEFAULT_RTE_CALPRM_GROUP.FordMsg217BusHiSpdFrntRiWhlSpdInvldFaildThd_Val" 0 DISPLAY_IDENTIFIER FordMsg217BusHiSpd.CalibrationPorts.FordMsg217BusHiSpdFrntRiWhlSpdInvldFaildThd.Val /end CHARACTERISTIC
/begin CHARACTERISTIC FordMsg217BusHiSpd.FordMsg217BusHiSpdFrntRiWhlSpdInvldPassdThd.Val "MICROSAR RTE" VALUE 0x0 RTE_RL_UWORD 0 NO_COMPU_METHOD 0 65535 SYMBOL_LINK "Rte_CalprmRom_CalRegn01Cmn_DEFAULT_RTE_CALPRM_GROUP.FordMsg217BusHiSpdFrntRiWhlSpdInvldPassdThd_Val" 0 DISPLAY_IDENTIFIER FordMsg217BusHiSpd.CalibrationPorts.FordMsg217BusHiSpdFrntRiWhlSpdInvldPassdThd.Val /end CHARACTERISTIC
/begin CHARACTERISTIC FordMsg217BusHiSpd.FordMsg217BusHiSpdFrntRiWhlVldFaildThd.Val "MICROSAR RTE" VALUE 0x0 RTE_RL_UWORD 0 NO_COMPU_METHOD 0 65535 SYMBOL_LINK "Rte_CalprmRom_CalRegn01Cmn_DEFAULT_RTE_CALPRM_GROUP.FordMsg217BusHiSpdFrntRiWhlVldFaildThd_Val" 0 DISPLAY_IDENTIFIER FordMsg217BusHiSpd.CalibrationPorts.FordMsg217BusHiSpdFrntRiWhlVldFaildThd.Val /end CHARACTERISTIC
/begin CHARACTERISTIC FordMsg217BusHiSpd.FordMsg217BusHiSpdFrntRiWhlVldMissThd.Val "MICROSAR RTE" VALUE 0x0 RTE_RL_UWORD 0 NO_COMPU_METHOD 0 65535 SYMBOL_LINK "Rte_CalprmRom_CalRegn01Cmn_DEFAULT_RTE_CALPRM_GROUP.FordMsg217BusHiSpdFrntRiWhlVldMissThd_Val" 0 DISPLAY_IDENTIFIER FordMsg217BusHiSpd.CalibrationPorts.FordMsg217BusHiSpdFrntRiWhlVldMissThd.Val /end CHARACTERISTIC
/begin CHARACTERISTIC FordMsg217BusHiSpd.FordMsg217BusHiSpdFrntRiWhlVldPassdThd.Val "MICROSAR RTE" VALUE 0x0 RTE_RL_UWORD 0 NO_COMPU_METHOD 0 65535 SYMBOL_LINK "Rte_CalprmRom_CalRegn01Cmn_DEFAULT_RTE_CALPRM_GROUP.FordMsg217BusHiSpdFrntRiWhlVldPassdThd_Val" 0 DISPLAY_IDENTIFIER FordMsg217BusHiSpd.CalibrationPorts.FordMsg217BusHiSpdFrntRiWhlVldPassdThd.Val /end CHARACTERISTIC
/begin CHARACTERISTIC FordMsg217BusHiSpd.FordMsg217BusHiSpdMissMsgFaildThd.Val "MICROSAR RTE" VALUE 0x0 RTE_RL_UWORD 0 NO_COMPU_METHOD 0 65535 SYMBOL_LINK "Rte_CalprmRom_CalRegn01Cmn_DEFAULT_RTE_CALPRM_GROUP.FordMsg217BusHiSpdMissMsgFaildThd_Val" 0 DISPLAY_IDENTIFIER FordMsg217BusHiSpd.CalibrationPorts.FordMsg217BusHiSpdMissMsgFaildThd.Val /end CHARACTERISTIC
/begin CHARACTERISTIC FordMsg217BusHiSpd.FordMsg217BusHiSpdMissMsgPassdThd.Val "MICROSAR RTE" VALUE 0x0 RTE_RL_UWORD 0 NO_COMPU_METHOD 0 65535 SYMBOL_LINK "Rte_CalprmRom_CalRegn01Cmn_DEFAULT_RTE_CALPRM_GROUP.FordMsg217BusHiSpdMissMsgPassdThd_Val" 0 DISPLAY_IDENTIFIER FordMsg217BusHiSpd.CalibrationPorts.FordMsg217BusHiSpdMissMsgPassdThd.Val /end CHARACTERISTIC
/begin CHARACTERISTIC FordMsg217BusHiSpd.FordMsg217BusHiSpdReLeWhlSpdInvldFaildThd.Val "MICROSAR RTE" VALUE 0x0 RTE_RL_UWORD 0 NO_COMPU_METHOD 0 65535 SYMBOL_LINK "Rte_CalprmRom_CalRegn01Cmn_DEFAULT_RTE_CALPRM_GROUP.FordMsg217BusHiSpdReLeWhlSpdInvldFaildThd_Val" 0 DISPLAY_IDENTIFIER FordMsg217BusHiSpd.CalibrationPorts.FordMsg217BusHiSpdReLeWhlSpdInvldFaildThd.Val /end CHARACTERISTIC
/begin CHARACTERISTIC FordMsg217BusHiSpd.FordMsg217BusHiSpdReLeWhlSpdInvldPassdThd.Val "MICROSAR RTE" VALUE 0x0 RTE_RL_UWORD 0 NO_COMPU_METHOD 0 65535 SYMBOL_LINK "Rte_CalprmRom_CalRegn01Cmn_DEFAULT_RTE_CALPRM_GROUP.FordMsg217BusHiSpdReLeWhlSpdInvldPassdThd_Val" 0 DISPLAY_IDENTIFIER FordMsg217BusHiSpd.CalibrationPorts.FordMsg217BusHiSpdReLeWhlSpdInvldPassdThd.Val /end CHARACTERISTIC
/begin CHARACTERISTIC FordMsg217BusHiSpd.FordMsg217BusHiSpdReLeWhlVldFaildThd.Val "MICROSAR RTE" VALUE 0x0 RTE_RL_UWORD 0 NO_COMPU_METHOD 0 65535 SYMBOL_LINK "Rte_CalprmRom_CalRegn01Cmn_DEFAULT_RTE_CALPRM_GROUP.FordMsg217BusHiSpdReLeWhlVldFaildThd_Val" 0 DISPLAY_IDENTIFIER FordMsg217BusHiSpd.CalibrationPorts.FordMsg217BusHiSpdReLeWhlVldFaildThd.Val /end CHARACTERISTIC
/begin CHARACTERISTIC FordMsg217BusHiSpd.FordMsg217BusHiSpdReLeWhlVldMissThd.Val "MICROSAR RTE" VALUE 0x0 RTE_RL_UWORD 0 NO_COMPU_METHOD 0 65535 SYMBOL_LINK "Rte_CalprmRom_CalRegn01Cmn_DEFAULT_RTE_CALPRM_GROUP.FordMsg217BusHiSpdReLeWhlVldMissThd_Val" 0 DISPLAY_IDENTIFIER FordMsg217BusHiSpd.CalibrationPorts.FordMsg217BusHiSpdReLeWhlVldMissThd.Val /end CHARACTERISTIC
/begin CHARACTERISTIC FordMsg217BusHiSpd.FordMsg217BusHiSpdReLeWhlVldPassdThd.Val "MICROSAR RTE" VALUE 0x0 RTE_RL_UWORD 0 NO_COMPU_METHOD 0 65535 SYMBOL_LINK "Rte_CalprmRom_CalRegn01Cmn_DEFAULT_RTE_CALPRM_GROUP.FordMsg217BusHiSpdReLeWhlVldPassdThd_Val" 0 DISPLAY_IDENTIFIER FordMsg217BusHiSpd.CalibrationPorts.FordMsg217BusHiSpdReLeWhlVldPassdThd.Val /end CHARACTERISTIC
/begin CHARACTERISTIC FordMsg217BusHiSpd.FordMsg217BusHiSpdReRiWhlSpdInvldFaildThd.Val "MICROSAR RTE" VALUE 0x0 RTE_RL_UWORD 0 NO_COMPU_METHOD 0 65535 SYMBOL_LINK "Rte_CalprmRom_CalRegn01Cmn_DEFAULT_RTE_CALPRM_GROUP.FordMsg217BusHiSpdReRiWhlSpdInvldFaildThd_Val" 0 DISPLAY_IDENTIFIER FordMsg217BusHiSpd.CalibrationPorts.FordMsg217BusHiSpdReRiWhlSpdInvldFaildThd.Val /end CHARACTERISTIC
/begin CHARACTERISTIC FordMsg217BusHiSpd.FordMsg217BusHiSpdReRiWhlSpdInvldPassdThd.Val "MICROSAR RTE" VALUE 0x0 RTE_RL_UWORD 0 NO_COMPU_METHOD 0 65535 SYMBOL_LINK "Rte_CalprmRom_CalRegn01Cmn_DEFAULT_RTE_CALPRM_GROUP.FordMsg217BusHiSpdReRiWhlSpdInvldPassdThd_Val" 0 DISPLAY_IDENTIFIER FordMsg217BusHiSpd.CalibrationPorts.FordMsg217BusHiSpdReRiWhlSpdInvldPassdThd.Val /end CHARACTERISTIC
/begin CHARACTERISTIC FordMsg217BusHiSpd.FordMsg217BusHiSpdReRiWhlVldFaildThd.Val "MICROSAR RTE" VALUE 0x0 RTE_RL_UWORD 0 NO_COMPU_METHOD 0 65535 SYMBOL_LINK "Rte_CalprmRom_CalRegn01Cmn_DEFAULT_RTE_CALPRM_GROUP.FordMsg217BusHiSpdReRiWhlVldFaildThd_Val" 0 DISPLAY_IDENTIFIER FordMsg217BusHiSpd.CalibrationPorts.FordMsg217BusHiSpdReRiWhlVldFaildThd.Val /end CHARACTERISTIC
/begin CHARACTERISTIC FordMsg217BusHiSpd.FordMsg217BusHiSpdReRiWhlVldMissThd.Val "MICROSAR RTE" VALUE 0x0 RTE_RL_UWORD 0 NO_COMPU_METHOD 0 65535 SYMBOL_LINK "Rte_CalprmRom_CalRegn01Cmn_DEFAULT_RTE_CALPRM_GROUP.FordMsg217BusHiSpdReRiWhlVldMissThd_Val" 0 DISPLAY_IDENTIFIER FordMsg217BusHiSpd.CalibrationPorts.FordMsg217BusHiSpdReRiWhlVldMissThd.Val /end CHARACTERISTIC
/begin CHARACTERISTIC FordMsg217BusHiSpd.FordMsg217BusHiSpdReRiWhlVldPassdThd.Val "MICROSAR RTE" VALUE 0x0 RTE_RL_UWORD 0 NO_COMPU_METHOD 0 65535 SYMBOL_LINK "Rte_CalprmRom_CalRegn01Cmn_DEFAULT_RTE_CALPRM_GROUP.FordMsg217BusHiSpdReRiWhlVldPassdThd_Val" 0 DISPLAY_IDENTIFIER FordMsg217BusHiSpd.CalibrationPorts.FordMsg217BusHiSpdReRiWhlVldPassdThd.Val /end CHARACTERISTIC
/begin CHARACTERISTIC FordMsg230BusHiSpd.FordMsg230BusHiSpdFordVehGearLvrPosnFaildTiThd.Val "MICROSAR RTE" VALUE 0x0 RTE_RL_UWORD 0 NO_COMPU_METHOD 0 65535 SYMBOL_LINK "Rte_CalprmRom_CalRegn01Cmn_DEFAULT_RTE_CALPRM_GROUP.FordMsg230BusHiSpdFordVehGearLvrPosnFaildTiThd_Val" 0 DISPLAY_IDENTIFIER FordMsg230BusHiSpd.CalibrationPorts.FordMsg230BusHiSpdFordVehGearLvrPosnFaildTiThd.Val /end CHARACTERISTIC
/begin CHARACTERISTIC FordMsg230BusHiSpd.FordMsg230BusHiSpdFordVehGearLvrPosnPassdTiThd.Val "MICROSAR RTE" VALUE 0x0 RTE_RL_UWORD 0 NO_COMPU_METHOD 0 65535 SYMBOL_LINK "Rte_CalprmRom_CalRegn01Cmn_DEFAULT_RTE_CALPRM_GROUP.FordMsg230BusHiSpdFordVehGearLvrPosnPassdTiThd_Val" 0 DISPLAY_IDENTIFIER FordMsg230BusHiSpd.CalibrationPorts.FordMsg230BusHiSpdFordVehGearLvrPosnPassdTiThd.Val /end CHARACTERISTIC
/begin CHARACTERISTIC FordMsg230BusHiSpd.FordMsg230BusHiSpdGearLvrPosnMissTiThd.Val "MICROSAR RTE" VALUE 0x0 RTE_RL_UWORD 0 NO_COMPU_METHOD 0 65535 SYMBOL_LINK "Rte_CalprmRom_CalRegn01Cmn_DEFAULT_RTE_CALPRM_GROUP.FordMsg230BusHiSpdGearLvrPosnMissTiThd_Val" 0 DISPLAY_IDENTIFIER FordMsg230BusHiSpd.CalibrationPorts.FordMsg230BusHiSpdGearLvrPosnMissTiThd.Val /end CHARACTERISTIC
/begin CHARACTERISTIC FordMsg230BusHiSpd.FordMsg230BusHiSpdInvldSigFaildThd.Val "MICROSAR RTE" VALUE 0x0 RTE_RL_UWORD 0 NO_COMPU_METHOD 0 65535 SYMBOL_LINK "Rte_CalprmRom_CalRegn01Cmn_DEFAULT_RTE_CALPRM_GROUP.FordMsg230BusHiSpdInvldSigFaildThd_Val" 0 DISPLAY_IDENTIFIER FordMsg230BusHiSpd.CalibrationPorts.FordMsg230BusHiSpdInvldSigFaildThd.Val /end CHARACTERISTIC
/begin CHARACTERISTIC FordMsg230BusHiSpd.FordMsg230BusHiSpdInvldSigPassdThd.Val "MICROSAR RTE" VALUE 0x0 RTE_RL_UWORD 0 NO_COMPU_METHOD 0 65535 SYMBOL_LINK "Rte_CalprmRom_CalRegn01Cmn_DEFAULT_RTE_CALPRM_GROUP.FordMsg230BusHiSpdInvldSigPassdThd_Val" 0 DISPLAY_IDENTIFIER FordMsg230BusHiSpd.CalibrationPorts.FordMsg230BusHiSpdInvldSigPassdThd.Val /end CHARACTERISTIC
/begin CHARACTERISTIC FordMsg230BusHiSpd.FordMsg230BusHiSpdMissMsgFaildThd.Val "MICROSAR RTE" VALUE 0x0 RTE_RL_UWORD 0 NO_COMPU_METHOD 0 65535 SYMBOL_LINK "Rte_CalprmRom_CalRegn01Cmn_DEFAULT_RTE_CALPRM_GROUP.FordMsg230BusHiSpdMissMsgFaildThd_Val" 0 DISPLAY_IDENTIFIER FordMsg230BusHiSpd.CalibrationPorts.FordMsg230BusHiSpdMissMsgFaildThd.Val /end CHARACTERISTIC
/begin CHARACTERISTIC FordMsg230BusHiSpd.FordMsg230BusHiSpdMissMsgPassdThd.Val "MICROSAR RTE" VALUE 0x0 RTE_RL_UWORD 0 NO_COMPU_METHOD 0 65535 SYMBOL_LINK "Rte_CalprmRom_CalRegn01Cmn_DEFAULT_RTE_CALPRM_GROUP.FordMsg230BusHiSpdMissMsgPassdThd_Val" 0 DISPLAY_IDENTIFIER FordMsg230BusHiSpd.CalibrationPorts.FordMsg230BusHiSpdMissMsgPassdThd.Val /end CHARACTERISTIC
/begin CHARACTERISTIC FordMsg2FDBusHiSpd.FordMsg2FDBusHiSpdFordVehEvasSteerAssiReqVldNotRxdTiThd.Val "MICROSAR RTE" VALUE 0x0 RTE_RL_UWORD 0 NO_COMPU_METHOD 0 65535 SYMBOL_LINK "Rte_CalprmRom_CalRegn01Cmn_DEFAULT_RTE_CALPRM_GROUP.FordMsg2FDBusHiSpdFordVehEvasSteerAssiReqVldNotRxdTiThd_Val" 0 DISPLAY_IDENTIFIER FordMsg2FDBusHiSpd.CalibrationPorts.FordMsg2FDBusHiSpdFordVehEvasSteerAssiReqVldNotRxdTiThd.Val /end CHARACTERISTIC
/begin CHARACTERISTIC FordMsg2FDBusHiSpd.FordMsg2FDBusHiSpdFordVehEvasSteerAssiReqVldRxdTiThd.Val "MICROSAR RTE" VALUE 0x0 RTE_RL_UWORD 0 NO_COMPU_METHOD 0 65535 SYMBOL_LINK "Rte_CalprmRom_CalRegn01Cmn_DEFAULT_RTE_CALPRM_GROUP.FordMsg2FDBusHiSpdFordVehEvasSteerAssiReqVldRxdTiThd_Val" 0 DISPLAY_IDENTIFIER FordMsg2FDBusHiSpd.CalibrationPorts.FordMsg2FDBusHiSpdFordVehEvasSteerAssiReqVldRxdTiThd.Val /end CHARACTERISTIC
/begin CHARACTERISTIC FordMsg2FDBusHiSpd.FordMsg2FDBusHiSpdMissMsgFaildTiThd.Val "MICROSAR RTE" VALUE 0x0 RTE_RL_UWORD 0 NO_COMPU_METHOD 0 65535 SYMBOL_LINK "Rte_CalprmRom_CalRegn01Cmn_DEFAULT_RTE_CALPRM_GROUP.FordMsg2FDBusHiSpdMissMsgFaildTiThd_Val" 0 DISPLAY_IDENTIFIER FordMsg2FDBusHiSpd.CalibrationPorts.FordMsg2FDBusHiSpdMissMsgFaildTiThd.Val /end CHARACTERISTIC
/begin CHARACTERISTIC FordMsg2FDBusHiSpd.FordMsg2FDBusHiSpdMissMsgPassdTiThd.Val "MICROSAR RTE" VALUE 0x0 RTE_RL_UWORD 0 NO_COMPU_METHOD 0 65535 SYMBOL_LINK "Rte_CalprmRom_CalRegn01Cmn_DEFAULT_RTE_CALPRM_GROUP.FordMsg2FDBusHiSpdMissMsgPassdTiThd_Val" 0 DISPLAY_IDENTIFIER FordMsg2FDBusHiSpd.CalibrationPorts.FordMsg2FDBusHiSpdMissMsgPassdTiThd.Val /end CHARACTERISTIC
/begin MEASUREMENT FordMsg202BusHiSpd.FordVehSpdEngModlRawPrev "MICROSAR RTE" UWORD NO_COMPU_METHOD 0 0 0 65535 ECU_ADDRESS 0 SYMBOL_LINK "Rte_FordMsg202BusHiSpd_FordVehSpdEngModlRawPrev" 0 DISPLAY_IDENTIFIER FordMsg202BusHiSpd.PerInstanceMemories.FordVehSpdEngModlRawPrev /end MEASUREMENT
/begin MEASUREMENT FordMsg202BusHiSpd.FordVehSpdEngModlVld.Logl "MICROSAR RTE" UBYTE RTE_CM_BOOLEAN 0 0 0 255 ECU_ADDRESS 0 SYMBOL_LINK "Rte_FordMsg202BusHiSpd_FordVehSpdEngModlVld_Logl" 0 DISPLAY_IDENTIFIER FordMsg202BusHiSpd.SenderPorts.FordVehSpdEngModlVld.Logl /end MEASUREMENT
/begin MEASUREMENT FordMsg202BusHiSpd.FordVehSpdEngModlVldFaildRefTi "MICROSAR RTE" ULONG NO_COMPU_METHOD 0 0 0 4294967295 ECU_ADDRESS 0 SYMBOL_LINK "Rte_FordMsg202BusHiSpd_FordVehSpdEngModlVldFaildRefTi" 0 DISPLAY_IDENTIFIER FordMsg202BusHiSpd.PerInstanceMemories.FordVehSpdEngModlVldFaildRefTi /end MEASUREMENT
/begin MEASUREMENT FordMsg202BusHiSpd.FordVehSpdEngModlVldMissRefTi "MICROSAR RTE" ULONG NO_COMPU_METHOD 0 0 0 4294967295 ECU_ADDRESS 0 SYMBOL_LINK "Rte_FordMsg202BusHiSpd_FordVehSpdEngModlVldMissRefTi" 0 DISPLAY_IDENTIFIER FordMsg202BusHiSpd.PerInstanceMemories.FordVehSpdEngModlVldMissRefTi /end MEASUREMENT
/begin MEASUREMENT FordMsg202BusHiSpd.FordVehSpdEngModlVldPrev "MICROSAR RTE" UBYTE RTE_CM_BOOLEAN 0 0 0 255 ECU_ADDRESS 0 SYMBOL_LINK "Rte_FordMsg202BusHiSpd_FordVehSpdEngModlVldPrev" 0 DISPLAY_IDENTIFIER FordMsg202BusHiSpd.PerInstanceMemories.FordVehSpdEngModlVldPrev /end MEASUREMENT
/begin MEASUREMENT FordMsg202BusHiSpd.FordVehSpdQlyFacEngModl.Ford_VehVActlEng_D_Qf "MICROSAR RTE" UBYTE RTE_CM_ENUM_Ford_VehVActlEng_D_Qf 0 0 0 3 ECU_ADDRESS 0 SYMBOL_LINK "Rte_FordMsg202BusHiSpd_FordVehSpdQlyFacEngModl_Ford_VehVActlEng_D_Qf" 0 DISPLAY_IDENTIFIER FordMsg202BusHiSpd.SenderPorts.FordVehSpdQlyFacEngModl.Ford_VehVActlEng_D_Qf /end MEASUREMENT
/begin MEASUREMENT FordMsg202BusHiSpd.FordVehSpdQlyFacEngModlInvldFaildRefTi "MICROSAR RTE" ULONG NO_COMPU_METHOD 0 0 0 4294967295 ECU_ADDRESS 0 SYMBOL_LINK "Rte_FordMsg202BusHiSpd_FordVehSpdQlyFacEngModlInvldFaildRefTi" 0 DISPLAY_IDENTIFIER FordMsg202BusHiSpd.PerInstanceMemories.FordVehSpdQlyFacEngModlInvldFaildRefTi /end MEASUREMENT
/begin MEASUREMENT FordMsg202BusHiSpd.FordVehSpdQlyFacEngModlInvldPassdRefTi "MICROSAR RTE" ULONG NO_COMPU_METHOD 0 0 0 4294967295 ECU_ADDRESS 0 SYMBOL_LINK "Rte_FordMsg202BusHiSpd_FordVehSpdQlyFacEngModlInvldPassdRefTi" 0 DISPLAY_IDENTIFIER FordMsg202BusHiSpd.PerInstanceMemories.FordVehSpdQlyFacEngModlInvldPassdRefTi /end MEASUREMENT
/begin MEASUREMENT FordMsg202BusHiSpd.FordVehSpdQlyFacEngModlPrev "MICROSAR RTE" UBYTE RTE_CM_ENUM_Ford_VehVActlEng_D_Qf 0 0 0 3 ECU_ADDRESS 0 SYMBOL_LINK "Rte_FordMsg202BusHiSpd_FordVehSpdQlyFacEngModlPrev" 0 DISPLAY_IDENTIFIER FordMsg202BusHiSpd.PerInstanceMemories.FordVehSpdQlyFacEngModlPrev /end MEASUREMENT
/begin MEASUREMENT FordMsg202BusHiSpd.FordVehTrlrAidAvl.Ford_VehVTrlrAid_B_Avail "MICROSAR RTE" UBYTE RTE_CM_BOOLEAN 0 0 0 255 ECU_ADDRESS 0 SYMBOL_LINK "Rte_FordMsg202BusHiSpd_FordVehTrlrAidAvl_Ford_VehVTrlrAid_B_Avail" 0 DISPLAY_IDENTIFIER FordMsg202BusHiSpd.SenderPorts.FordVehTrlrAidAvl.Ford_VehVTrlrAid_B_Avail /end MEASUREMENT
/begin MEASUREMENT FordMsg202BusHiSpd.FordVehTrlrAidAvlPrev "MICROSAR RTE" UBYTE RTE_CM_BOOLEAN 0 0 0 255 ECU_ADDRESS 0 SYMBOL_LINK "Rte_FordMsg202BusHiSpd_FordVehTrlrAidAvlPrev" 0 DISPLAY_IDENTIFIER FordMsg202BusHiSpd.PerInstanceMemories.FordVehTrlrAidAvlPrev /end MEASUREMENT
/begin MEASUREMENT FordMsg202BusHiSpd.FordVehTrlrAidAvlRaw.Val "MICROSAR RTE" UBYTE NO_COMPU_METHOD 0 0 0 255 ECU_ADDRESS 0 SYMBOL_LINK "Rte_FordMsg202BusHiSpd_FordVehTrlrAidAvlRaw_Val" 0 DISPLAY_IDENTIFIER FordMsg202BusHiSpd.SenderPorts.FordVehTrlrAidAvlRaw.Val /end MEASUREMENT
/begin MEASUREMENT FordMsg202BusHiSpd.FordVehTrlrAidAvlRawPrev "MICROSAR RTE" UBYTE NO_COMPU_METHOD 0 0 0 255 ECU_ADDRESS 0 SYMBOL_LINK "Rte_FordMsg202BusHiSpd_FordVehTrlrAidAvlRawPrev" 0 DISPLAY_IDENTIFIER FordMsg202BusHiSpd.PerInstanceMemories.FordVehTrlrAidAvlRawPrev /end MEASUREMENT
/begin MEASUREMENT FordMsg202BusHiSpd.FordVehTrlrBackupAssiAvlVld.Logl "MICROSAR RTE" UBYTE RTE_CM_BOOLEAN 0 0 0 255 ECU_ADDRESS 0 SYMBOL_LINK "Rte_FordMsg202BusHiSpd_FordVehTrlrBackupAssiAvlVld_Logl" 0 DISPLAY_IDENTIFIER FordMsg202BusHiSpd.SenderPorts.FordVehTrlrBackupAssiAvlVld.Logl /end MEASUREMENT
/begin MEASUREMENT FordMsg202BusHiSpd.FordVehTrlrBackupAssiAvlVldMissRefTi "MICROSAR RTE" ULONG NO_COMPU_METHOD 0 0 0 4294967295 ECU_ADDRESS 0 SYMBOL_LINK "Rte_FordMsg202BusHiSpd_FordVehTrlrBackupAssiAvlVldMissRefTi" 0 DISPLAY_IDENTIFIER FordMsg202BusHiSpd.PerInstanceMemories.FordVehTrlrBackupAssiAvlVldMissRefTi /end MEASUREMENT
/begin MEASUREMENT FordMsg202BusHiSpd.FordVehTrlrBackupAssiAvlVldPassdRefTi "MICROSAR RTE" ULONG NO_COMPU_METHOD 0 0 0 4294967295 ECU_ADDRESS 0 SYMBOL_LINK "Rte_FordMsg202BusHiSpd_FordVehTrlrBackupAssiAvlVldPassdRefTi" 0 DISPLAY_IDENTIFIER FordMsg202BusHiSpd.PerInstanceMemories.FordVehTrlrBackupAssiAvlVldPassdRefTi /end MEASUREMENT
/begin MEASUREMENT FordMsg202BusHiSpd.FordVehTrlrBackupAssiAvlVldPrev "MICROSAR RTE" UBYTE RTE_CM_BOOLEAN 0 0 0 255 ECU_ADDRESS 0 SYMBOL_LINK "Rte_FordMsg202BusHiSpd_FordVehTrlrBackupAssiAvlVldPrev" 0 DISPLAY_IDENTIFIER FordMsg202BusHiSpd.PerInstanceMemories.FordVehTrlrBackupAssiAvlVldPrev /end MEASUREMENT
/begin MEASUREMENT FordMsg202BusHiSpd.MissMsgFaildRefTi "MICROSAR RTE" ULONG NO_COMPU_METHOD 0 0 0 4294967295 ECU_ADDRESS 0 SYMBOL_LINK "Rte_FordMsg202BusHiSpd_MissMsgFaildRefTi" 0 DISPLAY_IDENTIFIER FordMsg202BusHiSpd.PerInstanceMemories.MissMsgFaildRefTi /end MEASUREMENT
/begin MEASUREMENT FordMsg202BusHiSpd.MissMsgPassdRefTi "MICROSAR RTE" ULONG NO_COMPU_METHOD 0 0 0 4294967295 ECU_ADDRESS 0 SYMBOL_LINK "Rte_FordMsg202BusHiSpd_MissMsgPassdRefTi" 0 DISPLAY_IDENTIFIER FordMsg202BusHiSpd.PerInstanceMemories.MissMsgPassdRefTi /end MEASUREMENT
/begin MEASUREMENT FordMsg213BusHiSpd.AbsActvVldFaildRefTi "Holds the elapsed time before setting ABS Active Valid to Fail" ULONG NO_COMPU_METHOD 0 0 0 4294967295 ECU_ADDRESS 0 SYMBOL_LINK "Rte_FordMsg213BusHiSpd_AbsActvVldFaildRefTi" 0 DISPLAY_IDENTIFIER FordMsg213BusHiSpd.PerInstanceMemories.AbsActvVldFaildRefTi /end MEASUREMENT
/begin MEASUREMENT FordMsg213BusHiSpd.AbsActvVldPassdRefTi "Holds the elapsed time before setting ABS Active Valid to Pass" ULONG NO_COMPU_METHOD 0 0 0 4294967295 ECU_ADDRESS 0 SYMBOL_LINK "Rte_FordMsg213BusHiSpd_AbsActvVldPassdRefTi" 0 DISPLAY_IDENTIFIER FordMsg213BusHiSpd.PerInstanceMemories.AbsActvVldPassdRefTi /end MEASUREMENT
/begin MEASUREMENT FordMsg213BusHiSpd.ClrDiagcFlgProxy.Val "MICROSAR RTE" UBYTE NO_COMPU_METHOD 0 0 0 255 ECU_ADDRESS 0 SYMBOL_LINK "Rte_DiagcMgr_ClrDiagcFlgProxy_Val" 0 DISPLAY_IDENTIFIER FordMsg213BusHiSpd.ReceiverPorts.ClrDiagcFlgProxy.Val /end MEASUREMENT
/begin MEASUREMENT FordMsg213BusHiSpd.ClrDiagcFlgProxyPrev "Clear Diagc Flag Proxy" UBYTE NO_COMPU_METHOD 0 0 0 255 ECU_ADDRESS 0 SYMBOL_LINK "Rte_FordMsg213BusHiSpd_ClrDiagcFlgProxyPrev" 0 DISPLAY_IDENTIFIER FordMsg213BusHiSpd.PerInstanceMemories.ClrDiagcFlgProxyPrev /end MEASUREMENT
/begin MEASUREMENT FordMsg213BusHiSpd.FirstTranVldFlg "This flag is used to indicate the reception of first message" UBYTE RTE_CM_BOOLEAN 0 0 0 255 ECU_ADDRESS 0 SYMBOL_LINK "Rte_FordMsg213BusHiSpd_FirstTranVldFlg" 0 DISPLAY_IDENTIFIER FordMsg213BusHiSpd.PerInstanceMemories.FirstTranVldFlg /end MEASUREMENT
/begin MEASUREMENT FordMsg213BusHiSpd.FordBrkOscnRednEnad.Logl "MICROSAR RTE" UBYTE RTE_CM_BOOLEAN 0 0 0 255 ECU_ADDRESS 0 SYMBOL_LINK "Rte_CustDiag_FordBrkPlsRejctnEnad_Logl" 0 DISPLAY_IDENTIFIER FordMsg213BusHiSpd.ReceiverPorts.FordBrkOscnRednEnad.Logl /end MEASUREMENT
/begin MEASUREMENT FordMsg213BusHiSpd.FordCanDtcInhb.Logl "MICROSAR RTE" UBYTE RTE_CM_BOOLEAN 0 0 0 255 ECU_ADDRESS 0 SYMBOL_LINK "Rte_FordCanDtcInhb_FordCanDtcInhb_Logl" 0 DISPLAY_IDENTIFIER FordMsg213BusHiSpd.ReceiverPorts.FordCanDtcInhb.Logl /end MEASUREMENT
/begin MEASUREMENT FordMsg213BusHiSpd.FordEpsLifeCycMod.Val "MICROSAR RTE" UBYTE NO_COMPU_METHOD 0 0 0 255 ECU_ADDRESS 0 SYMBOL_LINK "Rte_FordCanDtcInhb_FordEpsLifeCycMod_Val" 0 DISPLAY_IDENTIFIER FordMsg213BusHiSpd.ReceiverPorts.FordEpsLifeCycMod.Val /end MEASUREMENT
/begin MEASUREMENT FordMsg213BusHiSpd.FordEvasSteerAssiEnad.Logl "MICROSAR RTE" UBYTE RTE_CM_BOOLEAN 0 0 0 255 ECU_ADDRESS 0 SYMBOL_LINK "Rte_CustDiag_FordEvasSteerAssiEnad_Logl" 0 DISPLAY_IDENTIFIER FordMsg213BusHiSpd.ReceiverPorts.FordEvasSteerAssiEnad.Logl /end MEASUREMENT
/begin MEASUREMENT FordMsg213BusHiSpd.FordLaneCentrAssiEnad.Logl "MICROSAR RTE" UBYTE RTE_CM_BOOLEAN 0 0 0 255 ECU_ADDRESS 0 SYMBOL_LINK "Rte_CustDiag_FordLaneCentrAssiEnad_Logl" 0 DISPLAY_IDENTIFIER FordMsg213BusHiSpd.ReceiverPorts.FordLaneCentrAssiEnad.Logl /end MEASUREMENT
/begin MEASUREMENT FordMsg213BusHiSpd.FordLaneDetnWarnEnad.Logl "MICROSAR RTE" UBYTE RTE_CM_BOOLEAN 0 0 0 255 ECU_ADDRESS 0 SYMBOL_LINK "Rte_CustDiag_FordLaneDprtrWarnEnad_Logl" 0 DISPLAY_IDENTIFIER FordMsg213BusHiSpd.ReceiverPorts.FordLaneDetnWarnEnad.Logl /end MEASUREMENT
/begin MEASUREMENT FordMsg213BusHiSpd.FordLkaEnad.Logl "MICROSAR RTE" UBYTE RTE_CM_BOOLEAN 0 0 0 255 ECU_ADDRESS 0 SYMBOL_LINK "Rte_CustDiag_FordLaneKeepAssiEnad_Logl" 0 DISPLAY_IDENTIFIER FordMsg213BusHiSpd.ReceiverPorts.FordLkaEnad.Logl /end MEASUREMENT
/begin MEASUREMENT FordMsg213BusHiSpd.FordTrfcJamAssiEnad.Logl "MICROSAR RTE" UBYTE RTE_CM_BOOLEAN 0 0 0 255 ECU_ADDRESS 0 SYMBOL_LINK "Rte_CustDiag_FordTrfcJamAssiEnad_Logl" 0 DISPLAY_IDENTIFIER FordMsg213BusHiSpd.ReceiverPorts.FordTrfcJamAssiEnad.Logl /end MEASUREMENT
/begin MEASUREMENT FordMsg213BusHiSpd.FordVehAbsActv.Val "MICROSAR RTE" UBYTE NO_COMPU_METHOD 0 0 0 255 ECU_ADDRESS 0 SYMBOL_LINK "Rte_FordMsg213BusHiSpd_FordVehAbsActv_Val" 0 DISPLAY_IDENTIFIER FordMsg213BusHiSpd.SenderPorts.FordVehAbsActv.Val /end MEASUREMENT
/begin MEASUREMENT FordMsg213BusHiSpd.FordVehAbsActvPrev "Hold the Previous value of FordVehAbsActv" UBYTE NO_COMPU_METHOD 0 0 0 255 ECU_ADDRESS 0 SYMBOL_LINK "Rte_FordMsg213BusHiSpd_FordVehAbsActvPrev" 0 DISPLAY_IDENTIFIER FordMsg213BusHiSpd.PerInstanceMemories.FordVehAbsActvPrev /end MEASUREMENT
/begin MEASUREMENT FordMsg213BusHiSpd.FordVehAbsEscStsVld.Logl "MICROSAR RTE" UBYTE RTE_CM_BOOLEAN 0 0 0 255 ECU_ADDRESS 0 SYMBOL_LINK "Rte_FordMsg213BusHiSpd_FordVehAbsEscStsVld_Logl" 0 DISPLAY_IDENTIFIER FordMsg213BusHiSpd.SenderPorts.FordVehAbsEscStsVld.Logl /end MEASUREMENT
/begin MEASUREMENT FordMsg213BusHiSpd.FordVehAbsEscStsVldPrev "Hold the Previous value of FordVehAbsEscStsVld" UBYTE RTE_CM_BOOLEAN 0 0 0 255 ECU_ADDRESS 0 SYMBOL_LINK "Rte_FordMsg213BusHiSpd_FordVehAbsEscStsVldPrev" 0 DISPLAY_IDENTIFIER FordMsg213BusHiSpd.PerInstanceMemories.FordVehAbsEscStsVldPrev /end MEASUREMENT
/begin MEASUREMENT FordMsg213BusHiSpd.FordVehCllsnMtgtnByBrkgDenied.Val "MICROSAR RTE" UBYTE NO_COMPU_METHOD 0 0 0 255 ECU_ADDRESS 0 SYMBOL_LINK "Rte_FordMsg213BusHiSpd_FordVehCllsnMtgtnByBrkgDenied_Val" 0 DISPLAY_IDENTIFIER FordMsg213BusHiSpd.SenderPorts.FordVehCllsnMtgtnByBrkgDenied.Val /end MEASUREMENT
/begin MEASUREMENT FordMsg213BusHiSpd.FordVehCllsnMtgtnByBrkgDeniedPrev "Hold the Previous value of FordVehCllsnMtgtnByBrkgDenied" UBYTE NO_COMPU_METHOD 0 0 0 255 ECU_ADDRESS 0 SYMBOL_LINK "Rte_FordMsg213BusHiSpd_FordVehCllsnMtgtnByBrkgDeniedPrev" 0 DISPLAY_IDENTIFIER FordMsg213BusHiSpd.PerInstanceMemories.FordVehCllsnMtgtnByBrkgDeniedPrev /end MEASUREMENT
/begin MEASUREMENT FordMsg213BusHiSpd.FordVehCllsnMtgtnByBrkgDisad.Val "MICROSAR RTE" UBYTE NO_COMPU_METHOD 0 0 0 255 ECU_ADDRESS 0 SYMBOL_LINK "Rte_FordMsg213BusHiSpd_FordVehCllsnMtgtnByBrkgDisad_Val" 0 DISPLAY_IDENTIFIER FordMsg213BusHiSpd.SenderPorts.FordVehCllsnMtgtnByBrkgDisad.Val /end MEASUREMENT
/begin MEASUREMENT FordMsg213BusHiSpd.FordVehCllsnMtgtnByBrkgDisadPrev "Hold the Previous value of FordVehCllsnMtgtnByBrkgDisad" UBYTE NO_COMPU_METHOD 0 0 0 255 ECU_ADDRESS 0 SYMBOL_LINK "Rte_FordMsg213BusHiSpd_FordVehCllsnMtgtnByBrkgDisadPrev" 0 DISPLAY_IDENTIFIER FordMsg213BusHiSpd.PerInstanceMemories.FordVehCllsnMtgtnByBrkgDisadPrev /end MEASUREMENT
/begin MEASUREMENT FordMsg213BusHiSpd.FordVehEscActv.Val "MICROSAR RTE" UBYTE NO_COMPU_METHOD 0 0 0 255 ECU_ADDRESS 0 SYMBOL_LINK "Rte_FordMsg213BusHiSpd_FordVehEscActv_Val" 0 DISPLAY_IDENTIFIER FordMsg213BusHiSpd.SenderPorts.FordVehEscActv.Val /end MEASUREMENT
/begin MEASUREMENT FordMsg213BusHiSpd.FordVehEscActvPrev "Hold the Previous value of FordVehEscActv" UBYTE NO_COMPU_METHOD 0 0 0 255 ECU_ADDRESS 0 SYMBOL_LINK "Rte_FordMsg213BusHiSpd_FordVehEscActvPrev" 0 DISPLAY_IDENTIFIER FordMsg213BusHiSpd.PerInstanceMemories.FordVehEscActvPrev /end MEASUREMENT
/begin MEASUREMENT FordMsg213BusHiSpd.FordVehMsg213Miss "Previous value of Ford Vehicle Message 213 Missing" UBYTE RTE_CM_BOOLEAN 0 0 0 255 ECU_ADDRESS 0 SYMBOL_LINK "Rte_FordMsg213BusHiSpd_FordVehMsg213Miss" 0 DISPLAY_IDENTIFIER FordMsg213BusHiSpd.PerInstanceMemories.FordVehMsg213Miss /end MEASUREMENT
/begin MEASUREMENT FordMsg213BusHiSpd.MissMsgFaildRefTi "It holds the time to set miss message NTC to fail" ULONG NO_COMPU_METHOD 0 0 0 4294967295 ECU_ADDRESS 0 SYMBOL_LINK "Rte_FordMsg213BusHiSpd_MissMsgFaildRefTi" 0 DISPLAY_IDENTIFIER FordMsg213BusHiSpd.PerInstanceMemories.MissMsgFaildRefTi /end MEASUREMENT
/begin MEASUREMENT FordMsg213BusHiSpd.MissMsgPassdRefTi "It holds the time to set miss message NTC to pass" ULONG NO_COMPU_METHOD 0 0 0 4294967295 ECU_ADDRESS 0 SYMBOL_LINK "Rte_FordMsg213BusHiSpd_MissMsgPassdRefTi" 0 DISPLAY_IDENTIFIER FordMsg213BusHiSpd.PerInstanceMemories.MissMsgPassdRefTi /end MEASUREMENT
/begin MEASUREMENT FordMsg215BusHiSpd.ClrDiagcFlgProxy.Val "MICROSAR RTE" UBYTE NO_COMPU_METHOD 0 0 0 255 ECU_ADDRESS 0 SYMBOL_LINK "Rte_DiagcMgr_ClrDiagcFlgProxy_Val" 0 DISPLAY_IDENTIFIER FordMsg215BusHiSpd.ReceiverPorts.ClrDiagcFlgProxy.Val /end MEASUREMENT
/begin MEASUREMENT FordMsg215BusHiSpd.ClrDiagcFlgProxyPrev "PIM used to store the previous value of CLear Diagnostic Flag Proxy signal." UBYTE NO_COMPU_METHOD 0 0 0 255 ECU_ADDRESS 0 SYMBOL_LINK "Rte_FordMsg215BusHiSpd_ClrDiagcFlgProxyPrev" 0 DISPLAY_IDENTIFIER FordMsg215BusHiSpd.PerInstanceMemories.ClrDiagcFlgProxyPrev /end MEASUREMENT
/begin MEASUREMENT FordMsg215BusHiSpd.FirstTranVldFlg "PIM used to identify whether the message is the first message or not." UBYTE RTE_CM_BOOLEAN 0 0 0 255 ECU_ADDRESS 0 SYMBOL_LINK "Rte_FordMsg215BusHiSpd_FirstTranVldFlg" 0 DISPLAY_IDENTIFIER FordMsg215BusHiSpd.PerInstanceMemories.FirstTranVldFlg /end MEASUREMENT
/begin MEASUREMENT FordMsg215BusHiSpd.FordCanDtcInhb.Logl "MICROSAR RTE" UBYTE RTE_CM_BOOLEAN 0 0 0 255 ECU_ADDRESS 0 SYMBOL_LINK "Rte_FordCanDtcInhb_FordCanDtcInhb_Logl" 0 DISPLAY_IDENTIFIER FordMsg215BusHiSpd.ReceiverPorts.FordCanDtcInhb.Logl /end MEASUREMENT
/begin MEASUREMENT FordMsg215BusHiSpd.FordEpsLifeCycMod.Val "MICROSAR RTE" UBYTE NO_COMPU_METHOD 0 0 0 255 ECU_ADDRESS 0 SYMBOL_LINK "Rte_FordCanDtcInhb_FordEpsLifeCycMod_Val" 0 DISPLAY_IDENTIFIER FordMsg215BusHiSpd.ReceiverPorts.FordEpsLifeCycMod.Val /end MEASUREMENT
/begin MEASUREMENT FordMsg215BusHiSpd.FordTrlrBackupAssiEnad.Logl "MICROSAR RTE" UBYTE RTE_CM_BOOLEAN 0 0 0 255 ECU_ADDRESS 0 SYMBOL_LINK "Rte_FordMsg215BusHiSpd_FordTrlrBackupAssiEnad_Logl" 0 DISPLAY_IDENTIFIER FordMsg215BusHiSpd.ReceiverPorts.FordTrlrBackupAssiEnad.Logl /end MEASUREMENT
/begin MEASUREMENT FordMsg215BusHiSpd.FordVehMsg215Miss "PIM used to identify whether the message is missing or not." UBYTE RTE_CM_BOOLEAN 0 0 0 255 ECU_ADDRESS 0 SYMBOL_LINK "Rte_FordMsg215BusHiSpd_FordVehMsg215Miss" 0 DISPLAY_IDENTIFIER FordMsg215BusHiSpd.PerInstanceMemories.FordVehMsg215Miss /end MEASUREMENT
/begin MEASUREMENT FordMsg215BusHiSpd.FordVehMsg215MissTmr "PIM used to store the time related to missing message timer" ULONG NO_COMPU_METHOD 0 0 0 4294967295 ECU_ADDRESS 0 SYMBOL_LINK "Rte_FordMsg215BusHiSpd_FordVehMsg215MissTmr" 0 DISPLAY_IDENTIFIER FordMsg215BusHiSpd.PerInstanceMemories.FordVehMsg215MissTmr /end MEASUREMENT
/begin MEASUREMENT FordMsg215BusHiSpd.FordVehMsg215NotRxdRefTi "PIM used to store the time related to not received message" ULONG NO_COMPU_METHOD 0 0 0 4294967295 ECU_ADDRESS 0 SYMBOL_LINK "Rte_FordMsg215BusHiSpd_FordVehMsg215NotRxdRefTi" 0 DISPLAY_IDENTIFIER FordMsg215BusHiSpd.PerInstanceMemories.FordVehMsg215NotRxdRefTi /end MEASUREMENT
/begin MEASUREMENT FordMsg215BusHiSpd.FordVehMsg215RxdRefTi "PIM used to store the time related to received message." ULONG NO_COMPU_METHOD 0 0 0 4294967295 ECU_ADDRESS 0 SYMBOL_LINK "Rte_FordMsg215BusHiSpd_FordVehMsg215RxdRefTi" 0 DISPLAY_IDENTIFIER FordMsg215BusHiSpd.PerInstanceMemories.FordVehMsg215RxdRefTi /end MEASUREMENT
/begin MEASUREMENT FordMsg215BusHiSpd.FordVehMsg215RxdTmr "PIM used to store the time related to received message timer" ULONG NO_COMPU_METHOD 0 0 0 4294967295 ECU_ADDRESS 0 SYMBOL_LINK "Rte_FordMsg215BusHiSpd_FordVehMsg215RxdTmr" 0 DISPLAY_IDENTIFIER FordMsg215BusHiSpd.PerInstanceMemories.FordVehMsg215RxdTmr /end MEASUREMENT
/begin MEASUREMENT FordMsg215BusHiSpd.FordVehTrlrAidModReq.Ford_TrlrAidMde_D_Rq "MICROSAR RTE" UBYTE RTE_CM_ENUM_Ford_TrlrAidMde_D_Rq 0 0 0 3 ECU_ADDRESS 0 SYMBOL_LINK "Rte_FordMsg215BusHiSpd_FordVehTrlrAidModReq_Ford_TrlrAidMde_D_Rq" 0 DISPLAY_IDENTIFIER FordMsg215BusHiSpd.SenderPorts.FordVehTrlrAidModReq.Ford_TrlrAidMde_D_Rq /end MEASUREMENT
/begin MEASUREMENT FordMsg215BusHiSpd.FordVehTrlrAidModReqPrev "PIM used to store the previous value of Ford Vehicle Trailer Aid Mode Request." UBYTE RTE_CM_ENUM_Ford_TrlrAidMde_D_Rq 0 0 0 3 ECU_ADDRESS 0 SYMBOL_LINK "Rte_FordMsg215BusHiSpd_FordVehTrlrAidModReqPrev" 0 DISPLAY_IDENTIFIER FordMsg215BusHiSpd.PerInstanceMemories.FordVehTrlrAidModReqPrev /end MEASUREMENT
/begin MEASUREMENT FordMsg215BusHiSpd.FordVehTrlrAidModReqVld.Logl "MICROSAR RTE" UBYTE RTE_CM_BOOLEAN 0 0 0 255 ECU_ADDRESS 0 SYMBOL_LINK "Rte_FordMsg215BusHiSpd_FordVehTrlrAidModReqVld_Logl" 0 DISPLAY_IDENTIFIER FordMsg215BusHiSpd.SenderPorts.FordVehTrlrAidModReqVld.Logl /end MEASUREMENT
/begin MEASUREMENT FordMsg215BusHiSpd.FordVehTrlrAidModReqVldPrev "PIM used to store the previous value of Ford Vehicle Trailer Aid Mode Request Valid." UBYTE RTE_CM_BOOLEAN 0 0 0 255 ECU_ADDRESS 0 SYMBOL_LINK "Rte_FordMsg215BusHiSpd_FordVehTrlrAidModReqVldPrev" 0 DISPLAY_IDENTIFIER FordMsg215BusHiSpd.PerInstanceMemories.FordVehTrlrAidModReqVldPrev /end MEASUREMENT
/begin MEASUREMENT FordMsg216BusHiSpd.ClrDiagcFlgProxy.Val "MICROSAR RTE" UBYTE NO_COMPU_METHOD 0 0 0 255 ECU_ADDRESS 0 SYMBOL_LINK "Rte_DiagcMgr_ClrDiagcFlgProxy_Val" 0 DISPLAY_IDENTIFIER FordMsg216BusHiSpd.ReceiverPorts.ClrDiagcFlgProxy.Val /end MEASUREMENT
/begin MEASUREMENT FordMsg216BusHiSpd.ClrDiagcFlgProxyPrev "Clear Diagc Flag Proxy" UBYTE NO_COMPU_METHOD 0 0 0 255 ECU_ADDRESS 0 SYMBOL_LINK "Rte_FordMsg216BusHiSpd_ClrDiagcFlgProxyPrev" 0 DISPLAY_IDENTIFIER FordMsg216BusHiSpd.PerInstanceMemories.ClrDiagcFlgProxyPrev /end MEASUREMENT
/begin MEASUREMENT FordMsg216BusHiSpd.FirstTranVldFlg "This flag is used to indicate the reception of first message" UBYTE RTE_CM_BOOLEAN 0 0 0 255 ECU_ADDRESS 0 SYMBOL_LINK "Rte_FordMsg216BusHiSpd_FirstTranVldFlg" 0 DISPLAY_IDENTIFIER FordMsg216BusHiSpd.PerInstanceMemories.FirstTranVldFlg /end MEASUREMENT
/begin MEASUREMENT FordMsg216BusHiSpd.FordBrkOscnRednEnad.Logl "MICROSAR RTE" UBYTE RTE_CM_BOOLEAN 0 0 0 255 ECU_ADDRESS 0 SYMBOL_LINK "Rte_CustDiag_FordBrkPlsRejctnEnad_Logl" 0 DISPLAY_IDENTIFIER FordMsg216BusHiSpd.ReceiverPorts.FordBrkOscnRednEnad.Logl /end MEASUREMENT
/begin MEASUREMENT FordMsg216BusHiSpd.FordCanDtcInhb.Logl "MICROSAR RTE" UBYTE RTE_CM_BOOLEAN 0 0 0 255 ECU_ADDRESS 0 SYMBOL_LINK "Rte_FordCanDtcInhb_FordCanDtcInhb_Logl" 0 DISPLAY_IDENTIFIER FordMsg216BusHiSpd.ReceiverPorts.FordCanDtcInhb.Logl /end MEASUREMENT
/begin MEASUREMENT FordMsg216BusHiSpd.FordEpsLifeCycMod.Val "MICROSAR RTE" UBYTE NO_COMPU_METHOD 0 0 0 255 ECU_ADDRESS 0 SYMBOL_LINK "Rte_FordCanDtcInhb_FordEpsLifeCycMod_Val" 0 DISPLAY_IDENTIFIER FordMsg216BusHiSpd.ReceiverPorts.FordEpsLifeCycMod.Val /end MEASUREMENT
/begin MEASUREMENT FordMsg216BusHiSpd.FordTqSteerCmpEnad.Logl "MICROSAR RTE" UBYTE RTE_CM_BOOLEAN 0 0 0 255 ECU_ADDRESS 0 SYMBOL_LINK "Rte_CustDiag_FordTqSteerCmpEnad_Logl" 0 DISPLAY_IDENTIFIER FordMsg216BusHiSpd.ReceiverPorts.FordTqSteerCmpEnad.Logl /end MEASUREMENT
/begin MEASUREMENT FordMsg216BusHiSpd.FordTrlrBackUpAssiEnad.Logl "MICROSAR RTE" UBYTE RTE_CM_BOOLEAN 0 0 0 255 ECU_ADDRESS 0 SYMBOL_LINK "Rte_FordMsg216BusHiSpd_FordTrlrBackUpAssiEnad_Logl" 0 DISPLAY_IDENTIFIER FordMsg216BusHiSpd.ReceiverPorts.FordTrlrBackUpAssiEnad.Logl /end MEASUREMENT
/begin MEASUREMENT FordMsg216BusHiSpd.FordVehFrntLeWhlCntrDirVld.Logl "MICROSAR RTE" UBYTE RTE_CM_BOOLEAN 0 0 0 255 ECU_ADDRESS 0 SYMBOL_LINK "Rte_FordMsg216BusHiSpd_FordVehFrntLeWhlCntrDirVld_Logl" 0 DISPLAY_IDENTIFIER FordMsg216BusHiSpd.SenderPorts.FordVehFrntLeWhlCntrDirVld.Logl /end MEASUREMENT
/begin MEASUREMENT FordMsg216BusHiSpd.FordVehFrntLeWhlCntrDirVldPrev "Previous value of Ford Vehicle Front Left Wheel Counter Direction Valid" UBYTE RTE_CM_BOOLEAN 0 0 0 255 ECU_ADDRESS 0 SYMBOL_LINK "Rte_FordMsg216BusHiSpd_FordVehFrntLeWhlCntrDirVldPrev" 0 DISPLAY_IDENTIFIER FordMsg216BusHiSpd.PerInstanceMemories.FordVehFrntLeWhlCntrDirVldPrev /end MEASUREMENT
/begin MEASUREMENT FordMsg216BusHiSpd.FordVehFrntLeWhlDirRawPrev "Previous value of Ford Vehicle Front Left Wheel Direction Raw" UBYTE RTE_CM_ENUM_FordVehWhlDirRaw1 0 0 0 255 ECU_ADDRESS 0 SYMBOL_LINK "Rte_FordMsg216BusHiSpd_FordVehFrntLeWhlDirRawPrev" 0 DISPLAY_IDENTIFIER FordMsg216BusHiSpd.PerInstanceMemories.FordVehFrntLeWhlDirRawPrev /end MEASUREMENT
/begin MEASUREMENT FordMsg216BusHiSpd.FordVehFrntLeWhlRollgCntr.Ford_WhlRotatFl_No_Cnt "MICROSAR RTE" UBYTE RTE_CM_Ford_WhlRotatFl_No_Cnt 0 0 0 255 ECU_ADDRESS 0 SYMBOL_LINK "Rte_FordMsg216BusHiSpd_FordVehFrntLeWhlRollgCntr_Ford_WhlRotatFl_No_Cnt" 0 DISPLAY_IDENTIFIER FordMsg216BusHiSpd.SenderPorts.FordVehFrntLeWhlRollgCntr.Ford_WhlRotatFl_No_Cnt /end MEASUREMENT
/begin MEASUREMENT FordMsg216BusHiSpd.FordVehFrntLeWhlRollgCntrPrev "Previous value of Ford Vehicle Front Left Wheel Rolling Counter" UBYTE NO_COMPU_METHOD 0 0 0 255 ECU_ADDRESS 0 SYMBOL_LINK "Rte_FordMsg216BusHiSpd_FordVehFrntLeWhlRollgCntrPrev" 0 DISPLAY_IDENTIFIER FordMsg216BusHiSpd.PerInstanceMemories.FordVehFrntLeWhlRollgCntrPrev /end MEASUREMENT
/begin MEASUREMENT FordMsg216BusHiSpd.FordVehFrntRiWhlCntrDirVld.Logl "MICROSAR RTE" UBYTE RTE_CM_BOOLEAN 0 0 0 255 ECU_ADDRESS 0 SYMBOL_LINK "Rte_FordMsg216BusHiSpd_FordVehFrntRiWhlCntrDirVld_Logl" 0 DISPLAY_IDENTIFIER FordMsg216BusHiSpd.SenderPorts.FordVehFrntRiWhlCntrDirVld.Logl /end MEASUREMENT
/begin MEASUREMENT FordMsg216BusHiSpd.FordVehFrntRiWhlCntrDirVldPrev "Previous value of Ford Vehicle Front Right Wheel Counter Direction Valid" UBYTE RTE_CM_BOOLEAN 0 0 0 255 ECU_ADDRESS 0 SYMBOL_LINK "Rte_FordMsg216BusHiSpd_FordVehFrntRiWhlCntrDirVldPrev" 0 DISPLAY_IDENTIFIER FordMsg216BusHiSpd.PerInstanceMemories.FordVehFrntRiWhlCntrDirVldPrev /end MEASUREMENT
/begin MEASUREMENT FordMsg216BusHiSpd.FordVehFrntRiWhlDirRawPrev "Previous value of Ford Vehicle Front Right Wheel Direction Raw" UBYTE RTE_CM_ENUM_FordVehWhlDirRaw1 0 0 0 255 ECU_ADDRESS 0 SYMBOL_LINK "Rte_FordMsg216BusHiSpd_FordVehFrntRiWhlDirRawPrev" 0 DISPLAY_IDENTIFIER FordMsg216BusHiSpd.PerInstanceMemories.FordVehFrntRiWhlDirRawPrev /end MEASUREMENT
/begin MEASUREMENT FordMsg216BusHiSpd.FordVehFrntRiWhlRollgCntr.Ford_WhlRotatFr_No_Cnt "MICROSAR RTE" UBYTE RTE_CM_Ford_WhlRotatFr_No_Cnt 0 0 0 255 ECU_ADDRESS 0 SYMBOL_LINK "Rte_FordMsg216BusHiSpd_FordVehFrntRiWhlRollgCntr_Ford_WhlRotatFr_No_Cnt" 0 DISPLAY_IDENTIFIER FordMsg216BusHiSpd.SenderPorts.FordVehFrntRiWhlRollgCntr.Ford_WhlRotatFr_No_Cnt /end MEASUREMENT
/begin MEASUREMENT FordMsg216BusHiSpd.FordVehFrntRiWhlRollgCntrPrev "Previous value of Ford Vehicle Front Right Wheel Rolling Counter" UBYTE NO_COMPU_METHOD 0 0 0 255 ECU_ADDRESS 0 SYMBOL_LINK "Rte_FordMsg216BusHiSpd_FordVehFrntRiWhlRollgCntrPrev" 0 DISPLAY_IDENTIFIER FordMsg216BusHiSpd.PerInstanceMemories.FordVehFrntRiWhlRollgCntrPrev /end MEASUREMENT
/begin MEASUREMENT FordMsg216BusHiSpd.FordVehMsg064Miss "Flag for missing message diagnostics, it is true when message is missing" UBYTE RTE_CM_BOOLEAN 0 0 0 255 ECU_ADDRESS 0 SYMBOL_LINK "Rte_FordMsg216BusHiSpd_FordVehMsg064Miss" 0 DISPLAY_IDENTIFIER FordMsg216BusHiSpd.PerInstanceMemories.FordVehMsg064Miss /end MEASUREMENT
/begin MEASUREMENT FordMsg216BusHiSpd.FordVehReLeWhlCntrDirVld.Logl "MICROSAR RTE" UBYTE RTE_CM_BOOLEAN 0 0 0 255 ECU_ADDRESS 0 SYMBOL_LINK "Rte_FordMsg216BusHiSpd_FordVehReLeWhlCntrDirVld_Logl" 0 DISPLAY_IDENTIFIER FordMsg216BusHiSpd.SenderPorts.FordVehReLeWhlCntrDirVld.Logl /end MEASUREMENT
/begin MEASUREMENT FordMsg216BusHiSpd.FordVehReLeWhlCntrDirVldPrev "Previous value of Ford Vehicle Rear Left Wheel Counter Direction Valid" UBYTE RTE_CM_BOOLEAN 0 0 0 255 ECU_ADDRESS 0 SYMBOL_LINK "Rte_FordMsg216BusHiSpd_FordVehReLeWhlCntrDirVldPrev" 0 DISPLAY_IDENTIFIER FordMsg216BusHiSpd.PerInstanceMemories.FordVehReLeWhlCntrDirVldPrev /end MEASUREMENT
/begin MEASUREMENT FordMsg216BusHiSpd.FordVehReLeWhlDirRawPrev "Previous value of Ford Vehicle Rear Left Wheel Direction Raw" UBYTE RTE_CM_ENUM_FordVehWhlDirRaw1 0 0 0 255 ECU_ADDRESS 0 SYMBOL_LINK "Rte_FordMsg216BusHiSpd_FordVehReLeWhlDirRawPrev" 0 DISPLAY_IDENTIFIER FordMsg216BusHiSpd.PerInstanceMemories.FordVehReLeWhlDirRawPrev /end MEASUREMENT
/begin MEASUREMENT FordMsg216BusHiSpd.FordVehReLeWhlRollgCntr.Ford_WhlRotatRl_No_Cnt "MICROSAR RTE" UBYTE RTE_CM_Ford_WhlRotatRl_No_Cnt 0 0 0 255 ECU_ADDRESS 0 SYMBOL_LINK "Rte_FordMsg216BusHiSpd_FordVehReLeWhlRollgCntr_Ford_WhlRotatRl_No_Cnt" 0 DISPLAY_IDENTIFIER FordMsg216BusHiSpd.SenderPorts.FordVehReLeWhlRollgCntr.Ford_WhlRotatRl_No_Cnt /end MEASUREMENT
/begin MEASUREMENT FordMsg216BusHiSpd.FordVehReLeWhlRollgCntrPrev "Previous value of Ford Vehicle Rear Left Wheel Rolling Counter" UBYTE NO_COMPU_METHOD 0 0 0 255 ECU_ADDRESS 0 SYMBOL_LINK "Rte_FordMsg216BusHiSpd_FordVehReLeWhlRollgCntrPrev" 0 DISPLAY_IDENTIFIER FordMsg216BusHiSpd.PerInstanceMemories.FordVehReLeWhlRollgCntrPrev /end MEASUREMENT
/begin MEASUREMENT FordMsg216BusHiSpd.FordVehReRiWhlCntrDirVld.Logl "MICROSAR RTE" UBYTE RTE_CM_BOOLEAN 0 0 0 255 ECU_ADDRESS 0 SYMBOL_LINK "Rte_FordMsg216BusHiSpd_FordVehReRiWhlCntrDirVld_Logl" 0 DISPLAY_IDENTIFIER FordMsg216BusHiSpd.SenderPorts.FordVehReRiWhlCntrDirVld.Logl /end MEASUREMENT
/begin MEASUREMENT FordMsg216BusHiSpd.FordVehReRiWhlCntrDirVldPrev "Previous value of Ford Vehicle Rear Right Wheel Counter Direction Valid" UBYTE RTE_CM_BOOLEAN 0 0 0 255 ECU_ADDRESS 0 SYMBOL_LINK "Rte_FordMsg216BusHiSpd_FordVehReRiWhlCntrDirVldPrev" 0 DISPLAY_IDENTIFIER FordMsg216BusHiSpd.PerInstanceMemories.FordVehReRiWhlCntrDirVldPrev /end MEASUREMENT
/begin MEASUREMENT FordMsg216BusHiSpd.FordVehReRiWhlDirRawPrev "Previous value of Ford Vehicle Rear Right Wheel Direction Raw" UBYTE RTE_CM_ENUM_FordVehWhlDirRaw1 0 0 0 255 ECU_ADDRESS 0 SYMBOL_LINK "Rte_FordMsg216BusHiSpd_FordVehReRiWhlDirRawPrev" 0 DISPLAY_IDENTIFIER FordMsg216BusHiSpd.PerInstanceMemories.FordVehReRiWhlDirRawPrev /end MEASUREMENT
/begin MEASUREMENT FordMsg216BusHiSpd.FordVehReRiWhlRollgCntr.Ford_WhlRotatRr_No_Cnt "MICROSAR RTE" UBYTE RTE_CM_Ford_WhlRotatRr_No_Cnt 0 0 0 255 ECU_ADDRESS 0 SYMBOL_LINK "Rte_FordMsg216BusHiSpd_FordVehReRiWhlRollgCntr_Ford_WhlRotatRr_No_Cnt" 0 DISPLAY_IDENTIFIER FordMsg216BusHiSpd.SenderPorts.FordVehReRiWhlRollgCntr.Ford_WhlRotatRr_No_Cnt /end MEASUREMENT
/begin MEASUREMENT FordMsg216BusHiSpd.FordVehReRiWhlRollgCntrPrev "Previous value of Ford Vehicle Rear Right Wheel Rolling Counter" UBYTE NO_COMPU_METHOD 0 0 0 255 ECU_ADDRESS 0 SYMBOL_LINK "Rte_FordMsg216BusHiSpd_FordVehReRiWhlRollgCntrPrev" 0 DISPLAY_IDENTIFIER FordMsg216BusHiSpd.PerInstanceMemories.FordVehReRiWhlRollgCntrPrev /end MEASUREMENT
/begin MEASUREMENT FordMsg216BusHiSpd.FrntLeWhlCntrDirVldFaildRefTi "tLeWhlCntrDirVldFaildRefTi.Description = [Timer for Front Left Wheel Counter Direction Valid Failed Reference Time will increment or reset based on the conditions" ULONG NO_COMPU_METHOD 0 0 0 4294967295 ECU_ADDRESS 0 SYMBOL_LINK "Rte_FordMsg216BusHiSpd_FrntLeWhlCntrDirVldFaildRefTi" 0 DISPLAY_IDENTIFIER FordMsg216BusHiSpd.PerInstanceMemories.FrntLeWhlCntrDirVldFaildRefTi /end MEASUREMENT
/begin MEASUREMENT FordMsg216BusHiSpd.FrntLeWhlCntrDirVldPassdRefTi "Timer for Front Left Wheel Counter Direction Valid Passed Reference Ti'me will increment or reset based on the conditions" ULONG NO_COMPU_METHOD 0 0 0 4294967295 ECU_ADDRESS 0 SYMBOL_LINK "Rte_FordMsg216BusHiSpd_FrntLeWhlCntrDirVldPassdRefTi" 0 DISPLAY_IDENTIFIER FordMsg216BusHiSpd.PerInstanceMemories.FrntLeWhlCntrDirVldPassdRefTi /end MEASUREMENT
/begin MEASUREMENT FordMsg216BusHiSpd.FrntLeWhlVldMissMsgRefTi "Timer for Front Left Wheel Counter Direction Valid Missing Message Reference Time will increment or reset based on the conditions" ULONG NO_COMPU_METHOD 0 0 0 4294967295 ECU_ADDRESS 0 SYMBOL_LINK "Rte_FordMsg216BusHiSpd_FrntLeWhlVldMissMsgRefTi" 0 DISPLAY_IDENTIFIER FordMsg216BusHiSpd.PerInstanceMemories.FrntLeWhlVldMissMsgRefTi /end MEASUREMENT
/begin MEASUREMENT FordMsg216BusHiSpd.FrntRiWhlCntrDirVldFaildRefTi "'Timer for Front Right Wheel Counter Direction Valid Failed Reference Time will increment or reset based on the conditions" ULONG NO_COMPU_METHOD 0 0 0 4294967295 ECU_ADDRESS 0 SYMBOL_LINK "Rte_FordMsg216BusHiSpd_FrntRiWhlCntrDirVldFaildRefTi" 0 DISPLAY_IDENTIFIER FordMsg216BusHiSpd.PerInstanceMemories.FrntRiWhlCntrDirVldFaildRefTi /end MEASUREMENT
/begin MEASUREMENT FordMsg216BusHiSpd.FrntRiWhlCntrDirVldPassdRefTi "Timer for Front Right Wheel Counter Direction Valid Passed Reference Time will increment or reset based on the conditions" ULONG NO_COMPU_METHOD 0 0 0 4294967295 ECU_ADDRESS 0 SYMBOL_LINK "Rte_FordMsg216BusHiSpd_FrntRiWhlCntrDirVldPassdRefTi" 0 DISPLAY_IDENTIFIER FordMsg216BusHiSpd.PerInstanceMemories.FrntRiWhlCntrDirVldPassdRefTi /end MEASUREMENT
/begin MEASUREMENT FordMsg216BusHiSpd.FrntRiWhlVldMissMsgRefTi "Timer for Front Right Wheel Counter Direction Valid Missing Message Reference Time will increment or reset based on the conditions" ULONG NO_COMPU_METHOD 0 0 0 4294967295 ECU_ADDRESS 0 SYMBOL_LINK "Rte_FordMsg216BusHiSpd_FrntRiWhlVldMissMsgRefTi" 0 DISPLAY_IDENTIFIER FordMsg216BusHiSpd.PerInstanceMemories.FrntRiWhlVldMissMsgRefTi /end MEASUREMENT
/begin MEASUREMENT FordMsg216BusHiSpd.MissMsgFaildRefTi "Timer for misisng message will increment or reset based on the conditions" ULONG NO_COMPU_METHOD 0 0 0 4294967295 ECU_ADDRESS 0 SYMBOL_LINK "Rte_FordMsg216BusHiSpd_MissMsgFaildRefTi" 0 DISPLAY_IDENTIFIER FordMsg216BusHiSpd.PerInstanceMemories.MissMsgFaildRefTi /end MEASUREMENT
/begin MEASUREMENT FordMsg216BusHiSpd.MissMsgPassdRefTi "Timer for misisng message will increment or reset based on the conditions" ULONG NO_COMPU_METHOD 0 0 0 4294967295 ECU_ADDRESS 0 SYMBOL_LINK "Rte_FordMsg216BusHiSpd_MissMsgPassdRefTi" 0 DISPLAY_IDENTIFIER FordMsg216BusHiSpd.PerInstanceMemories.MissMsgPassdRefTi /end MEASUREMENT
/begin MEASUREMENT FordMsg216BusHiSpd.ReLeWhlCntrDirVldFaildRefTi "Timer for Rear Left Wheel Counter Direction Valid Failed Reference Time will increment or reset based on the conditions" ULONG NO_COMPU_METHOD 0 0 0 4294967295 ECU_ADDRESS 0 SYMBOL_LINK "Rte_FordMsg216BusHiSpd_ReLeWhlCntrDirVldFaildRefTi" 0 DISPLAY_IDENTIFIER FordMsg216BusHiSpd.PerInstanceMemories.ReLeWhlCntrDirVldFaildRefTi /end MEASUREMENT
/begin MEASUREMENT FordMsg216BusHiSpd.ReLeWhlCntrDirVldPassdRefTi "Timer for Rear Left Wheel Counter Direction Valid Passed Reference Time will increment or reset based on the conditions" ULONG NO_COMPU_METHOD 0 0 0 4294967295 ECU_ADDRESS 0 SYMBOL_LINK "Rte_FordMsg216BusHiSpd_ReLeWhlCntrDirVldPassdRefTi" 0 DISPLAY_IDENTIFIER FordMsg216BusHiSpd.PerInstanceMemories.ReLeWhlCntrDirVldPassdRefTi /end MEASUREMENT
/begin MEASUREMENT FordMsg216BusHiSpd.ReLeWhlVldMissMsgRefTi "Timer for Rear Left Wheel Counter Direction Valid Missing Message Reference Time will increment or reset based on the conditions" ULONG NO_COMPU_METHOD 0 0 0 4294967295 ECU_ADDRESS 0 SYMBOL_LINK "Rte_FordMsg216BusHiSpd_ReLeWhlVldMissMsgRefTi" 0 DISPLAY_IDENTIFIER FordMsg216BusHiSpd.PerInstanceMemories.ReLeWhlVldMissMsgRefTi /end MEASUREMENT
/begin MEASUREMENT FordMsg216BusHiSpd.ReRiWhlCntrDirVldFaildRefTi "Timer for Rear Right Wheel Counter Direction Valid Failed Reference Time will increment or reset based on the conditions" ULONG NO_COMPU_METHOD 0 0 0 4294967295 ECU_ADDRESS 0 SYMBOL_LINK "Rte_FordMsg216BusHiSpd_ReRiWhlCntrDirVldFaildRefTi" 0 DISPLAY_IDENTIFIER FordMsg216BusHiSpd.PerInstanceMemories.ReRiWhlCntrDirVldFaildRefTi /end MEASUREMENT
/begin MEASUREMENT FordMsg216BusHiSpd.ReRiWhlCntrDirVldPassdRefTi "Timer for Rear Right Wheel Counter Direction Valid Passed Reference Time will increment or reset based on the conditions" ULONG NO_COMPU_METHOD 0 0 0 4294967295 ECU_ADDRESS 0 SYMBOL_LINK "Rte_FordMsg216BusHiSpd_ReRiWhlCntrDirVldPassdRefTi" 0 DISPLAY_IDENTIFIER FordMsg216BusHiSpd.PerInstanceMemories.ReRiWhlCntrDirVldPassdRefTi /end MEASUREMENT
/begin MEASUREMENT FordMsg216BusHiSpd.ReRiWhlVldMissMsgRefTi "MICROSAR RTE" ULONG NO_COMPU_METHOD 0 0 0 4294967295 ECU_ADDRESS 0 SYMBOL_LINK "Rte_FordMsg216BusHiSpd_ReRiWhlVldMissMsgRefTi" 0 DISPLAY_IDENTIFIER FordMsg216BusHiSpd.PerInstanceMemories.ReRiWhlVldMissMsgRefTi /end MEASUREMENT
/begin MEASUREMENT FordMsg217BusHiSpd.ClrDiagcFlgProxy.Val "MICROSAR RTE" UBYTE NO_COMPU_METHOD 0 0 0 255 ECU_ADDRESS 0 SYMBOL_LINK "Rte_DiagcMgr_ClrDiagcFlgProxy_Val" 0 DISPLAY_IDENTIFIER FordMsg217BusHiSpd.ReceiverPorts.ClrDiagcFlgProxy.Val /end MEASUREMENT
/begin MEASUREMENT FordMsg217BusHiSpd.ClrDiagcFlgProxyPrev "MICROSAR RTE" UBYTE NO_COMPU_METHOD 0 0 0 255 ECU_ADDRESS 0 SYMBOL_LINK "Rte_FordMsg217BusHiSpd_ClrDiagcFlgProxyPrev" 0 DISPLAY_IDENTIFIER FordMsg217BusHiSpd.PerInstanceMemories.ClrDiagcFlgProxyPrev /end MEASUREMENT
/begin MEASUREMENT FordMsg217BusHiSpd.FordAbsPrsnt.Logl "MICROSAR RTE" UBYTE RTE_CM_BOOLEAN 0 0 0 255 ECU_ADDRESS 0 SYMBOL_LINK "Rte_CustDiag_FordAbsPrsnt_Logl" 0 DISPLAY_IDENTIFIER FordMsg217BusHiSpd.ReceiverPorts.FordAbsPrsnt.Logl /end MEASUREMENT
/begin MEASUREMENT FordMsg217BusHiSpd.FordActvNiblCtrlEnad.Logl "MICROSAR RTE" UBYTE RTE_CM_BOOLEAN 0 0 0 255 ECU_ADDRESS 0 SYMBOL_LINK "Rte_CustDiag_FordActvNiblCtrlEnad_Logl" 0 DISPLAY_IDENTIFIER FordMsg217BusHiSpd.ReceiverPorts.FordActvNiblCtrlEnad.Logl /end MEASUREMENT
/begin MEASUREMENT FordMsg217BusHiSpd.FordBrkOscnRednEnad.Logl "MICROSAR RTE" UBYTE RTE_CM_BOOLEAN 0 0 0 255 ECU_ADDRESS 0 SYMBOL_LINK "Rte_CustDiag_FordBrkPlsRejctnEnad_Logl" 0 DISPLAY_IDENTIFIER FordMsg217BusHiSpd.ReceiverPorts.FordBrkOscnRednEnad.Logl /end MEASUREMENT
/begin MEASUREMENT FordMsg217BusHiSpd.FordCanDtcInhb.Val "MICROSAR RTE" UBYTE NO_COMPU_METHOD 0 0 0 255 ECU_ADDRESS 0 SYMBOL_LINK "Rte_FordCanDtcInhb_FordCanDtcInhb8_Val" 0 DISPLAY_IDENTIFIER FordMsg217BusHiSpd.ReceiverPorts.FordCanDtcInhb.Val /end MEASUREMENT
/begin MEASUREMENT FordMsg217BusHiSpd.FordEpsLifeCycMod.Val "MICROSAR RTE" UBYTE NO_COMPU_METHOD 0 0 0 255 ECU_ADDRESS 0 SYMBOL_LINK "Rte_FordCanDtcInhb_FordEpsLifeCycMod_Val" 0 DISPLAY_IDENTIFIER FordMsg217BusHiSpd.ReceiverPorts.FordEpsLifeCycMod.Val /end MEASUREMENT
/begin MEASUREMENT FordMsg217BusHiSpd.FordInvldMsgDiagcInhb.Val "MICROSAR RTE" UBYTE NO_COMPU_METHOD 0 0 0 255 ECU_ADDRESS 0 SYMBOL_LINK "Rte_FordMsg217BusHiSpd_FordInvldMsgDiagcInhb_Val" 0 DISPLAY_IDENTIFIER FordMsg217BusHiSpd.ReceiverPorts.FordInvldMsgDiagcInhb.Val /end MEASUREMENT
/begin MEASUREMENT FordMsg217BusHiSpd.FordMfgDiagcInhb.Val "MICROSAR RTE" UBYTE NO_COMPU_METHOD 0 0 0 255 ECU_ADDRESS 0 SYMBOL_LINK "Rte_FordMsg217BusHiSpd_FordMfgDiagcInhb_Val" 0 DISPLAY_IDENTIFIER FordMsg217BusHiSpd.ReceiverPorts.FordMfgDiagcInhb.Val /end MEASUREMENT
/begin MEASUREMENT FordMsg217BusHiSpd.FordMissMsgDiagcInhb.Val "MICROSAR RTE" UBYTE NO_COMPU_METHOD 0 0 0 255 ECU_ADDRESS 0 SYMBOL_LINK "Rte_FordMsg217BusHiSpd_FordMissMsgDiagcInhb_Val" 0 DISPLAY_IDENTIFIER FordMsg217BusHiSpd.ReceiverPorts.FordMissMsgDiagcInhb.Val /end MEASUREMENT
/begin MEASUREMENT FordMsg217BusHiSpd.FordTqSteerCmpEnad.Logl "MICROSAR RTE" UBYTE RTE_CM_BOOLEAN 0 0 0 255 ECU_ADDRESS 0 SYMBOL_LINK "Rte_CustDiag_FordTqSteerCmpEnad_Logl" 0 DISPLAY_IDENTIFIER FordMsg217BusHiSpd.ReceiverPorts.FordTqSteerCmpEnad.Logl /end MEASUREMENT
/begin MEASUREMENT FordMsg217BusHiSpd.FordTrlrBackupAssiEnad.Logl "MICROSAR RTE" UBYTE RTE_CM_BOOLEAN 0 0 0 255 ECU_ADDRESS 0 SYMBOL_LINK "Rte_FordMsg217BusHiSpd_FordTrlrBackupAssiEnad_Logl" 0 DISPLAY_IDENTIFIER FordMsg217BusHiSpd.ReceiverPorts.FordTrlrBackupAssiEnad.Logl /end MEASUREMENT
/begin MEASUREMENT FordMsg217BusHiSpd.FordVehFrntLeWhlSpd.Val "MICROSAR RTE" FLOAT32_IEEE NO_COMPU_METHOD 0 0 -3.402823466e+38 3.402823466e+38 ECU_ADDRESS 0 SYMBOL_LINK "Rte_FordMsg217BusHiSpd_FordVehFrntLeWhlSpd_Val" 0 DISPLAY_IDENTIFIER FordMsg217BusHiSpd.SenderPorts.FordVehFrntLeWhlSpd.Val /end MEASUREMENT
/begin MEASUREMENT FordMsg217BusHiSpd.FordVehFrntLeWhlSpdInvldFaildRefTi "MICROSAR RTE" ULONG NO_COMPU_METHOD 0 0 0 4294967295 ECU_ADDRESS 0 SYMBOL_LINK "Rte_FordMsg217BusHiSpd_FordVehFrntLeWhlSpdInvldFaildRefTi" 0 DISPLAY_IDENTIFIER FordMsg217BusHiSpd.PerInstanceMemories.FordVehFrntLeWhlSpdInvldFaildRefTi /end MEASUREMENT
/begin MEASUREMENT FordMsg217BusHiSpd.FordVehFrntLeWhlSpdInvldPassdRefTi "MICROSAR RTE" ULONG NO_COMPU_METHOD 0 0 0 4294967295 ECU_ADDRESS 0 SYMBOL_LINK "Rte_FordMsg217BusHiSpd_FordVehFrntLeWhlSpdInvldPassdRefTi" 0 DISPLAY_IDENTIFIER FordMsg217BusHiSpd.PerInstanceMemories.FordVehFrntLeWhlSpdInvldPassdRefTi /end MEASUREMENT
/begin MEASUREMENT FordMsg217BusHiSpd.FordVehFrntLeWhlSpdPrev "MICROSAR RTE" FLOAT32_IEEE NO_COMPU_METHOD 0 0 -3.402823466e+38 3.402823466e+38 ECU_ADDRESS 0 SYMBOL_LINK "Rte_FordMsg217BusHiSpd_FordVehFrntLeWhlSpdPrev" 0 DISPLAY_IDENTIFIER FordMsg217BusHiSpd.PerInstanceMemories.FordVehFrntLeWhlSpdPrev /end MEASUREMENT
/begin MEASUREMENT FordMsg217BusHiSpd.FordVehFrntLeWhlSpdRaw.Val "MICROSAR RTE" UWORD NO_COMPU_METHOD 0 0 0 65535 ECU_ADDRESS 0 SYMBOL_LINK "Rte_FordMsg217BusHiSpd_FordVehFrntLeWhlSpdRaw_Val" 0 DISPLAY_IDENTIFIER FordMsg217BusHiSpd.SenderPorts.FordVehFrntLeWhlSpdRaw.Val /end MEASUREMENT
/begin MEASUREMENT FordMsg217BusHiSpd.FordVehFrntLeWhlSpdRawPrev "MICROSAR RTE" UWORD NO_COMPU_METHOD 0 0 0 65535 ECU_ADDRESS 0 SYMBOL_LINK "Rte_FordMsg217BusHiSpd_FordVehFrntLeWhlSpdRawPrev" 0 DISPLAY_IDENTIFIER FordMsg217BusHiSpd.PerInstanceMemories.FordVehFrntLeWhlSpdRawPrev /end MEASUREMENT
/begin MEASUREMENT FordMsg217BusHiSpd.FordVehFrntLeWhlSpdVld.Logl "MICROSAR RTE" UBYTE RTE_CM_BOOLEAN 0 0 0 255 ECU_ADDRESS 0 SYMBOL_LINK "Rte_FordMsg217BusHiSpd_FordVehFrntLeWhlSpdVld_Logl" 0 DISPLAY_IDENTIFIER FordMsg217BusHiSpd.SenderPorts.FordVehFrntLeWhlSpdVld.Logl /end MEASUREMENT
/begin MEASUREMENT FordMsg217BusHiSpd.FordVehFrntLeWhlSpdVldFaildRefTi "MICROSAR RTE" ULONG NO_COMPU_METHOD 0 0 0 4294967295 ECU_ADDRESS 0 SYMBOL_LINK "Rte_FordMsg217BusHiSpd_FordVehFrntLeWhlSpdVldFaildRefTi" 0 DISPLAY_IDENTIFIER FordMsg217BusHiSpd.PerInstanceMemories.FordVehFrntLeWhlSpdVldFaildRefTi /end MEASUREMENT
/begin MEASUREMENT FordMsg217BusHiSpd.FordVehFrntLeWhlSpdVldMissRefTi "MICROSAR RTE" ULONG NO_COMPU_METHOD 0 0 0 4294967295 ECU_ADDRESS 0 SYMBOL_LINK "Rte_FordMsg217BusHiSpd_FordVehFrntLeWhlSpdVldMissRefTi" 0 DISPLAY_IDENTIFIER FordMsg217BusHiSpd.PerInstanceMemories.FordVehFrntLeWhlSpdVldMissRefTi /end MEASUREMENT
/begin MEASUREMENT FordMsg217BusHiSpd.FordVehFrntLeWhlSpdVldPassdRefTi "MICROSAR RTE" ULONG NO_COMPU_METHOD 0 0 0 4294967295 ECU_ADDRESS 0 SYMBOL_LINK "Rte_FordMsg217BusHiSpd_FordVehFrntLeWhlSpdVldPassdRefTi" 0 DISPLAY_IDENTIFIER FordMsg217BusHiSpd.PerInstanceMemories.FordVehFrntLeWhlSpdVldPassdRefTi /end MEASUREMENT
/begin MEASUREMENT FordMsg217BusHiSpd.FordVehFrntLeWhlSpdVldPrev "MICROSAR RTE" UBYTE RTE_CM_BOOLEAN 0 0 0 255 ECU_ADDRESS 0 SYMBOL_LINK "Rte_FordMsg217BusHiSpd_FordVehFrntLeWhlSpdVldPrev" 0 DISPLAY_IDENTIFIER FordMsg217BusHiSpd.PerInstanceMemories.FordVehFrntLeWhlSpdVldPrev /end MEASUREMENT
/begin MEASUREMENT FordMsg217BusHiSpd.FordVehFrntRiWhlSpd.Val "MICROSAR RTE" FLOAT32_IEEE NO_COMPU_METHOD 0 0 -3.402823466e+38 3.402823466e+38 ECU_ADDRESS 0 SYMBOL_LINK "Rte_FordMsg217BusHiSpd_FordVehFrntRiWhlSpd_Val" 0 DISPLAY_IDENTIFIER FordMsg217BusHiSpd.SenderPorts.FordVehFrntRiWhlSpd.Val /end MEASUREMENT
/begin MEASUREMENT FordMsg217BusHiSpd.FordVehFrntRiWhlSpdInvldFaildRefTi "MICROSAR RTE" ULONG NO_COMPU_METHOD 0 0 0 4294967295 ECU_ADDRESS 0 SYMBOL_LINK "Rte_FordMsg217BusHiSpd_FordVehFrntRiWhlSpdInvldFaildRefTi" 0 DISPLAY_IDENTIFIER FordMsg217BusHiSpd.PerInstanceMemories.FordVehFrntRiWhlSpdInvldFaildRefTi /end MEASUREMENT
/begin MEASUREMENT FordMsg217BusHiSpd.FordVehFrntRiWhlSpdInvldPassdRefTi "MICROSAR RTE" ULONG NO_COMPU_METHOD 0 0 0 4294967295 ECU_ADDRESS 0 SYMBOL_LINK "Rte_FordMsg217BusHiSpd_FordVehFrntRiWhlSpdInvldPassdRefTi" 0 DISPLAY_IDENTIFIER FordMsg217BusHiSpd.PerInstanceMemories.FordVehFrntRiWhlSpdInvldPassdRefTi /end MEASUREMENT
/begin MEASUREMENT FordMsg217BusHiSpd.FordVehFrntRiWhlSpdPrev "MICROSAR RTE" FLOAT32_IEEE NO_COMPU_METHOD 0 0 -3.402823466e+38 3.402823466e+38 ECU_ADDRESS 0 SYMBOL_LINK "Rte_FordMsg217BusHiSpd_FordVehFrntRiWhlSpdPrev" 0 DISPLAY_IDENTIFIER FordMsg217BusHiSpd.PerInstanceMemories.FordVehFrntRiWhlSpdPrev /end MEASUREMENT
/begin MEASUREMENT FordMsg217BusHiSpd.FordVehFrntRiWhlSpdRaw.Val "MICROSAR RTE" UWORD NO_COMPU_METHOD 0 0 0 65535 ECU_ADDRESS 0 SYMBOL_LINK "Rte_FordMsg217BusHiSpd_FordVehFrntRiWhlSpdRaw_Val" 0 DISPLAY_IDENTIFIER FordMsg217BusHiSpd.SenderPorts.FordVehFrntRiWhlSpdRaw.Val /end MEASUREMENT
/begin MEASUREMENT FordMsg217BusHiSpd.FordVehFrntRiWhlSpdRawPrev "MICROSAR RTE" UWORD NO_COMPU_METHOD 0 0 0 65535 ECU_ADDRESS 0 SYMBOL_LINK "Rte_FordMsg217BusHiSpd_FordVehFrntRiWhlSpdRawPrev" 0 DISPLAY_IDENTIFIER FordMsg217BusHiSpd.PerInstanceMemories.FordVehFrntRiWhlSpdRawPrev /end MEASUREMENT
/begin MEASUREMENT FordMsg217BusHiSpd.FordVehFrntRiWhlSpdVld.Logl "MICROSAR RTE" UBYTE RTE_CM_BOOLEAN 0 0 0 255 ECU_ADDRESS 0 SYMBOL_LINK "Rte_FordMsg217BusHiSpd_FordVehFrntRiWhlSpdVld_Logl" 0 DISPLAY_IDENTIFIER FordMsg217BusHiSpd.SenderPorts.FordVehFrntRiWhlSpdVld.Logl /end MEASUREMENT
/begin MEASUREMENT FordMsg217BusHiSpd.FordVehFrntRiWhlSpdVldFaildRefTi "MICROSAR RTE" ULONG NO_COMPU_METHOD 0 0 0 4294967295 ECU_ADDRESS 0 SYMBOL_LINK "Rte_FordMsg217BusHiSpd_FordVehFrntRiWhlSpdVldFaildRefTi" 0 DISPLAY_IDENTIFIER FordMsg217BusHiSpd.PerInstanceMemories.FordVehFrntRiWhlSpdVldFaildRefTi /end MEASUREMENT
/begin MEASUREMENT FordMsg217BusHiSpd.FordVehFrntRiWhlSpdVldMissRefTi "MICROSAR RTE" ULONG NO_COMPU_METHOD 0 0 0 4294967295 ECU_ADDRESS 0 SYMBOL_LINK "Rte_FordMsg217BusHiSpd_FordVehFrntRiWhlSpdVldMissRefTi" 0 DISPLAY_IDENTIFIER FordMsg217BusHiSpd.PerInstanceMemories.FordVehFrntRiWhlSpdVldMissRefTi /end MEASUREMENT
/begin MEASUREMENT FordMsg217BusHiSpd.FordVehFrntRiWhlSpdVldPassdRefTi "MICROSAR RTE" ULONG NO_COMPU_METHOD 0 0 0 4294967295 ECU_ADDRESS 0 SYMBOL_LINK "Rte_FordMsg217BusHiSpd_FordVehFrntRiWhlSpdVldPassdRefTi" 0 DISPLAY_IDENTIFIER FordMsg217BusHiSpd.PerInstanceMemories.FordVehFrntRiWhlSpdVldPassdRefTi /end MEASUREMENT
/begin MEASUREMENT FordMsg217BusHiSpd.FordVehFrntRiWhlSpdVldPrev "MICROSAR RTE" UBYTE RTE_CM_BOOLEAN 0 0 0 255 ECU_ADDRESS 0 SYMBOL_LINK "Rte_FordMsg217BusHiSpd_FordVehFrntRiWhlSpdVldPrev" 0 DISPLAY_IDENTIFIER FordMsg217BusHiSpd.PerInstanceMemories.FordVehFrntRiWhlSpdVldPrev /end MEASUREMENT
/begin MEASUREMENT FordMsg217BusHiSpd.FordVehMsg217Miss "MICROSAR RTE" UBYTE RTE_CM_BOOLEAN 0 0 0 255 ECU_ADDRESS 0 SYMBOL_LINK "Rte_FordMsg217BusHiSpd_FordVehMsg217Miss" 0 DISPLAY_IDENTIFIER FordMsg217BusHiSpd.PerInstanceMemories.FordVehMsg217Miss /end MEASUREMENT
/begin MEASUREMENT FordMsg217BusHiSpd.FordVehMsg217Rxd "MICROSAR RTE" UBYTE RTE_CM_BOOLEAN 0 0 0 255 ECU_ADDRESS 0 SYMBOL_LINK "Rte_FordMsg217BusHiSpd_FordVehMsg217Rxd" 0 DISPLAY_IDENTIFIER FordMsg217BusHiSpd.PerInstanceMemories.FordVehMsg217Rxd /end MEASUREMENT
/begin MEASUREMENT FordMsg217BusHiSpd.FordVehReLeWhlSpd.Val "MICROSAR RTE" FLOAT32_IEEE NO_COMPU_METHOD 0 0 -3.402823466e+38 3.402823466e+38 ECU_ADDRESS 0 SYMBOL_LINK "Rte_FordMsg217BusHiSpd_FordVehReLeWhlSpd_Val" 0 DISPLAY_IDENTIFIER FordMsg217BusHiSpd.SenderPorts.FordVehReLeWhlSpd.Val /end MEASUREMENT
/begin MEASUREMENT FordMsg217BusHiSpd.FordVehReLeWhlSpdInvldFaildRefTi "MICROSAR RTE" ULONG NO_COMPU_METHOD 0 0 0 4294967295 ECU_ADDRESS 0 SYMBOL_LINK "Rte_FordMsg217BusHiSpd_FordVehReLeWhlSpdInvldFaildRefTi" 0 DISPLAY_IDENTIFIER FordMsg217BusHiSpd.PerInstanceMemories.FordVehReLeWhlSpdInvldFaildRefTi /end MEASUREMENT
/begin MEASUREMENT FordMsg217BusHiSpd.FordVehReLeWhlSpdInvldPassdRefTi "MICROSAR RTE" ULONG NO_COMPU_METHOD 0 0 0 4294967295 ECU_ADDRESS 0 SYMBOL_LINK "Rte_FordMsg217BusHiSpd_FordVehReLeWhlSpdInvldPassdRefTi" 0 DISPLAY_IDENTIFIER FordMsg217BusHiSpd.PerInstanceMemories.FordVehReLeWhlSpdInvldPassdRefTi /end MEASUREMENT
/begin MEASUREMENT FordMsg217BusHiSpd.FordVehReLeWhlSpdPrev "MICROSAR RTE" FLOAT32_IEEE NO_COMPU_METHOD 0 0 -3.402823466e+38 3.402823466e+38 ECU_ADDRESS 0 SYMBOL_LINK "Rte_FordMsg217BusHiSpd_FordVehReLeWhlSpdPrev" 0 DISPLAY_IDENTIFIER FordMsg217BusHiSpd.PerInstanceMemories.FordVehReLeWhlSpdPrev /end MEASUREMENT
/begin MEASUREMENT FordMsg217BusHiSpd.FordVehReLeWhlSpdRaw.Val "MICROSAR RTE" UWORD NO_COMPU_METHOD 0 0 0 65535 ECU_ADDRESS 0 SYMBOL_LINK "Rte_FordMsg217BusHiSpd_FordVehReLeWhlSpdRaw_Val" 0 DISPLAY_IDENTIFIER FordMsg217BusHiSpd.SenderPorts.FordVehReLeWhlSpdRaw.Val /end MEASUREMENT
/begin MEASUREMENT FordMsg217BusHiSpd.FordVehReLeWhlSpdRawPrev "MICROSAR RTE" UWORD NO_COMPU_METHOD 0 0 0 65535 ECU_ADDRESS 0 SYMBOL_LINK "Rte_FordMsg217BusHiSpd_FordVehReLeWhlSpdRawPrev" 0 DISPLAY_IDENTIFIER FordMsg217BusHiSpd.PerInstanceMemories.FordVehReLeWhlSpdRawPrev /end MEASUREMENT
/begin MEASUREMENT FordMsg217BusHiSpd.FordVehReLeWhlSpdVld.Logl "MICROSAR RTE" UBYTE RTE_CM_BOOLEAN 0 0 0 255 ECU_ADDRESS 0 SYMBOL_LINK "Rte_FordMsg217BusHiSpd_FordVehReLeWhlSpdVld_Logl" 0 DISPLAY_IDENTIFIER FordMsg217BusHiSpd.SenderPorts.FordVehReLeWhlSpdVld.Logl /end MEASUREMENT
/begin MEASUREMENT FordMsg217BusHiSpd.FordVehReLeWhlSpdVldFaildRefTi "MICROSAR RTE" ULONG NO_COMPU_METHOD 0 0 0 4294967295 ECU_ADDRESS 0 SYMBOL_LINK "Rte_FordMsg217BusHiSpd_FordVehReLeWhlSpdVldFaildRefTi" 0 DISPLAY_IDENTIFIER FordMsg217BusHiSpd.PerInstanceMemories.FordVehReLeWhlSpdVldFaildRefTi /end MEASUREMENT
/begin MEASUREMENT FordMsg217BusHiSpd.FordVehReLeWhlSpdVldMissRefTi "MICROSAR RTE" ULONG NO_COMPU_METHOD 0 0 0 4294967295 ECU_ADDRESS 0 SYMBOL_LINK "Rte_FordMsg217BusHiSpd_FordVehReLeWhlSpdVldMissRefTi" 0 DISPLAY_IDENTIFIER FordMsg217BusHiSpd.PerInstanceMemories.FordVehReLeWhlSpdVldMissRefTi /end MEASUREMENT
/begin MEASUREMENT FordMsg217BusHiSpd.FordVehReLeWhlSpdVldPassdRefTi "MICROSAR RTE" ULONG NO_COMPU_METHOD 0 0 0 4294967295 ECU_ADDRESS 0 SYMBOL_LINK "Rte_FordMsg217BusHiSpd_FordVehReLeWhlSpdVldPassdRefTi" 0 DISPLAY_IDENTIFIER FordMsg217BusHiSpd.PerInstanceMemories.FordVehReLeWhlSpdVldPassdRefTi /end MEASUREMENT
/begin MEASUREMENT FordMsg217BusHiSpd.FordVehReLeWhlSpdVldPrev "MICROSAR RTE" UBYTE RTE_CM_BOOLEAN 0 0 0 255 ECU_ADDRESS 0 SYMBOL_LINK "Rte_FordMsg217BusHiSpd_FordVehReLeWhlSpdVldPrev" 0 DISPLAY_IDENTIFIER FordMsg217BusHiSpd.PerInstanceMemories.FordVehReLeWhlSpdVldPrev /end MEASUREMENT
/begin MEASUREMENT FordMsg217BusHiSpd.FordVehReRiWhlSpd.Val "MICROSAR RTE" FLOAT32_IEEE NO_COMPU_METHOD 0 0 -3.402823466e+38 3.402823466e+38 ECU_ADDRESS 0 SYMBOL_LINK "Rte_FordMsg217BusHiSpd_FordVehReRiWhlSpd_Val" 0 DISPLAY_IDENTIFIER FordMsg217BusHiSpd.SenderPorts.FordVehReRiWhlSpd.Val /end MEASUREMENT
/begin MEASUREMENT FordMsg217BusHiSpd.FordVehReRiWhlSpdInvldFaildRefTi "MICROSAR RTE" ULONG NO_COMPU_METHOD 0 0 0 4294967295 ECU_ADDRESS 0 SYMBOL_LINK "Rte_FordMsg217BusHiSpd_FordVehReRiWhlSpdInvldFaildRefTi" 0 DISPLAY_IDENTIFIER FordMsg217BusHiSpd.PerInstanceMemories.FordVehReRiWhlSpdInvldFaildRefTi /end MEASUREMENT
/begin MEASUREMENT FordMsg217BusHiSpd.FordVehReRiWhlSpdInvldPassdRefTi "MICROSAR RTE" ULONG NO_COMPU_METHOD 0 0 0 4294967295 ECU_ADDRESS 0 SYMBOL_LINK "Rte_FordMsg217BusHiSpd_FordVehReRiWhlSpdInvldPassdRefTi" 0 DISPLAY_IDENTIFIER FordMsg217BusHiSpd.PerInstanceMemories.FordVehReRiWhlSpdInvldPassdRefTi /end MEASUREMENT
/begin MEASUREMENT FordMsg217BusHiSpd.FordVehReRiWhlSpdPrev "MICROSAR RTE" FLOAT32_IEEE NO_COMPU_METHOD 0 0 -3.402823466e+38 3.402823466e+38 ECU_ADDRESS 0 SYMBOL_LINK "Rte_FordMsg217BusHiSpd_FordVehReRiWhlSpdPrev" 0 DISPLAY_IDENTIFIER FordMsg217BusHiSpd.PerInstanceMemories.FordVehReRiWhlSpdPrev /end MEASUREMENT
/begin MEASUREMENT FordMsg217BusHiSpd.FordVehReRiWhlSpdRaw.Val "MICROSAR RTE" UWORD NO_COMPU_METHOD 0 0 0 65535 ECU_ADDRESS 0 SYMBOL_LINK "Rte_FordMsg217BusHiSpd_FordVehReRiWhlSpdRaw_Val" 0 DISPLAY_IDENTIFIER FordMsg217BusHiSpd.SenderPorts.FordVehReRiWhlSpdRaw.Val /end MEASUREMENT
/begin MEASUREMENT FordMsg217BusHiSpd.FordVehReRiWhlSpdRawPrev "MICROSAR RTE" UWORD NO_COMPU_METHOD 0 0 0 65535 ECU_ADDRESS 0 SYMBOL_LINK "Rte_FordMsg217BusHiSpd_FordVehReRiWhlSpdRawPrev" 0 DISPLAY_IDENTIFIER FordMsg217BusHiSpd.PerInstanceMemories.FordVehReRiWhlSpdRawPrev /end MEASUREMENT
/begin MEASUREMENT FordMsg217BusHiSpd.FordVehReRiWhlSpdVld.Logl "MICROSAR RTE" UBYTE RTE_CM_BOOLEAN 0 0 0 255 ECU_ADDRESS 0 SYMBOL_LINK "Rte_FordMsg217BusHiSpd_FordVehReRiWhlSpdVld_Logl" 0 DISPLAY_IDENTIFIER FordMsg217BusHiSpd.SenderPorts.FordVehReRiWhlSpdVld.Logl /end MEASUREMENT
/begin MEASUREMENT FordMsg217BusHiSpd.FordVehReRiWhlSpdVldFaildRefTi "MICROSAR RTE" ULONG NO_COMPU_METHOD 0 0 0 4294967295 ECU_ADDRESS 0 SYMBOL_LINK "Rte_FordMsg217BusHiSpd_FordVehReRiWhlSpdVldFaildRefTi" 0 DISPLAY_IDENTIFIER FordMsg217BusHiSpd.PerInstanceMemories.FordVehReRiWhlSpdVldFaildRefTi /end MEASUREMENT
/begin MEASUREMENT FordMsg217BusHiSpd.FordVehReRiWhlSpdVldMissRefTi "MICROSAR RTE" ULONG NO_COMPU_METHOD 0 0 0 4294967295 ECU_ADDRESS 0 SYMBOL_LINK "Rte_FordMsg217BusHiSpd_FordVehReRiWhlSpdVldMissRefTi" 0 DISPLAY_IDENTIFIER FordMsg217BusHiSpd.PerInstanceMemories.FordVehReRiWhlSpdVldMissRefTi /end MEASUREMENT
/begin MEASUREMENT FordMsg217BusHiSpd.FordVehReRiWhlSpdVldPassdRefTi "MICROSAR RTE" ULONG NO_COMPU_METHOD 0 0 0 4294967295 ECU_ADDRESS 0 SYMBOL_LINK "Rte_FordMsg217BusHiSpd_FordVehReRiWhlSpdVldPassdRefTi" 0 DISPLAY_IDENTIFIER FordMsg217BusHiSpd.PerInstanceMemories.FordVehReRiWhlSpdVldPassdRefTi /end MEASUREMENT
/begin MEASUREMENT FordMsg217BusHiSpd.FordVehReRiWhlSpdVldPrev "MICROSAR RTE" UBYTE RTE_CM_BOOLEAN 0 0 0 255 ECU_ADDRESS 0 SYMBOL_LINK "Rte_FordMsg217BusHiSpd_FordVehReRiWhlSpdVldPrev" 0 DISPLAY_IDENTIFIER FordMsg217BusHiSpd.PerInstanceMemories.FordVehReRiWhlSpdVldPrev /end MEASUREMENT
/begin MEASUREMENT FordMsg217BusHiSpd.MissMsgFaildRefTi "MICROSAR RTE" ULONG NO_COMPU_METHOD 0 0 0 4294967295 ECU_ADDRESS 0 SYMBOL_LINK "Rte_FordMsg217BusHiSpd_MissMsgFaildRefTi" 0 DISPLAY_IDENTIFIER FordMsg217BusHiSpd.PerInstanceMemories.MissMsgFaildRefTi /end MEASUREMENT
/begin MEASUREMENT FordMsg217BusHiSpd.MissMsgPassdRefTi "MICROSAR RTE" ULONG NO_COMPU_METHOD 0 0 0 4294967295 ECU_ADDRESS 0 SYMBOL_LINK "Rte_FordMsg217BusHiSpd_MissMsgPassdRefTi" 0 DISPLAY_IDENTIFIER FordMsg217BusHiSpd.PerInstanceMemories.MissMsgPassdRefTi /end MEASUREMENT
/begin MEASUREMENT FordMsg230BusHiSpd.ClrDiagcFlgProxy.Val "MICROSAR RTE" UBYTE NO_COMPU_METHOD 0 0 0 255 ECU_ADDRESS 0 SYMBOL_LINK "Rte_DiagcMgr_ClrDiagcFlgProxy_Val" 0 DISPLAY_IDENTIFIER FordMsg230BusHiSpd.ReceiverPorts.ClrDiagcFlgProxy.Val /end MEASUREMENT
/begin MEASUREMENT FordMsg230BusHiSpd.ClrDiagcFlgProxyPrev "Clear Diagc Flag Proxy Previous." UBYTE NO_COMPU_METHOD 0 0 0 255 ECU_ADDRESS 0 SYMBOL_LINK "Rte_FordMsg230BusHiSpd_ClrDiagcFlgProxyPrev" 0 DISPLAY_IDENTIFIER FordMsg230BusHiSpd.PerInstanceMemories.ClrDiagcFlgProxyPrev /end MEASUREMENT
/begin MEASUREMENT FordMsg230BusHiSpd.FirstTranVldFlg "This flag is used to indicate the reception of first message." UBYTE RTE_CM_BOOLEAN 0 0 0 255 ECU_ADDRESS 0 SYMBOL_LINK "Rte_FordMsg230BusHiSpd_FirstTranVldFlg" 0 DISPLAY_IDENTIFIER FordMsg230BusHiSpd.PerInstanceMemories.FirstTranVldFlg /end MEASUREMENT
/begin MEASUREMENT FordMsg230BusHiSpd.FordCanDtcInhb.Logl "MICROSAR RTE" UBYTE RTE_CM_BOOLEAN 0 0 0 255 ECU_ADDRESS 0 SYMBOL_LINK "Rte_FordCanDtcInhb_FordCanDtcInhb_Logl" 0 DISPLAY_IDENTIFIER FordMsg230BusHiSpd.ReceiverPorts.FordCanDtcInhb.Logl /end MEASUREMENT
/begin MEASUREMENT FordMsg230BusHiSpd.FordEpsLifeCycMod.Val "MICROSAR RTE" UBYTE NO_COMPU_METHOD 0 0 0 255 ECU_ADDRESS 0 SYMBOL_LINK "Rte_FordCanDtcInhb_FordEpsLifeCycMod_Val" 0 DISPLAY_IDENTIFIER FordMsg230BusHiSpd.ReceiverPorts.FordEpsLifeCycMod.Val /end MEASUREMENT
/begin MEASUREMENT FordMsg230BusHiSpd.FordTrlrBackupAssiEnad.Logl "MICROSAR RTE" UBYTE RTE_CM_BOOLEAN 0 0 0 255 ECU_ADDRESS 0 SYMBOL_LINK "Rte_FordMsg230BusHiSpd_FordTrlrBackupAssiEnad_Logl" 0 DISPLAY_IDENTIFIER FordMsg230BusHiSpd.ReceiverPorts.FordTrlrBackupAssiEnad.Logl /end MEASUREMENT
/begin MEASUREMENT FordMsg230BusHiSpd.FordVehGearLvrPosn.Ford_GearLvrPos_D_Actl "MICROSAR RTE" UBYTE RTE_CM_ENUM_Ford_GearLvrPos_D_Actl 0 0 0 15 ECU_ADDRESS 0 SYMBOL_LINK "Rte_FordMsg230BusHiSpd_FordVehGearLvrPosn_Ford_GearLvrPos_D_Actl" 0 DISPLAY_IDENTIFIER FordMsg230BusHiSpd.SenderPorts.FordVehGearLvrPosn.Ford_GearLvrPos_D_Actl /end MEASUREMENT
/begin MEASUREMENT FordMsg230BusHiSpd.FordVehGearLvrPosnInvldFaildRefTi "Timer for Invalid message will increment or reset based on the condition." ULONG NO_COMPU_METHOD 0 0 0 4294967295 ECU_ADDRESS 0 SYMBOL_LINK "Rte_FordMsg230BusHiSpd_FordVehGearLvrPosnInvldFaildRefTi" 0 DISPLAY_IDENTIFIER FordMsg230BusHiSpd.PerInstanceMemories.FordVehGearLvrPosnInvldFaildRefTi /end MEASUREMENT
/begin MEASUREMENT FordMsg230BusHiSpd.FordVehGearLvrPosnInvldPassdRefTi "Timer for Invalid message will increment or reset based on the condition." ULONG NO_COMPU_METHOD 0 0 0 4294967295 ECU_ADDRESS 0 SYMBOL_LINK "Rte_FordMsg230BusHiSpd_FordVehGearLvrPosnInvldPassdRefTi" 0 DISPLAY_IDENTIFIER FordMsg230BusHiSpd.PerInstanceMemories.FordVehGearLvrPosnInvldPassdRefTi /end MEASUREMENT
/begin MEASUREMENT FordMsg230BusHiSpd.FordVehGearLvrPosnPrev "Previous value of Ford Vehicle Gear Lever Position." UBYTE RTE_CM_ENUM_Ford_GearLvrPos_D_Actl 0 0 0 15 ECU_ADDRESS 0 SYMBOL_LINK "Rte_FordMsg230BusHiSpd_FordVehGearLvrPosnPrev" 0 DISPLAY_IDENTIFIER FordMsg230BusHiSpd.PerInstanceMemories.FordVehGearLvrPosnPrev /end MEASUREMENT
/begin MEASUREMENT FordMsg230BusHiSpd.FordVehGearLvrPosnVldFaildRefTi "Timer for Gear Lever Position Valid Failed Reference Time will increment or reset based on the conditions." ULONG NO_COMPU_METHOD 0 0 0 4294967295 ECU_ADDRESS 0 SYMBOL_LINK "Rte_FordMsg230BusHiSpd_FordVehGearLvrPosnVldFaildRefTi" 0 DISPLAY_IDENTIFIER FordMsg230BusHiSpd.PerInstanceMemories.FordVehGearLvrPosnVldFaildRefTi /end MEASUREMENT
/begin MEASUREMENT FordMsg230BusHiSpd.FordVehGearLvrPosnVldInt.Logl "MICROSAR RTE" UBYTE RTE_CM_BOOLEAN 0 0 0 255 ECU_ADDRESS 0 SYMBOL_LINK "Rte_FordMsg230BusHiSpd_FordVehGearLvrPosnVldInt_Logl" 0 DISPLAY_IDENTIFIER FordMsg230BusHiSpd.SenderPorts.FordVehGearLvrPosnVldInt.Logl /end MEASUREMENT
/begin MEASUREMENT FordMsg230BusHiSpd.FordVehGearLvrPosnVldIntPrev "Previous value of Ford Vehicle Gear Lever Position Valid Internal." UBYTE RTE_CM_BOOLEAN 0 0 0 255 ECU_ADDRESS 0 SYMBOL_LINK "Rte_FordMsg230BusHiSpd_FordVehGearLvrPosnVldIntPrev" 0 DISPLAY_IDENTIFIER FordMsg230BusHiSpd.PerInstanceMemories.FordVehGearLvrPosnVldIntPrev /end MEASUREMENT
/begin MEASUREMENT FordMsg230BusHiSpd.FordVehGearLvrPosnVldPassdRefTi "Timer for Gear Lever Position Valid Failed Reference Time will increment or reset based on the conditions." ULONG NO_COMPU_METHOD 0 0 0 4294967295 ECU_ADDRESS 0 SYMBOL_LINK "Rte_FordMsg230BusHiSpd_FordVehGearLvrPosnVldPassdRefTi" 0 DISPLAY_IDENTIFIER FordMsg230BusHiSpd.PerInstanceMemories.FordVehGearLvrPosnVldPassdRefTi /end MEASUREMENT
/begin MEASUREMENT FordMsg230BusHiSpd.FordVehMsg230Miss "Used to hold value of Ford Vehicle message 230 miss." UBYTE RTE_CM_BOOLEAN 0 0 0 255 ECU_ADDRESS 0 SYMBOL_LINK "Rte_FordMsg230BusHiSpd_FordVehMsg230Miss" 0 DISPLAY_IDENTIFIER FordMsg230BusHiSpd.PerInstanceMemories.FordVehMsg230Miss /end MEASUREMENT
/begin MEASUREMENT FordMsg230BusHiSpd.GearLvrPosnVldMissRefTi "Timer for Gear Lever Position Valid Missing Reference Time will increment or reset based on the conditions." ULONG NO_COMPU_METHOD 0 0 0 4294967295 ECU_ADDRESS 0 SYMBOL_LINK "Rte_FordMsg230BusHiSpd_GearLvrPosnVldMissRefTi" 0 DISPLAY_IDENTIFIER FordMsg230BusHiSpd.PerInstanceMemories.GearLvrPosnVldMissRefTi /end MEASUREMENT
/begin MEASUREMENT FordMsg230BusHiSpd.MissMsgFaildRefTi "Timer for missing message will increment or reset based on the conditions." ULONG NO_COMPU_METHOD 0 0 0 4294967295 ECU_ADDRESS 0 SYMBOL_LINK "Rte_FordMsg230BusHiSpd_MissMsgFaildRefTi" 0 DISPLAY_IDENTIFIER FordMsg230BusHiSpd.PerInstanceMemories.MissMsgFaildRefTi /end MEASUREMENT
/begin MEASUREMENT FordMsg230BusHiSpd.MissMsgPassdRefTi "Timer for missing message will increment or reset based on the conditions." ULONG NO_COMPU_METHOD 0 0 0 4294967295 ECU_ADDRESS 0 SYMBOL_LINK "Rte_FordMsg230BusHiSpd_MissMsgPassdRefTi" 0 DISPLAY_IDENTIFIER FordMsg230BusHiSpd.PerInstanceMemories.MissMsgPassdRefTi /end MEASUREMENT
/begin MEASUREMENT FordMsg2FDBusHiSpd.ClrDiagcFlgProxy.Val "MICROSAR RTE" UBYTE NO_COMPU_METHOD 0 0 0 255 ECU_ADDRESS 0 SYMBOL_LINK "Rte_DiagcMgr_ClrDiagcFlgProxy_Val" 0 DISPLAY_IDENTIFIER FordMsg2FDBusHiSpd.ReceiverPorts.ClrDiagcFlgProxy.Val /end MEASUREMENT
/begin MEASUREMENT FordMsg2FDBusHiSpd.ClrDiagcFlgProxyPrev "MICROSAR RTE" UBYTE NO_COMPU_METHOD 0 0 0 255 ECU_ADDRESS 0 SYMBOL_LINK "Rte_FordMsg2FDBusHiSpd_ClrDiagcFlgProxyPrev" 0 DISPLAY_IDENTIFIER FordMsg2FDBusHiSpd.PerInstanceMemories.ClrDiagcFlgProxyPrev /end MEASUREMENT
/begin MEASUREMENT FordMsg2FDBusHiSpd.FirstTranVldFlg "MICROSAR RTE" UBYTE RTE_CM_BOOLEAN 0 0 0 255 ECU_ADDRESS 0 SYMBOL_LINK "Rte_FordMsg2FDBusHiSpd_FirstTranVldFlg" 0 DISPLAY_IDENTIFIER FordMsg2FDBusHiSpd.PerInstanceMemories.FirstTranVldFlg /end MEASUREMENT
/begin MEASUREMENT FordMsg2FDBusHiSpd.FordCanDtcInhb.Logl "MICROSAR RTE" UBYTE RTE_CM_BOOLEAN 0 0 0 255 ECU_ADDRESS 0 SYMBOL_LINK "Rte_FordCanDtcInhb_FordCanDtcInhb_Logl" 0 DISPLAY_IDENTIFIER FordMsg2FDBusHiSpd.ReceiverPorts.FordCanDtcInhb.Logl /end MEASUREMENT
/begin MEASUREMENT FordMsg2FDBusHiSpd.FordEpsLifeCycMod.Val "MICROSAR RTE" UBYTE NO_COMPU_METHOD 0 0 0 255 ECU_ADDRESS 0 SYMBOL_LINK "Rte_FordCanDtcInhb_FordEpsLifeCycMod_Val" 0 DISPLAY_IDENTIFIER FordMsg2FDBusHiSpd.ReceiverPorts.FordEpsLifeCycMod.Val /end MEASUREMENT
/begin MEASUREMENT FordMsg2FDBusHiSpd.FordEvasSteerAssiEnad.Logl "MICROSAR RTE" UBYTE RTE_CM_BOOLEAN 0 0 0 255 ECU_ADDRESS 0 SYMBOL_LINK "Rte_CustDiag_FordEvasSteerAssiEnad_Logl" 0 DISPLAY_IDENTIFIER FordMsg2FDBusHiSpd.ReceiverPorts.FordEvasSteerAssiEnad.Logl /end MEASUREMENT
/begin MEASUREMENT FordMsg2FDBusHiSpd.FordVehEvasSteerAssiReq.Val "MICROSAR RTE" UBYTE NO_COMPU_METHOD 0 0 0 255 ECU_ADDRESS 0 SYMBOL_LINK "Rte_FordMsg2FDBusHiSpd_FordVehEvasSteerAssiReq_Val" 0 DISPLAY_IDENTIFIER FordMsg2FDBusHiSpd.SenderPorts.FordVehEvasSteerAssiReq.Val /end MEASUREMENT
/begin MEASUREMENT FordMsg2FDBusHiSpd.FordVehEvasSteerAssiReqPrev "MICROSAR RTE" UBYTE NO_COMPU_METHOD 0 0 0 255 ECU_ADDRESS 0 SYMBOL_LINK "Rte_FordMsg2FDBusHiSpd_FordVehEvasSteerAssiReqPrev" 0 DISPLAY_IDENTIFIER FordMsg2FDBusHiSpd.PerInstanceMemories.FordVehEvasSteerAssiReqPrev /end MEASUREMENT
/begin MEASUREMENT FordMsg2FDBusHiSpd.FordVehEvasSteerAssiReqVld.Logl "MICROSAR RTE" UBYTE RTE_CM_BOOLEAN 0 0 0 255 ECU_ADDRESS 0 SYMBOL_LINK "Rte_FordMsg2FDBusHiSpd_FordVehEvasSteerAssiReqVld_Logl" 0 DISPLAY_IDENTIFIER FordMsg2FDBusHiSpd.SenderPorts.FordVehEvasSteerAssiReqVld.Logl /end MEASUREMENT
/begin MEASUREMENT FordMsg2FDBusHiSpd.FordVehEvasSteerAssiReqVldPrev "MICROSAR RTE" UBYTE RTE_CM_BOOLEAN 0 0 0 255 ECU_ADDRESS 0 SYMBOL_LINK "Rte_FordMsg2FDBusHiSpd_FordVehEvasSteerAssiReqVldPrev" 0 DISPLAY_IDENTIFIER FordMsg2FDBusHiSpd.PerInstanceMemories.FordVehEvasSteerAssiReqVldPrev /end MEASUREMENT
/begin MEASUREMENT FordMsg2FDBusHiSpd.FordVehMsg2FDMiss "MICROSAR RTE" UBYTE RTE_CM_BOOLEAN 0 0 0 255 ECU_ADDRESS 0 SYMBOL_LINK "Rte_FordMsg2FDBusHiSpd_FordVehMsg2FDMiss" 0 DISPLAY_IDENTIFIER FordMsg2FDBusHiSpd.PerInstanceMemories.FordVehMsg2FDMiss /end MEASUREMENT
/begin MEASUREMENT FordMsg2FDBusHiSpd.FordVehMsg2FDMissTmr "MICROSAR RTE" ULONG NO_COMPU_METHOD 0 0 0 4294967295 ECU_ADDRESS 0 SYMBOL_LINK "Rte_FordMsg2FDBusHiSpd_FordVehMsg2FDMissTmr" 0 DISPLAY_IDENTIFIER FordMsg2FDBusHiSpd.PerInstanceMemories.FordVehMsg2FDMissTmr /end MEASUREMENT
/begin MEASUREMENT FordMsg2FDBusHiSpd.FordVehMsg2FDNotRxdRefTi "MICROSAR RTE" ULONG NO_COMPU_METHOD 0 0 0 4294967295 ECU_ADDRESS 0 SYMBOL_LINK "Rte_FordMsg2FDBusHiSpd_FordVehMsg2FDNotRxdRefTi" 0 DISPLAY_IDENTIFIER FordMsg2FDBusHiSpd.PerInstanceMemories.FordVehMsg2FDNotRxdRefTi /end MEASUREMENT
/begin MEASUREMENT FordMsg2FDBusHiSpd.FordVehMsg2FDRxdRefTi "MICROSAR RTE" ULONG NO_COMPU_METHOD 0 0 0 4294967295 ECU_ADDRESS 0 SYMBOL_LINK "Rte_FordMsg2FDBusHiSpd_FordVehMsg2FDRxdRefTi" 0 DISPLAY_IDENTIFIER FordMsg2FDBusHiSpd.PerInstanceMemories.FordVehMsg2FDRxdRefTi /end MEASUREMENT
/begin MEASUREMENT FordMsg2FDBusHiSpd.FordVehMsg2FDRxdTmr "MICROSAR RTE" ULONG NO_COMPU_METHOD 0 0 0 4294967295 ECU_ADDRESS 0 SYMBOL_LINK "Rte_FordMsg2FDBusHiSpd_FordVehMsg2FDRxdTmr" 0 DISPLAY_IDENTIFIER FordMsg2FDBusHiSpd.PerInstanceMemories.FordVehMsg2FDRxdTmr /end MEASUREMENT
/begin GROUP FordMsg202BusHiSpd.FordVehSpdEngModlRawPrev "MICROSAR RTE" /begin SUB_GROUP /end SUB_GROUP /begin FUNCTION_LIST /end FUNCTION_LIST /begin REF_CHARACTERISTIC /end REF_CHARACTERISTIC /begin REF_MEASUREMENT FordMsg202BusHiSpd.FordVehSpdEngModlRawPrev /end REF_MEASUREMENT /end GROUP
/begin GROUP FordMsg202BusHiSpd.FordVehSpdEngModlVld.Logl "MICROSAR RTE" /begin SUB_GROUP /end SUB_GROUP /begin FUNCTION_LIST /end FUNCTION_LIST /begin REF_CHARACTERISTIC /end REF_CHARACTERISTIC /begin REF_MEASUREMENT FordMsg202BusHiSpd.FordVehSpdEngModlVld.Logl /end REF_MEASUREMENT /end GROUP
/begin GROUP FordMsg202BusHiSpd.FordVehSpdEngModlVldFaildRefTi "MICROSAR RTE" /begin SUB_GROUP /end SUB_GROUP /begin FUNCTION_LIST /end FUNCTION_LIST /begin REF_CHARACTERISTIC /end REF_CHARACTERISTIC /begin REF_MEASUREMENT FordMsg202BusHiSpd.FordVehSpdEngModlVldFaildRefTi /end REF_MEASUREMENT /end GROUP
/begin GROUP FordMsg202BusHiSpd.FordVehSpdEngModlVldMissRefTi "MICROSAR RTE" /begin SUB_GROUP /end SUB_GROUP /begin FUNCTION_LIST /end FUNCTION_LIST /begin REF_CHARACTERISTIC /end REF_CHARACTERISTIC /begin REF_MEASUREMENT FordMsg202BusHiSpd.FordVehSpdEngModlVldMissRefTi /end REF_MEASUREMENT /end GROUP
/begin GROUP FordMsg202BusHiSpd.FordVehSpdEngModlVldPrev "MICROSAR RTE" /begin SUB_GROUP /end SUB_GROUP /begin FUNCTION_LIST /end FUNCTION_LIST /begin REF_CHARACTERISTIC /end REF_CHARACTERISTIC /begin REF_MEASUREMENT FordMsg202BusHiSpd.FordVehSpdEngModlVldPrev /end REF_MEASUREMENT /end GROUP
/begin GROUP FordMsg202BusHiSpd.FordVehSpdQlyFacEngModl.Ford_VehVActlEng_D_Qf "MICROSAR RTE" /begin SUB_GROUP /end SUB_GROUP /begin FUNCTION_LIST /end FUNCTION_LIST /begin REF_CHARACTERISTIC /end REF_CHARACTERISTIC
 /begin REF_MEASUREMENT FordMsg202BusHiSpd.FordVehSpdQlyFacEngModl.Ford_VehVActlEng_D_Qf /end REF_MEASUREMENT
/end GROUP
/begin GROUP FordMsg202BusHiSpd.FordVehSpdQlyFacEngModlInvldFaildRefTi "MICROSAR RTE" /begin SUB_GROUP /end SUB_GROUP /begin FUNCTION_LIST /end FUNCTION_LIST /begin REF_CHARACTERISTIC /end REF_CHARACTERISTIC /begin REF_MEASUREMENT FordMsg202BusHiSpd.FordVehSpdQlyFacEngModlInvldFaildRefTi /end REF_MEASUREMENT /end GROUP
/begin GROUP FordMsg202BusHiSpd.FordVehSpdQlyFacEngModlInvldPassdRefTi "MICROSAR RTE" /begin SUB_GROUP /end SUB_GROUP /begin FUNCTION_LIST /end FUNCTION_LIST /begin REF_CHARACTERISTIC /end REF_CHARACTERISTIC /begin REF_MEASUREMENT FordMsg202BusHiSpd.FordVehSpdQlyFacEngModlInvldPassdRefTi /end REF_MEASUREMENT /end GROUP
/begin GROUP FordMsg202BusHiSpd.FordVehSpdQlyFacEngModlPrev "MICROSAR RTE" /begin SUB_GROUP /end SUB_GROUP /begin FUNCTION_LIST /end FUNCTION_LIST /begin REF_CHARACTERISTIC /end REF_CHARACTERISTIC /begin REF_MEASUREMENT FordMsg202BusHiSpd.FordVehSpdQlyFacEngModlPrev /end REF_MEASUREMENT /end GROUP
/begin GROUP FordMsg202BusHiSpd.FordVehTrlrAidAvl.Ford_VehVTrlrAid_B_Avail "MICROSAR RTE" /begin SUB_GROUP /end SUB_GROUP /begin FUNCTION_LIST /end FUNCTION_LIST /begin REF_CHARACTERISTIC /end REF_CHARACTERISTIC
 /begin REF_MEASUREMENT FordMsg202BusHiSpd.FordVehTrlrAidAvl.Ford_VehVTrlrAid_B_Avail /end REF_MEASUREMENT
/end GROUP
/begin GROUP FordMsg202BusHiSpd.FordVehTrlrAidAvlPrev "MICROSAR RTE" /begin SUB_GROUP /end SUB_GROUP /begin FUNCTION_LIST /end FUNCTION_LIST /begin REF_CHARACTERISTIC /end REF_CHARACTERISTIC /begin REF_MEASUREMENT FordMsg202BusHiSpd.FordVehTrlrAidAvlPrev /end REF_MEASUREMENT /end GROUP
/begin GROUP FordMsg202BusHiSpd.FordVehTrlrAidAvlRaw.Val "MICROSAR RTE" /begin SUB_GROUP /end SUB_GROUP /begin FUNCTION_LIST /end FUNCTION_LIST /begin REF_CHARACTERISTIC /end REF_CHARACTERISTIC /begin REF_MEASUREMENT FordMsg202BusHiSpd.FordVehTrlrAidAvlRaw.Val /end REF_MEASUREMENT /end GROUP
/begin GROUP FordMsg202BusHiSpd.FordVehTrlrAidAvlRawPrev "MICROSAR RTE" /begin SUB_GROUP /end SUB_GROUP /begin FUNCTION_LIST /end FUNCTION_LIST /begin REF_CHARACTERISTIC /end REF_CHARACTERISTIC /begin REF_MEASUREMENT FordMsg202BusHiSpd.FordVehTrlrAidAvlRawPrev /end REF_MEASUREMENT /end GROUP
/begin GROUP FordMsg202BusHiSpd.FordVehTrlrBackupAssiAvlVld.Logl "MICROSAR RTE" /begin SUB_GROUP /end SUB_GROUP /begin FUNCTION_LIST /end FUNCTION_LIST /begin REF_CHARACTERISTIC /end REF_CHARACTERISTIC /begin REF_MEASUREMENT FordMsg202BusHiSpd.FordVehTrlrBackupAssiAvlVld.Logl /end REF_MEASUREMENT /end GROUP
/begin GROUP FordMsg202BusHiSpd.FordVehTrlrBackupAssiAvlVldMissRefTi "MICROSAR RTE" /begin SUB_GROUP /end SUB_GROUP /begin FUNCTION_LIST /end FUNCTION_LIST /begin REF_CHARACTERISTIC /end REF_CHARACTERISTIC /begin REF_MEASUREMENT FordMsg202BusHiSpd.FordVehTrlrBackupAssiAvlVldMissRefTi /end REF_MEASUREMENT /end GROUP
/begin GROUP FordMsg202BusHiSpd.FordVehTrlrBackupAssiAvlVldPassdRefTi "MICROSAR RTE" /begin SUB_GROUP /end SUB_GROUP /begin FUNCTION_LIST /end FUNCTION_LIST /begin REF_CHARACTERISTIC /end REF_CHARACTERISTIC /begin REF_MEASUREMENT FordMsg202BusHiSpd.FordVehTrlrBackupAssiAvlVldPassdRefTi /end REF_MEASUREMENT /end GROUP
/begin GROUP FordMsg202BusHiSpd.FordVehTrlrBackupAssiAvlVldPrev "MICROSAR RTE" /begin SUB_GROUP /end SUB_GROUP /begin FUNCTION_LIST /end FUNCTION_LIST /begin REF_CHARACTERISTIC /end REF_CHARACTERISTIC /begin REF_MEASUREMENT FordMsg202BusHiSpd.FordVehTrlrBackupAssiAvlVldPrev /end REF_MEASUREMENT /end GROUP
/begin GROUP FordMsg202BusHiSpd.MissMsgFaildRefTi "MICROSAR RTE" /begin SUB_GROUP /end SUB_GROUP /begin FUNCTION_LIST /end FUNCTION_LIST /begin REF_CHARACTERISTIC /end REF_CHARACTERISTIC /begin REF_MEASUREMENT FordMsg202BusHiSpd.MissMsgFaildRefTi /end REF_MEASUREMENT /end GROUP
/begin GROUP FordMsg202BusHiSpd.MissMsgPassdRefTi "MICROSAR RTE" /begin SUB_GROUP /end SUB_GROUP /begin FUNCTION_LIST /end FUNCTION_LIST /begin REF_CHARACTERISTIC /end REF_CHARACTERISTIC /begin REF_MEASUREMENT FordMsg202BusHiSpd.MissMsgPassdRefTi /end REF_MEASUREMENT /end GROUP
/begin GROUP FordMsg202BusHiSpd.PerInstanceMemories "MICROSAR RTE"
 /begin SUB_GROUP FordMsg202BusHiSpd.ClrDiagcFlgProxyPrev FordMsg202BusHiSpd.FirstTranVldFlg FordMsg202BusHiSpd.FordVehGearRvsStsInvldFaildRefTi FordMsg202BusHiSpd.FordVehGearRvsStsInvldPassdRefTi FordMsg202BusHiSpd.FordVehGearRvsStsPrev FordMsg202BusHiSpd.FordVehGearRvsStsRawPrev FordMsg202BusHiSpd.FordVehGearRvsStsVldFaildRefTi FordMsg202BusHiSpd.FordVehGearRvsStsVldMissRefTi FordMsg202BusHiSpd.FordVehGearRvsStsVldPassdRefTi FordMsg202BusHiSpd.FordVehGearRvsStsVldPrev FordMsg202BusHiSpd.FordVehMsg202Miss FordMsg202BusHiSpd.FordVehMsg202Rxd FordMsg202BusHiSpd.FordVehSpdChksEngModlPrev FordMsg202BusHiSpd.FordVehSpdCntrEngModlPrev FordMsg202BusHiSpd.FordVehSpdEngModLoQlyVldFaildRefTi FordMsg202BusHiSpd.FordVehSpdEngModLoQlyVldMissRefTi FordMsg202BusHiSpd.FordVehSpdEngModLoQlyVldPassdRefTi FordMsg202BusHiSpd.FordVehSpdEngModLoQlyVldPrev FordMsg202BusHiSpd.FordVehSpdEngModlPrev FordMsg202BusHiSpd.FordVehSpdEngModlRawPrev FordMsg202BusHiSpd.FordVehSpdEngModlVldFaildRefTi FordMsg202BusHiSpd.FordVehSpdEngModlVldMissRefTi FordMsg202BusHiSpd.FordVehSpdEngModlVldPrev FordMsg202BusHiSpd.FordVehSpdQlyFacEngModlInvldFaildRefTi FordMsg202BusHiSpd.FordVehSpdQlyFacEngModlInvldPassdRefTi FordMsg202BusHiSpd.FordVehSpdQlyFacEngModlPrev FordMsg202BusHiSpd.FordVehTrlrAidAvlPrev FordMsg202BusHiSpd.FordVehTrlrAidAvlRawPrev FordMsg202BusHiSpd.FordVehTrlrBackupAssiAvlVldMissRefTi FordMsg202BusHiSpd.FordVehTrlrBackupAssiAvlVldPassdRefTi FordMsg202BusHiSpd.FordVehTrlrBackupAssiAvlVldPrev FordMsg202BusHiSpd.MissMsgFaildRefTi FordMsg202BusHiSpd.MissMsgPassdRefTi /end SUB_GROUP
 /begin FUNCTION_LIST /end FUNCTION_LIST
 /begin REF_CHARACTERISTIC /end REF_CHARACTERISTIC
 /begin REF_MEASUREMENT /end REF_MEASUREMENT
/end GROUP
/begin GROUP FordMsg202BusHiSpd.ReceiverPorts "MICROSAR RTE"
 /begin SUB_GROUP FordMsg202BusHiSpd.ClrDiagcFlgProxy.Val FordMsg202BusHiSpd.FordAbsPrsnt.Logl FordMsg202BusHiSpd.FordBrkOscnRednEnad.Logl FordMsg202BusHiSpd.FordCanDtcInhb.Val FordMsg202BusHiSpd.FordEpsLifeCycMod.Val FordMsg202BusHiSpd.FordInvldMsgDiagcInhb.Val FordMsg202BusHiSpd.FordMfgDiagcInhb.Val FordMsg202BusHiSpd.FordMissMsgDiagcInhb.Val FordMsg202BusHiSpd.FordTqSteerCmpEnad.Logl FordMsg202BusHiSpd.FordTrlrBackupAssiEnad.Logl /end SUB_GROUP
 /begin FUNCTION_LIST /end FUNCTION_LIST
 /begin REF_CHARACTERISTIC /end REF_CHARACTERISTIC
 /begin REF_MEASUREMENT /end REF_MEASUREMENT
/end GROUP
/begin GROUP FordMsg202BusHiSpd.SenderPorts "MICROSAR RTE"
 /begin SUB_GROUP FordMsg202BusHiSpd.FordVehGearRvsSts.Ford_GearRvrse_D_Actl FordMsg202BusHiSpd.FordVehGearRvsStsRaw.Val FordMsg202BusHiSpd.FordVehGearRvsStsVld.Logl FordMsg202BusHiSpd.FordVehSpdChksEngModl.Val FordMsg202BusHiSpd.FordVehSpdCntrEngModl.Val FordMsg202BusHiSpd.FordVehSpdEngModLoQlyVld.Logl FordMsg202BusHiSpd.FordVehSpdEngModl.Val FordMsg202BusHiSpd.FordVehSpdEngModlRaw.Val FordMsg202BusHiSpd.FordVehSpdEngModlVld.Logl FordMsg202BusHiSpd.FordVehSpdQlyFacEngModl.Ford_VehVActlEng_D_Qf FordMsg202BusHiSpd.FordVehTrlrAidAvl.Ford_VehVTrlrAid_B_Avail FordMsg202BusHiSpd.FordVehTrlrAidAvlRaw.Val FordMsg202BusHiSpd.FordVehTrlrBackupAssiAvlVld.Logl /end SUB_GROUP
 /begin FUNCTION_LIST /end FUNCTION_LIST
 /begin REF_CHARACTERISTIC /end REF_CHARACTERISTIC
 /begin REF_MEASUREMENT /end REF_MEASUREMENT
/end GROUP
/begin GROUP FordMsg213BusHiSpd "MICROSAR RTE"
 /begin SUB_GROUP FordMsg213BusHiSpd.CalibrationPorts FordMsg213BusHiSpd.PerInstanceMemories FordMsg213BusHiSpd.ReceiverPorts FordMsg213BusHiSpd.SenderPorts /end SUB_GROUP
 /begin FUNCTION_LIST /end FUNCTION_LIST
 /begin REF_CHARACTERISTIC /end REF_CHARACTERISTIC
 /begin REF_MEASUREMENT /end REF_MEASUREMENT
/end GROUP
/begin GROUP FordMsg213BusHiSpd.AbsActvVldFaildRefTi "MICROSAR RTE" /begin SUB_GROUP /end SUB_GROUP /begin FUNCTION_LIST /end FUNCTION_LIST /begin REF_CHARACTERISTIC /end REF_CHARACTERISTIC /begin REF_MEASUREMENT FordMsg213BusHiSpd.AbsActvVldFaildRefTi /end REF_MEASUREMENT /end GROUP
/begin GROUP FordMsg213BusHiSpd.AbsActvVldPassdRefTi "MICROSAR RTE" /begin SUB_GROUP /end SUB_GROUP /begin FUNCTION_LIST /end FUNCTION_LIST /begin REF_CHARACTERISTIC /end REF_CHARACTERISTIC /begin REF_MEASUREMENT FordMsg213BusHiSpd.AbsActvVldPassdRefTi /end REF_MEASUREMENT /end GROUP
/begin GROUP FordMsg213BusHiSpd.CalibrationPorts "MICROSAR RTE"
 /begin SUB_GROUP FordMsg213BusHiSpd.FordMsg213BusHiSpdAbsActvVldFaildThd.Val FordMsg213BusHiSpd.FordMsg213BusHiSpdAbsActvVldPassdThd.Val FordMsg213BusHiSpd.FordMsg213BusHiSpdEvasSteerAssiEnadThd.Val FordMsg213BusHiSpd.FordMsg213BusHiSpdMissMsgFaildThd.Val FordMsg213BusHiSpd.FordMsg213BusHiSpdMissMsgPassdThd.Val /end SUB_GROUP
 /begin FUNCTION_LIST /end FUNCTION_LIST
 /begin REF_CHARACTERISTIC /end REF_CHARACTERISTIC
 /begin REF_MEASUREMENT /end REF_MEASUREMENT
/end GROUP
/begin GROUP FordMsg213BusHiSpd.ClrDiagcFlgProxy.Val "MICROSAR RTE" /begin SUB_GROUP /end SUB_GROUP /begin FUNCTION_LIST /end FUNCTION_LIST /begin REF_CHARACTERISTIC /end REF_CHARACTERISTIC /begin REF_MEASUREMENT FordMsg213BusHiSpd.ClrDiagcFlgProxy.Val /end REF_MEASUREMENT /end GROUP
/begin GROUP FordMsg213BusHiSpd.ClrDiagcFlgProxyPrev "MICROSAR RTE" /begin SUB_GROUP /end SUB_GROUP /begin FUNCTION_LIST /end FUNCTION_LIST /begin REF_CHARACTERISTIC /end REF_CHARACTERISTIC /begin REF_MEASUREMENT FordMsg213BusHiSpd.ClrDiagcFlgProxyPrev /end REF_MEASUREMENT /end GROUP
/begin GROUP FordMsg213BusHiSpd.FirstTranVldFlg "MICROSAR RTE" /begin SUB_GROUP /end SUB_GROUP /begin FUNCTION_LIST /end FUNCTION_LIST /begin REF_CHARACTERISTIC /end REF_CHARACTERISTIC /begin REF_MEASUREMENT FordMsg213BusHiSpd.FirstTranVldFlg /end REF_MEASUREMENT /end GROUP
/begin GROUP FordMsg213BusHiSpd.FordBrkOscnRednEnad.Logl "MICROSAR RTE" /begin SUB_GROUP /end SUB_GROUP /begin FUNCTION_LIST /end FUNCTION_LIST /begin REF_CHARACTERISTIC /end REF_CHARACTERISTIC /begin REF_MEASUREMENT FordMsg213BusHiSpd.FordBrkOscnRednEnad.Logl /end REF_MEASUREMENT /end GROUP
/begin GROUP FordMsg213BusHiSpd.FordCanDtcInhb.Logl "MICROSAR RTE" /begin SUB_GROUP /end SUB_GROUP /begin FUNCTION_LIST /end FUNCTION_LIST /begin REF_CHARACTERISTIC /end REF_CHARACTERISTIC /begin REF_MEASUREMENT FordMsg213BusHiSpd.FordCanDtcInhb.Logl /end REF_MEASUREMENT /end GROUP
/begin GROUP FordMsg213BusHiSpd.FordEpsLifeCycMod.Val "MICROSAR RTE" /begin SUB_GROUP /end SUB_GROUP /begin FUNCTION_LIST /end FUNCTION_LIST /begin REF_CHARACTERISTIC /end REF_CHARACTERISTIC /begin REF_MEASUREMENT FordMsg213BusHiSpd.FordEpsLifeCycMod.Val /end REF_MEASUREMENT /end GROUP
/begin GROUP FordMsg213BusHiSpd.FordEvasSteerAssiEnad.Logl "MICROSAR RTE" /begin SUB_GROUP /end SUB_GROUP /begin FUNCTION_LIST /end FUNCTION_LIST /begin REF_CHARACTERISTIC /end REF_CHARACTERISTIC /begin REF_MEASUREMENT FordMsg213BusHiSpd.FordEvasSteerAssiEnad.Logl /end REF_MEASUREMENT /end GROUP
/begin GROUP FordMsg213BusHiSpd.FordLaneCentrAssiEnad.Logl "MICROSAR RTE" /begin SUB_GROUP /end SUB_GROUP /begin FUNCTION_LIST /end FUNCTION_LIST /begin REF_CHARACTERISTIC /end REF_CHARACTERISTIC /begin REF_MEASUREMENT FordMsg213BusHiSpd.FordLaneCentrAssiEnad.Logl /end REF_MEASUREMENT /end GROUP
/begin GROUP FordMsg213BusHiSpd.FordLaneDetnWarnEnad.Logl "MICROSAR RTE" /begin SUB_GROUP /end SUB_GROUP /begin FUNCTION_LIST /end FUNCTION_LIST /begin REF_CHARACTERISTIC /end REF_CHARACTERISTIC /begin REF_MEASUREMENT FordMsg213BusHiSpd.FordLaneDetnWarnEnad.Logl /end REF_MEASUREMENT /end GROUP
/begin GROUP FordMsg213BusHiSpd.FordLkaEnad.Logl "MICROSAR RTE" /begin SUB_GROUP /end SUB_GROUP /begin FUNCTION_LIST /end FUNCTION_LIST /begin REF_CHARACTERISTIC /end REF_CHARACTERISTIC /begin REF_MEASUREMENT FordMsg213BusHiSpd.FordLkaEnad.Logl /end REF_MEASUREMENT /end GROUP
/begin GROUP FordMsg213BusHiSpd.FordMsg213BusHiSpdAbsActvVldFaildThd.Val "MICROSAR RTE" /begin SUB_GROUP /end SUB_GROUP /begin FUNCTION_LIST /end FUNCTION_LIST
 /begin REF_CHARACTERISTIC FordMsg213BusHiSpd.FordMsg213BusHiSpdAbsActvVldFaildThd.Val /end REF_CHARACTERISTIC
 /begin REF_MEASUREMENT /end REF_MEASUREMENT
/end GROUP
/begin GROUP FordMsg213BusHiSpd.FordMsg213BusHiSpdAbsActvVldPassdThd.Val "MICROSAR RTE" /begin SUB_GROUP /end SUB_GROUP /begin FUNCTION_LIST /end FUNCTION_LIST
 /begin REF_CHARACTERISTIC FordMsg213BusHiSpd.FordMsg213BusHiSpdAbsActvVldPassdThd.Val /end REF_CHARACTERISTIC
 /begin REF_MEASUREMENT /end REF_MEASUREMENT
/end GROUP
/begin GROUP FordMsg213BusHiSpd.FordMsg213BusHiSpdEvasSteerAssiEnadThd.Val "MICROSAR RTE" /begin SUB_GROUP /end SUB_GROUP /begin FUNCTION_LIST /end FUNCTION_LIST
 /begin REF_CHARACTERISTIC FordMsg213BusHiSpd.FordMsg213BusHiSpdEvasSteerAssiEnadThd.Val /end REF_CHARACTERISTIC
 /begin REF_MEASUREMENT /end REF_MEASUREMENT
/end GROUP
/begin GROUP FordMsg213BusHiSpd.FordMsg213BusHiSpdMissMsgFaildThd.Val "MICROSAR RTE" /begin SUB_GROUP /end SUB_GROUP /begin FUNCTION_LIST /end FUNCTION_LIST /begin REF_CHARACTERISTIC FordMsg213BusHiSpd.FordMsg213BusHiSpdMissMsgFaildThd.Val /end REF_CHARACTERISTIC /begin REF_MEASUREMENT /end REF_MEASUREMENT /end GROUP
/begin GROUP FordMsg213BusHiSpd.FordMsg213BusHiSpdMissMsgPassdThd.Val "MICROSAR RTE" /begin SUB_GROUP /end SUB_GROUP /begin FUNCTION_LIST /end FUNCTION_LIST /begin REF_CHARACTERISTIC FordMsg213BusHiSpd.FordMsg213BusHiSpdMissMsgPassdThd.Val /end REF_CHARACTERISTIC /begin REF_MEASUREMENT /end REF_MEASUREMENT /end GROUP
/begin GROUP FordMsg213BusHiSpd.FordTrfcJamAssiEnad.Logl "MICROSAR RTE" /begin SUB_GROUP /end SUB_GROUP /begin FUNCTION_LIST /end FUNCTION_LIST /begin REF_CHARACTERISTIC /end REF_CHARACTERISTIC /begin REF_MEASUREMENT FordMsg213BusHiSpd.FordTrfcJamAssiEnad.Logl /end REF_MEASUREMENT /end GROUP
/begin GROUP FordMsg213BusHiSpd.FordVehAbsActv.Val "MICROSAR RTE" /begin SUB_GROUP /end SUB_GROUP /begin FUNCTION_LIST /end FUNCTION_LIST /begin REF_CHARACTERISTIC /end REF_CHARACTERISTIC /begin REF_MEASUREMENT FordMsg213BusHiSpd.FordVehAbsActv.Val /end REF_MEASUREMENT /end GROUP
/begin GROUP FordMsg213BusHiSpd.FordVehAbsActvPrev "MICROSAR RTE" /begin SUB_GROUP /end SUB_GROUP /begin FUNCTION_LIST /end FUNCTION_LIST /begin REF_CHARACTERISTIC /end REF_CHARACTERISTIC /begin REF_MEASUREMENT FordMsg213BusHiSpd.FordVehAbsActvPrev /end REF_MEASUREMENT /end GROUP
/begin GROUP FordMsg213BusHiSpd.FordVehAbsEscStsVld.Logl "MICROSAR RTE" /begin SUB_GROUP /end SUB_GROUP /begin FUNCTION_LIST /end FUNCTION_LIST /begin REF_CHARACTERISTIC /end REF_CHARACTERISTIC /begin REF_MEASUREMENT FordMsg213BusHiSpd.FordVehAbsEscStsVld.Logl /end REF_MEASUREMENT /end GROUP
/begin GROUP FordMsg213BusHiSpd.FordVehAbsEscStsVldPrev "MICROSAR RTE" /begin SUB_GROUP /end SUB_GROUP /begin FUNCTION_LIST /end FUNCTION_LIST /begin REF_CHARACTERISTIC /end REF_CHARACTERISTIC /begin REF_MEASUREMENT FordMsg213BusHiSpd.FordVehAbsEscStsVldPrev /end REF_MEASUREMENT /end GROUP
/begin GROUP FordMsg213BusHiSpd.FordVehCllsnMtgtnByBrkgDenied.Val "MICROSAR RTE" /begin SUB_GROUP /end SUB_GROUP /begin FUNCTION_LIST /end FUNCTION_LIST /begin REF_CHARACTERISTIC /end REF_CHARACTERISTIC /begin REF_MEASUREMENT FordMsg213BusHiSpd.FordVehCllsnMtgtnByBrkgDenied.Val /end REF_MEASUREMENT /end GROUP
/begin GROUP FordMsg213BusHiSpd.FordVehCllsnMtgtnByBrkgDeniedPrev "MICROSAR RTE" /begin SUB_GROUP /end SUB_GROUP /begin FUNCTION_LIST /end FUNCTION_LIST /begin REF_CHARACTERISTIC /end REF_CHARACTERISTIC /begin REF_MEASUREMENT FordMsg213BusHiSpd.FordVehCllsnMtgtnByBrkgDeniedPrev /end REF_MEASUREMENT /end GROUP
/begin GROUP FordMsg213BusHiSpd.FordVehCllsnMtgtnByBrkgDisad.Val "MICROSAR RTE" /begin SUB_GROUP /end SUB_GROUP /begin FUNCTION_LIST /end FUNCTION_LIST /begin REF_CHARACTERISTIC /end REF_CHARACTERISTIC /begin REF_MEASUREMENT FordMsg213BusHiSpd.FordVehCllsnMtgtnByBrkgDisad.Val /end REF_MEASUREMENT /end GROUP
/begin GROUP FordMsg213BusHiSpd.FordVehCllsnMtgtnByBrkgDisadPrev "MICROSAR RTE" /begin SUB_GROUP /end SUB_GROUP /begin FUNCTION_LIST /end FUNCTION_LIST /begin REF_CHARACTERISTIC /end REF_CHARACTERISTIC /begin REF_MEASUREMENT FordMsg213BusHiSpd.FordVehCllsnMtgtnByBrkgDisadPrev /end REF_MEASUREMENT /end GROUP
/begin GROUP FordMsg213BusHiSpd.FordVehEscActv.Val "MICROSAR RTE" /begin SUB_GROUP /end SUB_GROUP /begin FUNCTION_LIST /end FUNCTION_LIST /begin REF_CHARACTERISTIC /end REF_CHARACTERISTIC /begin REF_MEASUREMENT FordMsg213BusHiSpd.FordVehEscActv.Val /end REF_MEASUREMENT /end GROUP
/begin GROUP FordMsg213BusHiSpd.FordVehEscActvPrev "MICROSAR RTE" /begin SUB_GROUP /end SUB_GROUP /begin FUNCTION_LIST /end FUNCTION_LIST /begin REF_CHARACTERISTIC /end REF_CHARACTERISTIC /begin REF_MEASUREMENT FordMsg213BusHiSpd.FordVehEscActvPrev /end REF_MEASUREMENT /end GROUP
/begin GROUP FordMsg213BusHiSpd.FordVehMsg213Miss "MICROSAR RTE" /begin SUB_GROUP /end SUB_GROUP /begin FUNCTION_LIST /end FUNCTION_LIST /begin REF_CHARACTERISTIC /end REF_CHARACTERISTIC /begin REF_MEASUREMENT FordMsg213BusHiSpd.FordVehMsg213Miss /end REF_MEASUREMENT /end GROUP
/begin GROUP FordMsg213BusHiSpd.MissMsgFaildRefTi "MICROSAR RTE" /begin SUB_GROUP /end SUB_GROUP /begin FUNCTION_LIST /end FUNCTION_LIST /begin REF_CHARACTERISTIC /end REF_CHARACTERISTIC /begin REF_MEASUREMENT FordMsg213BusHiSpd.MissMsgFaildRefTi /end REF_MEASUREMENT /end GROUP
/begin GROUP FordMsg213BusHiSpd.MissMsgPassdRefTi "MICROSAR RTE" /begin SUB_GROUP /end SUB_GROUP /begin FUNCTION_LIST /end FUNCTION_LIST /begin REF_CHARACTERISTIC /end REF_CHARACTERISTIC /begin REF_MEASUREMENT FordMsg213BusHiSpd.MissMsgPassdRefTi /end REF_MEASUREMENT /end GROUP
/begin GROUP FordMsg213BusHiSpd.PerInstanceMemories "MICROSAR RTE"
 /begin SUB_GROUP FordMsg213BusHiSpd.AbsActvVldFaildRefTi FordMsg213BusHiSpd.AbsActvVldPassdRefTi FordMsg213BusHiSpd.ClrDiagcFlgProxyPrev FordMsg213BusHiSpd.FirstTranVldFlg FordMsg213BusHiSpd.FordVehAbsActvPrev FordMsg213BusHiSpd.FordVehAbsEscStsVldPrev FordMsg213BusHiSpd.FordVehCllsnMtgtnByBrkgDeniedPrev FordMsg213BusHiSpd.FordVehCllsnMtgtnByBrkgDisadPrev FordMsg213BusHiSpd.FordVehEscActvPrev FordMsg213BusHiSpd.FordVehMsg213Miss FordMsg213BusHiSpd.MissMsgFaildRefTi FordMsg213BusHiSpd.MissMsgPassdRefTi /end SUB_GROUP
 /begin FUNCTION_LIST /end FUNCTION_LIST
 /begin REF_CHARACTERISTIC /end REF_CHARACTERISTIC
 /begin REF_MEASUREMENT /end REF_MEASUREMENT
/end GROUP
/begin GROUP FordMsg213BusHiSpd.ReceiverPorts "MICROSAR RTE"
 /begin SUB_GROUP FordMsg213BusHiSpd.ClrDiagcFlgProxy.Val FordMsg213BusHiSpd.FordBrkOscnRednEnad.Logl FordMsg213BusHiSpd.FordCanDtcInhb.Logl FordMsg213BusHiSpd.FordEpsLifeCycMod.Val FordMsg213BusHiSpd.FordEvasSteerAssiEnad.Logl FordMsg213BusHiSpd.FordLaneCentrAssiEnad.Logl FordMsg213BusHiSpd.FordLaneDetnWarnEnad.Logl FordMsg213BusHiSpd.FordLkaEnad.Logl FordMsg213BusHiSpd.FordTrfcJamAssiEnad.Logl /end SUB_GROUP
 /begin FUNCTION_LIST /end FUNCTION_LIST
 /begin REF_CHARACTERISTIC /end REF_CHARACTERISTIC
 /begin REF_MEASUREMENT /end REF_MEASUREMENT
/end GROUP
/begin GROUP FordMsg213BusHiSpd.SenderPorts "MICROSAR RTE"
 /begin SUB_GROUP FordMsg213BusHiSpd.FordVehAbsActv.Val FordMsg213BusHiSpd.FordVehAbsEscStsVld.Logl FordMsg213BusHiSpd.FordVehCllsnMtgtnByBrkgDenied.Val FordMsg213BusHiSpd.FordVehCllsnMtgtnByBrkgDisad.Val FordMsg213BusHiSpd.FordVehEscActv.Val /end SUB_GROUP
 /begin FUNCTION_LIST /end FUNCTION_LIST
 /begin REF_CHARACTERISTIC /end REF_CHARACTERISTIC
 /begin REF_MEASUREMENT /end REF_MEASUREMENT
/end GROUP
/begin GROUP FordMsg215BusHiSpd "MICROSAR RTE"
 /begin SUB_GROUP FordMsg215BusHiSpd.CalibrationPorts FordMsg215BusHiSpd.PerInstanceMemories FordMsg215BusHiSpd.ReceiverPorts FordMsg215BusHiSpd.SenderPorts /end SUB_GROUP
 /begin FUNCTION_LIST /end FUNCTION_LIST
 /begin REF_CHARACTERISTIC /end REF_CHARACTERISTIC
 /begin REF_MEASUREMENT /end REF_MEASUREMENT
/end GROUP
/begin GROUP FordMsg215BusHiSpd.CalibrationPorts "MICROSAR RTE"
 /begin SUB_GROUP FordMsg215BusHiSpd.FordMsg215BusHiSpdFordVehTrlrAidModReqVldNotRxdTiThd.Val FordMsg215BusHiSpd.FordMsg215BusHiSpdFordVehTrlrAidModReqVldRxdTiThd.Val FordMsg215BusHiSpd.FordMsg215BusHiSpdMissMsgFaildTiThd.Val FordMsg215BusHiSpd.FordMsg215BusHiSpdMissMsgPassdTiThd.Val /end SUB_GROUP
 /begin FUNCTION_LIST /end FUNCTION_LIST
 /begin REF_CHARACTERISTIC /end REF_CHARACTERISTIC
 /begin REF_MEASUREMENT /end REF_MEASUREMENT
/end GROUP
/begin GROUP FordMsg215BusHiSpd.ClrDiagcFlgProxy.Val "MICROSAR RTE" /begin SUB_GROUP /end SUB_GROUP /begin FUNCTION_LIST /end FUNCTION_LIST /begin REF_CHARACTERISTIC /end REF_CHARACTERISTIC /begin REF_MEASUREMENT FordMsg215BusHiSpd.ClrDiagcFlgProxy.Val /end REF_MEASUREMENT /end GROUP
/begin GROUP FordMsg215BusHiSpd.ClrDiagcFlgProxyPrev "MICROSAR RTE" /begin SUB_GROUP /end SUB_GROUP /begin FUNCTION_LIST /end FUNCTION_LIST /begin REF_CHARACTERISTIC /end REF_CHARACTERISTIC /begin REF_MEASUREMENT FordMsg215BusHiSpd.ClrDiagcFlgProxyPrev /end REF_MEASUREMENT /end GROUP
/begin GROUP FordMsg215BusHiSpd.FirstTranVldFlg "MICROSAR RTE" /begin SUB_GROUP /end SUB_GROUP /begin FUNCTION_LIST /end FUNCTION_LIST /begin REF_CHARACTERISTIC /end REF_CHARACTERISTIC /begin REF_MEASUREMENT FordMsg215BusHiSpd.FirstTranVldFlg /end REF_MEASUREMENT /end GROUP
/begin GROUP FordMsg215BusHiSpd.FordCanDtcInhb.Logl "MICROSAR RTE" /begin SUB_GROUP /end SUB_GROUP /begin FUNCTION_LIST /end FUNCTION_LIST /begin REF_CHARACTERISTIC /end REF_CHARACTERISTIC /begin REF_MEASUREMENT FordMsg215BusHiSpd.FordCanDtcInhb.Logl /end REF_MEASUREMENT /end GROUP
/begin GROUP FordMsg215BusHiSpd.FordEpsLifeCycMod.Val "MICROSAR RTE" /begin SUB_GROUP /end SUB_GROUP /begin FUNCTION_LIST /end FUNCTION_LIST /begin REF_CHARACTERISTIC /end REF_CHARACTERISTIC /begin REF_MEASUREMENT FordMsg215BusHiSpd.FordEpsLifeCycMod.Val /end REF_MEASUREMENT /end GROUP
/begin GROUP FordMsg215BusHiSpd.FordMsg215BusHiSpdFordVehTrlrAidModReqVldNotRxdTiThd.Val "MICROSAR RTE" /begin SUB_GROUP /end SUB_GROUP /begin FUNCTION_LIST /end FUNCTION_LIST
 /begin REF_CHARACTERISTIC FordMsg215BusHiSpd.FordMsg215BusHiSpdFordVehTrlrAidModReqVldNotRxdTiThd.Val /end REF_CHARACTERISTIC
 /begin REF_MEASUREMENT /end REF_MEASUREMENT
/end GROUP
/begin GROUP FordMsg215BusHiSpd.FordMsg215BusHiSpdFordVehTrlrAidModReqVldRxdTiThd.Val "MICROSAR RTE" /begin SUB_GROUP /end SUB_GROUP /begin FUNCTION_LIST /end FUNCTION_LIST
 /begin REF_CHARACTERISTIC FordMsg215BusHiSpd.FordMsg215BusHiSpdFordVehTrlrAidModReqVldRxdTiThd.Val /end REF_CHARACTERISTIC
 /begin REF_MEASUREMENT /end REF_MEASUREMENT
/end GROUP
/begin GROUP FordMsg215BusHiSpd.FordMsg215BusHiSpdMissMsgFaildTiThd.Val "MICROSAR RTE" /begin SUB_GROUP /end SUB_GROUP /begin FUNCTION_LIST /end FUNCTION_LIST /begin REF_CHARACTERISTIC FordMsg215BusHiSpd.FordMsg215BusHiSpdMissMsgFaildTiThd.Val /end REF_CHARACTERISTIC /begin REF_MEASUREMENT /end REF_MEASUREMENT /end GROUP
/begin GROUP FordMsg215BusHiSpd.FordMsg215BusHiSpdMissMsgPassdTiThd.Val "MICROSAR RTE" /begin SUB_GROUP /end SUB_GROUP /begin FUNCTION_LIST /end FUNCTION_LIST /begin REF_CHARACTERISTIC FordMsg215BusHiSpd.FordMsg215BusHiSpdMissMsgPassdTiThd.Val /end REF_CHARACTERISTIC /begin REF_MEASUREMENT /end REF_MEASUREMENT /end GROUP
/begin GROUP FordMsg215BusHiSpd.FordTrlrBackupAssiEnad.Logl "MICROSAR RTE" /begin SUB_GROUP /end SUB_GROUP /begin FUNCTION_LIST /end FUNCTION_LIST /begin REF_CHARACTERISTIC /end REF_CHARACTERISTIC /begin REF_MEASUREMENT FordMsg215BusHiSpd.FordTrlrBackupAssiEnad.Logl /end REF_MEASUREMENT /end GROUP
/begin GROUP FordMsg215BusHiSpd.FordVehMsg215Miss "MICROSAR RTE" /begin SUB_GROUP /end SUB_GROUP /begin FUNCTION_LIST /end FUNCTION_LIST /begin REF_CHARACTERISTIC /end REF_CHARACTERISTIC /begin REF_MEASUREMENT FordMsg215BusHiSpd.FordVehMsg215Miss /end REF_MEASUREMENT /end GROUP
/begin GROUP FordMsg215BusHiSpd.FordVehMsg215MissTmr "MICROSAR RTE" /begin SUB_GROUP /end SUB_GROUP /begin FUNCTION_LIST /end FUNCTION_LIST /begin REF_CHARACTERISTIC /end REF_CHARACTERISTIC /begin REF_MEASUREMENT FordMsg215BusHiSpd.FordVehMsg215MissTmr /end REF_MEASUREMENT /end GROUP
/begin GROUP FordMsg215BusHiSpd.FordVehMsg215NotRxdRefTi "MICROSAR RTE" /begin SUB_GROUP /end SUB_GROUP /begin FUNCTION_LIST /end FUNCTION_LIST /begin REF_CHARACTERISTIC /end REF_CHARACTERISTIC /begin REF_MEASUREMENT FordMsg215BusHiSpd.FordVehMsg215NotRxdRefTi /end REF_MEASUREMENT /end GROUP
/begin GROUP FordMsg215BusHiSpd.FordVehMsg215RxdRefTi "MICROSAR RTE" /begin SUB_GROUP /end SUB_GROUP /begin FUNCTION_LIST /end FUNCTION_LIST /begin REF_CHARACTERISTIC /end REF_CHARACTERISTIC /begin REF_MEASUREMENT FordMsg215BusHiSpd.FordVehMsg215RxdRefTi /end REF_MEASUREMENT /end GROUP
/begin GROUP FordMsg215BusHiSpd.FordVehMsg215RxdTmr "MICROSAR RTE" /begin SUB_GROUP /end SUB_GROUP /begin FUNCTION_LIST /end FUNCTION_LIST /begin REF_CHARACTERISTIC /end REF_CHARACTERISTIC /begin REF_MEASUREMENT FordMsg215BusHiSpd.FordVehMsg215RxdTmr /end REF_MEASUREMENT /end GROUP
/begin GROUP FordMsg215BusHiSpd.FordVehTrlrAidModReq.Ford_TrlrAidMde_D_Rq "MICROSAR RTE" /begin SUB_GROUP /end SUB_GROUP /begin FUNCTION_LIST /end FUNCTION_LIST /begin REF_CHARACTERISTIC /end REF_CHARACTERISTIC
 /begin REF_MEASUREMENT FordMsg215BusHiSpd.FordVehTrlrAidModReq.Ford_TrlrAidMde_D_Rq /end REF_MEASUREMENT
/end GROUP
/begin GROUP FordMsg215BusHiSpd.FordVehTrlrAidModReqPrev "MICROSAR RTE" /begin SUB_GROUP /end SUB_GROUP /begin FUNCTION_LIST /end FUNCTION_LIST /begin REF_CHARACTERISTIC /end REF_CHARACTERISTIC /begin REF_MEASUREMENT FordMsg215BusHiSpd.FordVehTrlrAidModReqPrev /end REF_MEASUREMENT /end GROUP
/begin GROUP FordMsg215BusHiSpd.FordVehTrlrAidModReqVld.Logl "MICROSAR RTE" /begin SUB_GROUP /end SUB_GROUP /begin FUNCTION_LIST /end FUNCTION_LIST /begin REF_CHARACTERISTIC /end REF_CHARACTERISTIC /begin REF_MEASUREMENT FordMsg215BusHiSpd.FordVehTrlrAidModReqVld.Logl /end REF_MEASUREMENT /end GROUP
/begin GROUP FordMsg215BusHiSpd.FordVehTrlrAidModReqVldPrev "MICROSAR RTE" /begin SUB_GROUP /end SUB_GROUP /begin FUNCTION_LIST /end FUNCTION_LIST /begin REF_CHARACTERISTIC /end REF_CHARACTERISTIC /begin REF_MEASUREMENT FordMsg215BusHiSpd.FordVehTrlrAidModReqVldPrev /end REF_MEASUREMENT /end GROUP
/begin GROUP FordMsg215BusHiSpd.PerInstanceMemories "MICROSAR RTE"
 /begin SUB_GROUP FordMsg215BusHiSpd.ClrDiagcFlgProxyPrev FordMsg215BusHiSpd.FirstTranVldFlg FordMsg215BusHiSpd.FordVehMsg215Miss FordMsg215BusHiSpd.FordVehMsg215MissTmr FordMsg215BusHiSpd.FordVehMsg215NotRxdRefTi FordMsg215BusHiSpd.FordVehMsg215RxdRefTi FordMsg215BusHiSpd.FordVehMsg215RxdTmr FordMsg215BusHiSpd.FordVehTrlrAidModReqPrev FordMsg215BusHiSpd.FordVehTrlrAidModReqVldPrev /end SUB_GROUP
 /begin FUNCTION_LIST /end FUNCTION_LIST
 /begin REF_CHARACTERISTIC /end REF_CHARACTERISTIC
 /begin REF_MEASUREMENT /end REF_MEASUREMENT
/end GROUP
/begin GROUP FordMsg215BusHiSpd.ReceiverPorts "MICROSAR RTE"
 /begin SUB_GROUP FordMsg215BusHiSpd.ClrDiagcFlgProxy.Val FordMsg215BusHiSpd.FordCanDtcInhb.Logl FordMsg215BusHiSpd.FordEpsLifeCycMod.Val FordMsg215BusHiSpd.FordTrlrBackupAssiEnad.Logl /end SUB_GROUP
 /begin FUNCTION_LIST /end FUNCTION_LIST
 /begin REF_CHARACTERISTIC /end REF_CHARACTERISTIC
 /begin REF_MEASUREMENT /end REF_MEASUREMENT
/end GROUP
/begin GROUP FordMsg215BusHiSpd.SenderPorts "MICROSAR RTE"
 /begin SUB_GROUP FordMsg215BusHiSpd.FordVehTrlrAidModReq.Ford_TrlrAidMde_D_Rq FordMsg215BusHiSpd.FordVehTrlrAidModReqVld.Logl /end SUB_GROUP
 /begin FUNCTION_LIST /end FUNCTION_LIST
 /begin REF_CHARACTERISTIC /end REF_CHARACTERISTIC
 /begin REF_MEASUREMENT /end REF_MEASUREMENT
/end GROUP
/begin GROUP FordMsg216BusHiSpd "MICROSAR RTE"
 /begin SUB_GROUP FordMsg216BusHiSpd.CalibrationPorts FordMsg216BusHiSpd.PerInstanceMemories FordMsg216BusHiSpd.ReceiverPorts FordMsg216BusHiSpd.SenderPorts /end SUB_GROUP
 /begin FUNCTION_LIST /end FUNCTION_LIST
 /begin REF_CHARACTERISTIC /end REF_CHARACTERISTIC
 /begin REF_MEASUREMENT /end REF_MEASUREMENT
/end GROUP
/begin GROUP FordMsg216BusHiSpd.CalibrationPorts "MICROSAR RTE"
 /begin SUB_GROUP FordMsg216BusHiSpd.FordMsg216BusHiSpdFrntLeWhlCntrDirFaildTiThd.Val FordMsg216BusHiSpd.FordMsg216BusHiSpdFrntLeWhlCntrDirPassdTiThd.Val FordMsg216BusHiSpd.FordMsg216BusHiSpdFrntLeWhlVldMissMsgThd.Val FordMsg216BusHiSpd.FordMsg216BusHiSpdFrntRiWhlCntrDirFaildTiThd.Val FordMsg216BusHiSpd.FordMsg216BusHiSpdFrntRiWhlCntrDirPassdTiThd.Val FordMsg216BusHiSpd.FordMsg216BusHiSpdFrntRiWhlVldMissMsgThd.Val FordMsg216BusHiSpd.FordMsg216BusHiSpdMissMsgFaildTiThd.Val FordMsg216BusHiSpd.FordMsg216BusHiSpdMissMsgPassdTiThd.Val FordMsg216BusHiSpd.FordMsg216BusHiSpdReLeWhlCntrDirFaildTiThd.Val FordMsg216BusHiSpd.FordMsg216BusHiSpdReLeWhlCntrDirPassdTiThd.Val FordMsg216BusHiSpd.FordMsg216BusHiSpdReLeWhlVldMissMsgThd.Val FordMsg216BusHiSpd.FordMsg216BusHiSpdReRiWhlCntrDirFaildTiThd.Val FordMsg216BusHiSpd.FordMsg216BusHiSpdReRiWhlCntrDirPassdTiThd.Val FordMsg216BusHiSpd.FordMsg216BusHiSpdReRiWhlVldMissMsgThd.Val /end SUB_GROUP
 /begin FUNCTION_LIST /end FUNCTION_LIST
 /begin REF_CHARACTERISTIC /end REF_CHARACTERISTIC
 /begin REF_MEASUREMENT /end REF_MEASUREMENT
/end GROUP
/begin GROUP FordMsg216BusHiSpd.ClrDiagcFlgProxy.Val "MICROSAR RTE" /begin SUB_GROUP /end SUB_GROUP /begin FUNCTION_LIST /end FUNCTION_LIST /begin REF_CHARACTERISTIC /end REF_CHARACTERISTIC /begin REF_MEASUREMENT FordMsg216BusHiSpd.ClrDiagcFlgProxy.Val /end REF_MEASUREMENT /end GROUP
/begin GROUP FordMsg216BusHiSpd.ClrDiagcFlgProxyPrev "MICROSAR RTE" /begin SUB_GROUP /end SUB_GROUP /begin FUNCTION_LIST /end FUNCTION_LIST /begin REF_CHARACTERISTIC /end REF_CHARACTERISTIC /begin REF_MEASUREMENT FordMsg216BusHiSpd.ClrDiagcFlgProxyPrev /end REF_MEASUREMENT /end GROUP
/begin GROUP FordMsg216BusHiSpd.FirstTranVldFlg "MICROSAR RTE" /begin SUB_GROUP /end SUB_GROUP /begin FUNCTION_LIST /end FUNCTION_LIST /begin REF_CHARACTERISTIC /end REF_CHARACTERISTIC /begin REF_MEASUREMENT FordMsg216BusHiSpd.FirstTranVldFlg /end REF_MEASUREMENT /end GROUP
/begin GROUP FordMsg216BusHiSpd.FordBrkOscnRednEnad.Logl "MICROSAR RTE" /begin SUB_GROUP /end SUB_GROUP /begin FUNCTION_LIST /end FUNCTION_LIST /begin REF_CHARACTERISTIC /end REF_CHARACTERISTIC /begin REF_MEASUREMENT FordMsg216BusHiSpd.FordBrkOscnRednEnad.Logl /end REF_MEASUREMENT /end GROUP
/begin GROUP FordMsg216BusHiSpd.FordCanDtcInhb.Logl "MICROSAR RTE" /begin SUB_GROUP /end SUB_GROUP /begin FUNCTION_LIST /end FUNCTION_LIST /begin REF_CHARACTERISTIC /end REF_CHARACTERISTIC /begin REF_MEASUREMENT FordMsg216BusHiSpd.FordCanDtcInhb.Logl /end REF_MEASUREMENT /end GROUP
/begin GROUP FordMsg216BusHiSpd.FordEpsLifeCycMod.Val "MICROSAR RTE" /begin SUB_GROUP /end SUB_GROUP /begin FUNCTION_LIST /end FUNCTION_LIST /begin REF_CHARACTERISTIC /end REF_CHARACTERISTIC /begin REF_MEASUREMENT FordMsg216BusHiSpd.FordEpsLifeCycMod.Val /end REF_MEASUREMENT /end GROUP
/begin GROUP FordMsg216BusHiSpd.FordMsg216BusHiSpdFrntLeWhlCntrDirFaildTiThd.Val "MICROSAR RTE" /begin SUB_GROUP /end SUB_GROUP /begin FUNCTION_LIST /end FUNCTION_LIST
 /begin REF_CHARACTERISTIC FordMsg216BusHiSpd.FordMsg216BusHiSpdFrntLeWhlCntrDirFaildTiThd.Val /end REF_CHARACTERISTIC
 /begin REF_MEASUREMENT /end REF_MEASUREMENT
/end GROUP
/begin GROUP FordMsg216BusHiSpd.FordMsg216BusHiSpdFrntLeWhlCntrDirPassdTiThd.Val "MICROSAR RTE" /begin SUB_GROUP /end SUB_GROUP /begin FUNCTION_LIST /end FUNCTION_LIST
 /begin REF_CHARACTERISTIC FordMsg216BusHiSpd.FordMsg216BusHiSpdFrntLeWhlCntrDirPassdTiThd.Val /end REF_CHARACTERISTIC
 /begin REF_MEASUREMENT /end REF_MEASUREMENT
/end GROUP
/begin GROUP FordMsg216BusHiSpd.FordMsg216BusHiSpdFrntLeWhlVldMissMsgThd.Val "MICROSAR RTE" /begin SUB_GROUP /end SUB_GROUP /begin FUNCTION_LIST /end FUNCTION_LIST
 /begin REF_CHARACTERISTIC FordMsg216BusHiSpd.FordMsg216BusHiSpdFrntLeWhlVldMissMsgThd.Val /end REF_CHARACTERISTIC
 /begin REF_MEASUREMENT /end REF_MEASUREMENT
/end GROUP
/begin GROUP FordMsg216BusHiSpd.FordMsg216BusHiSpdFrntRiWhlCntrDirFaildTiThd.Val "MICROSAR RTE" /begin SUB_GROUP /end SUB_GROUP /begin FUNCTION_LIST /end FUNCTION_LIST
 /begin REF_CHARACTERISTIC FordMsg216BusHiSpd.FordMsg216BusHiSpdFrntRiWhlCntrDirFaildTiThd.Val /end REF_CHARACTERISTIC
 /begin REF_MEASUREMENT /end REF_MEASUREMENT
/end GROUP
/begin GROUP FordMsg216BusHiSpd.FordMsg216BusHiSpdFrntRiWhlCntrDirPassdTiThd.Val "MICROSAR RTE" /begin SUB_GROUP /end SUB_GROUP /begin FUNCTION_LIST /end FUNCTION_LIST
 /begin REF_CHARACTERISTIC FordMsg216BusHiSpd.FordMsg216BusHiSpdFrntRiWhlCntrDirPassdTiThd.Val /end REF_CHARACTERISTIC
 /begin REF_MEASUREMENT /end REF_MEASUREMENT
/end GROUP
/begin GROUP FordMsg216BusHiSpd.FordMsg216BusHiSpdFrntRiWhlVldMissMsgThd.Val "MICROSAR RTE" /begin SUB_GROUP /end SUB_GROUP /begin FUNCTION_LIST /end FUNCTION_LIST
 /begin REF_CHARACTERISTIC FordMsg216BusHiSpd.FordMsg216BusHiSpdFrntRiWhlVldMissMsgThd.Val /end REF_CHARACTERISTIC
 /begin REF_MEASUREMENT /end REF_MEASUREMENT
/end GROUP
/begin GROUP FordMsg216BusHiSpd.FordMsg216BusHiSpdMissMsgFaildTiThd.Val "MICROSAR RTE" /begin SUB_GROUP /end SUB_GROUP /begin FUNCTION_LIST /end FUNCTION_LIST /begin REF_CHARACTERISTIC FordMsg216BusHiSpd.FordMsg216BusHiSpdMissMsgFaildTiThd.Val /end REF_CHARACTERISTIC /begin REF_MEASUREMENT /end REF_MEASUREMENT /end GROUP
/begin GROUP FordMsg216BusHiSpd.FordMsg216BusHiSpdMissMsgPassdTiThd.Val "MICROSAR RTE" /begin SUB_GROUP /end SUB_GROUP /begin FUNCTION_LIST /end FUNCTION_LIST /begin REF_CHARACTERISTIC FordMsg216BusHiSpd.FordMsg216BusHiSpdMissMsgPassdTiThd.Val /end REF_CHARACTERISTIC /begin REF_MEASUREMENT /end REF_MEASUREMENT /end GROUP
/begin GROUP FordMsg216BusHiSpd.FordMsg216BusHiSpdReLeWhlCntrDirFaildTiThd.Val "MICROSAR RTE" /begin SUB_GROUP /end SUB_GROUP /begin FUNCTION_LIST /end FUNCTION_LIST
 /begin REF_CHARACTERISTIC FordMsg216BusHiSpd.FordMsg216BusHiSpdReLeWhlCntrDirFaildTiThd.Val /end REF_CHARACTERISTIC
 /begin REF_MEASUREMENT /end REF_MEASUREMENT
/end GROUP
/begin GROUP FordMsg216BusHiSpd.FordMsg216BusHiSpdReLeWhlCntrDirPassdTiThd.Val "MICROSAR RTE" /begin SUB_GROUP /end SUB_GROUP /begin FUNCTION_LIST /end FUNCTION_LIST
 /begin REF_CHARACTERISTIC FordMsg216BusHiSpd.FordMsg216BusHiSpdReLeWhlCntrDirPassdTiThd.Val /end REF_CHARACTERISTIC
 /begin REF_MEASUREMENT /end REF_MEASUREMENT
/end GROUP
/begin GROUP FordMsg216BusHiSpd.FordMsg216BusHiSpdReLeWhlVldMissMsgThd.Val "MICROSAR RTE" /begin SUB_GROUP /end SUB_GROUP /begin FUNCTION_LIST /end FUNCTION_LIST
 /begin REF_CHARACTERISTIC FordMsg216BusHiSpd.FordMsg216BusHiSpdReLeWhlVldMissMsgThd.Val /end REF_CHARACTERISTIC
 /begin REF_MEASUREMENT /end REF_MEASUREMENT
/end GROUP
/begin GROUP FordMsg216BusHiSpd.FordMsg216BusHiSpdReRiWhlCntrDirFaildTiThd.Val "MICROSAR RTE" /begin SUB_GROUP /end SUB_GROUP /begin FUNCTION_LIST /end FUNCTION_LIST
 /begin REF_CHARACTERISTIC FordMsg216BusHiSpd.FordMsg216BusHiSpdReRiWhlCntrDirFaildTiThd.Val /end REF_CHARACTERISTIC
 /begin REF_MEASUREMENT /end REF_MEASUREMENT
/end GROUP
/begin GROUP FordMsg216BusHiSpd.FordMsg216BusHiSpdReRiWhlCntrDirPassdTiThd.Val "MICROSAR RTE" /begin SUB_GROUP /end SUB_GROUP /begin FUNCTION_LIST /end FUNCTION_LIST
 /begin REF_CHARACTERISTIC FordMsg216BusHiSpd.FordMsg216BusHiSpdReRiWhlCntrDirPassdTiThd.Val /end REF_CHARACTERISTIC
 /begin REF_MEASUREMENT /end REF_MEASUREMENT
/end GROUP
/begin GROUP FordMsg216BusHiSpd.FordMsg216BusHiSpdReRiWhlVldMissMsgThd.Val "MICROSAR RTE" /begin SUB_GROUP /end SUB_GROUP /begin FUNCTION_LIST /end FUNCTION_LIST
 /begin REF_CHARACTERISTIC FordMsg216BusHiSpd.FordMsg216BusHiSpdReRiWhlVldMissMsgThd.Val /end REF_CHARACTERISTIC
 /begin REF_MEASUREMENT /end REF_MEASUREMENT
/end GROUP
/begin GROUP FordMsg216BusHiSpd.FordTqSteerCmpEnad.Logl "MICROSAR RTE" /begin SUB_GROUP /end SUB_GROUP /begin FUNCTION_LIST /end FUNCTION_LIST /begin REF_CHARACTERISTIC /end REF_CHARACTERISTIC /begin REF_MEASUREMENT FordMsg216BusHiSpd.FordTqSteerCmpEnad.Logl /end REF_MEASUREMENT /end GROUP
/begin GROUP FordMsg216BusHiSpd.FordTrlrBackUpAssiEnad.Logl "MICROSAR RTE" /begin SUB_GROUP /end SUB_GROUP /begin FUNCTION_LIST /end FUNCTION_LIST /begin REF_CHARACTERISTIC /end REF_CHARACTERISTIC /begin REF_MEASUREMENT FordMsg216BusHiSpd.FordTrlrBackUpAssiEnad.Logl /end REF_MEASUREMENT /end GROUP
/begin GROUP FordMsg216BusHiSpd.FordVehFrntLeWhlCntrDirVld.Logl "MICROSAR RTE" /begin SUB_GROUP /end SUB_GROUP /begin FUNCTION_LIST /end FUNCTION_LIST /begin REF_CHARACTERISTIC /end REF_CHARACTERISTIC /begin REF_MEASUREMENT FordMsg216BusHiSpd.FordVehFrntLeWhlCntrDirVld.Logl /end REF_MEASUREMENT /end GROUP
/begin GROUP FordMsg216BusHiSpd.FordVehFrntLeWhlCntrDirVldPrev "MICROSAR RTE" /begin SUB_GROUP /end SUB_GROUP /begin FUNCTION_LIST /end FUNCTION_LIST /begin REF_CHARACTERISTIC /end REF_CHARACTERISTIC /begin REF_MEASUREMENT FordMsg216BusHiSpd.FordVehFrntLeWhlCntrDirVldPrev /end REF_MEASUREMENT /end GROUP
/begin GROUP FordMsg216BusHiSpd.FordVehFrntLeWhlDirRawPrev "MICROSAR RTE" /begin SUB_GROUP /end SUB_GROUP /begin FUNCTION_LIST /end FUNCTION_LIST /begin REF_CHARACTERISTIC /end REF_CHARACTERISTIC /begin REF_MEASUREMENT FordMsg216BusHiSpd.FordVehFrntLeWhlDirRawPrev /end REF_MEASUREMENT /end GROUP
/begin GROUP FordMsg216BusHiSpd.FordVehFrntLeWhlRollgCntr.Ford_WhlRotatFl_No_Cnt "MICROSAR RTE" /begin SUB_GROUP /end SUB_GROUP /begin FUNCTION_LIST /end FUNCTION_LIST /begin REF_CHARACTERISTIC /end REF_CHARACTERISTIC
 /begin REF_MEASUREMENT FordMsg216BusHiSpd.FordVehFrntLeWhlRollgCntr.Ford_WhlRotatFl_No_Cnt /end REF_MEASUREMENT
/end GROUP
/begin GROUP FordMsg216BusHiSpd.FordVehFrntLeWhlRollgCntrPrev "MICROSAR RTE" /begin SUB_GROUP /end SUB_GROUP /begin FUNCTION_LIST /end FUNCTION_LIST /begin REF_CHARACTERISTIC /end REF_CHARACTERISTIC /begin REF_MEASUREMENT FordMsg216BusHiSpd.FordVehFrntLeWhlRollgCntrPrev /end REF_MEASUREMENT /end GROUP
/begin GROUP FordMsg216BusHiSpd.FordVehFrntRiWhlCntrDirVld.Logl "MICROSAR RTE" /begin SUB_GROUP /end SUB_GROUP /begin FUNCTION_LIST /end FUNCTION_LIST /begin REF_CHARACTERISTIC /end REF_CHARACTERISTIC /begin REF_MEASUREMENT FordMsg216BusHiSpd.FordVehFrntRiWhlCntrDirVld.Logl /end REF_MEASUREMENT /end GROUP
/begin GROUP FordMsg216BusHiSpd.FordVehFrntRiWhlCntrDirVldPrev "MICROSAR RTE" /begin SUB_GROUP /end SUB_GROUP /begin FUNCTION_LIST /end FUNCTION_LIST /begin REF_CHARACTERISTIC /end REF_CHARACTERISTIC /begin REF_MEASUREMENT FordMsg216BusHiSpd.FordVehFrntRiWhlCntrDirVldPrev /end REF_MEASUREMENT /end GROUP
/begin GROUP FordMsg216BusHiSpd.FordVehFrntRiWhlDirRawPrev "MICROSAR RTE" /begin SUB_GROUP /end SUB_GROUP /begin FUNCTION_LIST /end FUNCTION_LIST /begin REF_CHARACTERISTIC /end REF_CHARACTERISTIC /begin REF_MEASUREMENT FordMsg216BusHiSpd.FordVehFrntRiWhlDirRawPrev /end REF_MEASUREMENT /end GROUP
/begin GROUP FordMsg216BusHiSpd.FordVehFrntRiWhlRollgCntr.Ford_WhlRotatFr_No_Cnt "MICROSAR RTE" /begin SUB_GROUP /end SUB_GROUP /begin FUNCTION_LIST /end FUNCTION_LIST /begin REF_CHARACTERISTIC /end REF_CHARACTERISTIC
 /begin REF_MEASUREMENT FordMsg216BusHiSpd.FordVehFrntRiWhlRollgCntr.Ford_WhlRotatFr_No_Cnt /end REF_MEASUREMENT
/end GROUP
/begin GROUP FordMsg216BusHiSpd.FordVehFrntRiWhlRollgCntrPrev "MICROSAR RTE" /begin SUB_GROUP /end SUB_GROUP /begin FUNCTION_LIST /end FUNCTION_LIST /begin REF_CHARACTERISTIC /end REF_CHARACTERISTIC /begin REF_MEASUREMENT FordMsg216BusHiSpd.FordVehFrntRiWhlRollgCntrPrev /end REF_MEASUREMENT /end GROUP
/begin GROUP FordMsg216BusHiSpd.FordVehMsg064Miss "MICROSAR RTE" /begin SUB_GROUP /end SUB_GROUP /begin FUNCTION_LIST /end FUNCTION_LIST /begin REF_CHARACTERISTIC /end REF_CHARACTERISTIC /begin REF_MEASUREMENT FordMsg216BusHiSpd.FordVehMsg064Miss /end REF_MEASUREMENT /end GROUP
/begin GROUP FordMsg216BusHiSpd.FordVehReLeWhlCntrDirVld.Logl "MICROSAR RTE" /begin SUB_GROUP /end SUB_GROUP /begin FUNCTION_LIST /end FUNCTION_LIST /begin REF_CHARACTERISTIC /end REF_CHARACTERISTIC /begin REF_MEASUREMENT FordMsg216BusHiSpd.FordVehReLeWhlCntrDirVld.Logl /end REF_MEASUREMENT /end GROUP
/begin GROUP FordMsg216BusHiSpd.FordVehReLeWhlCntrDirVldPrev "MICROSAR RTE" /begin SUB_GROUP /end SUB_GROUP /begin FUNCTION_LIST /end FUNCTION_LIST /begin REF_CHARACTERISTIC /end REF_CHARACTERISTIC /begin REF_MEASUREMENT FordMsg216BusHiSpd.FordVehReLeWhlCntrDirVldPrev /end REF_MEASUREMENT /end GROUP
/begin GROUP FordMsg216BusHiSpd.FordVehReLeWhlDirRawPrev "MICROSAR RTE" /begin SUB_GROUP /end SUB_GROUP /begin FUNCTION_LIST /end FUNCTION_LIST /begin REF_CHARACTERISTIC /end REF_CHARACTERISTIC /begin REF_MEASUREMENT FordMsg216BusHiSpd.FordVehReLeWhlDirRawPrev /end REF_MEASUREMENT /end GROUP
/begin GROUP FordMsg216BusHiSpd.FordVehReLeWhlRollgCntr.Ford_WhlRotatRl_No_Cnt "MICROSAR RTE" /begin SUB_GROUP /end SUB_GROUP /begin FUNCTION_LIST /end FUNCTION_LIST /begin REF_CHARACTERISTIC /end REF_CHARACTERISTIC
 /begin REF_MEASUREMENT FordMsg216BusHiSpd.FordVehReLeWhlRollgCntr.Ford_WhlRotatRl_No_Cnt /end REF_MEASUREMENT
/end GROUP
/begin GROUP FordMsg216BusHiSpd.FordVehReLeWhlRollgCntrPrev "MICROSAR RTE" /begin SUB_GROUP /end SUB_GROUP /begin FUNCTION_LIST /end FUNCTION_LIST /begin REF_CHARACTERISTIC /end REF_CHARACTERISTIC /begin REF_MEASUREMENT FordMsg216BusHiSpd.FordVehReLeWhlRollgCntrPrev /end REF_MEASUREMENT /end GROUP
/begin GROUP FordMsg216BusHiSpd.FordVehReRiWhlCntrDirVld.Logl "MICROSAR RTE" /begin SUB_GROUP /end SUB_GROUP /begin FUNCTION_LIST /end FUNCTION_LIST /begin REF_CHARACTERISTIC /end REF_CHARACTERISTIC /begin REF_MEASUREMENT FordMsg216BusHiSpd.FordVehReRiWhlCntrDirVld.Logl /end REF_MEASUREMENT /end GROUP
/begin GROUP FordMsg216BusHiSpd.FordVehReRiWhlCntrDirVldPrev "MICROSAR RTE" /begin SUB_GROUP /end SUB_GROUP /begin FUNCTION_LIST /end FUNCTION_LIST /begin REF_CHARACTERISTIC /end REF_CHARACTERISTIC /begin REF_MEASUREMENT FordMsg216BusHiSpd.FordVehReRiWhlCntrDirVldPrev /end REF_MEASUREMENT /end GROUP
/begin GROUP FordMsg216BusHiSpd.FordVehReRiWhlDirRawPrev "MICROSAR RTE" /begin SUB_GROUP /end SUB_GROUP /begin FUNCTION_LIST /end FUNCTION_LIST /begin REF_CHARACTERISTIC /end REF_CHARACTERISTIC /begin REF_MEASUREMENT FordMsg216BusHiSpd.FordVehReRiWhlDirRawPrev /end REF_MEASUREMENT /end GROUP
/begin GROUP FordMsg216BusHiSpd.FordVehReRiWhlRollgCntr.Ford_WhlRotatRr_No_Cnt "MICROSAR RTE" /begin SUB_GROUP /end SUB_GROUP /begin FUNCTION_LIST /end FUNCTION_LIST /begin REF_CHARACTERISTIC /end REF_CHARACTERISTIC
 /begin REF_MEASUREMENT FordMsg216BusHiSpd.FordVehReRiWhlRollgCntr.Ford_WhlRotatRr_No_Cnt /end REF_MEASUREMENT
/end GROUP
/begin GROUP FordMsg216BusHiSpd.FordVehReRiWhlRollgCntrPrev "MICROSAR RTE" /begin SUB_GROUP /end SUB_GROUP /begin FUNCTION_LIST /end FUNCTION_LIST /begin REF_CHARACTERISTIC /end REF_CHARACTERISTIC /begin REF_MEASUREMENT FordMsg216BusHiSpd.FordVehReRiWhlRollgCntrPrev /end REF_MEASUREMENT /end GROUP
/begin GROUP FordMsg216BusHiSpd.FrntLeWhlCntrDirVldFaildRefTi "MICROSAR RTE" /begin SUB_GROUP /end SUB_GROUP /begin FUNCTION_LIST /end FUNCTION_LIST /begin REF_CHARACTERISTIC /end REF_CHARACTERISTIC /begin REF_MEASUREMENT FordMsg216BusHiSpd.FrntLeWhlCntrDirVldFaildRefTi /end REF_MEASUREMENT /end GROUP
/begin GROUP FordMsg216BusHiSpd.FrntLeWhlCntrDirVldPassdRefTi "MICROSAR RTE" /begin SUB_GROUP /end SUB_GROUP /begin FUNCTION_LIST /end FUNCTION_LIST /begin REF_CHARACTERISTIC /end REF_CHARACTERISTIC /begin REF_MEASUREMENT FordMsg216BusHiSpd.FrntLeWhlCntrDirVldPassdRefTi /end REF_MEASUREMENT /end GROUP
/begin GROUP FordMsg216BusHiSpd.FrntLeWhlVldMissMsgRefTi "MICROSAR RTE" /begin SUB_GROUP /end SUB_GROUP /begin FUNCTION_LIST /end FUNCTION_LIST /begin REF_CHARACTERISTIC /end REF_CHARACTERISTIC /begin REF_MEASUREMENT FordMsg216BusHiSpd.FrntLeWhlVldMissMsgRefTi /end REF_MEASUREMENT /end GROUP
/begin GROUP FordMsg216BusHiSpd.FrntRiWhlCntrDirVldFaildRefTi "MICROSAR RTE" /begin SUB_GROUP /end SUB_GROUP /begin FUNCTION_LIST /end FUNCTION_LIST /begin REF_CHARACTERISTIC /end REF_CHARACTERISTIC /begin REF_MEASUREMENT FordMsg216BusHiSpd.FrntRiWhlCntrDirVldFaildRefTi /end REF_MEASUREMENT /end GROUP
/begin GROUP FordMsg216BusHiSpd.FrntRiWhlCntrDirVldPassdRefTi "MICROSAR RTE" /begin SUB_GROUP /end SUB_GROUP /begin FUNCTION_LIST /end FUNCTION_LIST /begin REF_CHARACTERISTIC /end REF_CHARACTERISTIC /begin REF_MEASUREMENT FordMsg216BusHiSpd.FrntRiWhlCntrDirVldPassdRefTi /end REF_MEASUREMENT /end GROUP
/begin GROUP FordMsg216BusHiSpd.FrntRiWhlVldMissMsgRefTi "MICROSAR RTE" /begin SUB_GROUP /end SUB_GROUP /begin FUNCTION_LIST /end FUNCTION_LIST /begin REF_CHARACTERISTIC /end REF_CHARACTERISTIC /begin REF_MEASUREMENT FordMsg216BusHiSpd.FrntRiWhlVldMissMsgRefTi /end REF_MEASUREMENT /end GROUP
/begin GROUP FordMsg216BusHiSpd.MissMsgFaildRefTi "MICROSAR RTE" /begin SUB_GROUP /end SUB_GROUP /begin FUNCTION_LIST /end FUNCTION_LIST /begin REF_CHARACTERISTIC /end REF_CHARACTERISTIC /begin REF_MEASUREMENT FordMsg216BusHiSpd.MissMsgFaildRefTi /end REF_MEASUREMENT /end GROUP
/begin GROUP FordMsg216BusHiSpd.MissMsgPassdRefTi "MICROSAR RTE" /begin SUB_GROUP /end SUB_GROUP /begin FUNCTION_LIST /end FUNCTION_LIST /begin REF_CHARACTERISTIC /end REF_CHARACTERISTIC /begin REF_MEASUREMENT FordMsg216BusHiSpd.MissMsgPassdRefTi /end REF_MEASUREMENT /end GROUP
/begin GROUP FordMsg216BusHiSpd.PerInstanceMemories "MICROSAR RTE"
 /begin SUB_GROUP FordMsg216BusHiSpd.ClrDiagcFlgProxyPrev FordMsg216BusHiSpd.FirstTranVldFlg FordMsg216BusHiSpd.FordVehFrntLeWhlCntrDirVldPrev FordMsg216BusHiSpd.FordVehFrntLeWhlDirRawPrev FordMsg216BusHiSpd.FordVehFrntLeWhlRollgCntrPrev FordMsg216BusHiSpd.FordVehFrntRiWhlCntrDirVldPrev FordMsg216BusHiSpd.FordVehFrntRiWhlDirRawPrev FordMsg216BusHiSpd.FordVehFrntRiWhlRollgCntrPrev FordMsg216BusHiSpd.FordVehMsg064Miss FordMsg216BusHiSpd.FordVehReLeWhlCntrDirVldPrev FordMsg216BusHiSpd.FordVehReLeWhlDirRawPrev FordMsg216BusHiSpd.FordVehReLeWhlRollgCntrPrev FordMsg216BusHiSpd.FordVehReRiWhlCntrDirVldPrev FordMsg216BusHiSpd.FordVehReRiWhlDirRawPrev FordMsg216BusHiSpd.FordVehReRiWhlRollgCntrPrev FordMsg216BusHiSpd.FrntLeWhlCntrDirVldFaildRefTi FordMsg216BusHiSpd.FrntLeWhlCntrDirVldPassdRefTi FordMsg216BusHiSpd.FrntLeWhlVldMissMsgRefTi FordMsg216BusHiSpd.FrntRiWhlCntrDirVldFaildRefTi FordMsg216BusHiSpd.FrntRiWhlCntrDirVldPassdRefTi FordMsg216BusHiSpd.FrntRiWhlVldMissMsgRefTi FordMsg216BusHiSpd.MissMsgFaildRefTi FordMsg216BusHiSpd.MissMsgPassdRefTi FordMsg216BusHiSpd.ReLeWhlCntrDirVldFaildRefTi FordMsg216BusHiSpd.ReLeWhlCntrDirVldPassdRefTi FordMsg216BusHiSpd.ReLeWhlVldMissMsgRefTi FordMsg216BusHiSpd.ReRiWhlCntrDirVldFaildRefTi FordMsg216BusHiSpd.ReRiWhlCntrDirVldPassdRefTi FordMsg216BusHiSpd.ReRiWhlVldMissMsgRefTi /end SUB_GROUP
 /begin FUNCTION_LIST /end FUNCTION_LIST
 /begin REF_CHARACTERISTIC /end REF_CHARACTERISTIC
 /begin REF_MEASUREMENT /end REF_MEASUREMENT
/end GROUP
/begin GROUP FordMsg216BusHiSpd.ReLeWhlCntrDirVldFaildRefTi "MICROSAR RTE" /begin SUB_GROUP /end SUB_GROUP /begin FUNCTION_LIST /end FUNCTION_LIST /begin REF_CHARACTERISTIC /end REF_CHARACTERISTIC /begin REF_MEASUREMENT FordMsg216BusHiSpd.ReLeWhlCntrDirVldFaildRefTi /end REF_MEASUREMENT /end GROUP
/begin GROUP FordMsg216BusHiSpd.ReLeWhlCntrDirVldPassdRefTi "MICROSAR RTE" /begin SUB_GROUP /end SUB_GROUP /begin FUNCTION_LIST /end FUNCTION_LIST /begin REF_CHARACTERISTIC /end REF_CHARACTERISTIC /begin REF_MEASUREMENT FordMsg216BusHiSpd.ReLeWhlCntrDirVldPassdRefTi /end REF_MEASUREMENT /end GROUP
/begin GROUP FordMsg216BusHiSpd.ReLeWhlVldMissMsgRefTi "MICROSAR RTE" /begin SUB_GROUP /end SUB_GROUP /begin FUNCTION_LIST /end FUNCTION_LIST /begin REF_CHARACTERISTIC /end REF_CHARACTERISTIC /begin REF_MEASUREMENT FordMsg216BusHiSpd.ReLeWhlVldMissMsgRefTi /end REF_MEASUREMENT /end GROUP
/begin GROUP FordMsg216BusHiSpd.ReRiWhlCntrDirVldFaildRefTi "MICROSAR RTE" /begin SUB_GROUP /end SUB_GROUP /begin FUNCTION_LIST /end FUNCTION_LIST /begin REF_CHARACTERISTIC /end REF_CHARACTERISTIC /begin REF_MEASUREMENT FordMsg216BusHiSpd.ReRiWhlCntrDirVldFaildRefTi /end REF_MEASUREMENT /end GROUP
/begin GROUP FordMsg216BusHiSpd.ReRiWhlCntrDirVldPassdRefTi "MICROSAR RTE" /begin SUB_GROUP /end SUB_GROUP /begin FUNCTION_LIST /end FUNCTION_LIST /begin REF_CHARACTERISTIC /end REF_CHARACTERISTIC /begin REF_MEASUREMENT FordMsg216BusHiSpd.ReRiWhlCntrDirVldPassdRefTi /end REF_MEASUREMENT /end GROUP
/begin GROUP FordMsg216BusHiSpd.ReRiWhlVldMissMsgRefTi "MICROSAR RTE" /begin SUB_GROUP /end SUB_GROUP /begin FUNCTION_LIST /end FUNCTION_LIST /begin REF_CHARACTERISTIC /end REF_CHARACTERISTIC /begin REF_MEASUREMENT FordMsg216BusHiSpd.ReRiWhlVldMissMsgRefTi /end REF_MEASUREMENT /end GROUP
/begin GROUP FordMsg216BusHiSpd.ReceiverPorts "MICROSAR RTE"
 /begin SUB_GROUP FordMsg216BusHiSpd.ClrDiagcFlgProxy.Val FordMsg216BusHiSpd.FordBrkOscnRednEnad.Logl FordMsg216BusHiSpd.FordCanDtcInhb.Logl FordMsg216BusHiSpd.FordEpsLifeCycMod.Val FordMsg216BusHiSpd.FordTqSteerCmpEnad.Logl FordMsg216BusHiSpd.FordTrlrBackUpAssiEnad.Logl /end SUB_GROUP
 /begin FUNCTION_LIST /end FUNCTION_LIST
 /begin REF_CHARACTERISTIC /end REF_CHARACTERISTIC
 /begin REF_MEASUREMENT /end REF_MEASUREMENT
/end GROUP
/begin GROUP FordMsg216BusHiSpd.SenderPorts "MICROSAR RTE"
 /begin SUB_GROUP FordMsg216BusHiSpd.FordVehFrntLeWhlCntrDirVld.Logl FordMsg216BusHiSpd.FordVehFrntLeWhlRollgCntr.Ford_WhlRotatFl_No_Cnt FordMsg216BusHiSpd.FordVehFrntRiWhlCntrDirVld.Logl FordMsg216BusHiSpd.FordVehFrntRiWhlRollgCntr.Ford_WhlRotatFr_No_Cnt FordMsg216BusHiSpd.FordVehReLeWhlCntrDirVld.Logl FordMsg216BusHiSpd.FordVehReLeWhlRollgCntr.Ford_WhlRotatRl_No_Cnt FordMsg216BusHiSpd.FordVehReRiWhlCntrDirVld.Logl FordMsg216BusHiSpd.FordVehReRiWhlRollgCntr.Ford_WhlRotatRr_No_Cnt /end SUB_GROUP
 /begin FUNCTION_LIST /end FUNCTION_LIST
 /begin REF_CHARACTERISTIC /end REF_CHARACTERISTIC
 /begin REF_MEASUREMENT /end REF_MEASUREMENT
/end GROUP
/begin GROUP FordMsg217BusHiSpd "MICROSAR RTE"
 /begin SUB_GROUP FordMsg217BusHiSpd.CalibrationPorts FordMsg217BusHiSpd.PerInstanceMemories FordMsg217BusHiSpd.ReceiverPorts FordMsg217BusHiSpd.SenderPorts /end SUB_GROUP
 /begin FUNCTION_LIST /end FUNCTION_LIST
 /begin REF_CHARACTERISTIC /end REF_CHARACTERISTIC
 /begin REF_MEASUREMENT /end REF_MEASUREMENT
/end GROUP
/begin GROUP FordMsg217BusHiSpd.CalibrationPorts "MICROSAR RTE"
 /begin SUB_GROUP FordMsg217BusHiSpd.FordMsg217BusHiSpdFrntLeWhlSpdInvldFaildThd.Val FordMsg217BusHiSpd.FordMsg217BusHiSpdFrntLeWhlSpdInvldPassdThd.Val FordMsg217BusHiSpd.FordMsg217BusHiSpdFrntLeWhlVldFaildThd.Val FordMsg217BusHiSpd.FordMsg217BusHiSpdFrntLeWhlVldMissThd.Val FordMsg217BusHiSpd.FordMsg217BusHiSpdFrntLeWhlVldPassdThd.Val FordMsg217BusHiSpd.FordMsg217BusHiSpdFrntRiWhlSpdInvldFaildThd.Val FordMsg217BusHiSpd.FordMsg217BusHiSpdFrntRiWhlSpdInvldPassdThd.Val FordMsg217BusHiSpd.FordMsg217BusHiSpdFrntRiWhlVldFaildThd.Val FordMsg217BusHiSpd.FordMsg217BusHiSpdFrntRiWhlVldMissThd.Val FordMsg217BusHiSpd.FordMsg217BusHiSpdFrntRiWhlVldPassdThd.Val FordMsg217BusHiSpd.FordMsg217BusHiSpdMissMsgFaildThd.Val FordMsg217BusHiSpd.FordMsg217BusHiSpdMissMsgPassdThd.Val FordMsg217BusHiSpd.FordMsg217BusHiSpdReLeWhlSpdInvldFaildThd.Val FordMsg217BusHiSpd.FordMsg217BusHiSpdReLeWhlSpdInvldPassdThd.Val FordMsg217BusHiSpd.FordMsg217BusHiSpdReLeWhlVldFaildThd.Val FordMsg217BusHiSpd.FordMsg217BusHiSpdReLeWhlVldMissThd.Val FordMsg217BusHiSpd.FordMsg217BusHiSpdReLeWhlVldPassdThd.Val FordMsg217BusHiSpd.FordMsg217BusHiSpdReRiWhlSpdInvldFaildThd.Val FordMsg217BusHiSpd.FordMsg217BusHiSpdReRiWhlSpdInvldPassdThd.Val FordMsg217BusHiSpd.FordMsg217BusHiSpdReRiWhlVldFaildThd.Val FordMsg217BusHiSpd.FordMsg217BusHiSpdReRiWhlVldMissThd.Val FordMsg217BusHiSpd.FordMsg217BusHiSpdReRiWhlVldPassdThd.Val /end SUB_GROUP
 /begin FUNCTION_LIST /end FUNCTION_LIST
 /begin REF_CHARACTERISTIC /end REF_CHARACTERISTIC
 /begin REF_MEASUREMENT /end REF_MEASUREMENT
/end GROUP
/begin GROUP FordMsg217BusHiSpd.ClrDiagcFlgProxy.Val "MICROSAR RTE" /begin SUB_GROUP /end SUB_GROUP /begin FUNCTION_LIST /end FUNCTION_LIST /begin REF_CHARACTERISTIC /end REF_CHARACTERISTIC /begin REF_MEASUREMENT FordMsg217BusHiSpd.ClrDiagcFlgProxy.Val /end REF_MEASUREMENT /end GROUP
/begin GROUP FordMsg217BusHiSpd.ClrDiagcFlgProxyPrev "MICROSAR RTE" /begin SUB_GROUP /end SUB_GROUP /begin FUNCTION_LIST /end FUNCTION_LIST /begin REF_CHARACTERISTIC /end REF_CHARACTERISTIC /begin REF_MEASUREMENT FordMsg217BusHiSpd.ClrDiagcFlgProxyPrev /end REF_MEASUREMENT /end GROUP
/begin GROUP FordMsg217BusHiSpd.FordAbsPrsnt.Logl "MICROSAR RTE" /begin SUB_GROUP /end SUB_GROUP /begin FUNCTION_LIST /end FUNCTION_LIST /begin REF_CHARACTERISTIC /end REF_CHARACTERISTIC /begin REF_MEASUREMENT FordMsg217BusHiSpd.FordAbsPrsnt.Logl /end REF_MEASUREMENT /end GROUP
/begin GROUP FordMsg217BusHiSpd.FordActvNiblCtrlEnad.Logl "MICROSAR RTE" /begin SUB_GROUP /end SUB_GROUP /begin FUNCTION_LIST /end FUNCTION_LIST /begin REF_CHARACTERISTIC /end REF_CHARACTERISTIC /begin REF_MEASUREMENT FordMsg217BusHiSpd.FordActvNiblCtrlEnad.Logl /end REF_MEASUREMENT /end GROUP
/begin GROUP FordMsg217BusHiSpd.FordBrkOscnRednEnad.Logl "MICROSAR RTE" /begin SUB_GROUP /end SUB_GROUP /begin FUNCTION_LIST /end FUNCTION_LIST /begin REF_CHARACTERISTIC /end REF_CHARACTERISTIC /begin REF_MEASUREMENT FordMsg217BusHiSpd.FordBrkOscnRednEnad.Logl /end REF_MEASUREMENT /end GROUP
/begin GROUP FordMsg217BusHiSpd.FordCanDtcInhb.Val "MICROSAR RTE" /begin SUB_GROUP /end SUB_GROUP /begin FUNCTION_LIST /end FUNCTION_LIST /begin REF_CHARACTERISTIC /end REF_CHARACTERISTIC /begin REF_MEASUREMENT FordMsg217BusHiSpd.FordCanDtcInhb.Val /end REF_MEASUREMENT /end GROUP
/begin GROUP FordMsg217BusHiSpd.FordEpsLifeCycMod.Val "MICROSAR RTE" /begin SUB_GROUP /end SUB_GROUP /begin FUNCTION_LIST /end FUNCTION_LIST /begin REF_CHARACTERISTIC /end REF_CHARACTERISTIC /begin REF_MEASUREMENT FordMsg217BusHiSpd.FordEpsLifeCycMod.Val /end REF_MEASUREMENT /end GROUP
/begin GROUP FordMsg217BusHiSpd.FordInvldMsgDiagcInhb.Val "MICROSAR RTE" /begin SUB_GROUP /end SUB_GROUP /begin FUNCTION_LIST /end FUNCTION_LIST /begin REF_CHARACTERISTIC /end REF_CHARACTERISTIC /begin REF_MEASUREMENT FordMsg217BusHiSpd.FordInvldMsgDiagcInhb.Val /end REF_MEASUREMENT /end GROUP
/begin GROUP FordMsg217BusHiSpd.FordMfgDiagcInhb.Val "MICROSAR RTE" /begin SUB_GROUP /end SUB_GROUP /begin FUNCTION_LIST /end FUNCTION_LIST /begin REF_CHARACTERISTIC /end REF_CHARACTERISTIC /begin REF_MEASUREMENT FordMsg217BusHiSpd.FordMfgDiagcInhb.Val /end REF_MEASUREMENT /end GROUP
/begin GROUP FordMsg217BusHiSpd.FordMissMsgDiagcInhb.Val "MICROSAR RTE" /begin SUB_GROUP /end SUB_GROUP /begin FUNCTION_LIST /end FUNCTION_LIST /begin REF_CHARACTERISTIC /end REF_CHARACTERISTIC /begin REF_MEASUREMENT FordMsg217BusHiSpd.FordMissMsgDiagcInhb.Val /end REF_MEASUREMENT /end GROUP
/begin GROUP FordMsg217BusHiSpd.FordMsg217BusHiSpdFrntLeWhlSpdInvldFaildThd.Val "MICROSAR RTE" /begin SUB_GROUP /end SUB_GROUP /begin FUNCTION_LIST /end FUNCTION_LIST
 /begin REF_CHARACTERISTIC FordMsg217BusHiSpd.FordMsg217BusHiSpdFrntLeWhlSpdInvldFaildThd.Val /end REF_CHARACTERISTIC
 /begin REF_MEASUREMENT /end REF_MEASUREMENT
/end GROUP
/begin GROUP FordMsg217BusHiSpd.FordMsg217BusHiSpdFrntLeWhlSpdInvldPassdThd.Val "MICROSAR RTE" /begin SUB_GROUP /end SUB_GROUP /begin FUNCTION_LIST /end FUNCTION_LIST
 /begin REF_CHARACTERISTIC FordMsg217BusHiSpd.FordMsg217BusHiSpdFrntLeWhlSpdInvldPassdThd.Val /end REF_CHARACTERISTIC
 /begin REF_MEASUREMENT /end REF_MEASUREMENT
/end GROUP
/begin GROUP FordMsg217BusHiSpd.FordMsg217BusHiSpdFrntLeWhlVldFaildThd.Val "MICROSAR RTE" /begin SUB_GROUP /end SUB_GROUP /begin FUNCTION_LIST /end FUNCTION_LIST
 /begin REF_CHARACTERISTIC FordMsg217BusHiSpd.FordMsg217BusHiSpdFrntLeWhlVldFaildThd.Val /end REF_CHARACTERISTIC
 /begin REF_MEASUREMENT /end REF_MEASUREMENT
/end GROUP
/begin GROUP FordMsg217BusHiSpd.FordMsg217BusHiSpdFrntLeWhlVldMissThd.Val "MICROSAR RTE" /begin SUB_GROUP /end SUB_GROUP /begin FUNCTION_LIST /end FUNCTION_LIST
 /begin REF_CHARACTERISTIC FordMsg217BusHiSpd.FordMsg217BusHiSpdFrntLeWhlVldMissThd.Val /end REF_CHARACTERISTIC
 /begin REF_MEASUREMENT /end REF_MEASUREMENT
/end GROUP
/begin GROUP FordMsg217BusHiSpd.FordMsg217BusHiSpdFrntLeWhlVldPassdThd.Val "MICROSAR RTE" /begin SUB_GROUP /end SUB_GROUP /begin FUNCTION_LIST /end FUNCTION_LIST
 /begin REF_CHARACTERISTIC FordMsg217BusHiSpd.FordMsg217BusHiSpdFrntLeWhlVldPassdThd.Val /end REF_CHARACTERISTIC
 /begin REF_MEASUREMENT /end REF_MEASUREMENT
/end GROUP
/begin GROUP FordMsg217BusHiSpd.FordMsg217BusHiSpdFrntRiWhlSpdInvldFaildThd.Val "MICROSAR RTE" /begin SUB_GROUP /end SUB_GROUP /begin FUNCTION_LIST /end FUNCTION_LIST
 /begin REF_CHARACTERISTIC FordMsg217BusHiSpd.FordMsg217BusHiSpdFrntRiWhlSpdInvldFaildThd.Val /end REF_CHARACTERISTIC
 /begin REF_MEASUREMENT /end REF_MEASUREMENT
/end GROUP
/begin GROUP FordMsg217BusHiSpd.FordMsg217BusHiSpdFrntRiWhlSpdInvldPassdThd.Val "MICROSAR RTE" /begin SUB_GROUP /end SUB_GROUP /begin FUNCTION_LIST /end FUNCTION_LIST
 /begin REF_CHARACTERISTIC FordMsg217BusHiSpd.FordMsg217BusHiSpdFrntRiWhlSpdInvldPassdThd.Val /end REF_CHARACTERISTIC
 /begin REF_MEASUREMENT /end REF_MEASUREMENT
/end GROUP
/begin GROUP FordMsg217BusHiSpd.FordMsg217BusHiSpdFrntRiWhlVldFaildThd.Val "MICROSAR RTE" /begin SUB_GROUP /end SUB_GROUP /begin FUNCTION_LIST /end FUNCTION_LIST
 /begin REF_CHARACTERISTIC FordMsg217BusHiSpd.FordMsg217BusHiSpdFrntRiWhlVldFaildThd.Val /end REF_CHARACTERISTIC
 /begin REF_MEASUREMENT /end REF_MEASUREMENT
/end GROUP
/begin GROUP FordMsg217BusHiSpd.FordMsg217BusHiSpdFrntRiWhlVldMissThd.Val "MICROSAR RTE" /begin SUB_GROUP /end SUB_GROUP /begin FUNCTION_LIST /end FUNCTION_LIST
 /begin REF_CHARACTERISTIC FordMsg217BusHiSpd.FordMsg217BusHiSpdFrntRiWhlVldMissThd.Val /end REF_CHARACTERISTIC
 /begin REF_MEASUREMENT /end REF_MEASUREMENT
/end GROUP
/begin GROUP FordMsg217BusHiSpd.FordMsg217BusHiSpdFrntRiWhlVldPassdThd.Val "MICROSAR RTE" /begin SUB_GROUP /end SUB_GROUP /begin FUNCTION_LIST /end FUNCTION_LIST
 /begin REF_CHARACTERISTIC FordMsg217BusHiSpd.FordMsg217BusHiSpdFrntRiWhlVldPassdThd.Val /end REF_CHARACTERISTIC
 /begin REF_MEASUREMENT /end REF_MEASUREMENT
/end GROUP
/begin GROUP FordMsg217BusHiSpd.FordMsg217BusHiSpdMissMsgFaildThd.Val "MICROSAR RTE" /begin SUB_GROUP /end SUB_GROUP /begin FUNCTION_LIST /end FUNCTION_LIST /begin REF_CHARACTERISTIC FordMsg217BusHiSpd.FordMsg217BusHiSpdMissMsgFaildThd.Val /end REF_CHARACTERISTIC /begin REF_MEASUREMENT /end REF_MEASUREMENT /end GROUP
/begin GROUP FordMsg217BusHiSpd.FordMsg217BusHiSpdMissMsgPassdThd.Val "MICROSAR RTE" /begin SUB_GROUP /end SUB_GROUP /begin FUNCTION_LIST /end FUNCTION_LIST /begin REF_CHARACTERISTIC FordMsg217BusHiSpd.FordMsg217BusHiSpdMissMsgPassdThd.Val /end REF_CHARACTERISTIC /begin REF_MEASUREMENT /end REF_MEASUREMENT /end GROUP
/begin GROUP FordMsg217BusHiSpd.FordMsg217BusHiSpdReLeWhlSpdInvldFaildThd.Val "MICROSAR RTE" /begin SUB_GROUP /end SUB_GROUP /begin FUNCTION_LIST /end FUNCTION_LIST
 /begin REF_CHARACTERISTIC FordMsg217BusHiSpd.FordMsg217BusHiSpdReLeWhlSpdInvldFaildThd.Val /end REF_CHARACTERISTIC
 /begin REF_MEASUREMENT /end REF_MEASUREMENT
/end GROUP
/begin GROUP FordMsg217BusHiSpd.FordMsg217BusHiSpdReLeWhlSpdInvldPassdThd.Val "MICROSAR RTE" /begin SUB_GROUP /end SUB_GROUP /begin FUNCTION_LIST /end FUNCTION_LIST
 /begin REF_CHARACTERISTIC FordMsg217BusHiSpd.FordMsg217BusHiSpdReLeWhlSpdInvldPassdThd.Val /end REF_CHARACTERISTIC
 /begin REF_MEASUREMENT /end REF_MEASUREMENT
/end GROUP
/begin GROUP FordMsg217BusHiSpd.FordMsg217BusHiSpdReLeWhlVldFaildThd.Val "MICROSAR RTE" /begin SUB_GROUP /end SUB_GROUP /begin FUNCTION_LIST /end FUNCTION_LIST
 /begin REF_CHARACTERISTIC FordMsg217BusHiSpd.FordMsg217BusHiSpdReLeWhlVldFaildThd.Val /end REF_CHARACTERISTIC
 /begin REF_MEASUREMENT /end REF_MEASUREMENT
/end GROUP
/begin GROUP FordMsg217BusHiSpd.FordMsg217BusHiSpdReLeWhlVldMissThd.Val "MICROSAR RTE" /begin SUB_GROUP /end SUB_GROUP /begin FUNCTION_LIST /end FUNCTION_LIST /begin REF_CHARACTERISTIC FordMsg217BusHiSpd.FordMsg217BusHiSpdReLeWhlVldMissThd.Val /end REF_CHARACTERISTIC /begin REF_MEASUREMENT /end REF_MEASUREMENT /end GROUP
/begin GROUP FordMsg217BusHiSpd.FordMsg217BusHiSpdReLeWhlVldPassdThd.Val "MICROSAR RTE" /begin SUB_GROUP /end SUB_GROUP /begin FUNCTION_LIST /end FUNCTION_LIST
 /begin REF_CHARACTERISTIC FordMsg217BusHiSpd.FordMsg217BusHiSpdReLeWhlVldPassdThd.Val /end REF_CHARACTERISTIC
 /begin REF_MEASUREMENT /end REF_MEASUREMENT
/end GROUP
/begin GROUP FordMsg217BusHiSpd.FordMsg217BusHiSpdReRiWhlSpdInvldFaildThd.Val "MICROSAR RTE" /begin SUB_GROUP /end SUB_GROUP /begin FUNCTION_LIST /end FUNCTION_LIST
 /begin REF_CHARACTERISTIC FordMsg217BusHiSpd.FordMsg217BusHiSpdReRiWhlSpdInvldFaildThd.Val /end REF_CHARACTERISTIC
 /begin REF_MEASUREMENT /end REF_MEASUREMENT
/end GROUP
/begin GROUP FordMsg217BusHiSpd.FordMsg217BusHiSpdReRiWhlSpdInvldPassdThd.Val "MICROSAR RTE" /begin SUB_GROUP /end SUB_GROUP /begin FUNCTION_LIST /end FUNCTION_LIST
 /begin REF_CHARACTERISTIC FordMsg217BusHiSpd.FordMsg217BusHiSpdReRiWhlSpdInvldPassdThd.Val /end REF_CHARACTERISTIC
 /begin REF_MEASUREMENT /end REF_MEASUREMENT
/end GROUP
/begin GROUP FordMsg217BusHiSpd.FordMsg217BusHiSpdReRiWhlVldFaildThd.Val "MICROSAR RTE" /begin SUB_GROUP /end SUB_GROUP /begin FUNCTION_LIST /end FUNCTION_LIST
 /begin REF_CHARACTERISTIC FordMsg217BusHiSpd.FordMsg217BusHiSpdReRiWhlVldFaildThd.Val /end REF_CHARACTERISTIC
 /begin REF_MEASUREMENT /end REF_MEASUREMENT
/end GROUP
/begin GROUP FordMsg217BusHiSpd.FordMsg217BusHiSpdReRiWhlVldMissThd.Val "MICROSAR RTE" /begin SUB_GROUP /end SUB_GROUP /begin FUNCTION_LIST /end FUNCTION_LIST /begin REF_CHARACTERISTIC FordMsg217BusHiSpd.FordMsg217BusHiSpdReRiWhlVldMissThd.Val /end REF_CHARACTERISTIC /begin REF_MEASUREMENT /end REF_MEASUREMENT /end GROUP
/begin GROUP FordMsg217BusHiSpd.FordMsg217BusHiSpdReRiWhlVldPassdThd.Val "MICROSAR RTE" /begin SUB_GROUP /end SUB_GROUP /begin FUNCTION_LIST /end FUNCTION_LIST
 /begin REF_CHARACTERISTIC FordMsg217BusHiSpd.FordMsg217BusHiSpdReRiWhlVldPassdThd.Val /end REF_CHARACTERISTIC
 /begin REF_MEASUREMENT /end REF_MEASUREMENT
/end GROUP
/begin GROUP FordMsg217BusHiSpd.FordTqSteerCmpEnad.Logl "MICROSAR RTE" /begin SUB_GROUP /end SUB_GROUP /begin FUNCTION_LIST /end FUNCTION_LIST /begin REF_CHARACTERISTIC /end REF_CHARACTERISTIC /begin REF_MEASUREMENT FordMsg217BusHiSpd.FordTqSteerCmpEnad.Logl /end REF_MEASUREMENT /end GROUP
/begin GROUP FordMsg217BusHiSpd.FordTrlrBackupAssiEnad.Logl "MICROSAR RTE" /begin SUB_GROUP /end SUB_GROUP /begin FUNCTION_LIST /end FUNCTION_LIST /begin REF_CHARACTERISTIC /end REF_CHARACTERISTIC /begin REF_MEASUREMENT FordMsg217BusHiSpd.FordTrlrBackupAssiEnad.Logl /end REF_MEASUREMENT /end GROUP
/begin GROUP FordMsg217BusHiSpd.FordVehFrntLeWhlSpd.Val "MICROSAR RTE" /begin SUB_GROUP /end SUB_GROUP /begin FUNCTION_LIST /end FUNCTION_LIST /begin REF_CHARACTERISTIC /end REF_CHARACTERISTIC /begin REF_MEASUREMENT FordMsg217BusHiSpd.FordVehFrntLeWhlSpd.Val /end REF_MEASUREMENT /end GROUP
/begin GROUP FordMsg217BusHiSpd.FordVehFrntLeWhlSpdInvldFaildRefTi "MICROSAR RTE" /begin SUB_GROUP /end SUB_GROUP /begin FUNCTION_LIST /end FUNCTION_LIST /begin REF_CHARACTERISTIC /end REF_CHARACTERISTIC /begin REF_MEASUREMENT FordMsg217BusHiSpd.FordVehFrntLeWhlSpdInvldFaildRefTi /end REF_MEASUREMENT /end GROUP
/begin GROUP FordMsg217BusHiSpd.FordVehFrntLeWhlSpdInvldPassdRefTi "MICROSAR RTE" /begin SUB_GROUP /end SUB_GROUP /begin FUNCTION_LIST /end FUNCTION_LIST /begin REF_CHARACTERISTIC /end REF_CHARACTERISTIC /begin REF_MEASUREMENT FordMsg217BusHiSpd.FordVehFrntLeWhlSpdInvldPassdRefTi /end REF_MEASUREMENT /end GROUP
/begin GROUP FordMsg217BusHiSpd.FordVehFrntLeWhlSpdPrev "MICROSAR RTE" /begin SUB_GROUP /end SUB_GROUP /begin FUNCTION_LIST /end FUNCTION_LIST /begin REF_CHARACTERISTIC /end REF_CHARACTERISTIC /begin REF_MEASUREMENT FordMsg217BusHiSpd.FordVehFrntLeWhlSpdPrev /end REF_MEASUREMENT /end GROUP
/begin GROUP FordMsg217BusHiSpd.FordVehFrntLeWhlSpdRaw.Val "MICROSAR RTE" /begin SUB_GROUP /end SUB_GROUP /begin FUNCTION_LIST /end FUNCTION_LIST /begin REF_CHARACTERISTIC /end REF_CHARACTERISTIC /begin REF_MEASUREMENT FordMsg217BusHiSpd.FordVehFrntLeWhlSpdRaw.Val /end REF_MEASUREMENT /end GROUP
/begin GROUP FordMsg217BusHiSpd.FordVehFrntLeWhlSpdRawPrev "MICROSAR RTE" /begin SUB_GROUP /end SUB_GROUP /begin FUNCTION_LIST /end FUNCTION_LIST /begin REF_CHARACTERISTIC /end REF_CHARACTERISTIC /begin REF_MEASUREMENT FordMsg217BusHiSpd.FordVehFrntLeWhlSpdRawPrev /end REF_MEASUREMENT /end GROUP
/begin GROUP FordMsg217BusHiSpd.FordVehFrntLeWhlSpdVld.Logl "MICROSAR RTE" /begin SUB_GROUP /end SUB_GROUP /begin FUNCTION_LIST /end FUNCTION_LIST /begin REF_CHARACTERISTIC /end REF_CHARACTERISTIC /begin REF_MEASUREMENT FordMsg217BusHiSpd.FordVehFrntLeWhlSpdVld.Logl /end REF_MEASUREMENT /end GROUP
/begin GROUP FordMsg217BusHiSpd.FordVehFrntLeWhlSpdVldFaildRefTi "MICROSAR RTE" /begin SUB_GROUP /end SUB_GROUP /begin FUNCTION_LIST /end FUNCTION_LIST /begin REF_CHARACTERISTIC /end REF_CHARACTERISTIC /begin REF_MEASUREMENT FordMsg217BusHiSpd.FordVehFrntLeWhlSpdVldFaildRefTi /end REF_MEASUREMENT /end GROUP
/begin GROUP FordMsg217BusHiSpd.FordVehFrntLeWhlSpdVldMissRefTi "MICROSAR RTE" /begin SUB_GROUP /end SUB_GROUP /begin FUNCTION_LIST /end FUNCTION_LIST /begin REF_CHARACTERISTIC /end REF_CHARACTERISTIC /begin REF_MEASUREMENT FordMsg217BusHiSpd.FordVehFrntLeWhlSpdVldMissRefTi /end REF_MEASUREMENT /end GROUP
/begin GROUP FordMsg217BusHiSpd.FordVehFrntLeWhlSpdVldPassdRefTi "MICROSAR RTE" /begin SUB_GROUP /end SUB_GROUP /begin FUNCTION_LIST /end FUNCTION_LIST /begin REF_CHARACTERISTIC /end REF_CHARACTERISTIC /begin REF_MEASUREMENT FordMsg217BusHiSpd.FordVehFrntLeWhlSpdVldPassdRefTi /end REF_MEASUREMENT /end GROUP
/begin GROUP FordMsg217BusHiSpd.FordVehFrntLeWhlSpdVldPrev "MICROSAR RTE" /begin SUB_GROUP /end SUB_GROUP /begin FUNCTION_LIST /end FUNCTION_LIST /begin REF_CHARACTERISTIC /end REF_CHARACTERISTIC /begin REF_MEASUREMENT FordMsg217BusHiSpd.FordVehFrntLeWhlSpdVldPrev /end REF_MEASUREMENT /end GROUP
/begin GROUP FordMsg217BusHiSpd.FordVehFrntRiWhlSpd.Val "MICROSAR RTE" /begin SUB_GROUP /end SUB_GROUP /begin FUNCTION_LIST /end FUNCTION_LIST /begin REF_CHARACTERISTIC /end REF_CHARACTERISTIC /begin REF_MEASUREMENT FordMsg217BusHiSpd.FordVehFrntRiWhlSpd.Val /end REF_MEASUREMENT /end GROUP
/begin GROUP FordMsg217BusHiSpd.FordVehFrntRiWhlSpdInvldFaildRefTi "MICROSAR RTE" /begin SUB_GROUP /end SUB_GROUP /begin FUNCTION_LIST /end FUNCTION_LIST /begin REF_CHARACTERISTIC /end REF_CHARACTERISTIC /begin REF_MEASUREMENT FordMsg217BusHiSpd.FordVehFrntRiWhlSpdInvldFaildRefTi /end REF_MEASUREMENT /end GROUP
/begin GROUP FordMsg217BusHiSpd.FordVehFrntRiWhlSpdInvldPassdRefTi "MICROSAR RTE" /begin SUB_GROUP /end SUB_GROUP /begin FUNCTION_LIST /end FUNCTION_LIST /begin REF_CHARACTERISTIC /end REF_CHARACTERISTIC /begin REF_MEASUREMENT FordMsg217BusHiSpd.FordVehFrntRiWhlSpdInvldPassdRefTi /end REF_MEASUREMENT /end GROUP
/begin GROUP FordMsg217BusHiSpd.FordVehFrntRiWhlSpdPrev "MICROSAR RTE" /begin SUB_GROUP /end SUB_GROUP /begin FUNCTION_LIST /end FUNCTION_LIST /begin REF_CHARACTERISTIC /end REF_CHARACTERISTIC /begin REF_MEASUREMENT FordMsg217BusHiSpd.FordVehFrntRiWhlSpdPrev /end REF_MEASUREMENT /end GROUP
/begin GROUP FordMsg217BusHiSpd.FordVehFrntRiWhlSpdRaw.Val "MICROSAR RTE" /begin SUB_GROUP /end SUB_GROUP /begin FUNCTION_LIST /end FUNCTION_LIST /begin REF_CHARACTERISTIC /end REF_CHARACTERISTIC /begin REF_MEASUREMENT FordMsg217BusHiSpd.FordVehFrntRiWhlSpdRaw.Val /end REF_MEASUREMENT /end GROUP
/begin GROUP FordMsg217BusHiSpd.FordVehFrntRiWhlSpdRawPrev "MICROSAR RTE" /begin SUB_GROUP /end SUB_GROUP /begin FUNCTION_LIST /end FUNCTION_LIST /begin REF_CHARACTERISTIC /end REF_CHARACTERISTIC /begin REF_MEASUREMENT FordMsg217BusHiSpd.FordVehFrntRiWhlSpdRawPrev /end REF_MEASUREMENT /end GROUP
/begin GROUP FordMsg217BusHiSpd.FordVehFrntRiWhlSpdVld.Logl "MICROSAR RTE" /begin SUB_GROUP /end SUB_GROUP /begin FUNCTION_LIST /end FUNCTION_LIST /begin REF_CHARACTERISTIC /end REF_CHARACTERISTIC /begin REF_MEASUREMENT FordMsg217BusHiSpd.FordVehFrntRiWhlSpdVld.Logl /end REF_MEASUREMENT /end GROUP
/begin GROUP FordMsg217BusHiSpd.FordVehFrntRiWhlSpdVldFaildRefTi "MICROSAR RTE" /begin SUB_GROUP /end SUB_GROUP /begin FUNCTION_LIST /end FUNCTION_LIST /begin REF_CHARACTERISTIC /end REF_CHARACTERISTIC /begin REF_MEASUREMENT FordMsg217BusHiSpd.FordVehFrntRiWhlSpdVldFaildRefTi /end REF_MEASUREMENT /end GROUP
/begin GROUP FordMsg217BusHiSpd.FordVehFrntRiWhlSpdVldMissRefTi "MICROSAR RTE" /begin SUB_GROUP /end SUB_GROUP /begin FUNCTION_LIST /end FUNCTION_LIST /begin REF_CHARACTERISTIC /end REF_CHARACTERISTIC /begin REF_MEASUREMENT FordMsg217BusHiSpd.FordVehFrntRiWhlSpdVldMissRefTi /end REF_MEASUREMENT /end GROUP
/begin GROUP FordMsg217BusHiSpd.FordVehFrntRiWhlSpdVldPassdRefTi "MICROSAR RTE" /begin SUB_GROUP /end SUB_GROUP /begin FUNCTION_LIST /end FUNCTION_LIST /begin REF_CHARACTERISTIC /end REF_CHARACTERISTIC /begin REF_MEASUREMENT FordMsg217BusHiSpd.FordVehFrntRiWhlSpdVldPassdRefTi /end REF_MEASUREMENT /end GROUP
/begin GROUP FordMsg217BusHiSpd.FordVehFrntRiWhlSpdVldPrev "MICROSAR RTE" /begin SUB_GROUP /end SUB_GROUP /begin FUNCTION_LIST /end FUNCTION_LIST /begin REF_CHARACTERISTIC /end REF_CHARACTERISTIC /begin REF_MEASUREMENT FordMsg217BusHiSpd.FordVehFrntRiWhlSpdVldPrev /end REF_MEASUREMENT /end GROUP
/begin GROUP FordMsg217BusHiSpd.FordVehMsg217Miss "MICROSAR RTE" /begin SUB_GROUP /end SUB_GROUP /begin FUNCTION_LIST /end FUNCTION_LIST /begin REF_CHARACTERISTIC /end REF_CHARACTERISTIC /begin REF_MEASUREMENT FordMsg217BusHiSpd.FordVehMsg217Miss /end REF_MEASUREMENT /end GROUP
/begin GROUP FordMsg217BusHiSpd.FordVehMsg217Rxd "MICROSAR RTE" /begin SUB_GROUP /end SUB_GROUP /begin FUNCTION_LIST /end FUNCTION_LIST /begin REF_CHARACTERISTIC /end REF_CHARACTERISTIC /begin REF_MEASUREMENT FordMsg217BusHiSpd.FordVehMsg217Rxd /end REF_MEASUREMENT /end GROUP
/begin GROUP FordMsg217BusHiSpd.FordVehReLeWhlSpd.Val "MICROSAR RTE" /begin SUB_GROUP /end SUB_GROUP /begin FUNCTION_LIST /end FUNCTION_LIST /begin REF_CHARACTERISTIC /end REF_CHARACTERISTIC /begin REF_MEASUREMENT FordMsg217BusHiSpd.FordVehReLeWhlSpd.Val /end REF_MEASUREMENT /end GROUP
/begin GROUP FordMsg217BusHiSpd.FordVehReLeWhlSpdInvldFaildRefTi "MICROSAR RTE" /begin SUB_GROUP /end SUB_GROUP /begin FUNCTION_LIST /end FUNCTION_LIST /begin REF_CHARACTERISTIC /end REF_CHARACTERISTIC /begin REF_MEASUREMENT FordMsg217BusHiSpd.FordVehReLeWhlSpdInvldFaildRefTi /end REF_MEASUREMENT /end GROUP
/begin GROUP FordMsg217BusHiSpd.FordVehReLeWhlSpdInvldPassdRefTi "MICROSAR RTE" /begin SUB_GROUP /end SUB_GROUP /begin FUNCTION_LIST /end FUNCTION_LIST /begin REF_CHARACTERISTIC /end REF_CHARACTERISTIC /begin REF_MEASUREMENT FordMsg217BusHiSpd.FordVehReLeWhlSpdInvldPassdRefTi /end REF_MEASUREMENT /end GROUP
/begin GROUP FordMsg217BusHiSpd.FordVehReLeWhlSpdPrev "MICROSAR RTE" /begin SUB_GROUP /end SUB_GROUP /begin FUNCTION_LIST /end FUNCTION_LIST /begin REF_CHARACTERISTIC /end REF_CHARACTERISTIC /begin REF_MEASUREMENT FordMsg217BusHiSpd.FordVehReLeWhlSpdPrev /end REF_MEASUREMENT /end GROUP
/begin GROUP FordMsg217BusHiSpd.FordVehReLeWhlSpdRaw.Val "MICROSAR RTE" /begin SUB_GROUP /end SUB_GROUP /begin FUNCTION_LIST /end FUNCTION_LIST /begin REF_CHARACTERISTIC /end REF_CHARACTERISTIC /begin REF_MEASUREMENT FordMsg217BusHiSpd.FordVehReLeWhlSpdRaw.Val /end REF_MEASUREMENT /end GROUP
/begin GROUP FordMsg217BusHiSpd.FordVehReLeWhlSpdRawPrev "MICROSAR RTE" /begin SUB_GROUP /end SUB_GROUP /begin FUNCTION_LIST /end FUNCTION_LIST /begin REF_CHARACTERISTIC /end REF_CHARACTERISTIC /begin REF_MEASUREMENT FordMsg217BusHiSpd.FordVehReLeWhlSpdRawPrev /end REF_MEASUREMENT /end GROUP
/begin GROUP FordMsg217BusHiSpd.FordVehReLeWhlSpdVld.Logl "MICROSAR RTE" /begin SUB_GROUP /end SUB_GROUP /begin FUNCTION_LIST /end FUNCTION_LIST /begin REF_CHARACTERISTIC /end REF_CHARACTERISTIC /begin REF_MEASUREMENT FordMsg217BusHiSpd.FordVehReLeWhlSpdVld.Logl /end REF_MEASUREMENT /end GROUP
/begin GROUP FordMsg217BusHiSpd.FordVehReLeWhlSpdVldFaildRefTi "MICROSAR RTE" /begin SUB_GROUP /end SUB_GROUP /begin FUNCTION_LIST /end FUNCTION_LIST /begin REF_CHARACTERISTIC /end REF_CHARACTERISTIC /begin REF_MEASUREMENT FordMsg217BusHiSpd.FordVehReLeWhlSpdVldFaildRefTi /end REF_MEASUREMENT /end GROUP
/begin GROUP FordMsg217BusHiSpd.FordVehReLeWhlSpdVldMissRefTi "MICROSAR RTE" /begin SUB_GROUP /end SUB_GROUP /begin FUNCTION_LIST /end FUNCTION_LIST /begin REF_CHARACTERISTIC /end REF_CHARACTERISTIC /begin REF_MEASUREMENT FordMsg217BusHiSpd.FordVehReLeWhlSpdVldMissRefTi /end REF_MEASUREMENT /end GROUP
/begin GROUP FordMsg217BusHiSpd.FordVehReLeWhlSpdVldPassdRefTi "MICROSAR RTE" /begin SUB_GROUP /end SUB_GROUP /begin FUNCTION_LIST /end FUNCTION_LIST /begin REF_CHARACTERISTIC /end REF_CHARACTERISTIC /begin REF_MEASUREMENT FordMsg217BusHiSpd.FordVehReLeWhlSpdVldPassdRefTi /end REF_MEASUREMENT /end GROUP
/begin GROUP FordMsg217BusHiSpd.FordVehReLeWhlSpdVldPrev "MICROSAR RTE" /begin SUB_GROUP /end SUB_GROUP /begin FUNCTION_LIST /end FUNCTION_LIST /begin REF_CHARACTERISTIC /end REF_CHARACTERISTIC /begin REF_MEASUREMENT FordMsg217BusHiSpd.FordVehReLeWhlSpdVldPrev /end REF_MEASUREMENT /end GROUP
/begin GROUP FordMsg217BusHiSpd.FordVehReRiWhlSpd.Val "MICROSAR RTE" /begin SUB_GROUP /end SUB_GROUP /begin FUNCTION_LIST /end FUNCTION_LIST /begin REF_CHARACTERISTIC /end REF_CHARACTERISTIC /begin REF_MEASUREMENT FordMsg217BusHiSpd.FordVehReRiWhlSpd.Val /end REF_MEASUREMENT /end GROUP
/begin GROUP FordMsg217BusHiSpd.FordVehReRiWhlSpdInvldFaildRefTi "MICROSAR RTE" /begin SUB_GROUP /end SUB_GROUP /begin FUNCTION_LIST /end FUNCTION_LIST /begin REF_CHARACTERISTIC /end REF_CHARACTERISTIC /begin REF_MEASUREMENT FordMsg217BusHiSpd.FordVehReRiWhlSpdInvldFaildRefTi /end REF_MEASUREMENT /end GROUP
/begin GROUP FordMsg217BusHiSpd.FordVehReRiWhlSpdInvldPassdRefTi "MICROSAR RTE" /begin SUB_GROUP /end SUB_GROUP /begin FUNCTION_LIST /end FUNCTION_LIST /begin REF_CHARACTERISTIC /end REF_CHARACTERISTIC /begin REF_MEASUREMENT FordMsg217BusHiSpd.FordVehReRiWhlSpdInvldPassdRefTi /end REF_MEASUREMENT /end GROUP
/begin GROUP FordMsg217BusHiSpd.FordVehReRiWhlSpdPrev "MICROSAR RTE" /begin SUB_GROUP /end SUB_GROUP /begin FUNCTION_LIST /end FUNCTION_LIST /begin REF_CHARACTERISTIC /end REF_CHARACTERISTIC /begin REF_MEASUREMENT FordMsg217BusHiSpd.FordVehReRiWhlSpdPrev /end REF_MEASUREMENT /end GROUP
/begin GROUP FordMsg217BusHiSpd.FordVehReRiWhlSpdRaw.Val "MICROSAR RTE" /begin SUB_GROUP /end SUB_GROUP /begin FUNCTION_LIST /end FUNCTION_LIST /begin REF_CHARACTERISTIC /end REF_CHARACTERISTIC /begin REF_MEASUREMENT FordMsg217BusHiSpd.FordVehReRiWhlSpdRaw.Val /end REF_MEASUREMENT /end GROUP
/begin GROUP FordMsg217BusHiSpd.FordVehReRiWhlSpdRawPrev "MICROSAR RTE" /begin SUB_GROUP /end SUB_GROUP /begin FUNCTION_LIST /end FUNCTION_LIST /begin REF_CHARACTERISTIC /end REF_CHARACTERISTIC /begin REF_MEASUREMENT FordMsg217BusHiSpd.FordVehReRiWhlSpdRawPrev /end REF_MEASUREMENT /end GROUP
/begin GROUP FordMsg217BusHiSpd.FordVehReRiWhlSpdVld.Logl "MICROSAR RTE" /begin SUB_GROUP /end SUB_GROUP /begin FUNCTION_LIST /end FUNCTION_LIST /begin REF_CHARACTERISTIC /end REF_CHARACTERISTIC /begin REF_MEASUREMENT FordMsg217BusHiSpd.FordVehReRiWhlSpdVld.Logl /end REF_MEASUREMENT /end GROUP
/begin GROUP FordMsg217BusHiSpd.FordVehReRiWhlSpdVldFaildRefTi "MICROSAR RTE" /begin SUB_GROUP /end SUB_GROUP /begin FUNCTION_LIST /end FUNCTION_LIST /begin REF_CHARACTERISTIC /end REF_CHARACTERISTIC /begin REF_MEASUREMENT FordMsg217BusHiSpd.FordVehReRiWhlSpdVldFaildRefTi /end REF_MEASUREMENT /end GROUP
/begin GROUP FordMsg217BusHiSpd.FordVehReRiWhlSpdVldMissRefTi "MICROSAR RTE" /begin SUB_GROUP /end SUB_GROUP /begin FUNCTION_LIST /end FUNCTION_LIST /begin REF_CHARACTERISTIC /end REF_CHARACTERISTIC /begin REF_MEASUREMENT FordMsg217BusHiSpd.FordVehReRiWhlSpdVldMissRefTi /end REF_MEASUREMENT /end GROUP
/begin GROUP FordMsg217BusHiSpd.FordVehReRiWhlSpdVldPassdRefTi "MICROSAR RTE" /begin SUB_GROUP /end SUB_GROUP /begin FUNCTION_LIST /end FUNCTION_LIST /begin REF_CHARACTERISTIC /end REF_CHARACTERISTIC /begin REF_MEASUREMENT FordMsg217BusHiSpd.FordVehReRiWhlSpdVldPassdRefTi /end REF_MEASUREMENT /end GROUP
/begin GROUP FordMsg217BusHiSpd.FordVehReRiWhlSpdVldPrev "MICROSAR RTE" /begin SUB_GROUP /end SUB_GROUP /begin FUNCTION_LIST /end FUNCTION_LIST /begin REF_CHARACTERISTIC /end REF_CHARACTERISTIC /begin REF_MEASUREMENT FordMsg217BusHiSpd.FordVehReRiWhlSpdVldPrev /end REF_MEASUREMENT /end GROUP
/begin GROUP FordMsg217BusHiSpd.MissMsgFaildRefTi "MICROSAR RTE" /begin SUB_GROUP /end SUB_GROUP /begin FUNCTION_LIST /end FUNCTION_LIST /begin REF_CHARACTERISTIC /end REF_CHARACTERISTIC /begin REF_MEASUREMENT FordMsg217BusHiSpd.MissMsgFaildRefTi /end REF_MEASUREMENT /end GROUP
/begin GROUP FordMsg217BusHiSpd.MissMsgPassdRefTi "MICROSAR RTE" /begin SUB_GROUP /end SUB_GROUP /begin FUNCTION_LIST /end FUNCTION_LIST /begin REF_CHARACTERISTIC /end REF_CHARACTERISTIC /begin REF_MEASUREMENT FordMsg217BusHiSpd.MissMsgPassdRefTi /end REF_MEASUREMENT /end GROUP
/begin GROUP FordMsg217BusHiSpd.PerInstanceMemories "MICROSAR RTE"
 /begin SUB_GROUP FordMsg217BusHiSpd.ClrDiagcFlgProxyPrev FordMsg217BusHiSpd.FordVehFrntLeWhlSpdInvldFaildRefTi FordMsg217BusHiSpd.FordVehFrntLeWhlSpdInvldPassdRefTi FordMsg217BusHiSpd.FordVehFrntLeWhlSpdPrev FordMsg217BusHiSpd.FordVehFrntLeWhlSpdRawPrev FordMsg217BusHiSpd.FordVehFrntLeWhlSpdVldFaildRefTi FordMsg217BusHiSpd.FordVehFrntLeWhlSpdVldMissRefTi FordMsg217BusHiSpd.FordVehFrntLeWhlSpdVldPassdRefTi FordMsg217BusHiSpd.FordVehFrntLeWhlSpdVldPrev FordMsg217BusHiSpd.FordVehFrntRiWhlSpdInvldFaildRefTi FordMsg217BusHiSpd.FordVehFrntRiWhlSpdInvldPassdRefTi FordMsg217BusHiSpd.FordVehFrntRiWhlSpdPrev FordMsg217BusHiSpd.FordVehFrntRiWhlSpdRawPrev FordMsg217BusHiSpd.FordVehFrntRiWhlSpdVldFaildRefTi FordMsg217BusHiSpd.FordVehFrntRiWhlSpdVldMissRefTi FordMsg217BusHiSpd.FordVehFrntRiWhlSpdVldPassdRefTi FordMsg217BusHiSpd.FordVehFrntRiWhlSpdVldPrev FordMsg217BusHiSpd.FordVehMsg217Miss FordMsg217BusHiSpd.FordVehMsg217Rxd FordMsg217BusHiSpd.FordVehReLeWhlSpdInvldFaildRefTi FordMsg217BusHiSpd.FordVehReLeWhlSpdInvldPassdRefTi FordMsg217BusHiSpd.FordVehReLeWhlSpdPrev FordMsg217BusHiSpd.FordVehReLeWhlSpdRawPrev FordMsg217BusHiSpd.FordVehReLeWhlSpdVldFaildRefTi FordMsg217BusHiSpd.FordVehReLeWhlSpdVldMissRefTi FordMsg217BusHiSpd.FordVehReLeWhlSpdVldPassdRefTi FordMsg217BusHiSpd.FordVehReLeWhlSpdVldPrev FordMsg217BusHiSpd.FordVehReRiWhlSpdInvldFaildRefTi FordMsg217BusHiSpd.FordVehReRiWhlSpdInvldPassdRefTi FordMsg217BusHiSpd.FordVehReRiWhlSpdPrev FordMsg217BusHiSpd.FordVehReRiWhlSpdRawPrev FordMsg217BusHiSpd.FordVehReRiWhlSpdVldFaildRefTi FordMsg217BusHiSpd.FordVehReRiWhlSpdVldMissRefTi FordMsg217BusHiSpd.FordVehReRiWhlSpdVldPassdRefTi FordMsg217BusHiSpd.FordVehReRiWhlSpdVldPrev FordMsg217BusHiSpd.MissMsgFaildRefTi FordMsg217BusHiSpd.MissMsgPassdRefTi /end SUB_GROUP
 /begin FUNCTION_LIST /end FUNCTION_LIST
 /begin REF_CHARACTERISTIC /end REF_CHARACTERISTIC
 /begin REF_MEASUREMENT /end REF_MEASUREMENT
/end GROUP
/begin GROUP FordMsg217BusHiSpd.ReceiverPorts "MICROSAR RTE"
 /begin SUB_GROUP FordMsg217BusHiSpd.ClrDiagcFlgProxy.Val FordMsg217BusHiSpd.FordAbsPrsnt.Logl FordMsg217BusHiSpd.FordActvNiblCtrlEnad.Logl FordMsg217BusHiSpd.FordBrkOscnRednEnad.Logl FordMsg217BusHiSpd.FordCanDtcInhb.Val FordMsg217BusHiSpd.FordEpsLifeCycMod.Val FordMsg217BusHiSpd.FordInvldMsgDiagcInhb.Val FordMsg217BusHiSpd.FordMfgDiagcInhb.Val FordMsg217BusHiSpd.FordMissMsgDiagcInhb.Val FordMsg217BusHiSpd.FordTqSteerCmpEnad.Logl FordMsg217BusHiSpd.FordTrlrBackupAssiEnad.Logl /end SUB_GROUP
 /begin FUNCTION_LIST /end FUNCTION_LIST
 /begin REF_CHARACTERISTIC /end REF_CHARACTERISTIC
 /begin REF_MEASUREMENT /end REF_MEASUREMENT
/end GROUP
/begin GROUP FordMsg217BusHiSpd.SenderPorts "MICROSAR RTE"
 /begin SUB_GROUP FordMsg217BusHiSpd.FordVehFrntLeWhlSpd.Val FordMsg217BusHiSpd.FordVehFrntLeWhlSpdRaw.Val FordMsg217BusHiSpd.FordVehFrntLeWhlSpdVld.Logl FordMsg217BusHiSpd.FordVehFrntRiWhlSpd.Val FordMsg217BusHiSpd.FordVehFrntRiWhlSpdRaw.Val FordMsg217BusHiSpd.FordVehFrntRiWhlSpdVld.Logl FordMsg217BusHiSpd.FordVehReLeWhlSpd.Val FordMsg217BusHiSpd.FordVehReLeWhlSpdRaw.Val FordMsg217BusHiSpd.FordVehReLeWhlSpdVld.Logl FordMsg217BusHiSpd.FordVehReRiWhlSpd.Val FordMsg217BusHiSpd.FordVehReRiWhlSpdRaw.Val FordMsg217BusHiSpd.FordVehReRiWhlSpdVld.Logl /end SUB_GROUP
 /begin FUNCTION_LIST /end FUNCTION_LIST
 /begin REF_CHARACTERISTIC /end REF_CHARACTERISTIC
 /begin REF_MEASUREMENT /end REF_MEASUREMENT
/end GROUP
/begin GROUP FordMsg230BusHiSpd "MICROSAR RTE"
 /begin SUB_GROUP FordMsg230BusHiSpd.CalibrationPorts FordMsg230BusHiSpd.PerInstanceMemories FordMsg230BusHiSpd.ReceiverPorts FordMsg230BusHiSpd.SenderPorts /end SUB_GROUP
 /begin FUNCTION_LIST /end FUNCTION_LIST
 /begin REF_CHARACTERISTIC /end REF_CHARACTERISTIC
 /begin REF_MEASUREMENT /end REF_MEASUREMENT
/end GROUP
/begin GROUP FordMsg230BusHiSpd.CalibrationPorts "MICROSAR RTE"
 /begin SUB_GROUP FordMsg230BusHiSpd.FordMsg230BusHiSpdFordVehGearLvrPosnFaildTiThd.Val FordMsg230BusHiSpd.FordMsg230BusHiSpdFordVehGearLvrPosnPassdTiThd.Val FordMsg230BusHiSpd.FordMsg230BusHiSpdGearLvrPosnMissTiThd.Val FordMsg230BusHiSpd.FordMsg230BusHiSpdInvldSigFaildThd.Val FordMsg230BusHiSpd.FordMsg230BusHiSpdInvldSigPassdThd.Val FordMsg230BusHiSpd.FordMsg230BusHiSpdMissMsgFaildThd.Val FordMsg230BusHiSpd.FordMsg230BusHiSpdMissMsgPassdThd.Val /end SUB_GROUP
 /begin FUNCTION_LIST /end FUNCTION_LIST
 /begin REF_CHARACTERISTIC /end REF_CHARACTERISTIC
 /begin REF_MEASUREMENT /end REF_MEASUREMENT
/end GROUP
/begin GROUP FordMsg230BusHiSpd.ClrDiagcFlgProxy.Val "MICROSAR RTE" /begin SUB_GROUP /end SUB_GROUP /begin FUNCTION_LIST /end FUNCTION_LIST /begin REF_CHARACTERISTIC /end REF_CHARACTERISTIC /begin REF_MEASUREMENT FordMsg230BusHiSpd.ClrDiagcFlgProxy.Val /end REF_MEASUREMENT /end GROUP
/begin GROUP FordMsg230BusHiSpd.ClrDiagcFlgProxyPrev "MICROSAR RTE" /begin SUB_GROUP /end SUB_GROUP /begin FUNCTION_LIST /end FUNCTION_LIST /begin REF_CHARACTERISTIC /end REF_CHARACTERISTIC /begin REF_MEASUREMENT FordMsg230BusHiSpd.ClrDiagcFlgProxyPrev /end REF_MEASUREMENT /end GROUP
/begin GROUP FordMsg230BusHiSpd.FirstTranVldFlg "MICROSAR RTE" /begin SUB_GROUP /end SUB_GROUP /begin FUNCTION_LIST /end FUNCTION_LIST /begin REF_CHARACTERISTIC /end REF_CHARACTERISTIC /begin REF_MEASUREMENT FordMsg230BusHiSpd.FirstTranVldFlg /end REF_MEASUREMENT /end GROUP
/begin GROUP FordMsg230BusHiSpd.FordCanDtcInhb.Logl "MICROSAR RTE" /begin SUB_GROUP /end SUB_GROUP /begin FUNCTION_LIST /end FUNCTION_LIST /begin REF_CHARACTERISTIC /end REF_CHARACTERISTIC /begin REF_MEASUREMENT FordMsg230BusHiSpd.FordCanDtcInhb.Logl /end REF_MEASUREMENT /end GROUP
/begin GROUP FordMsg230BusHiSpd.FordEpsLifeCycMod.Val "MICROSAR RTE" /begin SUB_GROUP /end SUB_GROUP /begin FUNCTION_LIST /end FUNCTION_LIST /begin REF_CHARACTERISTIC /end REF_CHARACTERISTIC /begin REF_MEASUREMENT FordMsg230BusHiSpd.FordEpsLifeCycMod.Val /end REF_MEASUREMENT /end GROUP
/begin GROUP FordMsg230BusHiSpd.FordMsg230BusHiSpdFordVehGearLvrPosnFaildTiThd.Val "MICROSAR RTE" /begin SUB_GROUP /end SUB_GROUP /begin FUNCTION_LIST /end FUNCTION_LIST
 /begin REF_CHARACTERISTIC FordMsg230BusHiSpd.FordMsg230BusHiSpdFordVehGearLvrPosnFaildTiThd.Val /end REF_CHARACTERISTIC
 /begin REF_MEASUREMENT /end REF_MEASUREMENT
/end GROUP
/begin GROUP FordMsg230BusHiSpd.FordMsg230BusHiSpdFordVehGearLvrPosnPassdTiThd.Val "MICROSAR RTE" /begin SUB_GROUP /end SUB_GROUP /begin FUNCTION_LIST /end FUNCTION_LIST
 /begin REF_CHARACTERISTIC FordMsg230BusHiSpd.FordMsg230BusHiSpdFordVehGearLvrPosnPassdTiThd.Val /end REF_CHARACTERISTIC
 /begin REF_MEASUREMENT /end REF_MEASUREMENT
/end GROUP
/begin GROUP FordMsg230BusHiSpd.FordMsg230BusHiSpdGearLvrPosnMissTiThd.Val "MICROSAR RTE" /begin SUB_GROUP /end SUB_GROUP /begin FUNCTION_LIST /end FUNCTION_LIST
 /begin REF_CHARACTERISTIC FordMsg230BusHiSpd.FordMsg230BusHiSpdGearLvrPosnMissTiThd.Val /end REF_CHARACTERISTIC
 /begin REF_MEASUREMENT /end REF_MEASUREMENT
/end GROUP
/begin GROUP FordMsg230BusHiSpd.FordMsg230BusHiSpdInvldSigFaildThd.Val "MICROSAR RTE" /begin SUB_GROUP /end SUB_GROUP /begin FUNCTION_LIST /end FUNCTION_LIST /begin REF_CHARACTERISTIC FordMsg230BusHiSpd.FordMsg230BusHiSpdInvldSigFaildThd.Val /end REF_CHARACTERISTIC /begin REF_MEASUREMENT /end REF_MEASUREMENT /end GROUP
/begin GROUP FordMsg230BusHiSpd.FordMsg230BusHiSpdInvldSigPassdThd.Val "MICROSAR RTE" /begin SUB_GROUP /end SUB_GROUP /begin FUNCTION_LIST /end FUNCTION_LIST /begin REF_CHARACTERISTIC FordMsg230BusHiSpd.FordMsg230BusHiSpdInvldSigPassdThd.Val /end REF_CHARACTERISTIC /begin REF_MEASUREMENT /end REF_MEASUREMENT /end GROUP
/begin GROUP FordMsg230BusHiSpd.FordMsg230BusHiSpdMissMsgFaildThd.Val "MICROSAR RTE" /begin SUB_GROUP /end SUB_GROUP /begin FUNCTION_LIST /end FUNCTION_LIST /begin REF_CHARACTERISTIC FordMsg230BusHiSpd.FordMsg230BusHiSpdMissMsgFaildThd.Val /end REF_CHARACTERISTIC /begin REF_MEASUREMENT /end REF_MEASUREMENT /end GROUP
/begin GROUP FordMsg230BusHiSpd.FordMsg230BusHiSpdMissMsgPassdThd.Val "MICROSAR RTE" /begin SUB_GROUP /end SUB_GROUP /begin FUNCTION_LIST /end FUNCTION_LIST /begin REF_CHARACTERISTIC FordMsg230BusHiSpd.FordMsg230BusHiSpdMissMsgPassdThd.Val /end REF_CHARACTERISTIC /begin REF_MEASUREMENT /end REF_MEASUREMENT /end GROUP
/begin GROUP FordMsg230BusHiSpd.FordTrlrBackupAssiEnad.Logl "MICROSAR RTE" /begin SUB_GROUP /end SUB_GROUP /begin FUNCTION_LIST /end FUNCTION_LIST /begin REF_CHARACTERISTIC /end REF_CHARACTERISTIC /begin REF_MEASUREMENT FordMsg230BusHiSpd.FordTrlrBackupAssiEnad.Logl /end REF_MEASUREMENT /end GROUP
/begin GROUP FordMsg230BusHiSpd.FordVehGearLvrPosn.Ford_GearLvrPos_D_Actl "MICROSAR RTE" /begin SUB_GROUP /end SUB_GROUP /begin FUNCTION_LIST /end FUNCTION_LIST /begin REF_CHARACTERISTIC /end REF_CHARACTERISTIC
 /begin REF_MEASUREMENT FordMsg230BusHiSpd.FordVehGearLvrPosn.Ford_GearLvrPos_D_Actl /end REF_MEASUREMENT
/end GROUP
/begin GROUP FordMsg230BusHiSpd.FordVehGearLvrPosnInvldFaildRefTi "MICROSAR RTE" /begin SUB_GROUP /end SUB_GROUP /begin FUNCTION_LIST /end FUNCTION_LIST /begin REF_CHARACTERISTIC /end REF_CHARACTERISTIC /begin REF_MEASUREMENT FordMsg230BusHiSpd.FordVehGearLvrPosnInvldFaildRefTi /end REF_MEASUREMENT /end GROUP
/begin GROUP FordMsg230BusHiSpd.FordVehGearLvrPosnInvldPassdRefTi "MICROSAR RTE" /begin SUB_GROUP /end SUB_GROUP /begin FUNCTION_LIST /end FUNCTION_LIST /begin REF_CHARACTERISTIC /end REF_CHARACTERISTIC /begin REF_MEASUREMENT FordMsg230BusHiSpd.FordVehGearLvrPosnInvldPassdRefTi /end REF_MEASUREMENT /end GROUP
/begin GROUP FordMsg230BusHiSpd.FordVehGearLvrPosnPrev "MICROSAR RTE" /begin SUB_GROUP /end SUB_GROUP /begin FUNCTION_LIST /end FUNCTION_LIST /begin REF_CHARACTERISTIC /end REF_CHARACTERISTIC /begin REF_MEASUREMENT FordMsg230BusHiSpd.FordVehGearLvrPosnPrev /end REF_MEASUREMENT /end GROUP
/begin GROUP FordMsg230BusHiSpd.FordVehGearLvrPosnVldFaildRefTi "MICROSAR RTE" /begin SUB_GROUP /end SUB_GROUP /begin FUNCTION_LIST /end FUNCTION_LIST /begin REF_CHARACTERISTIC /end REF_CHARACTERISTIC /begin REF_MEASUREMENT FordMsg230BusHiSpd.FordVehGearLvrPosnVldFaildRefTi /end REF_MEASUREMENT /end GROUP
/begin GROUP FordMsg230BusHiSpd.FordVehGearLvrPosnVldInt.Logl "MICROSAR RTE" /begin SUB_GROUP /end SUB_GROUP /begin FUNCTION_LIST /end FUNCTION_LIST /begin REF_CHARACTERISTIC /end REF_CHARACTERISTIC /begin REF_MEASUREMENT FordMsg230BusHiSpd.FordVehGearLvrPosnVldInt.Logl /end REF_MEASUREMENT /end GROUP
/begin GROUP FordMsg230BusHiSpd.FordVehGearLvrPosnVldIntPrev "MICROSAR RTE" /begin SUB_GROUP /end SUB_GROUP /begin FUNCTION_LIST /end FUNCTION_LIST /begin REF_CHARACTERISTIC /end REF_CHARACTERISTIC /begin REF_MEASUREMENT FordMsg230BusHiSpd.FordVehGearLvrPosnVldIntPrev /end REF_MEASUREMENT /end GROUP
/begin GROUP FordMsg230BusHiSpd.FordVehGearLvrPosnVldPassdRefTi "MICROSAR RTE" /begin SUB_GROUP /end SUB_GROUP /begin FUNCTION_LIST /end FUNCTION_LIST /begin REF_CHARACTERISTIC /end REF_CHARACTERISTIC /begin REF_MEASUREMENT FordMsg230BusHiSpd.FordVehGearLvrPosnVldPassdRefTi /end REF_MEASUREMENT /end GROUP
/begin GROUP FordMsg230BusHiSpd.FordVehMsg230Miss "MICROSAR RTE" /begin SUB_GROUP /end SUB_GROUP /begin FUNCTION_LIST /end FUNCTION_LIST /begin REF_CHARACTERISTIC /end REF_CHARACTERISTIC /begin REF_MEASUREMENT FordMsg230BusHiSpd.FordVehMsg230Miss /end REF_MEASUREMENT /end GROUP
/begin GROUP FordMsg230BusHiSpd.GearLvrPosnVldMissRefTi "MICROSAR RTE" /begin SUB_GROUP /end SUB_GROUP /begin FUNCTION_LIST /end FUNCTION_LIST /begin REF_CHARACTERISTIC /end REF_CHARACTERISTIC /begin REF_MEASUREMENT FordMsg230BusHiSpd.GearLvrPosnVldMissRefTi /end REF_MEASUREMENT /end GROUP
/begin GROUP FordMsg230BusHiSpd.MissMsgFaildRefTi "MICROSAR RTE" /begin SUB_GROUP /end SUB_GROUP /begin FUNCTION_LIST /end FUNCTION_LIST /begin REF_CHARACTERISTIC /end REF_CHARACTERISTIC /begin REF_MEASUREMENT FordMsg230BusHiSpd.MissMsgFaildRefTi /end REF_MEASUREMENT /end GROUP
/begin GROUP FordMsg230BusHiSpd.MissMsgPassdRefTi "MICROSAR RTE" /begin SUB_GROUP /end SUB_GROUP /begin FUNCTION_LIST /end FUNCTION_LIST /begin REF_CHARACTERISTIC /end REF_CHARACTERISTIC /begin REF_MEASUREMENT FordMsg230BusHiSpd.MissMsgPassdRefTi /end REF_MEASUREMENT /end GROUP
/begin GROUP FordMsg230BusHiSpd.PerInstanceMemories "MICROSAR RTE"
 /begin SUB_GROUP FordMsg230BusHiSpd.ClrDiagcFlgProxyPrev FordMsg230BusHiSpd.FirstTranVldFlg FordMsg230BusHiSpd.FordVehGearLvrPosnInvldFaildRefTi FordMsg230BusHiSpd.FordVehGearLvrPosnInvldPassdRefTi FordMsg230BusHiSpd.FordVehGearLvrPosnPrev FordMsg230BusHiSpd.FordVehGearLvrPosnVldFaildRefTi FordMsg230BusHiSpd.FordVehGearLvrPosnVldIntPrev FordMsg230BusHiSpd.FordVehGearLvrPosnVldPassdRefTi FordMsg230BusHiSpd.FordVehMsg230Miss FordMsg230BusHiSpd.GearLvrPosnVldMissRefTi FordMsg230BusHiSpd.MissMsgFaildRefTi FordMsg230BusHiSpd.MissMsgPassdRefTi /end SUB_GROUP
 /begin FUNCTION_LIST /end FUNCTION_LIST
 /begin REF_CHARACTERISTIC /end REF_CHARACTERISTIC
 /begin REF_MEASUREMENT /end REF_MEASUREMENT
/end GROUP
/begin GROUP FordMsg230BusHiSpd.ReceiverPorts "MICROSAR RTE"
 /begin SUB_GROUP FordMsg230BusHiSpd.ClrDiagcFlgProxy.Val FordMsg230BusHiSpd.FordCanDtcInhb.Logl FordMsg230BusHiSpd.FordEpsLifeCycMod.Val FordMsg230BusHiSpd.FordTrlrBackupAssiEnad.Logl /end SUB_GROUP
 /begin FUNCTION_LIST /end FUNCTION_LIST
 /begin REF_CHARACTERISTIC /end REF_CHARACTERISTIC
 /begin REF_MEASUREMENT /end REF_MEASUREMENT
/end GROUP
/begin GROUP FordMsg230BusHiSpd.SenderPorts "MICROSAR RTE"
 /begin SUB_GROUP FordMsg230BusHiSpd.FordVehGearLvrPosn.Ford_GearLvrPos_D_Actl FordMsg230BusHiSpd.FordVehGearLvrPosnVldInt.Logl /end SUB_GROUP
 /begin FUNCTION_LIST /end FUNCTION_LIST
 /begin REF_CHARACTERISTIC /end REF_CHARACTERISTIC
 /begin REF_MEASUREMENT /end REF_MEASUREMENT
/end GROUP
/begin GROUP FordMsg2FDBusHiSpd "MICROSAR RTE"
 /begin SUB_GROUP FordMsg2FDBusHiSpd.CalibrationPorts FordMsg2FDBusHiSpd.PerInstanceMemories FordMsg2FDBusHiSpd.ReceiverPorts FordMsg2FDBusHiSpd.SenderPorts /end SUB_GROUP
 /begin FUNCTION_LIST /end FUNCTION_LIST
 /begin REF_CHARACTERISTIC /end REF_CHARACTERISTIC
 /begin REF_MEASUREMENT /end REF_MEASUREMENT
/end GROUP
/begin GROUP FordMsg2FDBusHiSpd.CalibrationPorts "MICROSAR RTE"
 /begin SUB_GROUP FordMsg2FDBusHiSpd.FordMsg2FDBusHiSpdFordVehEvasSteerAssiReqVldNotRxdTiThd.Val FordMsg2FDBusHiSpd.FordMsg2FDBusHiSpdFordVehEvasSteerAssiReqVldRxdTiThd.Val FordMsg2FDBusHiSpd.FordMsg2FDBusHiSpdMissMsgFaildTiThd.Val FordMsg2FDBusHiSpd.FordMsg2FDBusHiSpdMissMsgPassdTiThd.Val /end SUB_GROUP
 /begin FUNCTION_LIST /end FUNCTION_LIST
 /begin REF_CHARACTERISTIC /end REF_CHARACTERISTIC
 /begin REF_MEASUREMENT /end REF_MEASUREMENT
/end GROUP
/begin GROUP FordMsg2FDBusHiSpd.ClrDiagcFlgProxy.Val "MICROSAR RTE" /begin SUB_GROUP /end SUB_GROUP /begin FUNCTION_LIST /end FUNCTION_LIST /begin REF_CHARACTERISTIC /end REF_CHARACTERISTIC /begin REF_MEASUREMENT FordMsg2FDBusHiSpd.ClrDiagcFlgProxy.Val /end REF_MEASUREMENT /end GROUP
/begin GROUP FordMsg2FDBusHiSpd.ClrDiagcFlgProxyPrev "MICROSAR RTE" /begin SUB_GROUP /end SUB_GROUP /begin FUNCTION_LIST /end FUNCTION_LIST /begin REF_CHARACTERISTIC /end REF_CHARACTERISTIC /begin REF_MEASUREMENT FordMsg2FDBusHiSpd.ClrDiagcFlgProxyPrev /end REF_MEASUREMENT /end GROUP
/begin GROUP FordMsg2FDBusHiSpd.FirstTranVldFlg "MICROSAR RTE" /begin SUB_GROUP /end SUB_GROUP /begin FUNCTION_LIST /end FUNCTION_LIST /begin REF_CHARACTERISTIC /end REF_CHARACTERISTIC /begin REF_MEASUREMENT FordMsg2FDBusHiSpd.FirstTranVldFlg /end REF_MEASUREMENT /end GROUP
/begin GROUP FordMsg2FDBusHiSpd.FordCanDtcInhb.Logl "MICROSAR RTE" /begin SUB_GROUP /end SUB_GROUP /begin FUNCTION_LIST /end FUNCTION_LIST /begin REF_CHARACTERISTIC /end REF_CHARACTERISTIC /begin REF_MEASUREMENT FordMsg2FDBusHiSpd.FordCanDtcInhb.Logl /end REF_MEASUREMENT /end GROUP
/begin GROUP FordMsg2FDBusHiSpd.FordEpsLifeCycMod.Val "MICROSAR RTE" /begin SUB_GROUP /end SUB_GROUP /begin FUNCTION_LIST /end FUNCTION_LIST /begin REF_CHARACTERISTIC /end REF_CHARACTERISTIC /begin REF_MEASUREMENT FordMsg2FDBusHiSpd.FordEpsLifeCycMod.Val /end REF_MEASUREMENT /end GROUP
/begin GROUP FordMsg2FDBusHiSpd.FordEvasSteerAssiEnad.Logl "MICROSAR RTE" /begin SUB_GROUP /end SUB_GROUP /begin FUNCTION_LIST /end FUNCTION_LIST /begin REF_CHARACTERISTIC /end REF_CHARACTERISTIC /begin REF_MEASUREMENT FordMsg2FDBusHiSpd.FordEvasSteerAssiEnad.Logl /end REF_MEASUREMENT /end GROUP
/begin GROUP FordMsg2FDBusHiSpd.FordMsg2FDBusHiSpdFordVehEvasSteerAssiReqVldNotRxdTiThd.Val "MICROSAR RTE" /begin SUB_GROUP /end SUB_GROUP /begin FUNCTION_LIST /end FUNCTION_LIST
 /begin REF_CHARACTERISTIC FordMsg2FDBusHiSpd.FordMsg2FDBusHiSpdFordVehEvasSteerAssiReqVldNotRxdTiThd.Val /end REF_CHARACTERISTIC
 /begin REF_MEASUREMENT /end REF_MEASUREMENT
/end GROUP
/begin GROUP FordMsg2FDBusHiSpd.FordMsg2FDBusHiSpdFordVehEvasSteerAssiReqVldRxdTiThd.Val "MICROSAR RTE" /begin SUB_GROUP /end SUB_GROUP /begin FUNCTION_LIST /end FUNCTION_LIST
 /begin REF_CHARACTERISTIC FordMsg2FDBusHiSpd.FordMsg2FDBusHiSpdFordVehEvasSteerAssiReqVldRxdTiThd.Val /end REF_CHARACTERISTIC
 /begin REF_MEASUREMENT /end REF_MEASUREMENT
/end GROUP
/begin GROUP FordMsg2FDBusHiSpd.FordMsg2FDBusHiSpdMissMsgFaildTiThd.Val "MICROSAR RTE" /begin SUB_GROUP /end SUB_GROUP /begin FUNCTION_LIST /end FUNCTION_LIST /begin REF_CHARACTERISTIC FordMsg2FDBusHiSpd.FordMsg2FDBusHiSpdMissMsgFaildTiThd.Val /end REF_CHARACTERISTIC /begin REF_MEASUREMENT /end REF_MEASUREMENT /end GROUP
/begin GROUP FordMsg2FDBusHiSpd.FordMsg2FDBusHiSpdMissMsgPassdTiThd.Val "MICROSAR RTE" /begin SUB_GROUP /end SUB_GROUP /begin FUNCTION_LIST /end FUNCTION_LIST /begin REF_CHARACTERISTIC FordMsg2FDBusHiSpd.FordMsg2FDBusHiSpdMissMsgPassdTiThd.Val /end REF_CHARACTERISTIC /begin REF_MEASUREMENT /end REF_MEASUREMENT /end GROUP
/begin GROUP FordMsg2FDBusHiSpd.FordVehEvasSteerAssiReq.Val "MICROSAR RTE" /begin SUB_GROUP /end SUB_GROUP /begin FUNCTION_LIST /end FUNCTION_LIST /begin REF_CHARACTERISTIC /end REF_CHARACTERISTIC /begin REF_MEASUREMENT FordMsg2FDBusHiSpd.FordVehEvasSteerAssiReq.Val /end REF_MEASUREMENT /end GROUP
/begin GROUP FordMsg2FDBusHiSpd.FordVehEvasSteerAssiReqPrev "MICROSAR RTE" /begin SUB_GROUP /end SUB_GROUP /begin FUNCTION_LIST /end FUNCTION_LIST /begin REF_CHARACTERISTIC /end REF_CHARACTERISTIC /begin REF_MEASUREMENT FordMsg2FDBusHiSpd.FordVehEvasSteerAssiReqPrev /end REF_MEASUREMENT /end GROUP
/begin GROUP FordMsg2FDBusHiSpd.FordVehEvasSteerAssiReqVld.Logl "MICROSAR RTE" /begin SUB_GROUP /end SUB_GROUP /begin FUNCTION_LIST /end FUNCTION_LIST /begin REF_CHARACTERISTIC /end REF_CHARACTERISTIC /begin REF_MEASUREMENT FordMsg2FDBusHiSpd.FordVehEvasSteerAssiReqVld.Logl /end REF_MEASUREMENT /end GROUP
/begin GROUP FordMsg2FDBusHiSpd.FordVehEvasSteerAssiReqVldPrev "MICROSAR RTE" /begin SUB_GROUP /end SUB_GROUP /begin FUNCTION_LIST /end FUNCTION_LIST /begin REF_CHARACTERISTIC /end REF_CHARACTERISTIC /begin REF_MEASUREMENT FordMsg2FDBusHiSpd.FordVehEvasSteerAssiReqVldPrev /end REF_MEASUREMENT /end GROUP
/begin GROUP FordMsg2FDBusHiSpd.FordVehMsg2FDMiss "MICROSAR RTE" /begin SUB_GROUP /end SUB_GROUP /begin FUNCTION_LIST /end FUNCTION_LIST /begin REF_CHARACTERISTIC /end REF_CHARACTERISTIC /begin REF_MEASUREMENT FordMsg2FDBusHiSpd.FordVehMsg2FDMiss /end REF_MEASUREMENT /end GROUP
/begin GROUP FordMsg2FDBusHiSpd.FordVehMsg2FDMissTmr "MICROSAR RTE" /begin SUB_GROUP /end SUB_GROUP /begin FUNCTION_LIST /end FUNCTION_LIST /begin REF_CHARACTERISTIC /end REF_CHARACTERISTIC /begin REF_MEASUREMENT FordMsg2FDBusHiSpd.FordVehMsg2FDMissTmr /end REF_MEASUREMENT /end GROUP
/begin GROUP FordMsg2FDBusHiSpd.FordVehMsg2FDNotRxdRefTi "MICROSAR RTE" /begin SUB_GROUP /end SUB_GROUP /begin FUNCTION_LIST /end FUNCTION_LIST /begin REF_CHARACTERISTIC /end REF_CHARACTERISTIC /begin REF_MEASUREMENT FordMsg2FDBusHiSpd.FordVehMsg2FDNotRxdRefTi /end REF_MEASUREMENT /end GROUP
/begin GROUP FordMsg2FDBusHiSpd.FordVehMsg2FDRxdRefTi "MICROSAR RTE" /begin SUB_GROUP /end SUB_GROUP /begin FUNCTION_LIST /end FUNCTION_LIST /begin REF_CHARACTERISTIC /end REF_CHARACTERISTIC /begin REF_MEASUREMENT FordMsg2FDBusHiSpd.FordVehMsg2FDRxdRefTi /end REF_MEASUREMENT /end GROUP
/begin GROUP FordMsg2FDBusHiSpd.FordVehMsg2FDRxdTmr "MICROSAR RTE" /begin SUB_GROUP /end SUB_GROUP /begin FUNCTION_LIST /end FUNCTION_LIST /begin REF_CHARACTERISTIC /end REF_CHARACTERISTIC /begin REF_MEASUREMENT FordMsg2FDBusHiSpd.FordVehMsg2FDRxdTmr /end REF_MEASUREMENT /end GROUP
/begin GROUP FordMsg2FDBusHiSpd.PerInstanceMemories "MICROSAR RTE"
 /begin SUB_GROUP FordMsg2FDBusHiSpd.ClrDiagcFlgProxyPrev FordMsg2FDBusHiSpd.FirstTranVldFlg FordMsg2FDBusHiSpd.FordVehEvasSteerAssiReqPrev FordMsg2FDBusHiSpd.FordVehEvasSteerAssiReqVldPrev FordMsg2FDBusHiSpd.FordVehMsg2FDMiss FordMsg2FDBusHiSpd.FordVehMsg2FDMissTmr FordMsg2FDBusHiSpd.FordVehMsg2FDNotRxdRefTi FordMsg2FDBusHiSpd.FordVehMsg2FDRxdRefTi FordMsg2FDBusHiSpd.FordVehMsg2FDRxdTmr /end SUB_GROUP
 /begin FUNCTION_LIST /end FUNCTION_LIST
 /begin REF_CHARACTERISTIC /end REF_CHARACTERISTIC
 /begin REF_MEASUREMENT /end REF_MEASUREMENT
/end GROUP
/begin RECORD_LAYOUT RTE_RL_UWORD FNC_VALUES 1 UWORD ROW_DIR DIRECT /end RECORD_LAYOUT
/**********************************************************************************************************************
* COMPU_METHOD / COMPU_VTAB_RANGE
*********************************************************************************************************************/
/begin COMPU_METHOD RTE_CM_BOOLEAN "" TAB_VERB "%3.1" "" COMPU_TAB_REF RTE_CM_BOOLEAN /end COMPU_METHOD
/begin COMPU_VTAB_RANGE RTE_CM_BOOLEAN "" 2 0 0 "false" 1 255 "true" /end COMPU_VTAB_RANGE
/begin COMPU_METHOD RTE_CM_ENUM_Ford_VehVActlEng_D_Qf "" TAB_VERB "%.1" "" COMPU_TAB_REF RTE_CM_ENUM_Ford_VehVActlEng_D_Qf /end COMPU_METHOD
/begin COMPU_VTAB_RANGE RTE_CM_ENUM_Ford_VehVActlEng_D_Qf "" 5 0 3 "RANGE" 0 0 "Cx0_Faulty" 1 1 "Cx1_No_Data_Exists" 2 2 "Cx2_Not_Within_Specifications" 3 3 "Cx3_OK" /end COMPU_VTAB_RANGE
/begin COMPU_METHOD RTE_CM_ENUM_Ford_TrlrAidMde_D_Rq "" TAB_VERB "%.1" "" COMPU_TAB_REF RTE_CM_ENUM_Ford_TrlrAidMde_D_Rq /end COMPU_METHOD
/begin COMPU_VTAB_RANGE RTE_CM_ENUM_Ford_TrlrAidMde_D_Rq "" 5 0 3 "RANGE" 0 0 "Cx0_NoRequest" 1 1 "Cx1_Mode_1" 2 2 "Cx2_Mode_2" 3 3 "Cx3_Mode_3" /end COMPU_VTAB_RANGE
/begin COMPU_METHOD RTE_CM_ENUM_FordVehWhlDirRaw1 "" TAB_VERB "%.1" "" COMPU_TAB_REF RTE_CM_ENUM_FordVehWhlDirRaw1 /end COMPU_METHOD
/begin COMPU_VTAB_RANGE RTE_CM_ENUM_FordVehWhlDirRaw1 "" 4 0 0 "FORDVEHWHLDIRRAW_FWD" 1 1 "FORDVEHWHLDIRRAW_BACKW" 2 2 "FORDVEHWHLDIRRAW_UKWN" 3 3 "FORDVEHWHLDIRRAW_FAILD" /end COMPU_VTAB_RANGE
/begin COMPU_METHOD RTE_CM_Ford_WhlRotatFl_No_Cnt "" RAT_FUNC "%.1" "Unitless" COEFFS 0 1 0 0 0 1 /end COMPU_METHOD
/begin COMPU_METHOD RTE_CM_Ford_WhlRotatFr_No_Cnt "" RAT_FUNC "%.1" "Unitless" COEFFS 0 1 0 0 0 1 /end COMPU_METHOD
/begin COMPU_METHOD RTE_CM_Ford_WhlRotatRl_No_Cnt "" RAT_FUNC "%.1" "Unitless" COEFFS 0 1 0 0 0 1 /end COMPU_METHOD
/begin COMPU_METHOD RTE_CM_Ford_WhlRotatRr_No_Cnt "" RAT_FUNC "%.1" "Unitless" COEFFS 0 1 0 0 0 1 /end COMPU_METHOD
/begin COMPU_METHOD RTE_CM_ENUM_Ford_GearLvrPos_D_Actl "" TAB_VERB "%.1" "" COMPU_TAB_REF RTE_CM_ENUM_Ford_GearLvrPos_D_Actl /end COMPU_METHOD
/begin COMPU_VTAB_RANGE RTE_CM_ENUM_Ford_GearLvrPos_D_Actl "" 17 0 15 "RANGE" 0 0 "Cx0_Park" 1 1 "Cx1_Reverse" 2 2 "Cx2_Neutral" 3 3 "Cx3_Drive" 4 4 "Cx4_Sport_DriveSport" 5 5 "Cx5_Low" 6 6 "Cx6_first" 7 7 "Cx7_second" 8 8 "Cx8_third" 9 9 "Cx9_fourth" 10 10 "CxA_fifth" 11 11 "CxB_sixth" 12 12 "CxC_Undefined_Treat_as_Fault" 13 13 "CxD_Undefined_Treat_as_Fault" 14 14 "CxE_Unknown_Position" 15 15 "CxF_Fault" /end COMPU_VTAB_RANGE
