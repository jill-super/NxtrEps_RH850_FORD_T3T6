/begin CHARACTERISTIC TEstimn.TEstimnAmbPwrMplr.Ary1D "MICROSAR RTE" VAL_BLK 0x0 RTE_RL_FLOAT32_IEEE 0 NO_COMPU_METHOD -3.402823466e+38 3.402823466e+38 MATRIX_DIM 3 1 1 SYMBOL_LINK "Rte_CalprmRom_CalRegn01Inin00_DEFAULT_RTE_CALPRM_GROUP.TEstimnAmbPwrMplr_Ary1D" 0 DISPLAY_IDENTIFIER TEstimn.CalibrationPorts.TEstimnAmbPwrMplr.Ary1D /end CHARACTERISTIC
/begin CHARACTERISTIC TEstimn.TEstimnAmbTSca.Ary1D "MICROSAR RTE" VAL_BLK 0x0 RTE_RL_FLOAT32_IEEE 0 NO_COMPU_METHOD -3.402823466e+38 3.402823466e+38 MATRIX_DIM 3 1 1 SYMBOL_LINK "Rte_CalprmRom_CalRegn01Inin00_DEFAULT_RTE_CALPRM_GROUP.TEstimnAmbTSca_Ary1D" 0 DISPLAY_IDENTIFIER TEstimn.CalibrationPorts.TEstimnAmbTSca.Ary1D /end CHARACTERISTIC
/begin CHARACTERISTIC TEstimn.TEstimnAssiMechAmbLpFilFrq.Val "MICROSAR RTE" VALUE 0x0 RTE_RL_FLOAT32_IEEE 0 NO_COMPU_METHOD -3.402823466e+38 3.402823466e+38 SYMBOL_LINK "Rte_CalprmRom_CalRegn01Inin00_DEFAULT_RTE_CALPRM_GROUP.TEstimnAssiMechAmbLpFilFrq_Val" 0 DISPLAY_IDENTIFIER TEstimn.CalibrationPorts.TEstimnAssiMechAmbLpFilFrq.Val /end CHARACTERISTIC
/begin CHARACTERISTIC TEstimn.TEstimnAssiMechAmbLpFilFrqDualEcuFltMtgtn.Val "MICROSAR RTE" VALUE 0x0 RTE_RL_FLOAT32_IEEE 0 NO_COMPU_METHOD -3.402823466e+38 3.402823466e+38 SYMBOL_LINK "Rte_CalprmRom_CalRegn01Inin00_DEFAULT_RTE_CALPRM_GROUP.TEstimnAssiMechAmbLpFilFrqDualEcuFltMtgtn_Val" 0 DISPLAY_IDENTIFIER TEstimn.CalibrationPorts.TEstimnAssiMechAmbLpFilFrqDualEcuFltMtgtn.Val /end CHARACTERISTIC
/begin CHARACTERISTIC TEstimn.TEstimnAssiMechAmbLpFilFrqFetMtgtnEna.Val "MICROSAR RTE" VALUE 0x0 RTE_RL_FLOAT32_IEEE 0 NO_COMPU_METHOD -3.402823466e+38 3.402823466e+38 SYMBOL_LINK "Rte_CalprmRom_CalRegn01Inin00_DEFAULT_RTE_CALPRM_GROUP.TEstimnAssiMechAmbLpFilFrqFetMtgtnEna_Val" 0 DISPLAY_IDENTIFIER TEstimn.CalibrationPorts.TEstimnAssiMechAmbLpFilFrqFetMtgtnEna.Val /end CHARACTERISTIC
/begin CHARACTERISTIC TEstimn.TEstimnAssiMechAmbMplr.Ary1D "MICROSAR RTE" VAL_BLK 0x0 RTE_RL_FLOAT32_IEEE 0 NO_COMPU_METHOD -3.402823466e+38 3.402823466e+38 MATRIX_DIM 3 1 1 SYMBOL_LINK "Rte_CalprmRom_CalRegn01Inin00_DEFAULT_RTE_CALPRM_GROUP.TEstimnAssiMechAmbMplr_Ary1D" 0 DISPLAY_IDENTIFIER TEstimn.CalibrationPorts.TEstimnAssiMechAmbMplr.Ary1D /end CHARACTERISTIC
/begin CHARACTERISTIC TEstimn.TEstimnAssiMechCorrLim.Ary1D "MICROSAR RTE" VAL_BLK 0x0 RTE_RL_FLOAT32_IEEE 0 NO_COMPU_METHOD -3.402823466e+38 3.402823466e+38 MATRIX_DIM 3 1 1 SYMBOL_LINK "Rte_CalprmRom_CalRegn01Inin00_DEFAULT_RTE_CALPRM_GROUP.TEstimnAssiMechCorrLim_Ary1D" 0 DISPLAY_IDENTIFIER TEstimn.CalibrationPorts.TEstimnAssiMechCorrLim.Ary1D /end CHARACTERISTIC
/begin CHARACTERISTIC TEstimn.TEstimnAssiMechDampgSca.Ary1D "MICROSAR RTE" VAL_BLK 0x0 RTE_RL_FLOAT32_IEEE 0 NO_COMPU_METHOD -3.402823466e+38 3.402823466e+38 MATRIX_DIM 3 1 1 SYMBOL_LINK "Rte_CalprmRom_CalRegn01Inin00_DEFAULT_RTE_CALPRM_GROUP.TEstimnAssiMechDampgSca_Ary1D" 0 DISPLAY_IDENTIFIER TEstimn.CalibrationPorts.TEstimnAssiMechDampgSca.Ary1D /end CHARACTERISTIC
/begin CHARACTERISTIC TEstimn.TEstimnAssiMechDftT.Ary1D "MICROSAR RTE" VAL_BLK 0x0 RTE_RL_FLOAT32_IEEE 0 NO_COMPU_METHOD -3.402823466e+38 3.402823466e+38 MATRIX_DIM 3 1 1 SYMBOL_LINK "Rte_CalprmRom_CalRegn01Inin00_DEFAULT_RTE_CALPRM_GROUP.TEstimnAssiMechDftT_Ary1D" 0 DISPLAY_IDENTIFIER TEstimn.CalibrationPorts.TEstimnAssiMechDftT.Ary1D /end CHARACTERISTIC
/begin CHARACTERISTIC TEstimn.TEstimnAssiMechLLFilCoeffA1.Ary1D "MICROSAR RTE" VAL_BLK 0x0 RTE_RL_FLOAT32_IEEE 0 NO_COMPU_METHOD -3.402823466e+38 3.402823466e+38 MATRIX_DIM 3 1 1 SYMBOL_LINK "Rte_CalprmRom_CalRegn01Inin00_DEFAULT_RTE_CALPRM_GROUP.TEstimnAssiMechLLFilCoeffA1_Ary1D" 0 DISPLAY_IDENTIFIER TEstimn.CalibrationPorts.TEstimnAssiMechLLFilCoeffA1.Ary1D /end CHARACTERISTIC
/begin CHARACTERISTIC TEstimn.TEstimnAssiMechLLFilCoeffB0.Ary1D "MICROSAR RTE" VAL_BLK 0x0 RTE_RL_FLOAT32_IEEE 0 NO_COMPU_METHOD -3.402823466e+38 3.402823466e+38 MATRIX_DIM 3 1 1 SYMBOL_LINK "Rte_CalprmRom_CalRegn01Inin00_DEFAULT_RTE_CALPRM_GROUP.TEstimnAssiMechLLFilCoeffB0_Ary1D" 0 DISPLAY_IDENTIFIER TEstimn.CalibrationPorts.TEstimnAssiMechLLFilCoeffB0.Ary1D /end CHARACTERISTIC
/begin CHARACTERISTIC TEstimn.TEstimnAssiMechLLFilCoeffB1.Ary1D "MICROSAR RTE" VAL_BLK 0x0 RTE_RL_FLOAT32_IEEE 0 NO_COMPU_METHOD -3.402823466e+38 3.402823466e+38 MATRIX_DIM 3 1 1 SYMBOL_LINK "Rte_CalprmRom_CalRegn01Inin00_DEFAULT_RTE_CALPRM_GROUP.TEstimnAssiMechLLFilCoeffB1_Ary1D" 0 DISPLAY_IDENTIFIER TEstimn.CalibrationPorts.TEstimnAssiMechLLFilCoeffB1.Ary1D /end CHARACTERISTIC
/begin CHARACTERISTIC TEstimn.TEstimnAssiMechSlew.Ary1D "MICROSAR RTE" VAL_BLK 0x0 RTE_RL_FLOAT32_IEEE 0 NO_COMPU_METHOD -3.402823466e+38 3.402823466e+38 MATRIX_DIM 3 1 1 SYMBOL_LINK "Rte_CalprmRom_CalRegn01Inin00_DEFAULT_RTE_CALPRM_GROUP.TEstimnAssiMechSlew_Ary1D" 0 DISPLAY_IDENTIFIER TEstimn.CalibrationPorts.TEstimnAssiMechSlew.Ary1D /end CHARACTERISTIC
/begin CHARACTERISTIC TEstimn.TEstimnCorrnTAssiMech.Ary1D "MICROSAR RTE" VAL_BLK 0x0 RTE_RL_FLOAT32_IEEE 0 NO_COMPU_METHOD -3.402823466e+38 3.402823466e+38 MATRIX_DIM 3 1 1 SYMBOL_LINK "Rte_CalprmRom_CalRegn01Inin00_DEFAULT_RTE_CALPRM_GROUP.TEstimnCorrnTAssiMech_Ary1D" 0 DISPLAY_IDENTIFIER TEstimn.CalibrationPorts.TEstimnCorrnTAssiMech.Ary1D /end CHARACTERISTIC
/begin CHARACTERISTIC TEstimn.TEstimnCorrnTCu.Ary1D "MICROSAR RTE" VAL_BLK 0x0 RTE_RL_FLOAT32_IEEE 0 NO_COMPU_METHOD -3.402823466e+38 3.402823466e+38 MATRIX_DIM 3 1 1 SYMBOL_LINK "Rte_CalprmRom_CalRegn01Inin00_DEFAULT_RTE_CALPRM_GROUP.TEstimnCorrnTCu_Ary1D" 0 DISPLAY_IDENTIFIER TEstimn.CalibrationPorts.TEstimnCorrnTCu.Ary1D /end CHARACTERISTIC
/begin CHARACTERISTIC TEstimn.TEstimnCorrnTMag.Ary1D "MICROSAR RTE" VAL_BLK 0x0 RTE_RL_FLOAT32_IEEE 0 NO_COMPU_METHOD -3.402823466e+38 3.402823466e+38 MATRIX_DIM 3 1 1 SYMBOL_LINK "Rte_CalprmRom_CalRegn01Inin00_DEFAULT_RTE_CALPRM_GROUP.TEstimnCorrnTMag_Ary1D" 0 DISPLAY_IDENTIFIER TEstimn.CalibrationPorts.TEstimnCorrnTMag.Ary1D /end CHARACTERISTIC
/begin CHARACTERISTIC TEstimn.TEstimnCorrnTSi.Ary1D "MICROSAR RTE" VAL_BLK 0x0 RTE_RL_FLOAT32_IEEE 0 NO_COMPU_METHOD -3.402823466e+38 3.402823466e+38 MATRIX_DIM 3 1 1 SYMBOL_LINK "Rte_CalprmRom_CalRegn01Inin00_DEFAULT_RTE_CALPRM_GROUP.TEstimnCorrnTSi_Ary1D" 0 DISPLAY_IDENTIFIER TEstimn.CalibrationPorts.TEstimnCorrnTSi.Ary1D /end CHARACTERISTIC
/begin CHARACTERISTIC TEstimn.TEstimnCuAmbLpFilFrq.Val "MICROSAR RTE" VALUE 0x0 RTE_RL_FLOAT32_IEEE 0 NO_COMPU_METHOD -3.402823466e+38 3.402823466e+38 SYMBOL_LINK "Rte_CalprmRom_CalRegn01Inin00_DEFAULT_RTE_CALPRM_GROUP.TEstimnCuAmbLpFilFrq_Val" 0 DISPLAY_IDENTIFIER TEstimn.CalibrationPorts.TEstimnCuAmbLpFilFrq.Val /end CHARACTERISTIC
/begin CHARACTERISTIC TEstimn.TEstimnCuAmbLpFilFrqDualEcuFltMtgtn.Val "MICROSAR RTE" VALUE 0x0 RTE_RL_FLOAT32_IEEE 0 NO_COMPU_METHOD -3.402823466e+38 3.402823466e+38 SYMBOL_LINK "Rte_CalprmRom_CalRegn01Inin00_DEFAULT_RTE_CALPRM_GROUP.TEstimnCuAmbLpFilFrqDualEcuFltMtgtn_Val" 0 DISPLAY_IDENTIFIER TEstimn.CalibrationPorts.TEstimnCuAmbLpFilFrqDualEcuFltMtgtn.Val /end CHARACTERISTIC
/begin CHARACTERISTIC TEstimn.TEstimnCuAmbLpFilFrqFetMtgtnEna.Val "MICROSAR RTE" VALUE 0x0 RTE_RL_FLOAT32_IEEE 0 NO_COMPU_METHOD -3.402823466e+38 3.402823466e+38 SYMBOL_LINK "Rte_CalprmRom_CalRegn01Inin00_DEFAULT_RTE_CALPRM_GROUP.TEstimnCuAmbLpFilFrqFetMtgtnEna_Val" 0 DISPLAY_IDENTIFIER TEstimn.CalibrationPorts.TEstimnCuAmbLpFilFrqFetMtgtnEna.Val /end CHARACTERISTIC
/begin CHARACTERISTIC TEstimn.TEstimnCuAmbMplr.Ary1D "MICROSAR RTE" VAL_BLK 0x0 RTE_RL_FLOAT32_IEEE 0 NO_COMPU_METHOD -3.402823466e+38 3.402823466e+38 MATRIX_DIM 3 1 1 SYMBOL_LINK "Rte_CalprmRom_CalRegn01Inin00_DEFAULT_RTE_CALPRM_GROUP.TEstimnCuAmbMplr_Ary1D" 0 DISPLAY_IDENTIFIER TEstimn.CalibrationPorts.TEstimnCuAmbMplr.Ary1D /end CHARACTERISTIC
/begin CHARACTERISTIC TEstimn.TEstimnCuCorrnLim.Ary1D "MICROSAR RTE" VAL_BLK 0x0 RTE_RL_FLOAT32_IEEE 0 NO_COMPU_METHOD -3.402823466e+38 3.402823466e+38 MATRIX_DIM 3 1 1 SYMBOL_LINK "Rte_CalprmRom_CalRegn01Inin00_DEFAULT_RTE_CALPRM_GROUP.TEstimnCuCorrnLim_Ary1D" 0 DISPLAY_IDENTIFIER TEstimn.CalibrationPorts.TEstimnCuCorrnLim.Ary1D /end CHARACTERISTIC
/begin CHARACTERISTIC TEstimn.TEstimnCuLLFilCoeffA1.Ary1D "MICROSAR RTE" VAL_BLK 0x0 RTE_RL_FLOAT32_IEEE 0 NO_COMPU_METHOD -3.402823466e+38 3.402823466e+38 MATRIX_DIM 3 1 1 SYMBOL_LINK "Rte_CalprmRom_CalRegn01Inin00_DEFAULT_RTE_CALPRM_GROUP.TEstimnCuLLFilCoeffA1_Ary1D" 0 DISPLAY_IDENTIFIER TEstimn.CalibrationPorts.TEstimnCuLLFilCoeffA1.Ary1D /end CHARACTERISTIC
/begin CHARACTERISTIC TEstimn.TEstimnCuLLFilCoeffB0.Ary1D "MICROSAR RTE" VAL_BLK 0x0 RTE_RL_FLOAT32_IEEE 0 NO_COMPU_METHOD -3.402823466e+38 3.402823466e+38 MATRIX_DIM 3 1 1 SYMBOL_LINK "Rte_CalprmRom_CalRegn01Inin00_DEFAULT_RTE_CALPRM_GROUP.TEstimnCuLLFilCoeffB0_Ary1D" 0 DISPLAY_IDENTIFIER TEstimn.CalibrationPorts.TEstimnCuLLFilCoeffB0.Ary1D /end CHARACTERISTIC
/begin CHARACTERISTIC TEstimn.TEstimnCuLLFilCoeffB1.Ary1D "MICROSAR RTE" VAL_BLK 0x0 RTE_RL_FLOAT32_IEEE 0 NO_COMPU_METHOD -3.402823466e+38 3.402823466e+38 MATRIX_DIM 3 1 1 SYMBOL_LINK "Rte_CalprmRom_CalRegn01Inin00_DEFAULT_RTE_CALPRM_GROUP.TEstimnCuLLFilCoeffB1_Ary1D" 0 DISPLAY_IDENTIFIER TEstimn.CalibrationPorts.TEstimnCuLLFilCoeffB1.Ary1D /end CHARACTERISTIC
/begin CHARACTERISTIC TEstimn.TEstimnEngTSca.Ary1D "MICROSAR RTE" VAL_BLK 0x0 RTE_RL_FLOAT32_IEEE 0 NO_COMPU_METHOD -3.402823466e+38 3.402823466e+38 MATRIX_DIM 3 1 1 SYMBOL_LINK "Rte_CalprmRom_CalRegn01Inin00_DEFAULT_RTE_CALPRM_GROUP.TEstimnEngTSca_Ary1D" 0 DISPLAY_IDENTIFIER TEstimn.CalibrationPorts.TEstimnEngTSca.Ary1D /end CHARACTERISTIC
/begin CHARACTERISTIC TEstimn.TEstimnIgnOffCtrlEna.Logl "MICROSAR RTE" VALUE 0x0 RTE_RL_BOOLEAN 0 RTE_CM_BOOLEAN 0 255 SYMBOL_LINK "Rte_CalprmRom_CalRegn01Cmn_DEFAULT_RTE_CALPRM_GROUP.TEstimnIgnOffCtrlEna_Logl" 0 DISPLAY_IDENTIFIER TEstimn.CalibrationPorts.TEstimnIgnOffCtrlEna.Logl /end CHARACTERISTIC
/begin CHARACTERISTIC TEstimn.TEstimnIgnOffMsgWaitTi.Val "MICROSAR RTE" VALUE 0x0 RTE_RL_FLOAT32_IEEE 0 NO_COMPU_METHOD -3.402823466e+38 3.402823466e+38 SYMBOL_LINK "Rte_CalprmRom_CalRegn01Cmn_DEFAULT_RTE_CALPRM_GROUP.TEstimnIgnOffMsgWaitTi_Val" 0 DISPLAY_IDENTIFIER TEstimn.CalibrationPorts.TEstimnIgnOffMsgWaitTi.Val /end CHARACTERISTIC
/begin CHARACTERISTIC TEstimn.TEstimnMagAmbLpFilFrq.Val "MICROSAR RTE" VALUE 0x0 RTE_RL_FLOAT32_IEEE 0 NO_COMPU_METHOD -3.402823466e+38 3.402823466e+38 SYMBOL_LINK "Rte_CalprmRom_CalRegn01Inin00_DEFAULT_RTE_CALPRM_GROUP.TEstimnMagAmbLpFilFrq_Val" 0 DISPLAY_IDENTIFIER TEstimn.CalibrationPorts.TEstimnMagAmbLpFilFrq.Val /end CHARACTERISTIC
/begin CHARACTERISTIC TEstimn.TEstimnMagAmbLpFilFrqDualEcuFltMtgtn.Val "MICROSAR RTE" VALUE 0x0 RTE_RL_FLOAT32_IEEE 0 NO_COMPU_METHOD -3.402823466e+38 3.402823466e+38 SYMBOL_LINK "Rte_CalprmRom_CalRegn01Inin00_DEFAULT_RTE_CALPRM_GROUP.TEstimnMagAmbLpFilFrqDualEcuFltMtgtn_Val" 0 DISPLAY_IDENTIFIER TEstimn.CalibrationPorts.TEstimnMagAmbLpFilFrqDualEcuFltMtgtn.Val /end CHARACTERISTIC
/begin CHARACTERISTIC TEstimn.TEstimnMagAmbLpFilFrqFetMtgtnEna.Val "MICROSAR RTE" VALUE 0x0 RTE_RL_FLOAT32_IEEE 0 NO_COMPU_METHOD -3.402823466e+38 3.402823466e+38 SYMBOL_LINK "Rte_CalprmRom_CalRegn01Inin00_DEFAULT_RTE_CALPRM_GROUP.TEstimnMagAmbLpFilFrqFetMtgtnEna_Val" 0 DISPLAY_IDENTIFIER TEstimn.CalibrationPorts.TEstimnMagAmbLpFilFrqFetMtgtnEna.Val /end CHARACTERISTIC
/begin CHARACTERISTIC TEstimn.TEstimnMagAmbMplr.Ary1D "MICROSAR RTE" VAL_BLK 0x0 RTE_RL_FLOAT32_IEEE 0 NO_COMPU_METHOD -3.402823466e+38 3.402823466e+38 MATRIX_DIM 3 1 1 SYMBOL_LINK "Rte_CalprmRom_CalRegn01Rt00_DEFAULT_RTE_CALPRM_GROUP.TEstimnMagAmbMplr_Ary1D" 0 DISPLAY_IDENTIFIER TEstimn.CalibrationPorts.TEstimnMagAmbMplr.Ary1D /end CHARACTERISTIC
/begin CHARACTERISTIC TEstimn.TEstimnMagCorrnLim.Ary1D "MICROSAR RTE" VAL_BLK 0x0 RTE_RL_FLOAT32_IEEE 0 NO_COMPU_METHOD -3.402823466e+38 3.402823466e+38 MATRIX_DIM 3 1 1 SYMBOL_LINK "Rte_CalprmRom_CalRegn01Inin00_DEFAULT_RTE_CALPRM_GROUP.TEstimnMagCorrnLim_Ary1D" 0 DISPLAY_IDENTIFIER TEstimn.CalibrationPorts.TEstimnMagCorrnLim.Ary1D /end CHARACTERISTIC
/begin CHARACTERISTIC TEstimn.TEstimnMagLLFilCoeffA1.Ary1D "MICROSAR RTE" VAL_BLK 0x0 RTE_RL_FLOAT32_IEEE 0 NO_COMPU_METHOD -3.402823466e+38 3.402823466e+38 MATRIX_DIM 3 1 1 SYMBOL_LINK "Rte_CalprmRom_CalRegn01Inin00_DEFAULT_RTE_CALPRM_GROUP.TEstimnMagLLFilCoeffA1_Ary1D" 0 DISPLAY_IDENTIFIER TEstimn.CalibrationPorts.TEstimnMagLLFilCoeffA1.Ary1D /end CHARACTERISTIC
/begin CHARACTERISTIC TEstimn.TEstimnMagLLFilCoeffB0.Ary1D "MICROSAR RTE" VAL_BLK 0x0 RTE_RL_FLOAT32_IEEE 0 NO_COMPU_METHOD -3.402823466e+38 3.402823466e+38 MATRIX_DIM 3 1 1 SYMBOL_LINK "Rte_CalprmRom_CalRegn01Inin00_DEFAULT_RTE_CALPRM_GROUP.TEstimnMagLLFilCoeffB0_Ary1D" 0 DISPLAY_IDENTIFIER TEstimn.CalibrationPorts.TEstimnMagLLFilCoeffB0.Ary1D /end CHARACTERISTIC
/begin CHARACTERISTIC TEstimn.TEstimnMagLLFilCoeffB1.Ary1D "MICROSAR RTE" VAL_BLK 0x0 RTE_RL_FLOAT32_IEEE 0 NO_COMPU_METHOD -3.402823466e+38 3.402823466e+38 MATRIX_DIM 3 1 1 SYMBOL_LINK "Rte_CalprmRom_CalRegn01Inin00_DEFAULT_RTE_CALPRM_GROUP.TEstimnMagLLFilCoeffB1_Ary1D" 0 DISPLAY_IDENTIFIER TEstimn.CalibrationPorts.TEstimnMagLLFilCoeffB1.Ary1D /end CHARACTERISTIC
/begin CHARACTERISTIC TEstimn.TEstimnSiAmbLpFilFrq.Val "MICROSAR RTE" VALUE 0x0 RTE_RL_FLOAT32_IEEE 0 NO_COMPU_METHOD -3.402823466e+38 3.402823466e+38 SYMBOL_LINK "Rte_CalprmRom_CalRegn01Inin00_DEFAULT_RTE_CALPRM_GROUP.TEstimnSiAmbLpFilFrq_Val" 0 DISPLAY_IDENTIFIER TEstimn.CalibrationPorts.TEstimnSiAmbLpFilFrq.Val /end CHARACTERISTIC
/begin CHARACTERISTIC TEstimn.TEstimnSiAmbLpFilFrqDualEcuFltMtgtn.Val "MICROSAR RTE" VALUE 0x0 RTE_RL_FLOAT32_IEEE 0 NO_COMPU_METHOD -3.402823466e+38 3.402823466e+38 SYMBOL_LINK "Rte_CalprmRom_CalRegn01Inin00_DEFAULT_RTE_CALPRM_GROUP.TEstimnSiAmbLpFilFrqDualEcuFltMtgtn_Val" 0 DISPLAY_IDENTIFIER TEstimn.CalibrationPorts.TEstimnSiAmbLpFilFrqDualEcuFltMtgtn.Val /end CHARACTERISTIC
/begin CHARACTERISTIC TEstimn.TEstimnSiAmbLpFilFrqFetMtgtnEna.Val "MICROSAR RTE" VALUE 0x0 RTE_RL_FLOAT32_IEEE 0 NO_COMPU_METHOD -3.402823466e+38 3.402823466e+38 SYMBOL_LINK "Rte_CalprmRom_CalRegn01Inin00_DEFAULT_RTE_CALPRM_GROUP.TEstimnSiAmbLpFilFrqFetMtgtnEna_Val" 0 DISPLAY_IDENTIFIER TEstimn.CalibrationPorts.TEstimnSiAmbLpFilFrqFetMtgtnEna.Val /end CHARACTERISTIC
/begin CHARACTERISTIC TEstimn.TEstimnSiAmbMplr.Ary1D "MICROSAR RTE" VAL_BLK 0x0 RTE_RL_FLOAT32_IEEE 0 NO_COMPU_METHOD -3.402823466e+38 3.402823466e+38 MATRIX_DIM 3 1 1 SYMBOL_LINK "Rte_CalprmRom_CalRegn01Inin00_DEFAULT_RTE_CALPRM_GROUP.TEstimnSiAmbMplr_Ary1D" 0 DISPLAY_IDENTIFIER TEstimn.CalibrationPorts.TEstimnSiAmbMplr.Ary1D /end CHARACTERISTIC
/begin CHARACTERISTIC TEstimn.TEstimnSiCorrnLim.Ary1D "MICROSAR RTE" VAL_BLK 0x0 RTE_RL_FLOAT32_IEEE 0 NO_COMPU_METHOD -3.402823466e+38 3.402823466e+38 MATRIX_DIM 3 1 1 SYMBOL_LINK "Rte_CalprmRom_CalRegn01Inin00_DEFAULT_RTE_CALPRM_GROUP.TEstimnSiCorrnLim_Ary1D" 0 DISPLAY_IDENTIFIER TEstimn.CalibrationPorts.TEstimnSiCorrnLim.Ary1D /end CHARACTERISTIC
/begin CHARACTERISTIC TEstimn.TEstimnSiLLFilCoeffA1.Ary1D "MICROSAR RTE" VAL_BLK 0x0 RTE_RL_FLOAT32_IEEE 0 NO_COMPU_METHOD -3.402823466e+38 3.402823466e+38 MATRIX_DIM 3 1 1 SYMBOL_LINK "Rte_CalprmRom_CalRegn01Inin00_DEFAULT_RTE_CALPRM_GROUP.TEstimnSiLLFilCoeffA1_Ary1D" 0 DISPLAY_IDENTIFIER TEstimn.CalibrationPorts.TEstimnSiLLFilCoeffA1.Ary1D /end CHARACTERISTIC
/begin CHARACTERISTIC TEstimn.TEstimnSiLLFilCoeffB0.Ary1D "MICROSAR RTE" VAL_BLK 0x0 RTE_RL_FLOAT32_IEEE 0 NO_COMPU_METHOD -3.402823466e+38 3.402823466e+38 MATRIX_DIM 3 1 1 SYMBOL_LINK "Rte_CalprmRom_CalRegn01Inin00_DEFAULT_RTE_CALPRM_GROUP.TEstimnSiLLFilCoeffB0_Ary1D" 0 DISPLAY_IDENTIFIER TEstimn.CalibrationPorts.TEstimnSiLLFilCoeffB0.Ary1D /end CHARACTERISTIC
/begin CHARACTERISTIC TEstimn.TEstimnSiLLFilCoeffB1.Ary1D "MICROSAR RTE" VAL_BLK 0x0 RTE_RL_FLOAT32_IEEE 0 NO_COMPU_METHOD -3.402823466e+38 3.402823466e+38 MATRIX_DIM 3 1 1 SYMBOL_LINK "Rte_CalprmRom_CalRegn01Inin00_DEFAULT_RTE_CALPRM_GROUP.TEstimnSiLLFilCoeffB1_Ary1D" 0 DISPLAY_IDENTIFIER TEstimn.CalibrationPorts.TEstimnSiLLFilCoeffB1.Ary1D /end CHARACTERISTIC
/begin CHARACTERISTIC TEstimn.TEstimnTauAssiMech.Ary1D "MICROSAR RTE" VAL_BLK 0x0 RTE_RL_FLOAT32_IEEE 0 NO_COMPU_METHOD -3.402823466e+38 3.402823466e+38 MATRIX_DIM 3 1 1 SYMBOL_LINK "Rte_CalprmRom_CalRegn01Inin00_DEFAULT_RTE_CALPRM_GROUP.TEstimnTauAssiMech_Ary1D" 0 DISPLAY_IDENTIFIER TEstimn.CalibrationPorts.TEstimnTauAssiMech.Ary1D /end CHARACTERISTIC
/begin CHARACTERISTIC TEstimn.TEstimnTauCu.Ary1D "MICROSAR RTE" VAL_BLK 0x0 RTE_RL_FLOAT32_IEEE 0 NO_COMPU_METHOD -3.402823466e+38 3.402823466e+38 MATRIX_DIM 3 1 1 SYMBOL_LINK "Rte_CalprmRom_CalRegn01Inin00_DEFAULT_RTE_CALPRM_GROUP.TEstimnTauCu_Ary1D" 0 DISPLAY_IDENTIFIER TEstimn.CalibrationPorts.TEstimnTauCu.Ary1D /end CHARACTERISTIC
/begin CHARACTERISTIC TEstimn.TEstimnTauMag.Ary1D "MICROSAR RTE" VAL_BLK 0x0 RTE_RL_FLOAT32_IEEE 0 NO_COMPU_METHOD -3.402823466e+38 3.402823466e+38 MATRIX_DIM 3 1 1 SYMBOL_LINK "Rte_CalprmRom_CalRegn01Inin00_DEFAULT_RTE_CALPRM_GROUP.TEstimnTauMag_Ary1D" 0 DISPLAY_IDENTIFIER TEstimn.CalibrationPorts.TEstimnTauMag.Ary1D /end CHARACTERISTIC
/begin CHARACTERISTIC TEstimn.TEstimnTauSi.Ary1D "MICROSAR RTE" VAL_BLK 0x0 RTE_RL_FLOAT32_IEEE 0 NO_COMPU_METHOD -3.402823466e+38 3.402823466e+38 MATRIX_DIM 3 1 1 SYMBOL_LINK "Rte_CalprmRom_CalRegn01Inin00_DEFAULT_RTE_CALPRM_GROUP.TEstimnTauSi_Ary1D" 0 DISPLAY_IDENTIFIER TEstimn.CalibrationPorts.TEstimnTauSi.Ary1D /end CHARACTERISTIC
/begin CHARACTERISTIC TEstimn.TEstimnWghtAvrgTDi.Ary1D "MICROSAR RTE" VAL_BLK 0x0 RTE_RL_BOOLEAN 0 RTE_CM_BOOLEAN 0 255 MATRIX_DIM 3 1 1 SYMBOL_LINK "Rte_CalprmRom_CalRegn01Inin00_DEFAULT_RTE_CALPRM_GROUP.TEstimnWghtAvrgTDi_Ary1D" 0 DISPLAY_IDENTIFIER TEstimn.CalibrationPorts.TEstimnWghtAvrgTDi.Ary1D /end CHARACTERISTIC
/begin CHARACTERISTIC TqLoa.TqLoaDrvrTqNom.Val "MICROSAR RTE" VALUE 0x0 RTE_RL_FLOAT32_IEEE 0 NO_COMPU_METHOD -3.402823466e+38 3.402823466e+38 SYMBOL_LINK "Rte_CalprmRom_CalRegn01Cmn_DEFAULT_RTE_CALPRM_GROUP.TqLoaDrvrTqNom_Val" 0 DISPLAY_IDENTIFIER TqLoa.CalibrationPorts.TqLoaDrvrTqNom.Val /end CHARACTERISTIC
/begin CHARACTERISTIC TqLoa.TqLoaMotTqCmdLim.Val "MICROSAR RTE" VALUE 0x0 RTE_RL_FLOAT32_IEEE 0 NO_COMPU_METHOD -3.402823466e+38 3.402823466e+38 SYMBOL_LINK "Rte_CalprmRom_CalRegn01Cmn_DEFAULT_RTE_CALPRM_GROUP.TqLoaMotTqCmdLim_Val" 0 DISPLAY_IDENTIFIER TqLoa.CalibrationPorts.TqLoaMotTqCmdLim.Val /end CHARACTERISTIC
/begin CHARACTERISTIC TqLoa.TqLoaMotVelAndTqBasdScaFacFallRate.Val "MICROSAR RTE" VALUE 0x0 RTE_RL_FLOAT32_IEEE 0 NO_COMPU_METHOD -3.402823466e+38 3.402823466e+38 SYMBOL_LINK "Rte_CalprmRom_CalRegn01Cmn_DEFAULT_RTE_CALPRM_GROUP.TqLoaMotVelAndTqBasdScaFacFallRate_Val" 0 DISPLAY_IDENTIFIER TqLoa.CalibrationPorts.TqLoaMotVelAndTqBasdScaFacFallRate.Val /end CHARACTERISTIC
/begin CHARACTERISTIC TqLoa.TqLoaMotVelAndTqBasdScaFacMax.Val "MICROSAR RTE" VALUE 0x0 RTE_RL_FLOAT32_IEEE 0 NO_COMPU_METHOD -3.402823466e+38 3.402823466e+38 SYMBOL_LINK "Rte_CalprmRom_CalRegn01Cmn_DEFAULT_RTE_CALPRM_GROUP.TqLoaMotVelAndTqBasdScaFacMax_Val" 0 DISPLAY_IDENTIFIER TqLoa.CalibrationPorts.TqLoaMotVelAndTqBasdScaFacMax.Val /end CHARACTERISTIC
/begin CHARACTERISTIC TqLoa.TqLoaMotVelAndTqBasdScaFacMin.Val "MICROSAR RTE" VALUE 0x0 RTE_RL_FLOAT32_IEEE 0 NO_COMPU_METHOD -3.402823466e+38 3.402823466e+38 SYMBOL_LINK "Rte_CalprmRom_CalRegn01Cmn_DEFAULT_RTE_CALPRM_GROUP.TqLoaMotVelAndTqBasdScaFacMin_Val" 0 DISPLAY_IDENTIFIER TqLoa.CalibrationPorts.TqLoaMotVelAndTqBasdScaFacMin.Val /end CHARACTERISTIC
/begin CHARACTERISTIC TqLoa.TqLoaMotVelAndTqBasdScaFacRiseRate.Val "MICROSAR RTE" VALUE 0x0 RTE_RL_FLOAT32_IEEE 0 NO_COMPU_METHOD -3.402823466e+38 3.402823466e+38 SYMBOL_LINK "Rte_CalprmRom_CalRegn01Cmn_DEFAULT_RTE_CALPRM_GROUP.TqLoaMotVelAndTqBasdScaFacRiseRate_Val" 0 DISPLAY_IDENTIFIER TqLoa.CalibrationPorts.TqLoaMotVelAndTqBasdScaFacRiseRate.Val /end CHARACTERISTIC
/begin CHARACTERISTIC TqLoa.TqLoaMotVelMgnThd.Val "MICROSAR RTE" VALUE 0x0 RTE_RL_FLOAT32_IEEE 0 NO_COMPU_METHOD -3.402823466e+38 3.402823466e+38 SYMBOL_LINK "Rte_CalprmRom_CalRegn01Cmn_DEFAULT_RTE_CALPRM_GROUP.TqLoaMotVelMgnThd_Val" 0 DISPLAY_IDENTIFIER TqLoa.CalibrationPorts.TqLoaMotVelMgnThd.Val /end CHARACTERISTIC
/begin CHARACTERISTIC TqLoa.TqLoaTqCmdLimY.Ary1D "MICROSAR RTE" VAL_BLK 0x0 RTE_RL_UWORD 0 NO_COMPU_METHOD 0 65535 MATRIX_DIM 8 1 1 SYMBOL_LINK "Rte_CalprmRom_CalRegn01Cmn_DEFAULT_RTE_CALPRM_GROUP.TqLoaTqCmdLimY_Ary1D" 0 DISPLAY_IDENTIFIER TqLoa.CalibrationPorts.TqLoaTqCmdLimY.Ary1D /end CHARACTERISTIC
/begin CHARACTERISTIC TqLoa.TqLoaTqCmdMgnThd.Val "MICROSAR RTE" VALUE 0x0 RTE_RL_FLOAT32_IEEE 0 NO_COMPU_METHOD -3.402823466e+38 3.402823466e+38 SYMBOL_LINK "Rte_CalprmRom_CalRegn01Cmn_DEFAULT_RTE_CALPRM_GROUP.TqLoaTqCmdMgnThd_Val" 0 DISPLAY_IDENTIFIER TqLoa.CalibrationPorts.TqLoaTqCmdMgnThd.Val /end CHARACTERISTIC
/begin CHARACTERISTIC TqLoa.TqLoaVehLatADifScaFacFallRate.Val "MICROSAR RTE" VALUE 0x0 RTE_RL_FLOAT32_IEEE 0 NO_COMPU_METHOD -3.402823466e+38 3.402823466e+38 SYMBOL_LINK "Rte_CalprmRom_CalRegn01Cmn_DEFAULT_RTE_CALPRM_GROUP.TqLoaVehLatADifScaFacFallRate_Val" 0 DISPLAY_IDENTIFIER TqLoa.CalibrationPorts.TqLoaVehLatADifScaFacFallRate.Val /end CHARACTERISTIC
/begin CHARACTERISTIC TqLoa.TqLoaVehLatADifScaFacRiseRate.Val "MICROSAR RTE" VALUE 0x0 RTE_RL_FLOAT32_IEEE 0 NO_COMPU_METHOD -3.402823466e+38 3.402823466e+38 SYMBOL_LINK "Rte_CalprmRom_CalRegn01Cmn_DEFAULT_RTE_CALPRM_GROUP.TqLoaVehLatADifScaFacRiseRate_Val" 0 DISPLAY_IDENTIFIER TqLoa.CalibrationPorts.TqLoaVehLatADifScaFacRiseRate.Val /end CHARACTERISTIC
/begin CHARACTERISTIC TqLoa.TqLoaVehLatADifScaFacX.Ary1D "MICROSAR RTE" VAL_BLK 0x0 RTE_RL_UWORD 0 NO_COMPU_METHOD 0 65535 MATRIX_DIM 4 1 1 SYMBOL_LINK "Rte_CalprmRom_CalRegn01Cmn_DEFAULT_RTE_CALPRM_GROUP.TqLoaVehLatADifScaFacX_Ary1D" 0 DISPLAY_IDENTIFIER TqLoa.CalibrationPorts.TqLoaVehLatADifScaFacX.Ary1D /end CHARACTERISTIC
/begin CHARACTERISTIC TqLoa.TqLoaVehLatADifScaFacY.Ary2D "MICROSAR RTE" VAL_BLK 0x0 RTE_RL_UWORD 0 NO_COMPU_METHOD 0 65535 MATRIX_DIM 4 8 1 SYMBOL_LINK "Rte_CalprmRom_CalRegn01Cmn_DEFAULT_RTE_CALPRM_GROUP.TqLoaVehLatADifScaFacY_Ary2D" 0 DISPLAY_IDENTIFIER TqLoa.CalibrationPorts.TqLoaVehLatADifScaFacY.Ary2D /end CHARACTERISTIC
/begin CHARACTERISTIC TqLoa.TqLoaVehLatAEstimnFilFrq.Val "MICROSAR RTE" VALUE 0x0 RTE_RL_FLOAT32_IEEE 0 NO_COMPU_METHOD -3.402823466e+38 3.402823466e+38 SYMBOL_LINK "Rte_CalprmRom_CalRegn01Cmn_DEFAULT_RTE_CALPRM_GROUP.TqLoaVehLatAEstimnFilFrq_Val" 0 DISPLAY_IDENTIFIER TqLoa.CalibrationPorts.TqLoaVehLatAEstimnFilFrq.Val /end CHARACTERISTIC
/begin CHARACTERISTIC TqLoa.TqLoaVehLatAGainY.Ary1D "MICROSAR RTE" VAL_BLK 0x0 RTE_RL_UWORD 0 NO_COMPU_METHOD 0 65535 MATRIX_DIM 8 1 1 SYMBOL_LINK "Rte_CalprmRom_CalRegn01Cmn_DEFAULT_RTE_CALPRM_GROUP.TqLoaVehLatAGainY_Ary1D" 0 DISPLAY_IDENTIFIER TqLoa.CalibrationPorts.TqLoaVehLatAGainY.Ary1D /end CHARACTERISTIC
/begin CHARACTERISTIC TqLoa.TqLoaVehSpdScaFacX.Ary1D "MICROSAR RTE" VAL_BLK 0x0 RTE_RL_UWORD 0 NO_COMPU_METHOD 0 65535 MATRIX_DIM 5 1 1 SYMBOL_LINK "Rte_CalprmRom_CalRegn01Cmn_DEFAULT_RTE_CALPRM_GROUP.TqLoaVehSpdScaFacX_Ary1D" 0 DISPLAY_IDENTIFIER TqLoa.CalibrationPorts.TqLoaVehSpdScaFacX.Ary1D /end CHARACTERISTIC
/begin CHARACTERISTIC TqLoa.TqLoaVehSpdScaFacY.Ary1D "MICROSAR RTE" VAL_BLK 0x0 RTE_RL_UWORD 0 NO_COMPU_METHOD 0 65535 MATRIX_DIM 5 1 1 SYMBOL_LINK "Rte_CalprmRom_CalRegn01Cmn_DEFAULT_RTE_CALPRM_GROUP.TqLoaVehSpdScaFacY_Ary1D" 0 DISPLAY_IDENTIFIER TqLoa.CalibrationPorts.TqLoaVehSpdScaFacY.Ary1D /end CHARACTERISTIC
/begin CHARACTERISTIC TqLoa.TqLoaVehSpdX.Ary1D "MICROSAR RTE" VAL_BLK 0x0 RTE_RL_UWORD 0 NO_COMPU_METHOD 0 65535 MATRIX_DIM 8 1 1 SYMBOL_LINK "Rte_CalprmRom_CalRegn01Cmn_DEFAULT_RTE_CALPRM_GROUP.TqLoaVehSpdX_Ary1D" 0 DISPLAY_IDENTIFIER TqLoa.CalibrationPorts.TqLoaVehSpdX.Ary1D /end CHARACTERISTIC
/begin CHARACTERISTIC TqLoa.TqLoaVehSteerRat.Val "MICROSAR RTE" VALUE 0x0 RTE_RL_FLOAT32_IEEE 0 NO_COMPU_METHOD -3.402823466e+38 3.402823466e+38 SYMBOL_LINK "Rte_CalprmRom_CalRegn01Cmn_DEFAULT_RTE_CALPRM_GROUP.TqLoaVehSteerRat_Val" 0 DISPLAY_IDENTIFIER TqLoa.CalibrationPorts.TqLoaVehSteerRat.Val /end CHARACTERISTIC
/begin CHARACTERISTIC TqLoa.TqLoaVehUnderSteerGrdt.Val "MICROSAR RTE" VALUE 0x0 RTE_RL_FLOAT32_IEEE 0 NO_COMPU_METHOD -3.402823466e+38 3.402823466e+38 SYMBOL_LINK "Rte_CalprmRom_CalRegn01Cmn_DEFAULT_RTE_CALPRM_GROUP.TqLoaVehUnderSteerGrdt_Val" 0 DISPLAY_IDENTIFIER TqLoa.CalibrationPorts.TqLoaVehUnderSteerGrdt.Val /end CHARACTERISTIC
/begin CHARACTERISTIC TqLoa.TqLoaVehWhlBas.Val "MICROSAR RTE" VALUE 0x0 RTE_RL_FLOAT32_IEEE 0 NO_COMPU_METHOD -3.402823466e+38 3.402823466e+38 SYMBOL_LINK "Rte_CalprmRom_CalRegn01Cmn_DEFAULT_RTE_CALPRM_GROUP.TqLoaVehWhlBas_Val" 0 DISPLAY_IDENTIFIER TqLoa.CalibrationPorts.TqLoaVehWhlBas.Val /end CHARACTERISTIC
/begin CHARACTERISTIC TunSelnAuthy.TunSelnAuthyHwTqY.Ary1D "MICROSAR RTE" VAL_BLK 0x0 RTE_RL_UWORD 0 NO_COMPU_METHOD 0 65535 MATRIX_DIM 6 1 1 SYMBOL_LINK "Rte_CalprmRom_CalRegn01CmnGroupA_DEFAULT_RTE_CALPRM_GROUP.TunSelnAuthyHwTqY_Ary1D" 0 DISPLAY_IDENTIFIER TunSelnAuthy.CalibrationPorts.TunSelnAuthyHwTqY.Ary1D /end CHARACTERISTIC
/begin CHARACTERISTIC TunSelnAuthy.TunSelnAuthyHwVelY.Ary1D "MICROSAR RTE" VAL_BLK 0x0 RTE_RL_UWORD 0 NO_COMPU_METHOD 0 65535 MATRIX_DIM 6 1 1 SYMBOL_LINK "Rte_CalprmRom_CalRegn01CmnGroupA_DEFAULT_RTE_CALPRM_GROUP.TunSelnAuthyHwVelY_Ary1D" 0 DISPLAY_IDENTIFIER TunSelnAuthy.CalibrationPorts.TunSelnAuthyHwVelY.Ary1D /end CHARACTERISTIC
/begin CHARACTERISTIC TunSelnAuthy.TunSelnAuthyTunSelnRtDiCmd.Logl "MICROSAR RTE" VALUE 0x0 RTE_RL_BOOLEAN 0 RTE_CM_BOOLEAN 0 255 SYMBOL_LINK "Rte_CalprmRom_CalRegn01CmnGroupA_DEFAULT_RTE_CALPRM_GROUP.TunSelnAuthyTunSelnRtDiCmd_Logl" 0 DISPLAY_IDENTIFIER TunSelnAuthy.CalibrationPorts.TunSelnAuthyTunSelnRtDiCmd.Logl /end CHARACTERISTIC
/begin CHARACTERISTIC TunSelnAuthy.TunSelnAuthyVehSpdX.Ary1D "MICROSAR RTE" VAL_BLK 0x0 RTE_RL_UWORD 0 NO_COMPU_METHOD 0 65535 MATRIX_DIM 6 1 1 SYMBOL_LINK "Rte_CalprmRom_CalRegn01Inin00GroupA_DEFAULT_RTE_CALPRM_GROUP.TunSelnAuthyVehSpdX_Ary1D" 0 DISPLAY_IDENTIFIER TunSelnAuthy.CalibrationPorts.TunSelnAuthyVehSpdX.Ary1D /end CHARACTERISTIC
/begin CHARACTERISTIC VehSigCdng.VehSigCdngDftLatA.Val "MICROSAR RTE" VALUE 0x0 RTE_RL_FLOAT32_IEEE 0 NO_COMPU_METHOD -3.402823466e+38 3.402823466e+38 SYMBOL_LINK "Rte_CalprmRom_CalRegn01Cmn_DEFAULT_RTE_CALPRM_GROUP.VehSigCdngDftLatA_Val" 0 DISPLAY_IDENTIFIER VehSigCdng.CalibrationPorts.VehSigCdngDftLatA.Val /end CHARACTERISTIC
/begin CHARACTERISTIC VehSigCdng.VehSigCdngDftLgtA.Val "MICROSAR RTE" VALUE 0x0 RTE_RL_FLOAT32_IEEE 0 NO_COMPU_METHOD -3.402823466e+38 3.402823466e+38 SYMBOL_LINK "Rte_CalprmRom_CalRegn01Cmn_DEFAULT_RTE_CALPRM_GROUP.VehSigCdngDftLgtA_Val" 0 DISPLAY_IDENTIFIER VehSigCdng.CalibrationPorts.VehSigCdngDftLgtA.Val /end CHARACTERISTIC
/begin CHARACTERISTIC VehSigCdng.VehSigCdngDftVehSpd.Val "MICROSAR RTE" VALUE 0x0 RTE_RL_FLOAT32_IEEE 0 NO_COMPU_METHOD -3.402823466e+38 3.402823466e+38 SYMBOL_LINK "Rte_CalprmRom_CalRegn01Cmn_DEFAULT_RTE_CALPRM_GROUP.VehSigCdngDftVehSpd_Val" 0 DISPLAY_IDENTIFIER VehSigCdng.CalibrationPorts.VehSigCdngDftVehSpd.Val /end CHARACTERISTIC
/begin CHARACTERISTIC VehSigCdng.VehSigCdngDftYawRate.Val "MICROSAR RTE" VALUE 0x0 RTE_RL_FLOAT32_IEEE 0 NO_COMPU_METHOD -3.402823466e+38 3.402823466e+38 SYMBOL_LINK "Rte_CalprmRom_CalRegn01Cmn_DEFAULT_RTE_CALPRM_GROUP.VehSigCdngDftYawRate_Val" 0 DISPLAY_IDENTIFIER VehSigCdng.CalibrationPorts.VehSigCdngDftYawRate.Val /end CHARACTERISTIC
/begin CHARACTERISTIC VehSigCdng.VehSigCdngLatADifThd.Val "MICROSAR RTE" VALUE 0x0 RTE_RL_FLOAT32_IEEE 0 NO_COMPU_METHOD -3.402823466e+38 3.402823466e+38 SYMBOL_LINK "Rte_CalprmRom_CalRegn01Cmn_DEFAULT_RTE_CALPRM_GROUP.VehSigCdngLatADifThd_Val" 0 DISPLAY_IDENTIFIER VehSigCdng.CalibrationPorts.VehSigCdngLatADifThd.Val /end CHARACTERISTIC
/begin CHARACTERISTIC VehSigCdng.VehSigCdngLatAFilFrq.Val "MICROSAR RTE" VALUE 0x0 RTE_RL_FLOAT32_IEEE 0 NO_COMPU_METHOD -3.402823466e+38 3.402823466e+38 SYMBOL_LINK "Rte_CalprmRom_CalRegn01Cmn_DEFAULT_RTE_CALPRM_GROUP.VehSigCdngLatAFilFrq_Val" 0 DISPLAY_IDENTIFIER VehSigCdng.CalibrationPorts.VehSigCdngLatAFilFrq.Val /end CHARACTERISTIC
/begin CHARACTERISTIC VehSigCdng.VehSigCdngLatASlewRate.Val "MICROSAR RTE" VALUE 0x0 RTE_RL_FLOAT32_IEEE 0 NO_COMPU_METHOD -3.402823466e+38 3.402823466e+38 SYMBOL_LINK "Rte_CalprmRom_CalRegn01Inin00_DEFAULT_RTE_CALPRM_GROUP.VehSigCdngLatASlewRate_Val" 0 DISPLAY_IDENTIFIER VehSigCdng.CalibrationPorts.VehSigCdngLatASlewRate.Val /end CHARACTERISTIC
/begin CHARACTERISTIC VehSigCdng.VehSigCdngLtgADifThd.Val "MICROSAR RTE" VALUE 0x0 RTE_RL_FLOAT32_IEEE 0 NO_COMPU_METHOD -3.402823466e+38 3.402823466e+38 SYMBOL_LINK "Rte_CalprmRom_CalRegn01Cmn_DEFAULT_RTE_CALPRM_GROUP.VehSigCdngLtgADifThd_Val" 0 DISPLAY_IDENTIFIER VehSigCdng.CalibrationPorts.VehSigCdngLtgADifThd.Val /end CHARACTERISTIC
/begin CHARACTERISTIC VehSigCdng.VehSigCdngLtgASlewRate.Val "MICROSAR RTE" VALUE 0x0 RTE_RL_FLOAT32_IEEE 0 NO_COMPU_METHOD -3.402823466e+38 3.402823466e+38 SYMBOL_LINK "Rte_CalprmRom_CalRegn01Inin00_DEFAULT_RTE_CALPRM_GROUP.VehSigCdngLtgASlewRate_Val" 0 DISPLAY_IDENTIFIER VehSigCdng.CalibrationPorts.VehSigCdngLtgASlewRate.Val /end CHARACTERISTIC
/begin CHARACTERISTIC VehSigCdng.VehSigCdngVehSpdDifThd.Val "MICROSAR RTE" VALUE 0x0 RTE_RL_FLOAT32_IEEE 0 NO_COMPU_METHOD -3.402823466e+38 3.402823466e+38 SYMBOL_LINK "Rte_CalprmRom_CalRegn01Cmn_DEFAULT_RTE_CALPRM_GROUP.VehSigCdngVehSpdDifThd_Val" 0 DISPLAY_IDENTIFIER VehSigCdng.CalibrationPorts.VehSigCdngVehSpdDifThd.Val /end CHARACTERISTIC
/begin CHARACTERISTIC VehSigCdng.VehSigCdngVehSpdSlewRate.Val "MICROSAR RTE" VALUE 0x0 RTE_RL_FLOAT32_IEEE 0 NO_COMPU_METHOD -3.402823466e+38 3.402823466e+38 SYMBOL_LINK "Rte_CalprmRom_CalRegn02Inin00_DEFAULT_RTE_CALPRM_GROUP.VehSigCdngVehSpdSlewRate_Val" 0 DISPLAY_IDENTIFIER VehSigCdng.CalibrationPorts.VehSigCdngVehSpdSlewRate.Val /end CHARACTERISTIC
/begin CHARACTERISTIC VehSigCdng.VehSigCdngVehYawSlewRate.Val "MICROSAR RTE" VALUE 0x0 RTE_RL_FLOAT32_IEEE 0 NO_COMPU_METHOD -3.402823466e+38 3.402823466e+38 SYMBOL_LINK "Rte_CalprmRom_CalRegn01Cmn_DEFAULT_RTE_CALPRM_GROUP.VehSigCdngVehYawSlewRate_Val" 0 DISPLAY_IDENTIFIER VehSigCdng.CalibrationPorts.VehSigCdngVehYawSlewRate.Val /end CHARACTERISTIC
/begin CHARACTERISTIC VehSigCdng.VehSigCdngYawRateDifThd.Val "MICROSAR RTE" VALUE 0x0 RTE_RL_FLOAT32_IEEE 0 NO_COMPU_METHOD -3.402823466e+38 3.402823466e+38 SYMBOL_LINK "Rte_CalprmRom_CalRegn01Cmn_DEFAULT_RTE_CALPRM_GROUP.VehSigCdngYawRateDifThd_Val" 0 DISPLAY_IDENTIFIER VehSigCdng.CalibrationPorts.VehSigCdngYawRateDifThd.Val /end CHARACTERISTIC
/begin CHARACTERISTIC VehSpdLimr.VehSpdLimrMaxAssiX.Ary1D "MICROSAR RTE" VAL_BLK 0x0 RTE_RL_UWORD 0 NO_COMPU_METHOD 0 65535 MATRIX_DIM 5 1 1 SYMBOL_LINK "Rte_CalprmRom_CalRegn01Cmn_DEFAULT_RTE_CALPRM_GROUP.VehSpdLimrMaxAssiX_Ary1D" 0 DISPLAY_IDENTIFIER VehSpdLimr.CalibrationPorts.VehSpdLimrMaxAssiX.Ary1D /end CHARACTERISTIC
/begin CHARACTERISTIC VehSpdLimr.VehSpdLimrMaxAssiY.Ary1D "MICROSAR RTE" VAL_BLK 0x0 RTE_RL_UWORD 0 NO_COMPU_METHOD 0 65535 MATRIX_DIM 5 1 1 SYMBOL_LINK "Rte_CalprmRom_CalRegn01Cmn_DEFAULT_RTE_CALPRM_GROUP.VehSpdLimrMaxAssiY_Ary1D" 0 DISPLAY_IDENTIFIER VehSpdLimr.CalibrationPorts.VehSpdLimrMaxAssiY.Ary1D /end CHARACTERISTIC
/begin CHARACTERISTIC VehSpdLimr.VehSpdLimrPosMaxOffs1.Val "MICROSAR RTE" VALUE 0x0 RTE_RL_FLOAT32_IEEE 0 NO_COMPU_METHOD -3.402823466e+38 3.402823466e+38 SYMBOL_LINK "Rte_CalprmRom_CalRegn01Cmn_DEFAULT_RTE_CALPRM_GROUP.VehSpdLimrPosMaxOffs1_Val" 0 DISPLAY_IDENTIFIER VehSpdLimr.CalibrationPorts.VehSpdLimrPosMaxOffs1.Val /end CHARACTERISTIC
/begin CHARACTERISTIC VehSpdLimr.VehSpdLimrPosMaxOffs2.Val "MICROSAR RTE" VALUE 0x0 RTE_RL_FLOAT32_IEEE 0 NO_COMPU_METHOD -3.402823466e+38 3.402823466e+38 SYMBOL_LINK "Rte_CalprmRom_CalRegn01Cmn_DEFAULT_RTE_CALPRM_GROUP.VehSpdLimrPosMaxOffs2_Val" 0 DISPLAY_IDENTIFIER VehSpdLimr.CalibrationPorts.VehSpdLimrPosMaxOffs2.Val /end CHARACTERISTIC
/begin MEASUREMENT SysStMod.SysStReqEna.Logl "MICROSAR RTE" UBYTE RTE_CM_BOOLEAN 0 0 0 255 ECU_ADDRESS 0 SYMBOL_LINK "Rte_FordSysSt_SysStReqEna_Logl" 0 DISPLAY_IDENTIFIER SysStMod.ReceiverPorts.SysStReqEna.Logl /end MEASUREMENT
/begin MEASUREMENT SysStMod.SysStWrmIninCmpl.Logl "MICROSAR RTE" UBYTE RTE_CM_BOOLEAN 0 0 0 255 ECU_ADDRESS 0 SYMBOL_LINK "Rte_PwrUpSeq_SysStWrmIninCmpl_Logl" 0 DISPLAY_IDENTIFIER SysStMod.ReceiverPorts.SysStWrmIninCmpl.Logl /end MEASUREMENT
/begin MEASUREMENT SysStMod.dSysStModTranVect "MICROSAR RTE" UWORD NO_COMPU_METHOD 0 0 0.0 31.0 ECU_ADDRESS 0 SYMBOL_LINK "Rte_SysStMod_dSysStModTranVect" 0 DISPLAY_IDENTIFIER SysStMod.PerInstanceMemories.dSysStModTranVect /end MEASUREMENT
/begin MEASUREMENT TEstimn.AmbT.Val "MICROSAR RTE" FLOAT32_IEEE NO_COMPU_METHOD 0 0 -3.402823466e+38 3.402823466e+38 ECU_ADDRESS 0 SYMBOL_LINK "Rte_TEstimn_AmbT_Val" 0 DISPLAY_IDENTIFIER TEstimn.ReceiverPorts.AmbT.Val /end MEASUREMENT
/begin MEASUREMENT TEstimn.AmbTVld.Logl "MICROSAR RTE" UBYTE RTE_CM_BOOLEAN 0 0 0 255 ECU_ADDRESS 0 SYMBOL_LINK "Rte_TEstimn_AmbTVld_Logl" 0 DISPLAY_IDENTIFIER TEstimn.ReceiverPorts.AmbTVld.Logl /end MEASUREMENT
/begin MEASUREMENT TEstimn.AmbTVldPrev "MICROSAR RTE" UBYTE RTE_CM_BOOLEAN 0 0 0 255 ECU_ADDRESS 0 SYMBOL_LINK "Rte_TEstimn_AmbTVldPrev" 0 DISPLAY_IDENTIFIER TEstimn.PerInstanceMemories.AmbTVldPrev /end MEASUREMENT
/begin MEASUREMENT TEstimn.AssiMechFilLp.FilGain "MICROSAR RTE" FLOAT32_IEEE NO_COMPU_METHOD 0 0 -3.402823466e+38 3.402823466e+38 ECU_ADDRESS 0 SYMBOL_LINK "Rte_TEstimn_AssiMechFilLp.FilGain" 0 DISPLAY_IDENTIFIER TEstimn.PerInstanceMemories.AssiMechFilLp.FilGain /end MEASUREMENT
/begin MEASUREMENT TEstimn.AssiMechFilLp.FilSt "MICROSAR RTE" FLOAT32_IEEE NO_COMPU_METHOD 0 0 -3.402823466e+38 3.402823466e+38 ECU_ADDRESS 0 SYMBOL_LINK "Rte_TEstimn_AssiMechFilLp.FilSt" 0 DISPLAY_IDENTIFIER TEstimn.PerInstanceMemories.AssiMechFilLp.FilSt /end MEASUREMENT
/begin MEASUREMENT TEstimn.AssiMechT.Val "MICROSAR RTE" FLOAT32_IEEE NO_COMPU_METHOD 0 0 -3.402823466e+38 3.402823466e+38 ECU_ADDRESS 0 SYMBOL_LINK "Rte_TEstimn_AssiMechT_Val" 0 DISPLAY_IDENTIFIER TEstimn.SenderPorts.AssiMechT.Val /end MEASUREMENT
/begin MEASUREMENT TEstimn.AssiMechTEstimnDi.Logl "MICROSAR RTE" UBYTE RTE_CM_BOOLEAN 0 0 0 255 ECU_ADDRESS 0 SYMBOL_LINK "Rte_CmnMfgSrv_AssiMechTEstimnDi_Logl" 0 DISPLAY_IDENTIFIER TEstimn.ReceiverPorts.AssiMechTEstimnDi.Logl /end MEASUREMENT
/begin MEASUREMENT TEstimn.AssiMechTEstimnPrev "MICROSAR RTE" FLOAT32_IEEE NO_COMPU_METHOD 0 0 -3.402823466e+38 3.402823466e+38 ECU_ADDRESS 0 SYMBOL_LINK "Rte_TEstimn_AssiMechTEstimnPrev" 0 DISPLAY_IDENTIFIER TEstimn.PerInstanceMemories.AssiMechTEstimnPrev /end MEASUREMENT
/begin MEASUREMENT TEstimn.AssiMechTInitEna "MICROSAR RTE" UBYTE RTE_CM_BOOLEAN 0 0 0 255 ECU_ADDRESS 0 SYMBOL_LINK "Rte_TEstimn_AssiMechTInitEna" 0 DISPLAY_IDENTIFIER TEstimn.PerInstanceMemories.AssiMechTInitEna /end MEASUREMENT
/begin MEASUREMENT TEstimn.AssiMechTSlewLimPrev "MICROSAR RTE" FLOAT32_IEEE NO_COMPU_METHOD 0 0 -3.402823466e+38 3.402823466e+38 ECU_ADDRESS 0 SYMBOL_LINK "Rte_TEstimn_AssiMechTSlewLimPrev" 0 DISPLAY_IDENTIFIER TEstimn.PerInstanceMemories.AssiMechTSlewLimPrev /end MEASUREMENT
/begin MEASUREMENT TEstimn.CuFilLp.FilGain "MICROSAR RTE" FLOAT32_IEEE NO_COMPU_METHOD 0 0 -3.402823466e+38 3.402823466e+38 ECU_ADDRESS 0 SYMBOL_LINK "Rte_TEstimn_CuFilLp.FilGain" 0 DISPLAY_IDENTIFIER TEstimn.PerInstanceMemories.CuFilLp.FilGain /end MEASUREMENT
/begin MEASUREMENT TEstimn.CuFilLp.FilSt "MICROSAR RTE" FLOAT32_IEEE NO_COMPU_METHOD 0 0 -3.402823466e+38 3.402823466e+38 ECU_ADDRESS 0 SYMBOL_LINK "Rte_TEstimn_CuFilLp.FilSt" 0 DISPLAY_IDENTIFIER TEstimn.PerInstanceMemories.CuFilLp.FilSt /end MEASUREMENT
/begin MEASUREMENT TEstimn.CuTEstimnPrev "MICROSAR RTE" FLOAT32_IEEE NO_COMPU_METHOD 0 0 -3.402823466e+38 3.402823466e+38 ECU_ADDRESS 0 SYMBOL_LINK "Rte_TEstimn_CuTEstimnPrev" 0 DISPLAY_IDENTIFIER TEstimn.PerInstanceMemories.CuTEstimnPrev /end MEASUREMENT
/begin MEASUREMENT TEstimn.DualEcuFltMtgtnEna.Logl "MICROSAR RTE" UBYTE RTE_CM_BOOLEAN 0 0 0 255 ECU_ADDRESS 0 SYMBOL_LINK "Rte_DualCtrlrOutpMgr_DualEcuFltMtgtnEna_Logl" 0 DISPLAY_IDENTIFIER TEstimn.ReceiverPorts.DualEcuFltMtgtnEna.Logl /end MEASUREMENT
/begin MEASUREMENT TEstimn.DualEcuFltMtgtnPrev "MICROSAR RTE" UBYTE RTE_CM_BOOLEAN 0 0 0 255 ECU_ADDRESS 0 SYMBOL_LINK "Rte_TEstimn_DualEcuFltMtgtnPrev" 0 DISPLAY_IDENTIFIER TEstimn.PerInstanceMemories.DualEcuFltMtgtnPrev /end MEASUREMENT
/begin MEASUREMENT TEstimn.EcuTFild.Val "MICROSAR RTE" FLOAT32_IEEE NO_COMPU_METHOD 0 0 -3.402823466e+38 3.402823466e+38 ECU_ADDRESS 0 SYMBOL_LINK "Rte_EcuTMeas_EcuTFild_Val" 0 DISPLAY_IDENTIFIER TEstimn.ReceiverPorts.EcuTFild.Val /end MEASUREMENT
/begin MEASUREMENT TEstimn.EngOilT.Val "MICROSAR RTE" FLOAT32_IEEE NO_COMPU_METHOD 0 0 -3.402823466e+38 3.402823466e+38 ECU_ADDRESS 0 SYMBOL_LINK "Rte_TEstimn_EngOilT_Val" 0 DISPLAY_IDENTIFIER TEstimn.ReceiverPorts.EngOilT.Val /end MEASUREMENT
/begin MEASUREMENT TEstimn.EngOilTVld.Logl "MICROSAR RTE" UBYTE RTE_CM_BOOLEAN 0 0 0 255 ECU_ADDRESS 0 SYMBOL_LINK "Rte_TEstimn_EngOilTVld_Logl" 0 DISPLAY_IDENTIFIER TEstimn.ReceiverPorts.EngOilTVld.Logl /end MEASUREMENT
/begin MEASUREMENT TEstimn.EngOilTVldPrev "MICROSAR RTE" UBYTE RTE_CM_BOOLEAN 0 0 0 255 ECU_ADDRESS 0 SYMBOL_LINK "Rte_TEstimn_EngOilTVldPrev" 0 DISPLAY_IDENTIFIER TEstimn.PerInstanceMemories.EngOilTVldPrev /end MEASUREMENT
/begin MEASUREMENT TEstimn.FetMtgtnEnaPrev "MICROSAR RTE" UBYTE RTE_CM_BOOLEAN 0 0 0 255 ECU_ADDRESS 0 SYMBOL_LINK "Rte_TEstimn_FetMtgtnEnaPrev" 0 DISPLAY_IDENTIFIER TEstimn.PerInstanceMemories.FetMtgtnEnaPrev /end MEASUREMENT
/begin MEASUREMENT TEstimn.FilAssiMechLLValPwrUp "MICROSAR RTE" FLOAT32_IEEE NO_COMPU_METHOD 0 0 -3.402823466e+38 3.402823466e+38 ECU_ADDRESS 0 SYMBOL_LINK "Rte_TEstimn_FilAssiMechLLValPwrUp" 0 DISPLAY_IDENTIFIER TEstimn.PerInstanceMemories.FilAssiMechLLValPwrUp /end MEASUREMENT
/begin MEASUREMENT TEstimn.FilAssiMechLpValPwrUp "MICROSAR RTE" FLOAT32_IEEE NO_COMPU_METHOD 0 0 -3.402823466e+38 3.402823466e+38 ECU_ADDRESS 0 SYMBOL_LINK "Rte_TEstimn_FilAssiMechLpValPwrUp" 0 DISPLAY_IDENTIFIER TEstimn.PerInstanceMemories.FilAssiMechLpValPwrUp /end MEASUREMENT
/begin MEASUREMENT TEstimn.FilCuLLValPwrUp "MICROSAR RTE" FLOAT32_IEEE NO_COMPU_METHOD 0 0 -3.402823466e+38 3.402823466e+38 ECU_ADDRESS 0 SYMBOL_LINK "Rte_TEstimn_FilCuLLValPwrUp" 0 DISPLAY_IDENTIFIER TEstimn.PerInstanceMemories.FilCuLLValPwrUp /end MEASUREMENT
/begin MEASUREMENT TEstimn.FilCuLpValPwrUp "MICROSAR RTE" FLOAT32_IEEE NO_COMPU_METHOD 0 0 -3.402823466e+38 3.402823466e+38 ECU_ADDRESS 0 SYMBOL_LINK "Rte_TEstimn_FilCuLpValPwrUp" 0 DISPLAY_IDENTIFIER TEstimn.PerInstanceMemories.FilCuLpValPwrUp /end MEASUREMENT
/begin MEASUREMENT TEstimn.FilMagLLValPwrUp "MICROSAR RTE" FLOAT32_IEEE NO_COMPU_METHOD 0 0 -3.402823466e+38 3.402823466e+38 ECU_ADDRESS 0 SYMBOL_LINK "Rte_TEstimn_FilMagLLValPwrUp" 0 DISPLAY_IDENTIFIER TEstimn.PerInstanceMemories.FilMagLLValPwrUp /end MEASUREMENT
/begin MEASUREMENT TEstimn.FilMagLpValPwrUp "MICROSAR RTE" FLOAT32_IEEE NO_COMPU_METHOD 0 0 -3.402823466e+38 3.402823466e+38 ECU_ADDRESS 0 SYMBOL_LINK "Rte_TEstimn_FilMagLpValPwrUp" 0 DISPLAY_IDENTIFIER TEstimn.PerInstanceMemories.FilMagLpValPwrUp /end MEASUREMENT
/begin MEASUREMENT TEstimn.FilSiLLValPwrUp "MICROSAR RTE" FLOAT32_IEEE NO_COMPU_METHOD 0 0 -3.402823466e+38 3.402823466e+38 ECU_ADDRESS 0 SYMBOL_LINK "Rte_TEstimn_FilSiLLValPwrUp" 0 DISPLAY_IDENTIFIER TEstimn.PerInstanceMemories.FilSiLLValPwrUp /end MEASUREMENT
/begin MEASUREMENT TEstimn.FilSiLpValPwrUp "MICROSAR RTE" FLOAT32_IEEE NO_COMPU_METHOD 0 0 -3.402823466e+38 3.402823466e+38 ECU_ADDRESS 0 SYMBOL_LINK "Rte_TEstimn_FilSiLpValPwrUp" 0 DISPLAY_IDENTIFIER TEstimn.PerInstanceMemories.FilSiLpValPwrUp /end MEASUREMENT
/begin MEASUREMENT TEstimn.HwVel.Val "MICROSAR RTE" FLOAT32_IEEE NO_COMPU_METHOD 0 0 -3.402823466e+38 3.402823466e+38 ECU_ADDRESS 0 SYMBOL_LINK "Rte_HwAgSysArbn_HwVel_Val" 0 DISPLAY_IDENTIFIER TEstimn.ReceiverPorts.HwVel.Val /end MEASUREMENT
/begin MEASUREMENT TEstimn.IgnTiOff.Val "MICROSAR RTE" ULONG NO_COMPU_METHOD 0 0 0 4294967295 ECU_ADDRESS 0 SYMBOL_LINK "Rte_TEstimn_IgnTiOff_Val" 0 DISPLAY_IDENTIFIER TEstimn.ReceiverPorts.IgnTiOff.Val /end MEASUREMENT
/begin MEASUREMENT TEstimn.MagFilLp.FilGain "MICROSAR RTE" FLOAT32_IEEE NO_COMPU_METHOD 0 0 -3.402823466e+38 3.402823466e+38 ECU_ADDRESS 0 SYMBOL_LINK "Rte_TEstimn_MagFilLp.FilGain" 0 DISPLAY_IDENTIFIER TEstimn.PerInstanceMemories.MagFilLp.FilGain /end MEASUREMENT
/begin MEASUREMENT TEstimn.MagFilLp.FilSt "MICROSAR RTE" FLOAT32_IEEE NO_COMPU_METHOD 0 0 -3.402823466e+38 3.402823466e+38 ECU_ADDRESS 0 SYMBOL_LINK "Rte_TEstimn_MagFilLp.FilSt" 0 DISPLAY_IDENTIFIER TEstimn.PerInstanceMemories.MagFilLp.FilSt /end MEASUREMENT
/begin MEASUREMENT TEstimn.MagTEstimnPrev "MICROSAR RTE" FLOAT32_IEEE NO_COMPU_METHOD 0 0 -3.402823466e+38 3.402823466e+38 ECU_ADDRESS 0 SYMBOL_LINK "Rte_TEstimn_MagTEstimnPrev" 0 DISPLAY_IDENTIFIER TEstimn.PerInstanceMemories.MagTEstimnPrev /end MEASUREMENT
/begin MEASUREMENT TEstimn.MotAndThermProtnLoaMod.Val "MICROSAR RTE" UBYTE NO_COMPU_METHOD 0 0 0 255 ECU_ADDRESS 0 SYMBOL_LINK "Rte_LoaMgr_MotAndThermProtnLoaMod_Val" 0 DISPLAY_IDENTIFIER TEstimn.ReceiverPorts.MotAndThermProtnLoaMod.Val /end MEASUREMENT
/begin MEASUREMENT TEstimn.MotCurrPeakEstimd.Val "MICROSAR RTE" FLOAT32_IEEE NO_COMPU_METHOD 0 0 -3.402823466e+38 3.402823466e+38 ECU_ADDRESS 0 SYMBOL_LINK "Rte_MotCurrPeakEstimn_MotCurrPeakEstimd_Val" 0 DISPLAY_IDENTIFIER TEstimn.ReceiverPorts.MotCurrPeakEstimd.Val /end MEASUREMENT
/begin MEASUREMENT TEstimn.MotFetT.Val "MICROSAR RTE" FLOAT32_IEEE NO_COMPU_METHOD 0 0 -3.402823466e+38 3.402823466e+38 ECU_ADDRESS 0 SYMBOL_LINK "Rte_TEstimn_MotFetT_Val" 0 DISPLAY_IDENTIFIER TEstimn.SenderPorts.MotFetT.Val /end MEASUREMENT
/begin MEASUREMENT TEstimn.MotMagT.Val "MICROSAR RTE" FLOAT32_IEEE NO_COMPU_METHOD 0 0 -3.402823466e+38 3.402823466e+38 ECU_ADDRESS 0 SYMBOL_LINK "Rte_TEstimn_MotMagT_Val" 0 DISPLAY_IDENTIFIER TEstimn.SenderPorts.MotMagT.Val /end MEASUREMENT
/begin MEASUREMENT TEstimn.MotWidgT.Val "MICROSAR RTE" FLOAT32_IEEE NO_COMPU_METHOD 0 0 -3.402823466e+38 3.402823466e+38 ECU_ADDRESS 0 SYMBOL_LINK "Rte_TEstimn_MotWidgT_Val" 0 DISPLAY_IDENTIFIER TEstimn.SenderPorts.MotWidgT.Val /end MEASUREMENT
/begin MEASUREMENT TEstimn.RepInitCntrFlg "MICROSAR RTE" UBYTE RTE_CM_BOOLEAN 0 0 0 255 ECU_ADDRESS 0 SYMBOL_LINK "Rte_TEstimn_RepInitCntrFlg" 0 DISPLAY_IDENTIFIER TEstimn.PerInstanceMemories.RepInitCntrFlg /end MEASUREMENT
/begin MEASUREMENT TEstimn.RepInitCntrVal "MICROSAR RTE" FLOAT32_IEEE NO_COMPU_METHOD 0 0 -3.402823466e+38 3.402823466e+38 ECU_ADDRESS 0 SYMBOL_LINK "Rte_TEstimn_RepInitCntrVal" 0 DISPLAY_IDENTIFIER TEstimn.PerInstanceMemories.RepInitCntrVal /end MEASUREMENT
/begin MEASUREMENT TEstimn.SiFilLp.FilGain "MICROSAR RTE" FLOAT32_IEEE NO_COMPU_METHOD 0 0 -3.402823466e+38 3.402823466e+38 ECU_ADDRESS 0 SYMBOL_LINK "Rte_TEstimn_SiFilLp.FilGain" 0 DISPLAY_IDENTIFIER TEstimn.PerInstanceMemories.SiFilLp.FilGain /end MEASUREMENT
/begin MEASUREMENT TEstimn.SiFilLp.FilSt "MICROSAR RTE" FLOAT32_IEEE NO_COMPU_METHOD 0 0 -3.402823466e+38 3.402823466e+38 ECU_ADDRESS 0 SYMBOL_LINK "Rte_TEstimn_SiFilLp.FilSt" 0 DISPLAY_IDENTIFIER TEstimn.PerInstanceMemories.SiFilLp.FilSt /end MEASUREMENT
/begin MEASUREMENT TEstimn.SiTEstimnPrev "MICROSAR RTE" FLOAT32_IEEE NO_COMPU_METHOD 0 0 -3.402823466e+38 3.402823466e+38 ECU_ADDRESS 0 SYMBOL_LINK "Rte_TEstimn_SiTEstimnPrev" 0 DISPLAY_IDENTIFIER TEstimn.PerInstanceMemories.SiTEstimnPrev /end MEASUREMENT
/begin MEASUREMENT TEstimn.TEstimnFltMtgtnCalIdx "MICROSAR RTE" UBYTE NO_COMPU_METHOD 0 0 0 255 ECU_ADDRESS 0 SYMBOL_LINK "Rte_TEstimn_TEstimnFltMtgtnCalIdx" 0 DISPLAY_IDENTIFIER TEstimn.PerInstanceMemories.TEstimnFltMtgtnCalIdx /end MEASUREMENT
/begin MEASUREMENT TEstimn.TFilStVal.FilAssisMechLLStVal "MICROSAR RTE" FLOAT32_IEEE NO_COMPU_METHOD 0 0 -3.402823466e+38 3.402823466e+38 ECU_ADDRESS 0 SYMBOL_LINK "Rte_TEstimn_TFilStVal.FilAssisMechLLStVal" 0 DISPLAY_IDENTIFIER TEstimn.PerInstanceMemories.TFilStVal.FilAssisMechLLStVal /end MEASUREMENT
/begin MEASUREMENT TEstimn.TFilStVal.FilAssisMechLpStVal "MICROSAR RTE" FLOAT32_IEEE NO_COMPU_METHOD 0 0 -3.402823466e+38 3.402823466e+38 ECU_ADDRESS 0 SYMBOL_LINK "Rte_TEstimn_TFilStVal.FilAssisMechLpStVal" 0 DISPLAY_IDENTIFIER TEstimn.PerInstanceMemories.TFilStVal.FilAssisMechLpStVal /end MEASUREMENT
/begin MEASUREMENT TEstimn.TFilStVal.FilCuLLStVal "MICROSAR RTE" FLOAT32_IEEE NO_COMPU_METHOD 0 0 -3.402823466e+38 3.402823466e+38 ECU_ADDRESS 0 SYMBOL_LINK "Rte_TEstimn_TFilStVal.FilCuLLStVal" 0 DISPLAY_IDENTIFIER TEstimn.PerInstanceMemories.TFilStVal.FilCuLLStVal /end MEASUREMENT
/begin MEASUREMENT TEstimn.TFilStVal.FilCuLpStVal "MICROSAR RTE" FLOAT32_IEEE NO_COMPU_METHOD 0 0 -3.402823466e+38 3.402823466e+38 ECU_ADDRESS 0 SYMBOL_LINK "Rte_TEstimn_TFilStVal.FilCuLpStVal" 0 DISPLAY_IDENTIFIER TEstimn.PerInstanceMemories.TFilStVal.FilCuLpStVal /end MEASUREMENT
/begin MEASUREMENT TEstimn.TFilStVal.FilMagLLStVal "MICROSAR RTE" FLOAT32_IEEE NO_COMPU_METHOD 0 0 -3.402823466e+38 3.402823466e+38 ECU_ADDRESS 0 SYMBOL_LINK "Rte_TEstimn_TFilStVal.FilMagLLStVal" 0 DISPLAY_IDENTIFIER TEstimn.PerInstanceMemories.TFilStVal.FilMagLLStVal /end MEASUREMENT
/begin MEASUREMENT TEstimn.TFilStVal.FilMagLpStVal "MICROSAR RTE" FLOAT32_IEEE NO_COMPU_METHOD 0 0 -3.402823466e+38 3.402823466e+38 ECU_ADDRESS 0 SYMBOL_LINK "Rte_TEstimn_TFilStVal.FilMagLpStVal" 0 DISPLAY_IDENTIFIER TEstimn.PerInstanceMemories.TFilStVal.FilMagLpStVal /end MEASUREMENT
/begin MEASUREMENT TEstimn.TFilStVal.FilSiLLStVal "MICROSAR RTE" FLOAT32_IEEE NO_COMPU_METHOD 0 0 -3.402823466e+38 3.402823466e+38 ECU_ADDRESS 0 SYMBOL_LINK "Rte_TEstimn_TFilStVal.FilSiLLStVal" 0 DISPLAY_IDENTIFIER TEstimn.PerInstanceMemories.TFilStVal.FilSiLLStVal /end MEASUREMENT
/begin MEASUREMENT TEstimn.TFilStVal.FilSiLpStVal "MICROSAR RTE" FLOAT32_IEEE NO_COMPU_METHOD 0 0 -3.402823466e+38 3.402823466e+38 ECU_ADDRESS 0 SYMBOL_LINK "Rte_TEstimn_TFilStVal.FilSiLpStVal" 0 DISPLAY_IDENTIFIER TEstimn.PerInstanceMemories.TFilStVal.FilSiLpStVal /end MEASUREMENT
/begin MEASUREMENT TEstimn.VehTiVld.Logl "MICROSAR RTE" UBYTE RTE_CM_BOOLEAN 0 0 0 255 ECU_ADDRESS 0 SYMBOL_LINK "Rte_TEstimn_VehTiVld_Logl" 0 DISPLAY_IDENTIFIER TEstimn.ReceiverPorts.VehTiVld.Logl /end MEASUREMENT
/begin MEASUREMENT TEstimn.dTEstimnAmbPwr "MICROSAR RTE" FLOAT32_IEEE NO_COMPU_METHOD 0 0 -3.402823466e+38 3.402823466e+38 ECU_ADDRESS 0 SYMBOL_LINK "Rte_TEstimn_dTEstimnAmbPwr" 0 DISPLAY_IDENTIFIER TEstimn.PerInstanceMemories.dTEstimnAmbPwr /end MEASUREMENT
/begin MEASUREMENT TEstimn.dTEstimnAssiMechCorrn "MICROSAR RTE" FLOAT32_IEEE NO_COMPU_METHOD 0 0 -3.402823466e+38 3.402823466e+38 ECU_ADDRESS 0 SYMBOL_LINK "Rte_TEstimn_dTEstimnAssiMechCorrn" 0 DISPLAY_IDENTIFIER TEstimn.PerInstanceMemories.dTEstimnAssiMechCorrn /end MEASUREMENT
/begin MEASUREMENT TEstimn.dTEstimnAssiMechDampgSca "MICROSAR RTE" FLOAT32_IEEE NO_COMPU_METHOD 0 0 -3.402823466e+38 3.402823466e+38 ECU_ADDRESS 0 SYMBOL_LINK "Rte_TEstimn_dTEstimnAssiMechDampgSca" 0 DISPLAY_IDENTIFIER TEstimn.PerInstanceMemories.dTEstimnAssiMechDampgSca /end MEASUREMENT
/begin MEASUREMENT TEstimn.dTEstimnAssiMechFil "MICROSAR RTE" FLOAT32_IEEE NO_COMPU_METHOD 0 0 -3.402823466e+38 3.402823466e+38 ECU_ADDRESS 0 SYMBOL_LINK "Rte_TEstimn_dTEstimnAssiMechFil" 0 DISPLAY_IDENTIFIER TEstimn.PerInstanceMemories.dTEstimnAssiMechFil /end MEASUREMENT
/begin MEASUREMENT TEstimn.dTEstimnCuCorrn "MICROSAR RTE" FLOAT32_IEEE NO_COMPU_METHOD 0 0 -3.402823466e+38 3.402823466e+38 ECU_ADDRESS 0 SYMBOL_LINK "Rte_TEstimn_dTEstimnCuCorrn" 0 DISPLAY_IDENTIFIER TEstimn.PerInstanceMemories.dTEstimnCuCorrn /end MEASUREMENT
/begin MEASUREMENT TEstimn.dTEstimnMagCorrn "MICROSAR RTE" FLOAT32_IEEE NO_COMPU_METHOD 0 0 -3.402823466e+38 3.402823466e+38 ECU_ADDRESS 0 SYMBOL_LINK "Rte_TEstimn_dTEstimnMagCorrn" 0 DISPLAY_IDENTIFIER TEstimn.PerInstanceMemories.dTEstimnMagCorrn /end MEASUREMENT
/begin MEASUREMENT TEstimn.dTEstimnScadAmbT "MICROSAR RTE" FLOAT32_IEEE NO_COMPU_METHOD 0 0 -3.402823466e+38 3.402823466e+38 ECU_ADDRESS 0 SYMBOL_LINK "Rte_TEstimn_dTEstimnScadAmbT" 0 DISPLAY_IDENTIFIER TEstimn.PerInstanceMemories.dTEstimnScadAmbT /end MEASUREMENT
/begin MEASUREMENT TEstimn.dTEstimnScadEngT "MICROSAR RTE" FLOAT32_IEEE NO_COMPU_METHOD 0 0 -3.402823466e+38 3.402823466e+38 ECU_ADDRESS 0 SYMBOL_LINK "Rte_TEstimn_dTEstimnScadEngT" 0 DISPLAY_IDENTIFIER TEstimn.PerInstanceMemories.dTEstimnScadEngT /end MEASUREMENT
/begin MEASUREMENT TEstimn.dTEstimnSiCorrn "MICROSAR RTE" FLOAT32_IEEE NO_COMPU_METHOD 0 0 -3.402823466e+38 3.402823466e+38 ECU_ADDRESS 0 SYMBOL_LINK "Rte_TEstimn_dTEstimnSiCorrn" 0 DISPLAY_IDENTIFIER TEstimn.PerInstanceMemories.dTEstimnSiCorrn /end MEASUREMENT
/begin MEASUREMENT TEstimn.dTEstimnWghtAvrgT "MICROSAR RTE" FLOAT32_IEEE NO_COMPU_METHOD 0 0 -3.402823466e+38 3.402823466e+38 ECU_ADDRESS 0 SYMBOL_LINK "Rte_TEstimn_dTEstimnWghtAvrgT" 0 DISPLAY_IDENTIFIER TEstimn.PerInstanceMemories.dTEstimnWghtAvrgT /end MEASUREMENT
/begin MEASUREMENT TmplMonr.AvrgElpdTiMicroSec "MICROSAR RTE" ULONG NO_COMPU_METHOD 0 0 0 4294967295 ECU_ADDRESS 0 SYMBOL_LINK "Rte_TmplMonr_AvrgElpdTiMicroSec" 0 DISPLAY_IDENTIFIER TmplMonr.PerInstanceMemories.AvrgElpdTiMicroSec /end MEASUREMENT
/begin MEASUREMENT TmplMonr.StrtUpSt.Val "MICROSAR RTE" UBYTE NO_COMPU_METHOD 0 0 0 255 ECU_ADDRESS 0 SYMBOL_LINK "Rte_PwrUpSeq_StrtUpSt_Val" 0 DISPLAY_IDENTIFIER TmplMonr.ReceiverPorts.StrtUpSt.Val /end MEASUREMENT
/begin MEASUREMENT TmplMonr.SysSt.Val "MICROSAR RTE" UBYTE RTE_CM_ENUM_SysSt1 0 0 0 255 ECU_ADDRESS 0 SYMBOL_LINK "Rte_SysStMod_SysSt_Val" 0 DISPLAY_IDENTIFIER TmplMonr.ReceiverPorts.SysSt.Val /end MEASUREMENT
/begin MEASUREMENT TmplMonr.TmplMonrIninCntr "MICROSAR RTE" UBYTE NO_COMPU_METHOD 0 0 0 255 ECU_ADDRESS 0 SYMBOL_LINK "Rte_TmplMonr_TmplMonrIninCntr" 0 DISPLAY_IDENTIFIER TmplMonr.PerInstanceMemories.TmplMonrIninCntr /end MEASUREMENT
/begin MEASUREMENT TmplMonr.TmplMonrIninTestCmpl.Logl "MICROSAR RTE" UBYTE RTE_CM_BOOLEAN 0 0 0 255 ECU_ADDRESS 0 SYMBOL_LINK "Rte_TmplMonr_TmplMonrIninTestCmpl_Logl" 0 DISPLAY_IDENTIFIER TmplMonr.SenderPorts.TmplMonrIninTestCmpl.Logl /end MEASUREMENT
/begin MEASUREMENT TmplMonr.TmplMonrIninTestCmplFlg "MICROSAR RTE" UBYTE RTE_CM_BOOLEAN 0 0 0 255 ECU_ADDRESS 0 SYMBOL_LINK "Rte_TmplMonr_TmplMonrIninTestCmplFlg" 0 DISPLAY_IDENTIFIER TmplMonr.PerInstanceMemories.TmplMonrIninTestCmplFlg /end MEASUREMENT
/begin MEASUREMENT TmplMonr.TmplMonrNtc40PrmByte "MICROSAR RTE" UBYTE NO_COMPU_METHOD 0 0 0 255 ECU_ADDRESS 0 SYMBOL_LINK "Rte_TmplMonr_TmplMonrNtc40PrmByte" 0 DISPLAY_IDENTIFIER TmplMonr.PerInstanceMemories.TmplMonrNtc40PrmByte /end MEASUREMENT
/begin MEASUREMENT TmplMonr.TmplMonrSpiReadWrOrderFlg1 "MICROSAR RTE" UBYTE RTE_CM_BOOLEAN 0 0 0 255 ECU_ADDRESS 0 SYMBOL_LINK "Rte_TmplMonr_TmplMonrSpiReadWrOrderFlg1" 0 DISPLAY_IDENTIFIER TmplMonr.PerInstanceMemories.TmplMonrSpiReadWrOrderFlg1 /end MEASUREMENT
/begin MEASUREMENT TmplMonr.TmplMonrSpiReadWrOrderFlg2 "MICROSAR RTE" UBYTE RTE_CM_BOOLEAN 0 0 0 255 ECU_ADDRESS 0 SYMBOL_LINK "Rte_TmplMonr_TmplMonrSpiReadWrOrderFlg2" 0 DISPLAY_IDENTIFIER TmplMonr.PerInstanceMemories.TmplMonrSpiReadWrOrderFlg2 /end MEASUREMENT
/begin MEASUREMENT TmplMonr.TmplMonrWdgRstrtCnt "MICROSAR RTE" UBYTE NO_COMPU_METHOD 0 0 0 255 ECU_ADDRESS 0 SYMBOL_LINK "Rte_TmplMonr_TmplMonrWdgRstrtCnt" 0 DISPLAY_IDENTIFIER TmplMonr.PerInstanceMemories.TmplMonrWdgRstrtCnt /end MEASUREMENT
/begin MEASUREMENT TmplMonr.TrsmErrCntr "MICROSAR RTE" UWORD NO_COMPU_METHOD 0 0 0 65535 ECU_ADDRESS 0 SYMBOL_LINK "Rte_TmplMonr_TrsmErrCntr" 0 DISPLAY_IDENTIFIER TmplMonr.PerInstanceMemories.TrsmErrCntr /end MEASUREMENT
/begin MEASUREMENT TmplMonr.TrsmErrNtcThd "MICROSAR RTE" UBYTE NO_COMPU_METHOD 0 0 0 255 ECU_ADDRESS 0 SYMBOL_LINK "Rte_TmplMonr_TrsmErrNtcThd" 0 DISPLAY_IDENTIFIER TmplMonr.PerInstanceMemories.TrsmErrNtcThd /end MEASUREMENT
/begin MEASUREMENT TqLoa.MotAgLoaMtgtnEna.Logl "MICROSAR RTE" UBYTE RTE_CM_BOOLEAN 0 0 0 255 ECU_ADDRESS 0 SYMBOL_LINK "Rte_LoaMgr_MotAgLoaMtgtnEna_Logl" 0 DISPLAY_IDENTIFIER TqLoa.ReceiverPorts.MotAgLoaMtgtnEna.Logl /end MEASUREMENT
/begin MEASUREMENT TqLoa.MotTqCmdPrev "MICROSAR RTE" FLOAT32_IEEE NO_COMPU_METHOD 0 0 -3.402823466e+38 3.402823466e+38 ECU_ADDRESS 0 SYMBOL_LINK "Rte_TqLoa_MotTqCmdPrev" 0 DISPLAY_IDENTIFIER TqLoa.PerInstanceMemories.MotTqCmdPrev /end MEASUREMENT
/begin MEASUREMENT TqLoa.MotVelAndTqBasdScaFacPrev "MICROSAR RTE" FLOAT32_IEEE NO_COMPU_METHOD 0 0 -3.402823466e+38 3.402823466e+38 ECU_ADDRESS 0 SYMBOL_LINK "Rte_TqLoa_MotVelAndTqBasdScaFacPrev" 0 DISPLAY_IDENTIFIER TqLoa.PerInstanceMemories.MotVelAndTqBasdScaFacPrev /end MEASUREMENT
/begin MEASUREMENT TqLoa.MotVelCrf.Val "MICROSAR RTE" FLOAT32_IEEE NO_COMPU_METHOD 0 0 -3.402823466e+38 3.402823466e+38 ECU_ADDRESS 0 SYMBOL_LINK "Rte_ImcSigArbn_MotVelCrfImcCorrd_Val" 0 DISPLAY_IDENTIFIER TqLoa.ReceiverPorts.MotVelCrf.Val /end MEASUREMENT
/begin MEASUREMENT TqLoa.PinionAg.Val "MICROSAR RTE" FLOAT32_IEEE NO_COMPU_METHOD 0 0 -3.402823466e+38 3.402823466e+38 ECU_ADDRESS 0 SYMBOL_LINK "Rte_ImcSigArbn_HwAgImcCorrd_Val" 0 DISPLAY_IDENTIFIER TqLoa.ReceiverPorts.PinionAg.Val /end MEASUREMENT
/begin MEASUREMENT TqLoa.PinionAgConf.Val "MICROSAR RTE" FLOAT32_IEEE NO_COMPU_METHOD 0 0 -3.402823466e+38 3.402823466e+38 ECU_ADDRESS 0 SYMBOL_LINK "Rte_HwAgSysArbn_PinionAgConf_Val" 0 DISPLAY_IDENTIFIER TqLoa.ReceiverPorts.PinionAgConf.Val /end MEASUREMENT
/begin MEASUREMENT TqLoa.TqLoaAvl.Logl "MICROSAR RTE" UBYTE RTE_CM_BOOLEAN 0 0 0 255 ECU_ADDRESS 0 SYMBOL_LINK "Rte_TqLoa_TqLoaAvl_Logl" 0 DISPLAY_IDENTIFIER TqLoa.SenderPorts.TqLoaAvl.Logl /end MEASUREMENT
/begin MEASUREMENT TqLoa.TqLoaCmd.Val "MICROSAR RTE" FLOAT32_IEEE NO_COMPU_METHOD 0 0 -3.402823466e+38 3.402823466e+38 ECU_ADDRESS 0 SYMBOL_LINK "Rte_TqLoa_TqLoaCmd_Val" 0 DISPLAY_IDENTIFIER TqLoa.SenderPorts.TqLoaCmd.Val /end MEASUREMENT
/begin MEASUREMENT TqLoa.VehLatA.Val "MICROSAR RTE" FLOAT32_IEEE NO_COMPU_METHOD 0 0 -3.402823466e+38 3.402823466e+38 ECU_ADDRESS 0 SYMBOL_LINK "Rte_VehSigCdng_VehLatA_Val" 0 DISPLAY_IDENTIFIER TqLoa.ReceiverPorts.VehLatA.Val /end MEASUREMENT
/begin MEASUREMENT TqLoa.VehLatADifScaFacPrev "MICROSAR RTE" FLOAT32_IEEE NO_COMPU_METHOD 0 0 -3.402823466e+38 3.402823466e+38 ECU_ADDRESS 0 SYMBOL_LINK "Rte_TqLoa_VehLatADifScaFacPrev" 0 DISPLAY_IDENTIFIER TqLoa.PerInstanceMemories.VehLatADifScaFacPrev /end MEASUREMENT
/begin MEASUREMENT TqLoa.VehLatAEstimnFil.FilGain "MICROSAR RTE" FLOAT32_IEEE NO_COMPU_METHOD 0 0 -3.402823466e+38 3.402823466e+38 ECU_ADDRESS 0 SYMBOL_LINK "Rte_TqLoa_VehLatAEstimnFil.FilGain" 0 DISPLAY_IDENTIFIER TqLoa.PerInstanceMemories.VehLatAEstimnFil.FilGain /end MEASUREMENT
/begin MEASUREMENT TqLoa.VehLatAEstimnFil.FilSt "MICROSAR RTE" FLOAT32_IEEE NO_COMPU_METHOD 0 0 -3.402823466e+38 3.402823466e+38 ECU_ADDRESS 0 SYMBOL_LINK "Rte_TqLoa_VehLatAEstimnFil.FilSt" 0 DISPLAY_IDENTIFIER TqLoa.PerInstanceMemories.VehLatAEstimnFil.FilSt /end MEASUREMENT
/begin MEASUREMENT TqLoa.VehLatAVld.Logl "MICROSAR RTE" UBYTE RTE_CM_BOOLEAN 0 0 0 255 ECU_ADDRESS 0 SYMBOL_LINK "Rte_VehSigCdng_VehLatAVld_Logl" 0 DISPLAY_IDENTIFIER TqLoa.ReceiverPorts.VehLatAVld.Logl /end MEASUREMENT
/begin MEASUREMENT TqLoa.VehSpd.Val "MICROSAR RTE" FLOAT32_IEEE NO_COMPU_METHOD 0 0 -3.402823466e+38 3.402823466e+38 ECU_ADDRESS 0 SYMBOL_LINK "Rte_ImcSigArbn_VehSpdImcCorrd_Val" 0 DISPLAY_IDENTIFIER TqLoa.ReceiverPorts.VehSpd.Val /end MEASUREMENT
/begin MEASUREMENT TqLoa.VehSpdVld.Logl "MICROSAR RTE" UBYTE RTE_CM_BOOLEAN 0 0 0 255 ECU_ADDRESS 0 SYMBOL_LINK "Rte_VehSigCdng_VehSpdVld_Logl" 0 DISPLAY_IDENTIFIER TqLoa.ReceiverPorts.VehSpdVld.Logl /end MEASUREMENT
/begin MEASUREMENT TqLoa.dTqLoaMotTqCmdPreScag "MICROSAR RTE" FLOAT32_IEEE NO_COMPU_METHOD 0 0 -3.402823466e+38 3.402823466e+38 ECU_ADDRESS 0 SYMBOL_LINK "Rte_TqLoa_dTqLoaMotTqCmdPreScag" 0 DISPLAY_IDENTIFIER TqLoa.PerInstanceMemories.dTqLoaMotTqCmdPreScag /end MEASUREMENT
/begin MEASUREMENT TqLoa.dTqLoaMotVelAndTqBasdScaFac "MICROSAR RTE" FLOAT32_IEEE NO_COMPU_METHOD 0 0 -3.402823466e+38 3.402823466e+38 ECU_ADDRESS 0 SYMBOL_LINK "Rte_TqLoa_dTqLoaMotVelAndTqBasdScaFac" 0 DISPLAY_IDENTIFIER TqLoa.PerInstanceMemories.dTqLoaMotVelAndTqBasdScaFac /end MEASUREMENT
/begin MEASUREMENT TqLoa.dTqLoaScaFacFinal "MICROSAR RTE" FLOAT32_IEEE NO_COMPU_METHOD 0 0 -3.402823466e+38 3.402823466e+38 ECU_ADDRESS 0 SYMBOL_LINK "Rte_TqLoa_dTqLoaScaFacFinal" 0 DISPLAY_IDENTIFIER TqLoa.PerInstanceMemories.dTqLoaScaFacFinal /end MEASUREMENT
/begin MEASUREMENT TqLoa.dTqLoaVehLatADifScaFac "MICROSAR RTE" FLOAT32_IEEE NO_COMPU_METHOD 0 0 -3.402823466e+38 3.402823466e+38 ECU_ADDRESS 0 SYMBOL_LINK "Rte_TqLoa_dTqLoaVehLatADifScaFac" 0 DISPLAY_IDENTIFIER TqLoa.PerInstanceMemories.dTqLoaVehLatADifScaFac /end MEASUREMENT
/begin MEASUREMENT TqLoa.dTqLoaVehLatAEstimn "MICROSAR RTE" FLOAT32_IEEE NO_COMPU_METHOD 0 0 -3.402823466e+38 3.402823466e+38 ECU_ADDRESS 0 SYMBOL_LINK "Rte_TqLoa_dTqLoaVehLatAEstimn" 0 DISPLAY_IDENTIFIER TqLoa.PerInstanceMemories.dTqLoaVehLatAEstimn /end MEASUREMENT
/begin MEASUREMENT TqLoa.dTqLoaVehSpdBasdScaFac "MICROSAR RTE" FLOAT32_IEEE NO_COMPU_METHOD 0 0 -3.402823466e+38 3.402823466e+38 ECU_ADDRESS 0 SYMBOL_LINK "Rte_TqLoa_dTqLoaVehSpdBasdScaFac" 0 DISPLAY_IDENTIFIER TqLoa.PerInstanceMemories.dTqLoaVehSpdBasdScaFac /end MEASUREMENT
/begin MEASUREMENT TunSelnAuthy.HwTq.Val "MICROSAR RTE" FLOAT32_IEEE NO_COMPU_METHOD 0 0 -3.402823466e+38 3.402823466e+38 ECU_ADDRESS 0 SYMBOL_LINK "Rte_ImcSigArbn_HwTqImcCorrd_Val" 0 DISPLAY_IDENTIFIER TunSelnAuthy.ReceiverPorts.HwTq.Val /end MEASUREMENT
/begin MEASUREMENT TunSelnAuthy.HwVel.Val "MICROSAR RTE" FLOAT32_IEEE NO_COMPU_METHOD 0 0 -3.402823466e+38 3.402823466e+38 ECU_ADDRESS 0 SYMBOL_LINK "Rte_HwAgSysArbn_HwVel_Val" 0 DISPLAY_IDENTIFIER TunSelnAuthy.ReceiverPorts.HwVel.Val /end MEASUREMENT
/begin MEASUREMENT TunSelnAuthy.TunSelnRtDi.Logl "MICROSAR RTE" UBYTE RTE_CM_BOOLEAN 0 0 0 255 ECU_ADDRESS 0 SYMBOL_LINK "Rte_TunSelnAuthy_TunSelnRtDi_Logl" 0 DISPLAY_IDENTIFIER TunSelnAuthy.ReceiverPorts.TunSelnRtDi.Logl /end MEASUREMENT
/begin MEASUREMENT TunSelnAuthy.VehSpd.Val "MICROSAR RTE" FLOAT32_IEEE NO_COMPU_METHOD 0 0 -3.402823466e+38 3.402823466e+38 ECU_ADDRESS 0 SYMBOL_LINK "Rte_ImcSigArbn_VehSpdImcCorrd_Val" 0 DISPLAY_IDENTIFIER TunSelnAuthy.ReceiverPorts.VehSpd.Val /end MEASUREMENT
/begin MEASUREMENT TunSelnMngt.ActvIninIdx.Val "MICROSAR RTE" UBYTE NO_COMPU_METHOD 0 0 0 255 ECU_ADDRESS 0 SYMBOL_LINK "Rte_TunSelnMngt_ActvIninIdx_Val" 0 DISPLAY_IDENTIFIER TunSelnMngt.SenderPorts.ActvIninIdx.Val /end MEASUREMENT
/begin MEASUREMENT TunSelnMngt.ActvRtIdx.Val "MICROSAR RTE" UBYTE NO_COMPU_METHOD 0 0 0 255 ECU_ADDRESS 0 SYMBOL_LINK "Rte_TunSelnMngt_ActvRtIdx_Val" 0 DISPLAY_IDENTIFIER TunSelnMngt.SenderPorts.ActvRtIdx.Val /end MEASUREMENT
/begin MEASUREMENT TunSelnMngt.DesIninIdx.Val "MICROSAR RTE" UBYTE NO_COMPU_METHOD 0 0 0 255 ECU_ADDRESS 0 SYMBOL_LINK "Rte_TunSelnMngt_DesIninIdx_Val" 0 DISPLAY_IDENTIFIER TunSelnMngt.ReceiverPorts.DesIninIdx.Val /end MEASUREMENT
/begin MEASUREMENT TunSelnMngt.DesRtIdx.Val "MICROSAR RTE" UBYTE NO_COMPU_METHOD 0 0 0 255 ECU_ADDRESS 0 SYMBOL_LINK "Rte_TunSelnMngt_DesRtIdx_Val" 0 DISPLAY_IDENTIFIER TunSelnMngt.ReceiverPorts.DesRtIdx.Val /end MEASUREMENT
/begin MEASUREMENT TunSelnMngt.PrevActvIninIdx "MICROSAR RTE" UBYTE NO_COMPU_METHOD 0 0 0 255 ECU_ADDRESS 0 SYMBOL_LINK "Rte_TunSelnMngt_PrevActvIninIdx" 0 DISPLAY_IDENTIFIER TunSelnMngt.PerInstanceMemories.PrevActvIninIdx /end MEASUREMENT
/begin MEASUREMENT TunSelnMngt.PrevActvRtIdx "MICROSAR RTE" UBYTE NO_COMPU_METHOD 0 0 0 255 ECU_ADDRESS 0 SYMBOL_LINK "Rte_TunSelnMngt_PrevActvRtIdx" 0 DISPLAY_IDENTIFIER TunSelnMngt.PerInstanceMemories.PrevActvRtIdx /end MEASUREMENT
/begin MEASUREMENT TunSelnMngt.PrevRamPageAcs "MICROSAR RTE" UBYTE NO_COMPU_METHOD 0 0 0 255 ECU_ADDRESS 0 SYMBOL_LINK "Rte_TunSelnMngt_PrevRamPageAcs" 0 DISPLAY_IDENTIFIER TunSelnMngt.PerInstanceMemories.PrevRamPageAcs /end MEASUREMENT
/begin MEASUREMENT TunSelnMngt.RamTblSwt "MICROSAR RTE" UBYTE NO_COMPU_METHOD 0 0 0 255 ECU_ADDRESS 0 SYMBOL_LINK "Rte_TunSelnMngt_RamTblSwt" 0 DISPLAY_IDENTIFIER TunSelnMngt.PerInstanceMemories.RamTblSwt /end MEASUREMENT
/begin MEASUREMENT VehSigCdng.HwTq.Val "MICROSAR RTE" FLOAT32_IEEE NO_COMPU_METHOD 0 0 -3.402823466e+38 3.402823466e+38 ECU_ADDRESS 0 SYMBOL_LINK "Rte_Swp_HwTqSwp_Val" 0 DISPLAY_IDENTIFIER VehSigCdng.ReceiverPorts.HwTq.Val /end MEASUREMENT
/begin MEASUREMENT VehSigCdng.HwTqFilRec.FilGain "MICROSAR RTE" FLOAT32_IEEE NO_COMPU_METHOD 0 0 -3.402823466e+38 3.402823466e+38 ECU_ADDRESS 0 SYMBOL_LINK "Rte_VehSigCdng_HwTqFilRec.FilGain" 0 DISPLAY_IDENTIFIER VehSigCdng.PerInstanceMemories.HwTqFilRec.FilGain /end MEASUREMENT
/begin MEASUREMENT VehSigCdng.HwTqFilRec.FilSt "MICROSAR RTE" FLOAT32_IEEE NO_COMPU_METHOD 0 0 -3.402823466e+38 3.402823466e+38 ECU_ADDRESS 0 SYMBOL_LINK "Rte_VehSigCdng_HwTqFilRec.FilSt" 0 DISPLAY_IDENTIFIER VehSigCdng.PerInstanceMemories.HwTqFilRec.FilSt /end MEASUREMENT
/begin MEASUREMENT VehSigCdng.LatAFilRec.FilGain "MICROSAR RTE" FLOAT32_IEEE NO_COMPU_METHOD 0 0 -3.402823466e+38 3.402823466e+38 ECU_ADDRESS 0 SYMBOL_LINK "Rte_VehSigCdng_LatAFilRec.FilGain" 0 DISPLAY_IDENTIFIER VehSigCdng.PerInstanceMemories.LatAFilRec.FilGain /end MEASUREMENT
/begin MEASUREMENT VehSigCdng.LatAFilRec.FilSt "MICROSAR RTE" FLOAT32_IEEE NO_COMPU_METHOD 0 0 -3.402823466e+38 3.402823466e+38 ECU_ADDRESS 0 SYMBOL_LINK "Rte_VehSigCdng_LatAFilRec.FilSt" 0 DISPLAY_IDENTIFIER VehSigCdng.PerInstanceMemories.LatAFilRec.FilSt /end MEASUREMENT
/begin MEASUREMENT VehSigCdng.PrevLatA "MICROSAR RTE" FLOAT32_IEEE NO_COMPU_METHOD 0 0 -3.402823466e+38 3.402823466e+38 ECU_ADDRESS 0 SYMBOL_LINK "Rte_VehSigCdng_PrevLatA" 0 DISPLAY_IDENTIFIER VehSigCdng.PerInstanceMemories.PrevLatA /end MEASUREMENT
/begin MEASUREMENT VehSigCdng.PrevLatAVld "MICROSAR RTE" UBYTE RTE_CM_BOOLEAN 0 0 0 255 ECU_ADDRESS 0 SYMBOL_LINK "Rte_VehSigCdng_PrevLatAVld" 0 DISPLAY_IDENTIFIER VehSigCdng.PerInstanceMemories.PrevLatAVld /end MEASUREMENT
/begin MEASUREMENT VehSigCdng.PrevLtgA "MICROSAR RTE" FLOAT32_IEEE NO_COMPU_METHOD 0 0 -3.402823466e+38 3.402823466e+38 ECU_ADDRESS 0 SYMBOL_LINK "Rte_VehSigCdng_PrevLtgA" 0 DISPLAY_IDENTIFIER VehSigCdng.PerInstanceMemories.PrevLtgA /end MEASUREMENT
/begin MEASUREMENT VehSigCdng.PrevLtgAVld "MICROSAR RTE" UBYTE RTE_CM_BOOLEAN 0 0 0 255 ECU_ADDRESS 0 SYMBOL_LINK "Rte_VehSigCdng_PrevLtgAVld" 0 DISPLAY_IDENTIFIER VehSigCdng.PerInstanceMemories.PrevLtgAVld /end MEASUREMENT
/begin MEASUREMENT VehSigCdng.PrevVehSpd "MICROSAR RTE" FLOAT32_IEEE NO_COMPU_METHOD 0 0 -3.402823466e+38 3.402823466e+38 ECU_ADDRESS 0 SYMBOL_LINK "Rte_VehSigCdng_PrevVehSpd" 0 DISPLAY_IDENTIFIER VehSigCdng.PerInstanceMemories.PrevVehSpd /end MEASUREMENT
/begin MEASUREMENT VehSigCdng.PrevVehSpdVld "MICROSAR RTE" UBYTE RTE_CM_BOOLEAN 0 0 0 255 ECU_ADDRESS 0 SYMBOL_LINK "Rte_VehSigCdng_PrevVehSpdVld" 0 DISPLAY_IDENTIFIER VehSigCdng.PerInstanceMemories.PrevVehSpdVld /end MEASUREMENT
/begin MEASUREMENT VehSigCdng.PrevYawRate "MICROSAR RTE" FLOAT32_IEEE NO_COMPU_METHOD 0 0 -3.402823466e+38 3.402823466e+38 ECU_ADDRESS 0 SYMBOL_LINK "Rte_VehSigCdng_PrevYawRate" 0 DISPLAY_IDENTIFIER VehSigCdng.PerInstanceMemories.PrevYawRate /end MEASUREMENT
/begin MEASUREMENT VehSigCdng.PrevYawRateVld "MICROSAR RTE" UBYTE RTE_CM_BOOLEAN 0 0 0 255 ECU_ADDRESS 0 SYMBOL_LINK "Rte_VehSigCdng_PrevYawRateVld" 0 DISPLAY_IDENTIFIER VehSigCdng.PerInstanceMemories.PrevYawRateVld /end MEASUREMENT
/begin MEASUREMENT VehSigCdng.VehLatA.Val "MICROSAR RTE" FLOAT32_IEEE NO_COMPU_METHOD 0 0 -3.402823466e+38 3.402823466e+38 ECU_ADDRESS 0 SYMBOL_LINK "Rte_VehSigCdng_VehLatA_Val" 0 DISPLAY_IDENTIFIER VehSigCdng.SenderPorts.VehLatA.Val /end MEASUREMENT
/begin MEASUREMENT VehSigCdng.VehLatAEstimd.Val "MICROSAR RTE" FLOAT32_IEEE NO_COMPU_METHOD 0 0 -3.402823466e+38 3.402823466e+38 ECU_ADDRESS 0 SYMBOL_LINK "Rte_VehSigCdng_VehLatAEstimd_Val" 0 DISPLAY_IDENTIFIER VehSigCdng.SenderPorts.VehLatAEstimd.Val /end MEASUREMENT
/begin MEASUREMENT VehSigCdng.VehLatAEstimdVld.Logl "MICROSAR RTE" UBYTE RTE_CM_BOOLEAN 0 0 0 255 ECU_ADDRESS 0 SYMBOL_LINK "Rte_VehSigCdng_VehLatAEstimdVld_Logl" 0 DISPLAY_IDENTIFIER VehSigCdng.SenderPorts.VehLatAEstimdVld.Logl /end MEASUREMENT
/begin MEASUREMENT VehSigCdng.VehLatASerlCom.Val "MICROSAR RTE" FLOAT32_IEEE NO_COMPU_METHOD 0 0 -3.402823466e+38 3.402823466e+38 ECU_ADDRESS 0 SYMBOL_LINK "Rte_VehSigCdng_VehLatASerlCom_Val" 0 DISPLAY_IDENTIFIER VehSigCdng.ReceiverPorts.VehLatASerlCom.Val /end MEASUREMENT
/begin MEASUREMENT VehSigCdng.VehLatAVld.Logl "MICROSAR RTE" UBYTE RTE_CM_BOOLEAN 0 0 0 255 ECU_ADDRESS 0 SYMBOL_LINK "Rte_VehSigCdng_VehLatAVld_Logl" 0 DISPLAY_IDENTIFIER VehSigCdng.SenderPorts.VehLatAVld.Logl /end MEASUREMENT
/begin MEASUREMENT VehSigCdng.VehLatAVldSerlCom.Logl "MICROSAR RTE" UBYTE RTE_CM_BOOLEAN 0 0 0 255 ECU_ADDRESS 0 SYMBOL_LINK "Rte_VehSigCdng_VehLatAVldSerlCom_Logl" 0 DISPLAY_IDENTIFIER VehSigCdng.ReceiverPorts.VehLatAVldSerlCom.Logl /end MEASUREMENT
/begin MEASUREMENT VehSigCdng.VehLgtA.Val "MICROSAR RTE" FLOAT32_IEEE NO_COMPU_METHOD 0 0 -3.402823466e+38 3.402823466e+38 ECU_ADDRESS 0 SYMBOL_LINK "Rte_VehSigCdng_VehLgtA_Val" 0 DISPLAY_IDENTIFIER VehSigCdng.SenderPorts.VehLgtA.Val /end MEASUREMENT
/begin MEASUREMENT VehSigCdng.VehLgtASerlCom.Val "MICROSAR RTE" FLOAT32_IEEE NO_COMPU_METHOD 0 0 -3.402823466e+38 3.402823466e+38 ECU_ADDRESS 0 SYMBOL_LINK "Rte_VehSigCdng_VehLgtASerlCom_Val" 0 DISPLAY_IDENTIFIER VehSigCdng.ReceiverPorts.VehLgtASerlCom.Val /end MEASUREMENT
/begin MEASUREMENT VehSigCdng.VehLgtAVld.Logl "MICROSAR RTE" UBYTE RTE_CM_BOOLEAN 0 0 0 255 ECU_ADDRESS 0 SYMBOL_LINK "Rte_VehSigCdng_VehLgtAVld_Logl" 0 DISPLAY_IDENTIFIER VehSigCdng.SenderPorts.VehLgtAVld.Logl /end MEASUREMENT
/begin MEASUREMENT VehSigCdng.VehLgtAVldSerlCom.Logl "MICROSAR RTE" UBYTE RTE_CM_BOOLEAN 0 0 0 255 ECU_ADDRESS 0 SYMBOL_LINK "Rte_VehSigCdng_VehLgtAVldSerlCom_Logl" 0 DISPLAY_IDENTIFIER VehSigCdng.ReceiverPorts.VehLgtAVldSerlCom.Logl /end MEASUREMENT
/begin MEASUREMENT VehSigCdng.VehSpd.Val "MICROSAR RTE" FLOAT32_IEEE NO_COMPU_METHOD 0 0 -3.402823466e+38 3.402823466e+38 ECU_ADDRESS 0 SYMBOL_LINK "Rte_VehSigCdng_VehSpd_Val" 0 DISPLAY_IDENTIFIER VehSigCdng.SenderPorts.VehSpd.Val /end MEASUREMENT
/begin MEASUREMENT VehSigCdng.VehSpdOvrd.Val "MICROSAR RTE" FLOAT32_IEEE NO_COMPU_METHOD 0 0 -3.402823466e+38 3.402823466e+38 ECU_ADDRESS 0 SYMBOL_LINK "Rte_CmnMfgSrv_VehSpdOvrd_Val" 0 DISPLAY_IDENTIFIER VehSigCdng.ReceiverPorts.VehSpdOvrd.Val /end MEASUREMENT
/begin MEASUREMENT VehSigCdng.VehSpdOvrdEna.Logl "MICROSAR RTE" UBYTE RTE_CM_BOOLEAN 0 0 0 255 ECU_ADDRESS 0 SYMBOL_LINK "Rte_CmnMfgSrv_VehSpdOvrdEna_Logl" 0 DISPLAY_IDENTIFIER VehSigCdng.ReceiverPorts.VehSpdOvrdEna.Logl /end MEASUREMENT
/begin MEASUREMENT VehSigCdng.VehSpdSerlCom.Val "MICROSAR RTE" FLOAT32_IEEE NO_COMPU_METHOD 0 0 -3.402823466e+38 3.402823466e+38 ECU_ADDRESS 0 SYMBOL_LINK "Rte_FordVehSpdArbn_FordVehSpd_Val" 0 DISPLAY_IDENTIFIER VehSigCdng.ReceiverPorts.VehSpdSerlCom.Val /end MEASUREMENT
/begin MEASUREMENT VehSigCdng.VehSpdVld.Logl "MICROSAR RTE" UBYTE RTE_CM_BOOLEAN 0 0 0 255 ECU_ADDRESS 0 SYMBOL_LINK "Rte_VehSigCdng_VehSpdVld_Logl" 0 DISPLAY_IDENTIFIER VehSigCdng.SenderPorts.VehSpdVld.Logl /end MEASUREMENT
/begin MEASUREMENT VehSigCdng.VehSpdVldSerlCom.Logl "MICROSAR RTE" UBYTE RTE_CM_BOOLEAN 0 0 0 255 ECU_ADDRESS 0 SYMBOL_LINK "Rte_FordVehSpdArbn_FordVehSpdVld_Logl" 0 DISPLAY_IDENTIFIER VehSigCdng.ReceiverPorts.VehSpdVldSerlCom.Logl /end MEASUREMENT
/begin MEASUREMENT VehSigCdng.VehYawRate.Val "MICROSAR RTE" FLOAT32_IEEE NO_COMPU_METHOD 0 0 -3.402823466e+38 3.402823466e+38 ECU_ADDRESS 0 SYMBOL_LINK "Rte_VehSigCdng_VehYawRate_Val" 0 DISPLAY_IDENTIFIER VehSigCdng.SenderPorts.VehYawRate.Val /end MEASUREMENT
/begin MEASUREMENT VehSigCdng.VehYawRateSerlCom.Val "MICROSAR RTE" FLOAT32_IEEE NO_COMPU_METHOD 0 0 -3.402823466e+38 3.402823466e+38 ECU_ADDRESS 0 SYMBOL_LINK "Rte_FordMsg091BusHiSpd_FordVehYawRate_Val" 0 DISPLAY_IDENTIFIER VehSigCdng.ReceiverPorts.VehYawRateSerlCom.Val /end MEASUREMENT
/begin MEASUREMENT VehSigCdng.VehYawRateVld.Logl "MICROSAR RTE" UBYTE RTE_CM_BOOLEAN 0 0 0 255 ECU_ADDRESS 0 SYMBOL_LINK "Rte_VehSigCdng_VehYawRateVld_Logl" 0 DISPLAY_IDENTIFIER VehSigCdng.SenderPorts.VehYawRateVld.Logl /end MEASUREMENT
/begin MEASUREMENT VehSigCdng.VehYawRateVldSerlCom.Logl "MICROSAR RTE" UBYTE RTE_CM_BOOLEAN 0 0 0 255 ECU_ADDRESS 0 SYMBOL_LINK "Rte_FordMsg091BusHiSpd_FordVehYawRateRawVld_Logl" 0 DISPLAY_IDENTIFIER VehSigCdng.ReceiverPorts.VehYawRateVldSerlCom.Logl /end MEASUREMENT
/begin MEASUREMENT VehSpdLimr.HwAg.Val "MICROSAR RTE" FLOAT32_IEEE NO_COMPU_METHOD 0 0 -3.402823466e+38 3.402823466e+38 ECU_ADDRESS 0 SYMBOL_LINK "Rte_ImcSigArbn_HwAgImcCorrd_Val" 0 DISPLAY_IDENTIFIER VehSpdLimr.ReceiverPorts.HwAg.Val /end MEASUREMENT
/begin MEASUREMENT VehSpdLimr.HwAgAuthy.Val "MICROSAR RTE" FLOAT32_IEEE NO_COMPU_METHOD 0 0 -3.402823466e+38 3.402823466e+38 ECU_ADDRESS 0 SYMBOL_LINK "Rte_HwAgSysArbn_PinionAgConf_Val" 0 DISPLAY_IDENTIFIER VehSpdLimr.ReceiverPorts.HwAgAuthy.Val /end MEASUREMENT
/begin MEASUREMENT VehSpdLimr.HwAgEotCcw.Val "MICROSAR RTE" FLOAT32_IEEE NO_COMPU_METHOD 0 0 -3.402823466e+38 3.402823466e+38 ECU_ADDRESS 0 SYMBOL_LINK "Rte_EotLrng_HwAgEotCcw_Val" 0 DISPLAY_IDENTIFIER VehSpdLimr.ReceiverPorts.HwAgEotCcw.Val /end MEASUREMENT
/begin MEASUREMENT VehSpdLimr.HwAgEotCw.Val "MICROSAR RTE" FLOAT32_IEEE NO_COMPU_METHOD 0 0 -3.402823466e+38 3.402823466e+38 ECU_ADDRESS 0 SYMBOL_LINK "Rte_EotLrng_HwAgEotCw_Val" 0 DISPLAY_IDENTIFIER VehSpdLimr.ReceiverPorts.HwAgEotCw.Val /end MEASUREMENT
/begin MEASUREMENT VehSpdLimr.VehSpd.Val "MICROSAR RTE" FLOAT32_IEEE NO_COMPU_METHOD 0 0 -3.402823466e+38 3.402823466e+38 ECU_ADDRESS 0 SYMBOL_LINK "Rte_ImcSigArbn_VehSpdImcCorrd_Val" 0 DISPLAY_IDENTIFIER VehSpdLimr.ReceiverPorts.VehSpd.Val /end MEASUREMENT
/begin MEASUREMENT VehSpdLimr.VehSpdMotTqLim.Val "MICROSAR RTE" FLOAT32_IEEE NO_COMPU_METHOD 0 0 -3.402823466e+38 3.402823466e+38 ECU_ADDRESS 0 SYMBOL_LINK "Rte_VehSpdLimr_VehSpdMotTqLim_Val" 0 DISPLAY_IDENTIFIER VehSpdLimr.SenderPorts.VehSpdMotTqLim.Val /end MEASUREMENT
/begin MEASUREMENT VehSpdLimr.dVehSpdLimrBreakPt1 "MICROSAR RTE" FLOAT32_IEEE NO_COMPU_METHOD 0 0 -3.402823466e+38 3.402823466e+38 ECU_ADDRESS 0 SYMBOL_LINK "Rte_VehSpdLimr_dVehSpdLimrBreakPt1" 0 DISPLAY_IDENTIFIER VehSpdLimr.PerInstanceMemories.dVehSpdLimrBreakPt1 /end MEASUREMENT
/begin MEASUREMENT VehSpdLimr.dVehSpdLimrBreakPt2 "MICROSAR RTE" FLOAT32_IEEE NO_COMPU_METHOD 0 0 -3.402823466e+38 3.402823466e+38 ECU_ADDRESS 0 SYMBOL_LINK "Rte_VehSpdLimr_dVehSpdLimrBreakPt2" 0 DISPLAY_IDENTIFIER VehSpdLimr.PerInstanceMemories.dVehSpdLimrBreakPt2 /end MEASUREMENT
/begin MEASUREMENT VehSpdLimr.dVehSpdLimrLimTerm "MICROSAR RTE" UWORD NO_COMPU_METHOD 0 0 0 65535 ECU_ADDRESS 0 SYMBOL_LINK "Rte_VehSpdLimr_dVehSpdLimrLimTerm" 0 DISPLAY_IDENTIFIER VehSpdLimr.PerInstanceMemories.dVehSpdLimrLimTerm /end MEASUREMENT
/begin MEASUREMENT VehSpdLimr.dVehSpdLimrZeroVehSpd "MICROSAR RTE" UWORD NO_COMPU_METHOD 0 0 0 65535 ECU_ADDRESS 0 SYMBOL_LINK "Rte_VehSpdLimr_dVehSpdLimrZeroVehSpd" 0 DISPLAY_IDENTIFIER VehSpdLimr.PerInstanceMemories.dVehSpdLimrZeroVehSpd /end MEASUREMENT
/begin GROUP SysStMod.SysStReqEna.Logl "MICROSAR RTE" /begin SUB_GROUP /end SUB_GROUP /begin FUNCTION_LIST /end FUNCTION_LIST /begin REF_CHARACTERISTIC /end REF_CHARACTERISTIC /begin REF_MEASUREMENT SysStMod.SysStReqEna.Logl /end REF_MEASUREMENT /end GROUP
/begin GROUP SysStMod.SysStWrmIninCmpl.Logl "MICROSAR RTE" /begin SUB_GROUP /end SUB_GROUP /begin FUNCTION_LIST /end FUNCTION_LIST /begin REF_CHARACTERISTIC /end REF_CHARACTERISTIC /begin REF_MEASUREMENT SysStMod.SysStWrmIninCmpl.Logl /end REF_MEASUREMENT /end GROUP
/begin GROUP SysStMod.dSysStModTranVect "MICROSAR RTE" /begin SUB_GROUP /end SUB_GROUP /begin FUNCTION_LIST /end FUNCTION_LIST /begin REF_CHARACTERISTIC /end REF_CHARACTERISTIC /begin REF_MEASUREMENT SysStMod.dSysStModTranVect /end REF_MEASUREMENT /end GROUP
/begin GROUP TEstimn "MICROSAR RTE"
 /begin SUB_GROUP TEstimn.CalibrationPorts TEstimn.PerInstanceMemories TEstimn.ReceiverPorts TEstimn.SenderPorts /end SUB_GROUP
 /begin FUNCTION_LIST /end FUNCTION_LIST
 /begin REF_CHARACTERISTIC /end REF_CHARACTERISTIC
 /begin REF_MEASUREMENT /end REF_MEASUREMENT
/end GROUP
/begin GROUP TEstimn.AmbT.Val "MICROSAR RTE" /begin SUB_GROUP /end SUB_GROUP /begin FUNCTION_LIST /end FUNCTION_LIST /begin REF_CHARACTERISTIC /end REF_CHARACTERISTIC /begin REF_MEASUREMENT TEstimn.AmbT.Val /end REF_MEASUREMENT /end GROUP
/begin GROUP TEstimn.AmbTVld.Logl "MICROSAR RTE" /begin SUB_GROUP /end SUB_GROUP /begin FUNCTION_LIST /end FUNCTION_LIST /begin REF_CHARACTERISTIC /end REF_CHARACTERISTIC /begin REF_MEASUREMENT TEstimn.AmbTVld.Logl /end REF_MEASUREMENT /end GROUP
/begin GROUP TEstimn.AmbTVldPrev "MICROSAR RTE" /begin SUB_GROUP /end SUB_GROUP /begin FUNCTION_LIST /end FUNCTION_LIST /begin REF_CHARACTERISTIC /end REF_CHARACTERISTIC /begin REF_MEASUREMENT TEstimn.AmbTVldPrev /end REF_MEASUREMENT /end GROUP
/begin GROUP TEstimn.AssiMechFilLp "MICROSAR RTE" /begin SUB_GROUP /end SUB_GROUP /begin FUNCTION_LIST /end FUNCTION_LIST /begin REF_CHARACTERISTIC /end REF_CHARACTERISTIC /begin REF_MEASUREMENT TEstimn.AssiMechFilLp.FilGain TEstimn.AssiMechFilLp.FilSt /end REF_MEASUREMENT /end GROUP
/begin GROUP TEstimn.AssiMechT.Val "MICROSAR RTE" /begin SUB_GROUP /end SUB_GROUP /begin FUNCTION_LIST /end FUNCTION_LIST /begin REF_CHARACTERISTIC /end REF_CHARACTERISTIC /begin REF_MEASUREMENT TEstimn.AssiMechT.Val /end REF_MEASUREMENT /end GROUP
/begin GROUP TEstimn.AssiMechTEstimnDi.Logl "MICROSAR RTE" /begin SUB_GROUP /end SUB_GROUP /begin FUNCTION_LIST /end FUNCTION_LIST /begin REF_CHARACTERISTIC /end REF_CHARACTERISTIC /begin REF_MEASUREMENT TEstimn.AssiMechTEstimnDi.Logl /end REF_MEASUREMENT /end GROUP
/begin GROUP TEstimn.AssiMechTEstimnPrev "MICROSAR RTE" /begin SUB_GROUP /end SUB_GROUP /begin FUNCTION_LIST /end FUNCTION_LIST /begin REF_CHARACTERISTIC /end REF_CHARACTERISTIC /begin REF_MEASUREMENT TEstimn.AssiMechTEstimnPrev /end REF_MEASUREMENT /end GROUP
/begin GROUP TEstimn.AssiMechTInitEna "MICROSAR RTE" /begin SUB_GROUP /end SUB_GROUP /begin FUNCTION_LIST /end FUNCTION_LIST /begin REF_CHARACTERISTIC /end REF_CHARACTERISTIC /begin REF_MEASUREMENT TEstimn.AssiMechTInitEna /end REF_MEASUREMENT /end GROUP
/begin GROUP TEstimn.AssiMechTSlewLimPrev "MICROSAR RTE" /begin SUB_GROUP /end SUB_GROUP /begin FUNCTION_LIST /end FUNCTION_LIST /begin REF_CHARACTERISTIC /end REF_CHARACTERISTIC /begin REF_MEASUREMENT TEstimn.AssiMechTSlewLimPrev /end REF_MEASUREMENT /end GROUP
/begin GROUP TEstimn.CalibrationPorts "MICROSAR RTE"
 /begin SUB_GROUP TEstimn.TEstimnAmbPwrMplr.Ary1D TEstimn.TEstimnAmbTSca.Ary1D TEstimn.TEstimnAssiMechAmbLpFilFrq.Val TEstimn.TEstimnAssiMechAmbLpFilFrqDualEcuFltMtgtn.Val TEstimn.TEstimnAssiMechAmbLpFilFrqFetMtgtnEna.Val TEstimn.TEstimnAssiMechAmbMplr.Ary1D TEstimn.TEstimnAssiMechCorrLim.Ary1D TEstimn.TEstimnAssiMechDampgSca.Ary1D TEstimn.TEstimnAssiMechDftT.Ary1D TEstimn.TEstimnAssiMechLLFilCoeffA1.Ary1D TEstimn.TEstimnAssiMechLLFilCoeffB0.Ary1D TEstimn.TEstimnAssiMechLLFilCoeffB1.Ary1D TEstimn.TEstimnAssiMechSlew.Ary1D TEstimn.TEstimnCorrnTAssiMech.Ary1D TEstimn.TEstimnCorrnTCu.Ary1D TEstimn.TEstimnCorrnTMag.Ary1D TEstimn.TEstimnCorrnTSi.Ary1D TEstimn.TEstimnCuAmbLpFilFrq.Val TEstimn.TEstimnCuAmbLpFilFrqDualEcuFltMtgtn.Val TEstimn.TEstimnCuAmbLpFilFrqFetMtgtnEna.Val TEstimn.TEstimnCuAmbMplr.Ary1D TEstimn.TEstimnCuCorrnLim.Ary1D TEstimn.TEstimnCuLLFilCoeffA1.Ary1D TEstimn.TEstimnCuLLFilCoeffB0.Ary1D TEstimn.TEstimnCuLLFilCoeffB1.Ary1D TEstimn.TEstimnEngTSca.Ary1D TEstimn.TEstimnIgnOffCtrlEna.Logl TEstimn.TEstimnIgnOffMsgWaitTi.Val TEstimn.TEstimnMagAmbLpFilFrq.Val TEstimn.TEstimnMagAmbLpFilFrqDualEcuFltMtgtn.Val TEstimn.TEstimnMagAmbLpFilFrqFetMtgtnEna.Val TEstimn.TEstimnMagAmbMplr.Ary1D TEstimn.TEstimnMagCorrnLim.Ary1D TEstimn.TEstimnMagLLFilCoeffA1.Ary1D TEstimn.TEstimnMagLLFilCoeffB0.Ary1D TEstimn.TEstimnMagLLFilCoeffB1.Ary1D TEstimn.TEstimnSiAmbLpFilFrq.Val TEstimn.TEstimnSiAmbLpFilFrqDualEcuFltMtgtn.Val TEstimn.TEstimnSiAmbLpFilFrqFetMtgtnEna.Val TEstimn.TEstimnSiAmbMplr.Ary1D TEstimn.TEstimnSiCorrnLim.Ary1D TEstimn.TEstimnSiLLFilCoeffA1.Ary1D TEstimn.TEstimnSiLLFilCoeffB0.Ary1D TEstimn.TEstimnSiLLFilCoeffB1.Ary1D TEstimn.TEstimnTauAssiMech.Ary1D TEstimn.TEstimnTauCu.Ary1D TEstimn.TEstimnTauMag.Ary1D TEstimn.TEstimnTauSi.Ary1D TEstimn.TEstimnWghtAvrgTDi.Ary1D /end SUB_GROUP
 /begin FUNCTION_LIST /end FUNCTION_LIST
 /begin REF_CHARACTERISTIC /end REF_CHARACTERISTIC
 /begin REF_MEASUREMENT /end REF_MEASUREMENT
/end GROUP
/begin GROUP TEstimn.CuFilLp "MICROSAR RTE" /begin SUB_GROUP /end SUB_GROUP /begin FUNCTION_LIST /end FUNCTION_LIST /begin REF_CHARACTERISTIC /end REF_CHARACTERISTIC /begin REF_MEASUREMENT TEstimn.CuFilLp.FilGain TEstimn.CuFilLp.FilSt /end REF_MEASUREMENT /end GROUP
/begin GROUP TEstimn.CuTEstimnPrev "MICROSAR RTE" /begin SUB_GROUP /end SUB_GROUP /begin FUNCTION_LIST /end FUNCTION_LIST /begin REF_CHARACTERISTIC /end REF_CHARACTERISTIC /begin REF_MEASUREMENT TEstimn.CuTEstimnPrev /end REF_MEASUREMENT /end GROUP
/begin GROUP TEstimn.DualEcuFltMtgtnEna.Logl "MICROSAR RTE" /begin SUB_GROUP /end SUB_GROUP /begin FUNCTION_LIST /end FUNCTION_LIST /begin REF_CHARACTERISTIC /end REF_CHARACTERISTIC /begin REF_MEASUREMENT TEstimn.DualEcuFltMtgtnEna.Logl /end REF_MEASUREMENT /end GROUP
/begin GROUP TEstimn.DualEcuFltMtgtnPrev "MICROSAR RTE" /begin SUB_GROUP /end SUB_GROUP /begin FUNCTION_LIST /end FUNCTION_LIST /begin REF_CHARACTERISTIC /end REF_CHARACTERISTIC /begin REF_MEASUREMENT TEstimn.DualEcuFltMtgtnPrev /end REF_MEASUREMENT /end GROUP
/begin GROUP TEstimn.EcuTFild.Val "MICROSAR RTE" /begin SUB_GROUP /end SUB_GROUP /begin FUNCTION_LIST /end FUNCTION_LIST /begin REF_CHARACTERISTIC /end REF_CHARACTERISTIC /begin REF_MEASUREMENT TEstimn.EcuTFild.Val /end REF_MEASUREMENT /end GROUP
/begin GROUP TEstimn.EngOilT.Val "MICROSAR RTE" /begin SUB_GROUP /end SUB_GROUP /begin FUNCTION_LIST /end FUNCTION_LIST /begin REF_CHARACTERISTIC /end REF_CHARACTERISTIC /begin REF_MEASUREMENT TEstimn.EngOilT.Val /end REF_MEASUREMENT /end GROUP
/begin GROUP TEstimn.EngOilTVld.Logl "MICROSAR RTE" /begin SUB_GROUP /end SUB_GROUP /begin FUNCTION_LIST /end FUNCTION_LIST /begin REF_CHARACTERISTIC /end REF_CHARACTERISTIC /begin REF_MEASUREMENT TEstimn.EngOilTVld.Logl /end REF_MEASUREMENT /end GROUP
/begin GROUP TEstimn.EngOilTVldPrev "MICROSAR RTE" /begin SUB_GROUP /end SUB_GROUP /begin FUNCTION_LIST /end FUNCTION_LIST /begin REF_CHARACTERISTIC /end REF_CHARACTERISTIC /begin REF_MEASUREMENT TEstimn.EngOilTVldPrev /end REF_MEASUREMENT /end GROUP
/begin GROUP TEstimn.FetMtgtnEnaPrev "MICROSAR RTE" /begin SUB_GROUP /end SUB_GROUP /begin FUNCTION_LIST /end FUNCTION_LIST /begin REF_CHARACTERISTIC /end REF_CHARACTERISTIC /begin REF_MEASUREMENT TEstimn.FetMtgtnEnaPrev /end REF_MEASUREMENT /end GROUP
/begin GROUP TEstimn.FilAssiMechLLValPwrUp "MICROSAR RTE" /begin SUB_GROUP /end SUB_GROUP /begin FUNCTION_LIST /end FUNCTION_LIST /begin REF_CHARACTERISTIC /end REF_CHARACTERISTIC /begin REF_MEASUREMENT TEstimn.FilAssiMechLLValPwrUp /end REF_MEASUREMENT /end GROUP
/begin GROUP TEstimn.FilAssiMechLpValPwrUp "MICROSAR RTE" /begin SUB_GROUP /end SUB_GROUP /begin FUNCTION_LIST /end FUNCTION_LIST /begin REF_CHARACTERISTIC /end REF_CHARACTERISTIC /begin REF_MEASUREMENT TEstimn.FilAssiMechLpValPwrUp /end REF_MEASUREMENT /end GROUP
/begin GROUP TEstimn.FilCuLLValPwrUp "MICROSAR RTE" /begin SUB_GROUP /end SUB_GROUP /begin FUNCTION_LIST /end FUNCTION_LIST /begin REF_CHARACTERISTIC /end REF_CHARACTERISTIC /begin REF_MEASUREMENT TEstimn.FilCuLLValPwrUp /end REF_MEASUREMENT /end GROUP
/begin GROUP TEstimn.FilCuLpValPwrUp "MICROSAR RTE" /begin SUB_GROUP /end SUB_GROUP /begin FUNCTION_LIST /end FUNCTION_LIST /begin REF_CHARACTERISTIC /end REF_CHARACTERISTIC /begin REF_MEASUREMENT TEstimn.FilCuLpValPwrUp /end REF_MEASUREMENT /end GROUP
/begin GROUP TEstimn.FilMagLLValPwrUp "MICROSAR RTE" /begin SUB_GROUP /end SUB_GROUP /begin FUNCTION_LIST /end FUNCTION_LIST /begin REF_CHARACTERISTIC /end REF_CHARACTERISTIC /begin REF_MEASUREMENT TEstimn.FilMagLLValPwrUp /end REF_MEASUREMENT /end GROUP
/begin GROUP TEstimn.FilMagLpValPwrUp "MICROSAR RTE" /begin SUB_GROUP /end SUB_GROUP /begin FUNCTION_LIST /end FUNCTION_LIST /begin REF_CHARACTERISTIC /end REF_CHARACTERISTIC /begin REF_MEASUREMENT TEstimn.FilMagLpValPwrUp /end REF_MEASUREMENT /end GROUP
/begin GROUP TEstimn.FilSiLLValPwrUp "MICROSAR RTE" /begin SUB_GROUP /end SUB_GROUP /begin FUNCTION_LIST /end FUNCTION_LIST /begin REF_CHARACTERISTIC /end REF_CHARACTERISTIC /begin REF_MEASUREMENT TEstimn.FilSiLLValPwrUp /end REF_MEASUREMENT /end GROUP
/begin GROUP TEstimn.FilSiLpValPwrUp "MICROSAR RTE" /begin SUB_GROUP /end SUB_GROUP /begin FUNCTION_LIST /end FUNCTION_LIST /begin REF_CHARACTERISTIC /end REF_CHARACTERISTIC /begin REF_MEASUREMENT TEstimn.FilSiLpValPwrUp /end REF_MEASUREMENT /end GROUP
/begin GROUP TEstimn.HwVel.Val "MICROSAR RTE" /begin SUB_GROUP /end SUB_GROUP /begin FUNCTION_LIST /end FUNCTION_LIST /begin REF_CHARACTERISTIC /end REF_CHARACTERISTIC /begin REF_MEASUREMENT TEstimn.HwVel.Val /end REF_MEASUREMENT /end GROUP
/begin GROUP TEstimn.IgnTiOff.Val "MICROSAR RTE" /begin SUB_GROUP /end SUB_GROUP /begin FUNCTION_LIST /end FUNCTION_LIST /begin REF_CHARACTERISTIC /end REF_CHARACTERISTIC /begin REF_MEASUREMENT TEstimn.IgnTiOff.Val /end REF_MEASUREMENT /end GROUP
/begin GROUP TEstimn.MagFilLp "MICROSAR RTE" /begin SUB_GROUP /end SUB_GROUP /begin FUNCTION_LIST /end FUNCTION_LIST /begin REF_CHARACTERISTIC /end REF_CHARACTERISTIC /begin REF_MEASUREMENT TEstimn.MagFilLp.FilGain TEstimn.MagFilLp.FilSt /end REF_MEASUREMENT /end GROUP
/begin GROUP TEstimn.MagTEstimnPrev "MICROSAR RTE" /begin SUB_GROUP /end SUB_GROUP /begin FUNCTION_LIST /end FUNCTION_LIST /begin REF_CHARACTERISTIC /end REF_CHARACTERISTIC /begin REF_MEASUREMENT TEstimn.MagTEstimnPrev /end REF_MEASUREMENT /end GROUP
/begin GROUP TEstimn.MotAndThermProtnLoaMod.Val "MICROSAR RTE" /begin SUB_GROUP /end SUB_GROUP /begin FUNCTION_LIST /end FUNCTION_LIST /begin REF_CHARACTERISTIC /end REF_CHARACTERISTIC /begin REF_MEASUREMENT TEstimn.MotAndThermProtnLoaMod.Val /end REF_MEASUREMENT /end GROUP
/begin GROUP TEstimn.MotCurrPeakEstimd.Val "MICROSAR RTE" /begin SUB_GROUP /end SUB_GROUP /begin FUNCTION_LIST /end FUNCTION_LIST /begin REF_CHARACTERISTIC /end REF_CHARACTERISTIC /begin REF_MEASUREMENT TEstimn.MotCurrPeakEstimd.Val /end REF_MEASUREMENT /end GROUP
/begin GROUP TEstimn.MotFetT.Val "MICROSAR RTE" /begin SUB_GROUP /end SUB_GROUP /begin FUNCTION_LIST /end FUNCTION_LIST /begin REF_CHARACTERISTIC /end REF_CHARACTERISTIC /begin REF_MEASUREMENT TEstimn.MotFetT.Val /end REF_MEASUREMENT /end GROUP
/begin GROUP TEstimn.MotMagT.Val "MICROSAR RTE" /begin SUB_GROUP /end SUB_GROUP /begin FUNCTION_LIST /end FUNCTION_LIST /begin REF_CHARACTERISTIC /end REF_CHARACTERISTIC /begin REF_MEASUREMENT TEstimn.MotMagT.Val /end REF_MEASUREMENT /end GROUP
/begin GROUP TEstimn.MotWidgT.Val "MICROSAR RTE" /begin SUB_GROUP /end SUB_GROUP /begin FUNCTION_LIST /end FUNCTION_LIST /begin REF_CHARACTERISTIC /end REF_CHARACTERISTIC /begin REF_MEASUREMENT TEstimn.MotWidgT.Val /end REF_MEASUREMENT /end GROUP
/begin GROUP TEstimn.PerInstanceMemories "MICROSAR RTE"
 /begin SUB_GROUP TEstimn.AmbTVldPrev TEstimn.AssiMechFilLp TEstimn.AssiMechTEstimnPrev TEstimn.AssiMechTInitEna TEstimn.AssiMechTSlewLimPrev TEstimn.CuFilLp TEstimn.CuTEstimnPrev TEstimn.DualEcuFltMtgtnPrev TEstimn.EngOilTVldPrev TEstimn.FetMtgtnEnaPrev TEstimn.FilAssiMechLLValPwrUp TEstimn.FilAssiMechLpValPwrUp TEstimn.FilCuLLValPwrUp TEstimn.FilCuLpValPwrUp TEstimn.FilMagLLValPwrUp TEstimn.FilMagLpValPwrUp TEstimn.FilSiLLValPwrUp TEstimn.FilSiLpValPwrUp TEstimn.MagFilLp TEstimn.MagTEstimnPrev TEstimn.RepInitCntrFlg TEstimn.RepInitCntrVal TEstimn.SiFilLp TEstimn.SiTEstimnPrev TEstimn.TEstimnFltMtgtnCalIdx TEstimn.TFilStVal TEstimn.dTEstimnAmbPwr TEstimn.dTEstimnAssiMechCorrn TEstimn.dTEstimnAssiMechDampgSca TEstimn.dTEstimnAssiMechFil TEstimn.dTEstimnCuCorrn TEstimn.dTEstimnMagCorrn TEstimn.dTEstimnScadAmbT TEstimn.dTEstimnScadEngT TEstimn.dTEstimnSiCorrn TEstimn.dTEstimnWghtAvrgT /end SUB_GROUP
 /begin FUNCTION_LIST /end FUNCTION_LIST
 /begin REF_CHARACTERISTIC /end REF_CHARACTERISTIC
 /begin REF_MEASUREMENT /end REF_MEASUREMENT
/end GROUP
/begin GROUP TEstimn.ReceiverPorts "MICROSAR RTE"
 /begin SUB_GROUP TEstimn.AmbT.Val TEstimn.AmbTVld.Logl TEstimn.AssiMechTEstimnDi.Logl TEstimn.DualEcuFltMtgtnEna.Logl TEstimn.EcuTFild.Val TEstimn.EngOilT.Val TEstimn.EngOilTVld.Logl TEstimn.HwVel.Val TEstimn.IgnTiOff.Val TEstimn.MotAndThermProtnLoaMod.Val TEstimn.MotCurrPeakEstimd.Val TEstimn.VehTiVld.Logl /end SUB_GROUP
 /begin FUNCTION_LIST /end FUNCTION_LIST
 /begin REF_CHARACTERISTIC /end REF_CHARACTERISTIC
 /begin REF_MEASUREMENT /end REF_MEASUREMENT
/end GROUP
/begin GROUP TEstimn.RepInitCntrFlg "MICROSAR RTE" /begin SUB_GROUP /end SUB_GROUP /begin FUNCTION_LIST /end FUNCTION_LIST /begin REF_CHARACTERISTIC /end REF_CHARACTERISTIC /begin REF_MEASUREMENT TEstimn.RepInitCntrFlg /end REF_MEASUREMENT /end GROUP
/begin GROUP TEstimn.RepInitCntrVal "MICROSAR RTE" /begin SUB_GROUP /end SUB_GROUP /begin FUNCTION_LIST /end FUNCTION_LIST /begin REF_CHARACTERISTIC /end REF_CHARACTERISTIC /begin REF_MEASUREMENT TEstimn.RepInitCntrVal /end REF_MEASUREMENT /end GROUP
/begin GROUP TEstimn.SenderPorts "MICROSAR RTE"
 /begin SUB_GROUP TEstimn.AssiMechT.Val TEstimn.MotFetT.Val TEstimn.MotMagT.Val TEstimn.MotWidgT.Val /end SUB_GROUP
 /begin FUNCTION_LIST /end FUNCTION_LIST
 /begin REF_CHARACTERISTIC /end REF_CHARACTERISTIC
 /begin REF_MEASUREMENT /end REF_MEASUREMENT
/end GROUP
/begin GROUP TEstimn.SiFilLp "MICROSAR RTE" /begin SUB_GROUP /end SUB_GROUP /begin FUNCTION_LIST /end FUNCTION_LIST /begin REF_CHARACTERISTIC /end REF_CHARACTERISTIC /begin REF_MEASUREMENT TEstimn.SiFilLp.FilGain TEstimn.SiFilLp.FilSt /end REF_MEASUREMENT /end GROUP
/begin GROUP TEstimn.SiTEstimnPrev "MICROSAR RTE" /begin SUB_GROUP /end SUB_GROUP /begin FUNCTION_LIST /end FUNCTION_LIST /begin REF_CHARACTERISTIC /end REF_CHARACTERISTIC /begin REF_MEASUREMENT TEstimn.SiTEstimnPrev /end REF_MEASUREMENT /end GROUP
/begin GROUP TEstimn.TEstimnAmbPwrMplr.Ary1D "MICROSAR RTE" /begin SUB_GROUP /end SUB_GROUP /begin FUNCTION_LIST /end FUNCTION_LIST /begin REF_CHARACTERISTIC TEstimn.TEstimnAmbPwrMplr.Ary1D /end REF_CHARACTERISTIC /begin REF_MEASUREMENT /end REF_MEASUREMENT /end GROUP
/begin GROUP TEstimn.TEstimnAmbTSca.Ary1D "MICROSAR RTE" /begin SUB_GROUP /end SUB_GROUP /begin FUNCTION_LIST /end FUNCTION_LIST /begin REF_CHARACTERISTIC TEstimn.TEstimnAmbTSca.Ary1D /end REF_CHARACTERISTIC /begin REF_MEASUREMENT /end REF_MEASUREMENT /end GROUP
/begin GROUP TEstimn.TEstimnAssiMechAmbLpFilFrq.Val "MICROSAR RTE" /begin SUB_GROUP /end SUB_GROUP /begin FUNCTION_LIST /end FUNCTION_LIST /begin REF_CHARACTERISTIC TEstimn.TEstimnAssiMechAmbLpFilFrq.Val /end REF_CHARACTERISTIC /begin REF_MEASUREMENT /end REF_MEASUREMENT /end GROUP
/begin GROUP TEstimn.TEstimnAssiMechAmbLpFilFrqDualEcuFltMtgtn.Val "MICROSAR RTE" /begin SUB_GROUP /end SUB_GROUP /begin FUNCTION_LIST /end FUNCTION_LIST /begin REF_CHARACTERISTIC TEstimn.TEstimnAssiMechAmbLpFilFrqDualEcuFltMtgtn.Val /end REF_CHARACTERISTIC /begin REF_MEASUREMENT /end REF_MEASUREMENT /end GROUP
/begin GROUP TEstimn.TEstimnAssiMechAmbLpFilFrqFetMtgtnEna.Val "MICROSAR RTE" /begin SUB_GROUP /end SUB_GROUP /begin FUNCTION_LIST /end FUNCTION_LIST /begin REF_CHARACTERISTIC TEstimn.TEstimnAssiMechAmbLpFilFrqFetMtgtnEna.Val /end REF_CHARACTERISTIC /begin REF_MEASUREMENT /end REF_MEASUREMENT /end GROUP
/begin GROUP TEstimn.TEstimnAssiMechAmbMplr.Ary1D "MICROSAR RTE" /begin SUB_GROUP /end SUB_GROUP /begin FUNCTION_LIST /end FUNCTION_LIST /begin REF_CHARACTERISTIC TEstimn.TEstimnAssiMechAmbMplr.Ary1D /end REF_CHARACTERISTIC /begin REF_MEASUREMENT /end REF_MEASUREMENT /end GROUP
/begin GROUP TEstimn.TEstimnAssiMechCorrLim.Ary1D "MICROSAR RTE" /begin SUB_GROUP /end SUB_GROUP /begin FUNCTION_LIST /end FUNCTION_LIST /begin REF_CHARACTERISTIC TEstimn.TEstimnAssiMechCorrLim.Ary1D /end REF_CHARACTERISTIC /begin REF_MEASUREMENT /end REF_MEASUREMENT /end GROUP
/begin GROUP TEstimn.TEstimnAssiMechDampgSca.Ary1D "MICROSAR RTE" /begin SUB_GROUP /end SUB_GROUP /begin FUNCTION_LIST /end FUNCTION_LIST /begin REF_CHARACTERISTIC TEstimn.TEstimnAssiMechDampgSca.Ary1D /end REF_CHARACTERISTIC /begin REF_MEASUREMENT /end REF_MEASUREMENT /end GROUP
/begin GROUP TEstimn.TEstimnAssiMechDftT.Ary1D "MICROSAR RTE" /begin SUB_GROUP /end SUB_GROUP /begin FUNCTION_LIST /end FUNCTION_LIST /begin REF_CHARACTERISTIC TEstimn.TEstimnAssiMechDftT.Ary1D /end REF_CHARACTERISTIC /begin REF_MEASUREMENT /end REF_MEASUREMENT /end GROUP
/begin GROUP TEstimn.TEstimnAssiMechLLFilCoeffA1.Ary1D "MICROSAR RTE" /begin SUB_GROUP /end SUB_GROUP /begin FUNCTION_LIST /end FUNCTION_LIST /begin REF_CHARACTERISTIC TEstimn.TEstimnAssiMechLLFilCoeffA1.Ary1D /end REF_CHARACTERISTIC /begin REF_MEASUREMENT /end REF_MEASUREMENT /end GROUP
/begin GROUP TEstimn.TEstimnAssiMechLLFilCoeffB0.Ary1D "MICROSAR RTE" /begin SUB_GROUP /end SUB_GROUP /begin FUNCTION_LIST /end FUNCTION_LIST /begin REF_CHARACTERISTIC TEstimn.TEstimnAssiMechLLFilCoeffB0.Ary1D /end REF_CHARACTERISTIC /begin REF_MEASUREMENT /end REF_MEASUREMENT /end GROUP
/begin GROUP TEstimn.TEstimnAssiMechLLFilCoeffB1.Ary1D "MICROSAR RTE" /begin SUB_GROUP /end SUB_GROUP /begin FUNCTION_LIST /end FUNCTION_LIST /begin REF_CHARACTERISTIC TEstimn.TEstimnAssiMechLLFilCoeffB1.Ary1D /end REF_CHARACTERISTIC /begin REF_MEASUREMENT /end REF_MEASUREMENT /end GROUP
/begin GROUP TEstimn.TEstimnAssiMechSlew.Ary1D "MICROSAR RTE" /begin SUB_GROUP /end SUB_GROUP /begin FUNCTION_LIST /end FUNCTION_LIST /begin REF_CHARACTERISTIC TEstimn.TEstimnAssiMechSlew.Ary1D /end REF_CHARACTERISTIC /begin REF_MEASUREMENT /end REF_MEASUREMENT /end GROUP
/begin GROUP TEstimn.TEstimnCorrnTAssiMech.Ary1D "MICROSAR RTE" /begin SUB_GROUP /end SUB_GROUP /begin FUNCTION_LIST /end FUNCTION_LIST /begin REF_CHARACTERISTIC TEstimn.TEstimnCorrnTAssiMech.Ary1D /end REF_CHARACTERISTIC /begin REF_MEASUREMENT /end REF_MEASUREMENT /end GROUP
/begin GROUP TEstimn.TEstimnCorrnTCu.Ary1D "MICROSAR RTE" /begin SUB_GROUP /end SUB_GROUP /begin FUNCTION_LIST /end FUNCTION_LIST /begin REF_CHARACTERISTIC TEstimn.TEstimnCorrnTCu.Ary1D /end REF_CHARACTERISTIC /begin REF_MEASUREMENT /end REF_MEASUREMENT /end GROUP
/begin GROUP TEstimn.TEstimnCorrnTMag.Ary1D "MICROSAR RTE" /begin SUB_GROUP /end SUB_GROUP /begin FUNCTION_LIST /end FUNCTION_LIST /begin REF_CHARACTERISTIC TEstimn.TEstimnCorrnTMag.Ary1D /end REF_CHARACTERISTIC /begin REF_MEASUREMENT /end REF_MEASUREMENT /end GROUP
/begin GROUP TEstimn.TEstimnCorrnTSi.Ary1D "MICROSAR RTE" /begin SUB_GROUP /end SUB_GROUP /begin FUNCTION_LIST /end FUNCTION_LIST /begin REF_CHARACTERISTIC TEstimn.TEstimnCorrnTSi.Ary1D /end REF_CHARACTERISTIC /begin REF_MEASUREMENT /end REF_MEASUREMENT /end GROUP
/begin GROUP TEstimn.TEstimnCuAmbLpFilFrq.Val "MICROSAR RTE" /begin SUB_GROUP /end SUB_GROUP /begin FUNCTION_LIST /end FUNCTION_LIST /begin REF_CHARACTERISTIC TEstimn.TEstimnCuAmbLpFilFrq.Val /end REF_CHARACTERISTIC /begin REF_MEASUREMENT /end REF_MEASUREMENT /end GROUP
/begin GROUP TEstimn.TEstimnCuAmbLpFilFrqDualEcuFltMtgtn.Val "MICROSAR RTE" /begin SUB_GROUP /end SUB_GROUP /begin FUNCTION_LIST /end FUNCTION_LIST /begin REF_CHARACTERISTIC TEstimn.TEstimnCuAmbLpFilFrqDualEcuFltMtgtn.Val /end REF_CHARACTERISTIC /begin REF_MEASUREMENT /end REF_MEASUREMENT /end GROUP
/begin GROUP TEstimn.TEstimnCuAmbLpFilFrqFetMtgtnEna.Val "MICROSAR RTE" /begin SUB_GROUP /end SUB_GROUP /begin FUNCTION_LIST /end FUNCTION_LIST /begin REF_CHARACTERISTIC TEstimn.TEstimnCuAmbLpFilFrqFetMtgtnEna.Val /end REF_CHARACTERISTIC /begin REF_MEASUREMENT /end REF_MEASUREMENT /end GROUP
/begin GROUP TEstimn.TEstimnCuAmbMplr.Ary1D "MICROSAR RTE" /begin SUB_GROUP /end SUB_GROUP /begin FUNCTION_LIST /end FUNCTION_LIST /begin REF_CHARACTERISTIC TEstimn.TEstimnCuAmbMplr.Ary1D /end REF_CHARACTERISTIC /begin REF_MEASUREMENT /end REF_MEASUREMENT /end GROUP
/begin GROUP TEstimn.TEstimnCuCorrnLim.Ary1D "MICROSAR RTE" /begin SUB_GROUP /end SUB_GROUP /begin FUNCTION_LIST /end FUNCTION_LIST /begin REF_CHARACTERISTIC TEstimn.TEstimnCuCorrnLim.Ary1D /end REF_CHARACTERISTIC /begin REF_MEASUREMENT /end REF_MEASUREMENT /end GROUP
/begin GROUP TEstimn.TEstimnCuLLFilCoeffA1.Ary1D "MICROSAR RTE" /begin SUB_GROUP /end SUB_GROUP /begin FUNCTION_LIST /end FUNCTION_LIST /begin REF_CHARACTERISTIC TEstimn.TEstimnCuLLFilCoeffA1.Ary1D /end REF_CHARACTERISTIC /begin REF_MEASUREMENT /end REF_MEASUREMENT /end GROUP
/begin GROUP TEstimn.TEstimnCuLLFilCoeffB0.Ary1D "MICROSAR RTE" /begin SUB_GROUP /end SUB_GROUP /begin FUNCTION_LIST /end FUNCTION_LIST /begin REF_CHARACTERISTIC TEstimn.TEstimnCuLLFilCoeffB0.Ary1D /end REF_CHARACTERISTIC /begin REF_MEASUREMENT /end REF_MEASUREMENT /end GROUP
/begin GROUP TEstimn.TEstimnCuLLFilCoeffB1.Ary1D "MICROSAR RTE" /begin SUB_GROUP /end SUB_GROUP /begin FUNCTION_LIST /end FUNCTION_LIST /begin REF_CHARACTERISTIC TEstimn.TEstimnCuLLFilCoeffB1.Ary1D /end REF_CHARACTERISTIC /begin REF_MEASUREMENT /end REF_MEASUREMENT /end GROUP
/begin GROUP TEstimn.TEstimnEngTSca.Ary1D "MICROSAR RTE" /begin SUB_GROUP /end SUB_GROUP /begin FUNCTION_LIST /end FUNCTION_LIST /begin REF_CHARACTERISTIC TEstimn.TEstimnEngTSca.Ary1D /end REF_CHARACTERISTIC /begin REF_MEASUREMENT /end REF_MEASUREMENT /end GROUP
/begin GROUP TEstimn.TEstimnFltMtgtnCalIdx "MICROSAR RTE" /begin SUB_GROUP /end SUB_GROUP /begin FUNCTION_LIST /end FUNCTION_LIST /begin REF_CHARACTERISTIC /end REF_CHARACTERISTIC /begin REF_MEASUREMENT TEstimn.TEstimnFltMtgtnCalIdx /end REF_MEASUREMENT /end GROUP
/begin GROUP TEstimn.TEstimnIgnOffCtrlEna.Logl "MICROSAR RTE" /begin SUB_GROUP /end SUB_GROUP /begin FUNCTION_LIST /end FUNCTION_LIST /begin REF_CHARACTERISTIC TEstimn.TEstimnIgnOffCtrlEna.Logl /end REF_CHARACTERISTIC /begin REF_MEASUREMENT /end REF_MEASUREMENT /end GROUP
/begin GROUP TEstimn.TEstimnIgnOffMsgWaitTi.Val "MICROSAR RTE" /begin SUB_GROUP /end SUB_GROUP /begin FUNCTION_LIST /end FUNCTION_LIST /begin REF_CHARACTERISTIC TEstimn.TEstimnIgnOffMsgWaitTi.Val /end REF_CHARACTERISTIC /begin REF_MEASUREMENT /end REF_MEASUREMENT /end GROUP
/begin GROUP TEstimn.TEstimnMagAmbLpFilFrq.Val "MICROSAR RTE" /begin SUB_GROUP /end SUB_GROUP /begin FUNCTION_LIST /end FUNCTION_LIST /begin REF_CHARACTERISTIC TEstimn.TEstimnMagAmbLpFilFrq.Val /end REF_CHARACTERISTIC /begin REF_MEASUREMENT /end REF_MEASUREMENT /end GROUP
/begin GROUP TEstimn.TEstimnMagAmbLpFilFrqDualEcuFltMtgtn.Val "MICROSAR RTE" /begin SUB_GROUP /end SUB_GROUP /begin FUNCTION_LIST /end FUNCTION_LIST /begin REF_CHARACTERISTIC TEstimn.TEstimnMagAmbLpFilFrqDualEcuFltMtgtn.Val /end REF_CHARACTERISTIC /begin REF_MEASUREMENT /end REF_MEASUREMENT /end GROUP
/begin GROUP TEstimn.TEstimnMagAmbLpFilFrqFetMtgtnEna.Val "MICROSAR RTE" /begin SUB_GROUP /end SUB_GROUP /begin FUNCTION_LIST /end FUNCTION_LIST /begin REF_CHARACTERISTIC TEstimn.TEstimnMagAmbLpFilFrqFetMtgtnEna.Val /end REF_CHARACTERISTIC /begin REF_MEASUREMENT /end REF_MEASUREMENT /end GROUP
/begin GROUP TEstimn.TEstimnMagAmbMplr.Ary1D "MICROSAR RTE" /begin SUB_GROUP /end SUB_GROUP /begin FUNCTION_LIST /end FUNCTION_LIST /begin REF_CHARACTERISTIC TEstimn.TEstimnMagAmbMplr.Ary1D /end REF_CHARACTERISTIC /begin REF_MEASUREMENT /end REF_MEASUREMENT /end GROUP
/begin GROUP TEstimn.TEstimnMagCorrnLim.Ary1D "MICROSAR RTE" /begin SUB_GROUP /end SUB_GROUP /begin FUNCTION_LIST /end FUNCTION_LIST /begin REF_CHARACTERISTIC TEstimn.TEstimnMagCorrnLim.Ary1D /end REF_CHARACTERISTIC /begin REF_MEASUREMENT /end REF_MEASUREMENT /end GROUP
/begin GROUP TEstimn.TEstimnMagLLFilCoeffA1.Ary1D "MICROSAR RTE" /begin SUB_GROUP /end SUB_GROUP /begin FUNCTION_LIST /end FUNCTION_LIST /begin REF_CHARACTERISTIC TEstimn.TEstimnMagLLFilCoeffA1.Ary1D /end REF_CHARACTERISTIC /begin REF_MEASUREMENT /end REF_MEASUREMENT /end GROUP
/begin GROUP TEstimn.TEstimnMagLLFilCoeffB0.Ary1D "MICROSAR RTE" /begin SUB_GROUP /end SUB_GROUP /begin FUNCTION_LIST /end FUNCTION_LIST /begin REF_CHARACTERISTIC TEstimn.TEstimnMagLLFilCoeffB0.Ary1D /end REF_CHARACTERISTIC /begin REF_MEASUREMENT /end REF_MEASUREMENT /end GROUP
/begin GROUP TEstimn.TEstimnMagLLFilCoeffB1.Ary1D "MICROSAR RTE" /begin SUB_GROUP /end SUB_GROUP /begin FUNCTION_LIST /end FUNCTION_LIST /begin REF_CHARACTERISTIC TEstimn.TEstimnMagLLFilCoeffB1.Ary1D /end REF_CHARACTERISTIC /begin REF_MEASUREMENT /end REF_MEASUREMENT /end GROUP
/begin GROUP TEstimn.TEstimnSiAmbLpFilFrq.Val "MICROSAR RTE" /begin SUB_GROUP /end SUB_GROUP /begin FUNCTION_LIST /end FUNCTION_LIST /begin REF_CHARACTERISTIC TEstimn.TEstimnSiAmbLpFilFrq.Val /end REF_CHARACTERISTIC /begin REF_MEASUREMENT /end REF_MEASUREMENT /end GROUP
/begin GROUP TEstimn.TEstimnSiAmbLpFilFrqDualEcuFltMtgtn.Val "MICROSAR RTE" /begin SUB_GROUP /end SUB_GROUP /begin FUNCTION_LIST /end FUNCTION_LIST /begin REF_CHARACTERISTIC TEstimn.TEstimnSiAmbLpFilFrqDualEcuFltMtgtn.Val /end REF_CHARACTERISTIC /begin REF_MEASUREMENT /end REF_MEASUREMENT /end GROUP
/begin GROUP TEstimn.TEstimnSiAmbLpFilFrqFetMtgtnEna.Val "MICROSAR RTE" /begin SUB_GROUP /end SUB_GROUP /begin FUNCTION_LIST /end FUNCTION_LIST /begin REF_CHARACTERISTIC TEstimn.TEstimnSiAmbLpFilFrqFetMtgtnEna.Val /end REF_CHARACTERISTIC /begin REF_MEASUREMENT /end REF_MEASUREMENT /end GROUP
/begin GROUP TEstimn.TEstimnSiAmbMplr.Ary1D "MICROSAR RTE" /begin SUB_GROUP /end SUB_GROUP /begin FUNCTION_LIST /end FUNCTION_LIST /begin REF_CHARACTERISTIC TEstimn.TEstimnSiAmbMplr.Ary1D /end REF_CHARACTERISTIC /begin REF_MEASUREMENT /end REF_MEASUREMENT /end GROUP
/begin GROUP TEstimn.TEstimnSiCorrnLim.Ary1D "MICROSAR RTE" /begin SUB_GROUP /end SUB_GROUP /begin FUNCTION_LIST /end FUNCTION_LIST /begin REF_CHARACTERISTIC TEstimn.TEstimnSiCorrnLim.Ary1D /end REF_CHARACTERISTIC /begin REF_MEASUREMENT /end REF_MEASUREMENT /end GROUP
/begin GROUP TEstimn.TEstimnSiLLFilCoeffA1.Ary1D "MICROSAR RTE" /begin SUB_GROUP /end SUB_GROUP /begin FUNCTION_LIST /end FUNCTION_LIST /begin REF_CHARACTERISTIC TEstimn.TEstimnSiLLFilCoeffA1.Ary1D /end REF_CHARACTERISTIC /begin REF_MEASUREMENT /end REF_MEASUREMENT /end GROUP
/begin GROUP TEstimn.TEstimnSiLLFilCoeffB0.Ary1D "MICROSAR RTE" /begin SUB_GROUP /end SUB_GROUP /begin FUNCTION_LIST /end FUNCTION_LIST /begin REF_CHARACTERISTIC TEstimn.TEstimnSiLLFilCoeffB0.Ary1D /end REF_CHARACTERISTIC /begin REF_MEASUREMENT /end REF_MEASUREMENT /end GROUP
/begin GROUP TEstimn.TEstimnSiLLFilCoeffB1.Ary1D "MICROSAR RTE" /begin SUB_GROUP /end SUB_GROUP /begin FUNCTION_LIST /end FUNCTION_LIST /begin REF_CHARACTERISTIC TEstimn.TEstimnSiLLFilCoeffB1.Ary1D /end REF_CHARACTERISTIC /begin REF_MEASUREMENT /end REF_MEASUREMENT /end GROUP
/begin GROUP TEstimn.TEstimnTauAssiMech.Ary1D "MICROSAR RTE" /begin SUB_GROUP /end SUB_GROUP /begin FUNCTION_LIST /end FUNCTION_LIST /begin REF_CHARACTERISTIC TEstimn.TEstimnTauAssiMech.Ary1D /end REF_CHARACTERISTIC /begin REF_MEASUREMENT /end REF_MEASUREMENT /end GROUP
/begin GROUP TEstimn.TEstimnTauCu.Ary1D "MICROSAR RTE" /begin SUB_GROUP /end SUB_GROUP /begin FUNCTION_LIST /end FUNCTION_LIST /begin REF_CHARACTERISTIC TEstimn.TEstimnTauCu.Ary1D /end REF_CHARACTERISTIC /begin REF_MEASUREMENT /end REF_MEASUREMENT /end GROUP
/begin GROUP TEstimn.TEstimnTauMag.Ary1D "MICROSAR RTE" /begin SUB_GROUP /end SUB_GROUP /begin FUNCTION_LIST /end FUNCTION_LIST /begin REF_CHARACTERISTIC TEstimn.TEstimnTauMag.Ary1D /end REF_CHARACTERISTIC /begin REF_MEASUREMENT /end REF_MEASUREMENT /end GROUP
/begin GROUP TEstimn.TEstimnTauSi.Ary1D "MICROSAR RTE" /begin SUB_GROUP /end SUB_GROUP /begin FUNCTION_LIST /end FUNCTION_LIST /begin REF_CHARACTERISTIC TEstimn.TEstimnTauSi.Ary1D /end REF_CHARACTERISTIC /begin REF_MEASUREMENT /end REF_MEASUREMENT /end GROUP
/begin GROUP TEstimn.TEstimnWghtAvrgTDi.Ary1D "MICROSAR RTE" /begin SUB_GROUP /end SUB_GROUP /begin FUNCTION_LIST /end FUNCTION_LIST /begin REF_CHARACTERISTIC TEstimn.TEstimnWghtAvrgTDi.Ary1D /end REF_CHARACTERISTIC /begin REF_MEASUREMENT /end REF_MEASUREMENT /end GROUP
/begin GROUP TEstimn.TFilStVal "MICROSAR RTE" /begin SUB_GROUP /end SUB_GROUP /begin FUNCTION_LIST /end FUNCTION_LIST /begin REF_CHARACTERISTIC /end REF_CHARACTERISTIC
 /begin REF_MEASUREMENT TEstimn.TFilStVal.FilAssisMechLLStVal TEstimn.TFilStVal.FilAssisMechLpStVal TEstimn.TFilStVal.FilCuLLStVal TEstimn.TFilStVal.FilCuLpStVal TEstimn.TFilStVal.FilMagLLStVal TEstimn.TFilStVal.FilMagLpStVal TEstimn.TFilStVal.FilSiLLStVal TEstimn.TFilStVal.FilSiLpStVal /end REF_MEASUREMENT
/end GROUP
/begin GROUP TEstimn.VehTiVld.Logl "MICROSAR RTE" /begin SUB_GROUP /end SUB_GROUP /begin FUNCTION_LIST /end FUNCTION_LIST /begin REF_CHARACTERISTIC /end REF_CHARACTERISTIC /begin REF_MEASUREMENT TEstimn.VehTiVld.Logl /end REF_MEASUREMENT /end GROUP
/begin GROUP TEstimn.dTEstimnAmbPwr "MICROSAR RTE" /begin SUB_GROUP /end SUB_GROUP /begin FUNCTION_LIST /end FUNCTION_LIST /begin REF_CHARACTERISTIC /end REF_CHARACTERISTIC /begin REF_MEASUREMENT TEstimn.dTEstimnAmbPwr /end REF_MEASUREMENT /end GROUP
/begin GROUP TEstimn.dTEstimnAssiMechCorrn "MICROSAR RTE" /begin SUB_GROUP /end SUB_GROUP /begin FUNCTION_LIST /end FUNCTION_LIST /begin REF_CHARACTERISTIC /end REF_CHARACTERISTIC /begin REF_MEASUREMENT TEstimn.dTEstimnAssiMechCorrn /end REF_MEASUREMENT /end GROUP
/begin GROUP TEstimn.dTEstimnAssiMechDampgSca "MICROSAR RTE" /begin SUB_GROUP /end SUB_GROUP /begin FUNCTION_LIST /end FUNCTION_LIST /begin REF_CHARACTERISTIC /end REF_CHARACTERISTIC /begin REF_MEASUREMENT TEstimn.dTEstimnAssiMechDampgSca /end REF_MEASUREMENT /end GROUP
/begin GROUP TEstimn.dTEstimnAssiMechFil "MICROSAR RTE" /begin SUB_GROUP /end SUB_GROUP /begin FUNCTION_LIST /end FUNCTION_LIST /begin REF_CHARACTERISTIC /end REF_CHARACTERISTIC /begin REF_MEASUREMENT TEstimn.dTEstimnAssiMechFil /end REF_MEASUREMENT /end GROUP
/begin GROUP TEstimn.dTEstimnCuCorrn "MICROSAR RTE" /begin SUB_GROUP /end SUB_GROUP /begin FUNCTION_LIST /end FUNCTION_LIST /begin REF_CHARACTERISTIC /end REF_CHARACTERISTIC /begin REF_MEASUREMENT TEstimn.dTEstimnCuCorrn /end REF_MEASUREMENT /end GROUP
/begin GROUP TEstimn.dTEstimnMagCorrn "MICROSAR RTE" /begin SUB_GROUP /end SUB_GROUP /begin FUNCTION_LIST /end FUNCTION_LIST /begin REF_CHARACTERISTIC /end REF_CHARACTERISTIC /begin REF_MEASUREMENT TEstimn.dTEstimnMagCorrn /end REF_MEASUREMENT /end GROUP
/begin GROUP TEstimn.dTEstimnScadAmbT "MICROSAR RTE" /begin SUB_GROUP /end SUB_GROUP /begin FUNCTION_LIST /end FUNCTION_LIST /begin REF_CHARACTERISTIC /end REF_CHARACTERISTIC /begin REF_MEASUREMENT TEstimn.dTEstimnScadAmbT /end REF_MEASUREMENT /end GROUP
/begin GROUP TEstimn.dTEstimnScadEngT "MICROSAR RTE" /begin SUB_GROUP /end SUB_GROUP /begin FUNCTION_LIST /end FUNCTION_LIST /begin REF_CHARACTERISTIC /end REF_CHARACTERISTIC /begin REF_MEASUREMENT TEstimn.dTEstimnScadEngT /end REF_MEASUREMENT /end GROUP
/begin GROUP TEstimn.dTEstimnSiCorrn "MICROSAR RTE" /begin SUB_GROUP /end SUB_GROUP /begin FUNCTION_LIST /end FUNCTION_LIST /begin REF_CHARACTERISTIC /end REF_CHARACTERISTIC /begin REF_MEASUREMENT TEstimn.dTEstimnSiCorrn /end REF_MEASUREMENT /end GROUP
/begin GROUP TEstimn.dTEstimnWghtAvrgT "MICROSAR RTE" /begin SUB_GROUP /end SUB_GROUP /begin FUNCTION_LIST /end FUNCTION_LIST /begin REF_CHARACTERISTIC /end REF_CHARACTERISTIC /begin REF_MEASUREMENT TEstimn.dTEstimnWghtAvrgT /end REF_MEASUREMENT /end GROUP
/begin GROUP TmplMonr "MICROSAR RTE"
 /begin SUB_GROUP TmplMonr.PerInstanceMemories TmplMonr.ReceiverPorts TmplMonr.SenderPorts /end SUB_GROUP
 /begin FUNCTION_LIST /end FUNCTION_LIST
 /begin REF_CHARACTERISTIC /end REF_CHARACTERISTIC
 /begin REF_MEASUREMENT /end REF_MEASUREMENT
/end GROUP
/begin GROUP TmplMonr.AvrgElpdTiMicroSec "MICROSAR RTE" /begin SUB_GROUP /end SUB_GROUP /begin FUNCTION_LIST /end FUNCTION_LIST /begin REF_CHARACTERISTIC /end REF_CHARACTERISTIC /begin REF_MEASUREMENT TmplMonr.AvrgElpdTiMicroSec /end REF_MEASUREMENT /end GROUP
/begin GROUP TmplMonr.PerInstanceMemories "MICROSAR RTE"
 /begin SUB_GROUP TmplMonr.AvrgElpdTiMicroSec TmplMonr.TmplMonrIninCntr TmplMonr.TmplMonrIninTestCmplFlg TmplMonr.TmplMonrNtc40PrmByte TmplMonr.TmplMonrSpiReadWrOrderFlg1 TmplMonr.TmplMonrSpiReadWrOrderFlg2 TmplMonr.TmplMonrWdgRstrtCnt TmplMonr.TrsmErrCntr TmplMonr.TrsmErrNtcThd /end SUB_GROUP
 /begin FUNCTION_LIST /end FUNCTION_LIST
 /begin REF_CHARACTERISTIC /end REF_CHARACTERISTIC
 /begin REF_MEASUREMENT /end REF_MEASUREMENT
/end GROUP
/begin GROUP TmplMonr.ReceiverPorts "MICROSAR RTE" /begin SUB_GROUP TmplMonr.StrtUpSt.Val TmplMonr.SysSt.Val /end SUB_GROUP /begin FUNCTION_LIST /end FUNCTION_LIST /begin REF_CHARACTERISTIC /end REF_CHARACTERISTIC /begin REF_MEASUREMENT /end REF_MEASUREMENT /end GROUP
/begin GROUP TmplMonr.SenderPorts "MICROSAR RTE" /begin SUB_GROUP TmplMonr.TmplMonrIninTestCmpl.Logl /end SUB_GROUP /begin FUNCTION_LIST /end FUNCTION_LIST /begin REF_CHARACTERISTIC /end REF_CHARACTERISTIC /begin REF_MEASUREMENT /end REF_MEASUREMENT /end GROUP
/begin GROUP TmplMonr.StrtUpSt.Val "MICROSAR RTE" /begin SUB_GROUP /end SUB_GROUP /begin FUNCTION_LIST /end FUNCTION_LIST /begin REF_CHARACTERISTIC /end REF_CHARACTERISTIC /begin REF_MEASUREMENT TmplMonr.StrtUpSt.Val /end REF_MEASUREMENT /end GROUP
/begin GROUP TmplMonr.SysSt.Val "MICROSAR RTE" /begin SUB_GROUP /end SUB_GROUP /begin FUNCTION_LIST /end FUNCTION_LIST /begin REF_CHARACTERISTIC /end REF_CHARACTERISTIC /begin REF_MEASUREMENT TmplMonr.SysSt.Val /end REF_MEASUREMENT /end GROUP
/begin GROUP TmplMonr.TmplMonrIninCntr "MICROSAR RTE" /begin SUB_GROUP /end SUB_GROUP /begin FUNCTION_LIST /end FUNCTION_LIST /begin REF_CHARACTERISTIC /end REF_CHARACTERISTIC /begin REF_MEASUREMENT TmplMonr.TmplMonrIninCntr /end REF_MEASUREMENT /end GROUP
/begin GROUP TmplMonr.TmplMonrIninTestCmpl.Logl "MICROSAR RTE" /begin SUB_GROUP /end SUB_GROUP /begin FUNCTION_LIST /end FUNCTION_LIST /begin REF_CHARACTERISTIC /end REF_CHARACTERISTIC /begin REF_MEASUREMENT TmplMonr.TmplMonrIninTestCmpl.Logl /end REF_MEASUREMENT /end GROUP
/begin GROUP TmplMonr.TmplMonrIninTestCmplFlg "MICROSAR RTE" /begin SUB_GROUP /end SUB_GROUP /begin FUNCTION_LIST /end FUNCTION_LIST /begin REF_CHARACTERISTIC /end REF_CHARACTERISTIC /begin REF_MEASUREMENT TmplMonr.TmplMonrIninTestCmplFlg /end REF_MEASUREMENT /end GROUP
/begin GROUP TmplMonr.TmplMonrNtc40PrmByte "MICROSAR RTE" /begin SUB_GROUP /end SUB_GROUP /begin FUNCTION_LIST /end FUNCTION_LIST /begin REF_CHARACTERISTIC /end REF_CHARACTERISTIC /begin REF_MEASUREMENT TmplMonr.TmplMonrNtc40PrmByte /end REF_MEASUREMENT /end GROUP
/begin GROUP TmplMonr.TmplMonrSpiReadWrOrderFlg1 "MICROSAR RTE" /begin SUB_GROUP /end SUB_GROUP /begin FUNCTION_LIST /end FUNCTION_LIST /begin REF_CHARACTERISTIC /end REF_CHARACTERISTIC /begin REF_MEASUREMENT TmplMonr.TmplMonrSpiReadWrOrderFlg1 /end REF_MEASUREMENT /end GROUP
/begin GROUP TmplMonr.TmplMonrSpiReadWrOrderFlg2 "MICROSAR RTE" /begin SUB_GROUP /end SUB_GROUP /begin FUNCTION_LIST /end FUNCTION_LIST /begin REF_CHARACTERISTIC /end REF_CHARACTERISTIC /begin REF_MEASUREMENT TmplMonr.TmplMonrSpiReadWrOrderFlg2 /end REF_MEASUREMENT /end GROUP
/begin GROUP TmplMonr.TmplMonrWdgRstrtCnt "MICROSAR RTE" /begin SUB_GROUP /end SUB_GROUP /begin FUNCTION_LIST /end FUNCTION_LIST /begin REF_CHARACTERISTIC /end REF_CHARACTERISTIC /begin REF_MEASUREMENT TmplMonr.TmplMonrWdgRstrtCnt /end REF_MEASUREMENT /end GROUP
/begin GROUP TmplMonr.TrsmErrCntr "MICROSAR RTE" /begin SUB_GROUP /end SUB_GROUP /begin FUNCTION_LIST /end FUNCTION_LIST /begin REF_CHARACTERISTIC /end REF_CHARACTERISTIC /begin REF_MEASUREMENT TmplMonr.TrsmErrCntr /end REF_MEASUREMENT /end GROUP
/begin GROUP TmplMonr.TrsmErrNtcThd "MICROSAR RTE" /begin SUB_GROUP /end SUB_GROUP /begin FUNCTION_LIST /end FUNCTION_LIST /begin REF_CHARACTERISTIC /end REF_CHARACTERISTIC /begin REF_MEASUREMENT TmplMonr.TrsmErrNtcThd /end REF_MEASUREMENT /end GROUP
/begin GROUP TqLoa "MICROSAR RTE"
 /begin SUB_GROUP TqLoa.CalibrationPorts TqLoa.PerInstanceMemories TqLoa.ReceiverPorts TqLoa.SenderPorts /end SUB_GROUP
 /begin FUNCTION_LIST /end FUNCTION_LIST
 /begin REF_CHARACTERISTIC /end REF_CHARACTERISTIC
 /begin REF_MEASUREMENT /end REF_MEASUREMENT
/end GROUP
/begin GROUP TqLoa.CalibrationPorts "MICROSAR RTE"
 /begin SUB_GROUP TqLoa.TqLoaDrvrTqNom.Val TqLoa.TqLoaMotTqCmdLim.Val TqLoa.TqLoaMotVelAndTqBasdScaFacFallRate.Val TqLoa.TqLoaMotVelAndTqBasdScaFacMax.Val TqLoa.TqLoaMotVelAndTqBasdScaFacMin.Val TqLoa.TqLoaMotVelAndTqBasdScaFacRiseRate.Val TqLoa.TqLoaMotVelMgnThd.Val TqLoa.TqLoaTqCmdLimY.Ary1D TqLoa.TqLoaTqCmdMgnThd.Val TqLoa.TqLoaVehLatADifScaFacFallRate.Val TqLoa.TqLoaVehLatADifScaFacRiseRate.Val TqLoa.TqLoaVehLatADifScaFacX.Ary1D TqLoa.TqLoaVehLatADifScaFacY.Ary2D TqLoa.TqLoaVehLatAEstimnFilFrq.Val TqLoa.TqLoaVehLatAGainY.Ary1D TqLoa.TqLoaVehSpdScaFacX.Ary1D TqLoa.TqLoaVehSpdScaFacY.Ary1D TqLoa.TqLoaVehSpdX.Ary1D TqLoa.TqLoaVehSteerRat.Val TqLoa.TqLoaVehUnderSteerGrdt.Val TqLoa.TqLoaVehWhlBas.Val /end SUB_GROUP
 /begin FUNCTION_LIST /end FUNCTION_LIST
 /begin REF_CHARACTERISTIC /end REF_CHARACTERISTIC
 /begin REF_MEASUREMENT /end REF_MEASUREMENT
/end GROUP
/begin GROUP TqLoa.MotAgLoaMtgtnEna.Logl "MICROSAR RTE" /begin SUB_GROUP /end SUB_GROUP /begin FUNCTION_LIST /end FUNCTION_LIST /begin REF_CHARACTERISTIC /end REF_CHARACTERISTIC /begin REF_MEASUREMENT TqLoa.MotAgLoaMtgtnEna.Logl /end REF_MEASUREMENT /end GROUP
/begin GROUP TqLoa.MotTqCmdPrev "MICROSAR RTE" /begin SUB_GROUP /end SUB_GROUP /begin FUNCTION_LIST /end FUNCTION_LIST /begin REF_CHARACTERISTIC /end REF_CHARACTERISTIC /begin REF_MEASUREMENT TqLoa.MotTqCmdPrev /end REF_MEASUREMENT /end GROUP
/begin GROUP TqLoa.MotVelAndTqBasdScaFacPrev "MICROSAR RTE" /begin SUB_GROUP /end SUB_GROUP /begin FUNCTION_LIST /end FUNCTION_LIST /begin REF_CHARACTERISTIC /end REF_CHARACTERISTIC /begin REF_MEASUREMENT TqLoa.MotVelAndTqBasdScaFacPrev /end REF_MEASUREMENT /end GROUP
/begin GROUP TqLoa.MotVelCrf.Val "MICROSAR RTE" /begin SUB_GROUP /end SUB_GROUP /begin FUNCTION_LIST /end FUNCTION_LIST /begin REF_CHARACTERISTIC /end REF_CHARACTERISTIC /begin REF_MEASUREMENT TqLoa.MotVelCrf.Val /end REF_MEASUREMENT /end GROUP
/begin GROUP TqLoa.PerInstanceMemories "MICROSAR RTE"
 /begin SUB_GROUP TqLoa.MotTqCmdPrev TqLoa.MotVelAndTqBasdScaFacPrev TqLoa.VehLatADifScaFacPrev TqLoa.VehLatAEstimnFil TqLoa.dTqLoaMotTqCmdPreScag TqLoa.dTqLoaMotVelAndTqBasdScaFac TqLoa.dTqLoaScaFacFinal TqLoa.dTqLoaVehLatADifScaFac TqLoa.dTqLoaVehLatAEstimn TqLoa.dTqLoaVehSpdBasdScaFac /end SUB_GROUP
 /begin FUNCTION_LIST /end FUNCTION_LIST
 /begin REF_CHARACTERISTIC /end REF_CHARACTERISTIC
 /begin REF_MEASUREMENT /end REF_MEASUREMENT
/end GROUP
/begin GROUP TqLoa.PinionAg.Val "MICROSAR RTE" /begin SUB_GROUP /end SUB_GROUP /begin FUNCTION_LIST /end FUNCTION_LIST /begin REF_CHARACTERISTIC /end REF_CHARACTERISTIC /begin REF_MEASUREMENT TqLoa.PinionAg.Val /end REF_MEASUREMENT /end GROUP
/begin GROUP TqLoa.PinionAgConf.Val "MICROSAR RTE" /begin SUB_GROUP /end SUB_GROUP /begin FUNCTION_LIST /end FUNCTION_LIST /begin REF_CHARACTERISTIC /end REF_CHARACTERISTIC /begin REF_MEASUREMENT TqLoa.PinionAgConf.Val /end REF_MEASUREMENT /end GROUP
/begin GROUP TqLoa.ReceiverPorts "MICROSAR RTE"
 /begin SUB_GROUP TqLoa.MotAgLoaMtgtnEna.Logl TqLoa.MotVelCrf.Val TqLoa.PinionAg.Val TqLoa.PinionAgConf.Val TqLoa.VehLatA.Val TqLoa.VehLatAVld.Logl TqLoa.VehSpd.Val TqLoa.VehSpdVld.Logl /end SUB_GROUP
 /begin FUNCTION_LIST /end FUNCTION_LIST
 /begin REF_CHARACTERISTIC /end REF_CHARACTERISTIC
 /begin REF_MEASUREMENT /end REF_MEASUREMENT
/end GROUP
/begin GROUP TqLoa.SenderPorts "MICROSAR RTE" /begin SUB_GROUP TqLoa.TqLoaAvl.Logl TqLoa.TqLoaCmd.Val /end SUB_GROUP /begin FUNCTION_LIST /end FUNCTION_LIST /begin REF_CHARACTERISTIC /end REF_CHARACTERISTIC /begin REF_MEASUREMENT /end REF_MEASUREMENT /end GROUP
/begin GROUP TqLoa.TqLoaAvl.Logl "MICROSAR RTE" /begin SUB_GROUP /end SUB_GROUP /begin FUNCTION_LIST /end FUNCTION_LIST /begin REF_CHARACTERISTIC /end REF_CHARACTERISTIC /begin REF_MEASUREMENT TqLoa.TqLoaAvl.Logl /end REF_MEASUREMENT /end GROUP
/begin GROUP TqLoa.TqLoaCmd.Val "MICROSAR RTE" /begin SUB_GROUP /end SUB_GROUP /begin FUNCTION_LIST /end FUNCTION_LIST /begin REF_CHARACTERISTIC /end REF_CHARACTERISTIC /begin REF_MEASUREMENT TqLoa.TqLoaCmd.Val /end REF_MEASUREMENT /end GROUP
/begin GROUP TqLoa.TqLoaDrvrTqNom.Val "MICROSAR RTE" /begin SUB_GROUP /end SUB_GROUP /begin FUNCTION_LIST /end FUNCTION_LIST /begin REF_CHARACTERISTIC TqLoa.TqLoaDrvrTqNom.Val /end REF_CHARACTERISTIC /begin REF_MEASUREMENT /end REF_MEASUREMENT /end GROUP
/begin GROUP TqLoa.TqLoaMotTqCmdLim.Val "MICROSAR RTE" /begin SUB_GROUP /end SUB_GROUP /begin FUNCTION_LIST /end FUNCTION_LIST /begin REF_CHARACTERISTIC TqLoa.TqLoaMotTqCmdLim.Val /end REF_CHARACTERISTIC /begin REF_MEASUREMENT /end REF_MEASUREMENT /end GROUP
/begin GROUP TqLoa.TqLoaMotVelAndTqBasdScaFacFallRate.Val "MICROSAR RTE" /begin SUB_GROUP /end SUB_GROUP /begin FUNCTION_LIST /end FUNCTION_LIST /begin REF_CHARACTERISTIC TqLoa.TqLoaMotVelAndTqBasdScaFacFallRate.Val /end REF_CHARACTERISTIC /begin REF_MEASUREMENT /end REF_MEASUREMENT /end GROUP
/begin GROUP TqLoa.TqLoaMotVelAndTqBasdScaFacMax.Val "MICROSAR RTE" /begin SUB_GROUP /end SUB_GROUP /begin FUNCTION_LIST /end FUNCTION_LIST /begin REF_CHARACTERISTIC TqLoa.TqLoaMotVelAndTqBasdScaFacMax.Val /end REF_CHARACTERISTIC /begin REF_MEASUREMENT /end REF_MEASUREMENT /end GROUP
/begin GROUP TqLoa.TqLoaMotVelAndTqBasdScaFacMin.Val "MICROSAR RTE" /begin SUB_GROUP /end SUB_GROUP /begin FUNCTION_LIST /end FUNCTION_LIST /begin REF_CHARACTERISTIC TqLoa.TqLoaMotVelAndTqBasdScaFacMin.Val /end REF_CHARACTERISTIC /begin REF_MEASUREMENT /end REF_MEASUREMENT /end GROUP
/begin GROUP TqLoa.TqLoaMotVelAndTqBasdScaFacRiseRate.Val "MICROSAR RTE" /begin SUB_GROUP /end SUB_GROUP /begin FUNCTION_LIST /end FUNCTION_LIST /begin REF_CHARACTERISTIC TqLoa.TqLoaMotVelAndTqBasdScaFacRiseRate.Val /end REF_CHARACTERISTIC /begin REF_MEASUREMENT /end REF_MEASUREMENT /end GROUP
/begin GROUP TqLoa.TqLoaMotVelMgnThd.Val "MICROSAR RTE" /begin SUB_GROUP /end SUB_GROUP /begin FUNCTION_LIST /end FUNCTION_LIST /begin REF_CHARACTERISTIC TqLoa.TqLoaMotVelMgnThd.Val /end REF_CHARACTERISTIC /begin REF_MEASUREMENT /end REF_MEASUREMENT /end GROUP
/begin GROUP TqLoa.TqLoaTqCmdLimY.Ary1D "MICROSAR RTE" /begin SUB_GROUP /end SUB_GROUP /begin FUNCTION_LIST /end FUNCTION_LIST /begin REF_CHARACTERISTIC TqLoa.TqLoaTqCmdLimY.Ary1D /end REF_CHARACTERISTIC /begin REF_MEASUREMENT /end REF_MEASUREMENT /end GROUP
/begin GROUP TqLoa.TqLoaTqCmdMgnThd.Val "MICROSAR RTE" /begin SUB_GROUP /end SUB_GROUP /begin FUNCTION_LIST /end FUNCTION_LIST /begin REF_CHARACTERISTIC TqLoa.TqLoaTqCmdMgnThd.Val /end REF_CHARACTERISTIC /begin REF_MEASUREMENT /end REF_MEASUREMENT /end GROUP
/begin GROUP TqLoa.TqLoaVehLatADifScaFacFallRate.Val "MICROSAR RTE" /begin SUB_GROUP /end SUB_GROUP /begin FUNCTION_LIST /end FUNCTION_LIST /begin REF_CHARACTERISTIC TqLoa.TqLoaVehLatADifScaFacFallRate.Val /end REF_CHARACTERISTIC /begin REF_MEASUREMENT /end REF_MEASUREMENT /end GROUP
/begin GROUP TqLoa.TqLoaVehLatADifScaFacRiseRate.Val "MICROSAR RTE" /begin SUB_GROUP /end SUB_GROUP /begin FUNCTION_LIST /end FUNCTION_LIST /begin REF_CHARACTERISTIC TqLoa.TqLoaVehLatADifScaFacRiseRate.Val /end REF_CHARACTERISTIC /begin REF_MEASUREMENT /end REF_MEASUREMENT /end GROUP
/begin GROUP TqLoa.TqLoaVehLatADifScaFacX.Ary1D "MICROSAR RTE" /begin SUB_GROUP /end SUB_GROUP /begin FUNCTION_LIST /end FUNCTION_LIST /begin REF_CHARACTERISTIC TqLoa.TqLoaVehLatADifScaFacX.Ary1D /end REF_CHARACTERISTIC /begin REF_MEASUREMENT /end REF_MEASUREMENT /end GROUP
/begin GROUP TqLoa.TqLoaVehLatADifScaFacY.Ary2D "MICROSAR RTE" /begin SUB_GROUP /end SUB_GROUP /begin FUNCTION_LIST /end FUNCTION_LIST /begin REF_CHARACTERISTIC TqLoa.TqLoaVehLatADifScaFacY.Ary2D /end REF_CHARACTERISTIC /begin REF_MEASUREMENT /end REF_MEASUREMENT /end GROUP
/begin GROUP TqLoa.TqLoaVehLatAEstimnFilFrq.Val "MICROSAR RTE" /begin SUB_GROUP /end SUB_GROUP /begin FUNCTION_LIST /end FUNCTION_LIST /begin REF_CHARACTERISTIC TqLoa.TqLoaVehLatAEstimnFilFrq.Val /end REF_CHARACTERISTIC /begin REF_MEASUREMENT /end REF_MEASUREMENT /end GROUP
/begin GROUP TqLoa.TqLoaVehLatAGainY.Ary1D "MICROSAR RTE" /begin SUB_GROUP /end SUB_GROUP /begin FUNCTION_LIST /end FUNCTION_LIST /begin REF_CHARACTERISTIC TqLoa.TqLoaVehLatAGainY.Ary1D /end REF_CHARACTERISTIC /begin REF_MEASUREMENT /end REF_MEASUREMENT /end GROUP
/begin GROUP TqLoa.TqLoaVehSpdScaFacX.Ary1D "MICROSAR RTE" /begin SUB_GROUP /end SUB_GROUP /begin FUNCTION_LIST /end FUNCTION_LIST /begin REF_CHARACTERISTIC TqLoa.TqLoaVehSpdScaFacX.Ary1D /end REF_CHARACTERISTIC /begin REF_MEASUREMENT /end REF_MEASUREMENT /end GROUP
/begin GROUP TqLoa.TqLoaVehSpdScaFacY.Ary1D "MICROSAR RTE" /begin SUB_GROUP /end SUB_GROUP /begin FUNCTION_LIST /end FUNCTION_LIST /begin REF_CHARACTERISTIC TqLoa.TqLoaVehSpdScaFacY.Ary1D /end REF_CHARACTERISTIC /begin REF_MEASUREMENT /end REF_MEASUREMENT /end GROUP
/begin GROUP TqLoa.TqLoaVehSpdX.Ary1D "MICROSAR RTE" /begin SUB_GROUP /end SUB_GROUP /begin FUNCTION_LIST /end FUNCTION_LIST /begin REF_CHARACTERISTIC TqLoa.TqLoaVehSpdX.Ary1D /end REF_CHARACTERISTIC /begin REF_MEASUREMENT /end REF_MEASUREMENT /end GROUP
/begin GROUP TqLoa.TqLoaVehSteerRat.Val "MICROSAR RTE" /begin SUB_GROUP /end SUB_GROUP /begin FUNCTION_LIST /end FUNCTION_LIST /begin REF_CHARACTERISTIC TqLoa.TqLoaVehSteerRat.Val /end REF_CHARACTERISTIC /begin REF_MEASUREMENT /end REF_MEASUREMENT /end GROUP
/begin GROUP TqLoa.TqLoaVehUnderSteerGrdt.Val "MICROSAR RTE" /begin SUB_GROUP /end SUB_GROUP /begin FUNCTION_LIST /end FUNCTION_LIST /begin REF_CHARACTERISTIC TqLoa.TqLoaVehUnderSteerGrdt.Val /end REF_CHARACTERISTIC /begin REF_MEASUREMENT /end REF_MEASUREMENT /end GROUP
/begin GROUP TqLoa.TqLoaVehWhlBas.Val "MICROSAR RTE" /begin SUB_GROUP /end SUB_GROUP /begin FUNCTION_LIST /end FUNCTION_LIST /begin REF_CHARACTERISTIC TqLoa.TqLoaVehWhlBas.Val /end REF_CHARACTERISTIC /begin REF_MEASUREMENT /end REF_MEASUREMENT /end GROUP
/begin GROUP TqLoa.VehLatA.Val "MICROSAR RTE" /begin SUB_GROUP /end SUB_GROUP /begin FUNCTION_LIST /end FUNCTION_LIST /begin REF_CHARACTERISTIC /end REF_CHARACTERISTIC /begin REF_MEASUREMENT TqLoa.VehLatA.Val /end REF_MEASUREMENT /end GROUP
/begin GROUP TqLoa.VehLatADifScaFacPrev "MICROSAR RTE" /begin SUB_GROUP /end SUB_GROUP /begin FUNCTION_LIST /end FUNCTION_LIST /begin REF_CHARACTERISTIC /end REF_CHARACTERISTIC /begin REF_MEASUREMENT TqLoa.VehLatADifScaFacPrev /end REF_MEASUREMENT /end GROUP
/begin GROUP TqLoa.VehLatAEstimnFil "MICROSAR RTE" /begin SUB_GROUP /end SUB_GROUP /begin FUNCTION_LIST /end FUNCTION_LIST /begin REF_CHARACTERISTIC /end REF_CHARACTERISTIC
 /begin REF_MEASUREMENT TqLoa.VehLatAEstimnFil.FilGain TqLoa.VehLatAEstimnFil.FilSt /end REF_MEASUREMENT
/end GROUP
/begin GROUP TqLoa.VehLatAVld.Logl "MICROSAR RTE" /begin SUB_GROUP /end SUB_GROUP /begin FUNCTION_LIST /end FUNCTION_LIST /begin REF_CHARACTERISTIC /end REF_CHARACTERISTIC /begin REF_MEASUREMENT TqLoa.VehLatAVld.Logl /end REF_MEASUREMENT /end GROUP
/begin GROUP TqLoa.VehSpd.Val "MICROSAR RTE" /begin SUB_GROUP /end SUB_GROUP /begin FUNCTION_LIST /end FUNCTION_LIST /begin REF_CHARACTERISTIC /end REF_CHARACTERISTIC /begin REF_MEASUREMENT TqLoa.VehSpd.Val /end REF_MEASUREMENT /end GROUP
/begin GROUP TqLoa.VehSpdVld.Logl "MICROSAR RTE" /begin SUB_GROUP /end SUB_GROUP /begin FUNCTION_LIST /end FUNCTION_LIST /begin REF_CHARACTERISTIC /end REF_CHARACTERISTIC /begin REF_MEASUREMENT TqLoa.VehSpdVld.Logl /end REF_MEASUREMENT /end GROUP
/begin GROUP TqLoa.dTqLoaMotTqCmdPreScag "MICROSAR RTE" /begin SUB_GROUP /end SUB_GROUP /begin FUNCTION_LIST /end FUNCTION_LIST /begin REF_CHARACTERISTIC /end REF_CHARACTERISTIC /begin REF_MEASUREMENT TqLoa.dTqLoaMotTqCmdPreScag /end REF_MEASUREMENT /end GROUP
/begin GROUP TqLoa.dTqLoaMotVelAndTqBasdScaFac "MICROSAR RTE" /begin SUB_GROUP /end SUB_GROUP /begin FUNCTION_LIST /end FUNCTION_LIST /begin REF_CHARACTERISTIC /end REF_CHARACTERISTIC /begin REF_MEASUREMENT TqLoa.dTqLoaMotVelAndTqBasdScaFac /end REF_MEASUREMENT /end GROUP
/begin GROUP TqLoa.dTqLoaScaFacFinal "MICROSAR RTE" /begin SUB_GROUP /end SUB_GROUP /begin FUNCTION_LIST /end FUNCTION_LIST /begin REF_CHARACTERISTIC /end REF_CHARACTERISTIC /begin REF_MEASUREMENT TqLoa.dTqLoaScaFacFinal /end REF_MEASUREMENT /end GROUP
/begin GROUP TqLoa.dTqLoaVehLatADifScaFac "MICROSAR RTE" /begin SUB_GROUP /end SUB_GROUP /begin FUNCTION_LIST /end FUNCTION_LIST /begin REF_CHARACTERISTIC /end REF_CHARACTERISTIC /begin REF_MEASUREMENT TqLoa.dTqLoaVehLatADifScaFac /end REF_MEASUREMENT /end GROUP
/begin GROUP TqLoa.dTqLoaVehLatAEstimn "MICROSAR RTE" /begin SUB_GROUP /end SUB_GROUP /begin FUNCTION_LIST /end FUNCTION_LIST /begin REF_CHARACTERISTIC /end REF_CHARACTERISTIC /begin REF_MEASUREMENT TqLoa.dTqLoaVehLatAEstimn /end REF_MEASUREMENT /end GROUP
/begin GROUP TqLoa.dTqLoaVehSpdBasdScaFac "MICROSAR RTE" /begin SUB_GROUP /end SUB_GROUP /begin FUNCTION_LIST /end FUNCTION_LIST /begin REF_CHARACTERISTIC /end REF_CHARACTERISTIC /begin REF_MEASUREMENT TqLoa.dTqLoaVehSpdBasdScaFac /end REF_MEASUREMENT /end GROUP
/begin GROUP TunSelnAuthy "MICROSAR RTE" /begin SUB_GROUP TunSelnAuthy.CalibrationPorts TunSelnAuthy.ReceiverPorts /end SUB_GROUP /begin FUNCTION_LIST /end FUNCTION_LIST /begin REF_CHARACTERISTIC /end REF_CHARACTERISTIC /begin REF_MEASUREMENT /end REF_MEASUREMENT /end GROUP
/begin GROUP TunSelnAuthy.CalibrationPorts "MICROSAR RTE"
 /begin SUB_GROUP TunSelnAuthy.TunSelnAuthyHwTqY.Ary1D TunSelnAuthy.TunSelnAuthyHwVelY.Ary1D TunSelnAuthy.TunSelnAuthyTunSelnRtDiCmd.Logl TunSelnAuthy.TunSelnAuthyVehSpdX.Ary1D /end SUB_GROUP
 /begin FUNCTION_LIST /end FUNCTION_LIST
 /begin REF_CHARACTERISTIC /end REF_CHARACTERISTIC
 /begin REF_MEASUREMENT /end REF_MEASUREMENT
/end GROUP
/begin GROUP TunSelnAuthy.HwTq.Val "MICROSAR RTE" /begin SUB_GROUP /end SUB_GROUP /begin FUNCTION_LIST /end FUNCTION_LIST /begin REF_CHARACTERISTIC /end REF_CHARACTERISTIC /begin REF_MEASUREMENT TunSelnAuthy.HwTq.Val /end REF_MEASUREMENT /end GROUP
/begin GROUP TunSelnAuthy.HwVel.Val "MICROSAR RTE" /begin SUB_GROUP /end SUB_GROUP /begin FUNCTION_LIST /end FUNCTION_LIST /begin REF_CHARACTERISTIC /end REF_CHARACTERISTIC /begin REF_MEASUREMENT TunSelnAuthy.HwVel.Val /end REF_MEASUREMENT /end GROUP
/begin GROUP TunSelnAuthy.ReceiverPorts "MICROSAR RTE"
 /begin SUB_GROUP TunSelnAuthy.HwTq.Val TunSelnAuthy.HwVel.Val TunSelnAuthy.TunSelnRtDi.Logl TunSelnAuthy.VehSpd.Val /end SUB_GROUP
 /begin FUNCTION_LIST /end FUNCTION_LIST
 /begin REF_CHARACTERISTIC /end REF_CHARACTERISTIC
 /begin REF_MEASUREMENT /end REF_MEASUREMENT
/end GROUP
/begin GROUP TunSelnAuthy.TunSelnAuthyHwTqY.Ary1D "MICROSAR RTE" /begin SUB_GROUP /end SUB_GROUP /begin FUNCTION_LIST /end FUNCTION_LIST /begin REF_CHARACTERISTIC TunSelnAuthy.TunSelnAuthyHwTqY.Ary1D /end REF_CHARACTERISTIC /begin REF_MEASUREMENT /end REF_MEASUREMENT /end GROUP
/begin GROUP TunSelnAuthy.TunSelnAuthyHwVelY.Ary1D "MICROSAR RTE" /begin SUB_GROUP /end SUB_GROUP /begin FUNCTION_LIST /end FUNCTION_LIST /begin REF_CHARACTERISTIC TunSelnAuthy.TunSelnAuthyHwVelY.Ary1D /end REF_CHARACTERISTIC /begin REF_MEASUREMENT /end REF_MEASUREMENT /end GROUP
/begin GROUP TunSelnAuthy.TunSelnAuthyTunSelnRtDiCmd.Logl "MICROSAR RTE" /begin SUB_GROUP /end SUB_GROUP /begin FUNCTION_LIST /end FUNCTION_LIST /begin REF_CHARACTERISTIC TunSelnAuthy.TunSelnAuthyTunSelnRtDiCmd.Logl /end REF_CHARACTERISTIC /begin REF_MEASUREMENT /end REF_MEASUREMENT /end GROUP
/begin GROUP TunSelnAuthy.TunSelnAuthyVehSpdX.Ary1D "MICROSAR RTE" /begin SUB_GROUP /end SUB_GROUP /begin FUNCTION_LIST /end FUNCTION_LIST /begin REF_CHARACTERISTIC TunSelnAuthy.TunSelnAuthyVehSpdX.Ary1D /end REF_CHARACTERISTIC /begin REF_MEASUREMENT /end REF_MEASUREMENT /end GROUP
/begin GROUP TunSelnAuthy.TunSelnRtDi.Logl "MICROSAR RTE" /begin SUB_GROUP /end SUB_GROUP /begin FUNCTION_LIST /end FUNCTION_LIST /begin REF_CHARACTERISTIC /end REF_CHARACTERISTIC /begin REF_MEASUREMENT TunSelnAuthy.TunSelnRtDi.Logl /end REF_MEASUREMENT /end GROUP
/begin GROUP TunSelnAuthy.VehSpd.Val "MICROSAR RTE" /begin SUB_GROUP /end SUB_GROUP /begin FUNCTION_LIST /end FUNCTION_LIST /begin REF_CHARACTERISTIC /end REF_CHARACTERISTIC /begin REF_MEASUREMENT TunSelnAuthy.VehSpd.Val /end REF_MEASUREMENT /end GROUP
/begin GROUP TunSelnMngt "MICROSAR RTE"
 /begin SUB_GROUP TunSelnMngt.PerInstanceMemories TunSelnMngt.ReceiverPorts TunSelnMngt.SenderPorts /end SUB_GROUP
 /begin FUNCTION_LIST /end FUNCTION_LIST
 /begin REF_CHARACTERISTIC /end REF_CHARACTERISTIC
 /begin REF_MEASUREMENT /end REF_MEASUREMENT
/end GROUP
/begin GROUP TunSelnMngt.ActvIninIdx.Val "MICROSAR RTE" /begin SUB_GROUP /end SUB_GROUP /begin FUNCTION_LIST /end FUNCTION_LIST /begin REF_CHARACTERISTIC /end REF_CHARACTERISTIC /begin REF_MEASUREMENT TunSelnMngt.ActvIninIdx.Val /end REF_MEASUREMENT /end GROUP
/begin GROUP TunSelnMngt.ActvRtIdx.Val "MICROSAR RTE" /begin SUB_GROUP /end SUB_GROUP /begin FUNCTION_LIST /end FUNCTION_LIST /begin REF_CHARACTERISTIC /end REF_CHARACTERISTIC /begin REF_MEASUREMENT TunSelnMngt.ActvRtIdx.Val /end REF_MEASUREMENT /end GROUP
/begin GROUP TunSelnMngt.DesIninIdx.Val "MICROSAR RTE" /begin SUB_GROUP /end SUB_GROUP /begin FUNCTION_LIST /end FUNCTION_LIST /begin REF_CHARACTERISTIC /end REF_CHARACTERISTIC /begin REF_MEASUREMENT TunSelnMngt.DesIninIdx.Val /end REF_MEASUREMENT /end GROUP
/begin GROUP TunSelnMngt.DesRtIdx.Val "MICROSAR RTE" /begin SUB_GROUP /end SUB_GROUP /begin FUNCTION_LIST /end FUNCTION_LIST /begin REF_CHARACTERISTIC /end REF_CHARACTERISTIC /begin REF_MEASUREMENT TunSelnMngt.DesRtIdx.Val /end REF_MEASUREMENT /end GROUP
/begin GROUP TunSelnMngt.PerInstanceMemories "MICROSAR RTE"
 /begin SUB_GROUP TunSelnMngt.PrevActvIninIdx TunSelnMngt.PrevActvRtIdx TunSelnMngt.PrevRamPageAcs TunSelnMngt.RamTblSwt /end SUB_GROUP
 /begin FUNCTION_LIST /end FUNCTION_LIST
 /begin REF_CHARACTERISTIC /end REF_CHARACTERISTIC
 /begin REF_MEASUREMENT /end REF_MEASUREMENT
/end GROUP
/begin GROUP TunSelnMngt.PrevActvIninIdx "MICROSAR RTE" /begin SUB_GROUP /end SUB_GROUP /begin FUNCTION_LIST /end FUNCTION_LIST /begin REF_CHARACTERISTIC /end REF_CHARACTERISTIC /begin REF_MEASUREMENT TunSelnMngt.PrevActvIninIdx /end REF_MEASUREMENT /end GROUP
/begin GROUP TunSelnMngt.PrevActvRtIdx "MICROSAR RTE" /begin SUB_GROUP /end SUB_GROUP /begin FUNCTION_LIST /end FUNCTION_LIST /begin REF_CHARACTERISTIC /end REF_CHARACTERISTIC /begin REF_MEASUREMENT TunSelnMngt.PrevActvRtIdx /end REF_MEASUREMENT /end GROUP
/begin GROUP TunSelnMngt.PrevRamPageAcs "MICROSAR RTE" /begin SUB_GROUP /end SUB_GROUP /begin FUNCTION_LIST /end FUNCTION_LIST /begin REF_CHARACTERISTIC /end REF_CHARACTERISTIC /begin REF_MEASUREMENT TunSelnMngt.PrevRamPageAcs /end REF_MEASUREMENT /end GROUP
/begin GROUP TunSelnMngt.RamTblSwt "MICROSAR RTE" /begin SUB_GROUP /end SUB_GROUP /begin FUNCTION_LIST /end FUNCTION_LIST /begin REF_CHARACTERISTIC /end REF_CHARACTERISTIC /begin REF_MEASUREMENT TunSelnMngt.RamTblSwt /end REF_MEASUREMENT /end GROUP
/begin GROUP TunSelnMngt.ReceiverPorts "MICROSAR RTE" /begin SUB_GROUP TunSelnMngt.DesIninIdx.Val TunSelnMngt.DesRtIdx.Val /end SUB_GROUP /begin FUNCTION_LIST /end FUNCTION_LIST /begin REF_CHARACTERISTIC /end REF_CHARACTERISTIC /begin REF_MEASUREMENT /end REF_MEASUREMENT /end GROUP
/begin GROUP TunSelnMngt.SenderPorts "MICROSAR RTE" /begin SUB_GROUP TunSelnMngt.ActvIninIdx.Val TunSelnMngt.ActvRtIdx.Val /end SUB_GROUP /begin FUNCTION_LIST /end FUNCTION_LIST /begin REF_CHARACTERISTIC /end REF_CHARACTERISTIC /begin REF_MEASUREMENT /end REF_MEASUREMENT /end GROUP
/begin GROUP VehSigCdng "MICROSAR RTE"
 /begin SUB_GROUP VehSigCdng.CalibrationPorts VehSigCdng.PerInstanceMemories VehSigCdng.ReceiverPorts VehSigCdng.SenderPorts /end SUB_GROUP
 /begin FUNCTION_LIST /end FUNCTION_LIST
 /begin REF_CHARACTERISTIC /end REF_CHARACTERISTIC
 /begin REF_MEASUREMENT /end REF_MEASUREMENT
/end GROUP
/begin GROUP VehSigCdng.CalibrationPorts "MICROSAR RTE"
 /begin SUB_GROUP VehSigCdng.VehSigCdngDftLatA.Val VehSigCdng.VehSigCdngDftLgtA.Val VehSigCdng.VehSigCdngDftVehSpd.Val VehSigCdng.VehSigCdngDftYawRate.Val VehSigCdng.VehSigCdngLatADifThd.Val VehSigCdng.VehSigCdngLatAFilFrq.Val VehSigCdng.VehSigCdngLatASlewRate.Val VehSigCdng.VehSigCdngLtgADifThd.Val VehSigCdng.VehSigCdngLtgASlewRate.Val VehSigCdng.VehSigCdngVehSpdDifThd.Val VehSigCdng.VehSigCdngVehSpdSlewRate.Val VehSigCdng.VehSigCdngVehYawSlewRate.Val VehSigCdng.VehSigCdngYawRateDifThd.Val /end SUB_GROUP
 /begin FUNCTION_LIST /end FUNCTION_LIST
 /begin REF_CHARACTERISTIC /end REF_CHARACTERISTIC
 /begin REF_MEASUREMENT /end REF_MEASUREMENT
/end GROUP
/begin GROUP VehSigCdng.HwTq.Val "MICROSAR RTE" /begin SUB_GROUP /end SUB_GROUP /begin FUNCTION_LIST /end FUNCTION_LIST /begin REF_CHARACTERISTIC /end REF_CHARACTERISTIC /begin REF_MEASUREMENT VehSigCdng.HwTq.Val /end REF_MEASUREMENT /end GROUP
/begin GROUP VehSigCdng.HwTqFilRec "MICROSAR RTE" /begin SUB_GROUP /end SUB_GROUP /begin FUNCTION_LIST /end FUNCTION_LIST /begin REF_CHARACTERISTIC /end REF_CHARACTERISTIC /begin REF_MEASUREMENT VehSigCdng.HwTqFilRec.FilGain VehSigCdng.HwTqFilRec.FilSt /end REF_MEASUREMENT /end GROUP
/begin GROUP VehSigCdng.LatAFilRec "MICROSAR RTE" /begin SUB_GROUP /end SUB_GROUP /begin FUNCTION_LIST /end FUNCTION_LIST /begin REF_CHARACTERISTIC /end REF_CHARACTERISTIC /begin REF_MEASUREMENT VehSigCdng.LatAFilRec.FilGain VehSigCdng.LatAFilRec.FilSt /end REF_MEASUREMENT /end GROUP
/begin GROUP VehSigCdng.PerInstanceMemories "MICROSAR RTE"
 /begin SUB_GROUP VehSigCdng.HwTqFilRec VehSigCdng.LatAFilRec VehSigCdng.PrevLatA VehSigCdng.PrevLatAVld VehSigCdng.PrevLtgA VehSigCdng.PrevLtgAVld VehSigCdng.PrevVehSpd VehSigCdng.PrevVehSpdVld VehSigCdng.PrevYawRate VehSigCdng.PrevYawRateVld /end SUB_GROUP
 /begin FUNCTION_LIST /end FUNCTION_LIST
 /begin REF_CHARACTERISTIC /end REF_CHARACTERISTIC
 /begin REF_MEASUREMENT /end REF_MEASUREMENT
/end GROUP
/begin GROUP VehSigCdng.PrevLatA "MICROSAR RTE" /begin SUB_GROUP /end SUB_GROUP /begin FUNCTION_LIST /end FUNCTION_LIST /begin REF_CHARACTERISTIC /end REF_CHARACTERISTIC /begin REF_MEASUREMENT VehSigCdng.PrevLatA /end REF_MEASUREMENT /end GROUP
/begin GROUP VehSigCdng.PrevLatAVld "MICROSAR RTE" /begin SUB_GROUP /end SUB_GROUP /begin FUNCTION_LIST /end FUNCTION_LIST /begin REF_CHARACTERISTIC /end REF_CHARACTERISTIC /begin REF_MEASUREMENT VehSigCdng.PrevLatAVld /end REF_MEASUREMENT /end GROUP
/begin GROUP VehSigCdng.PrevLtgA "MICROSAR RTE" /begin SUB_GROUP /end SUB_GROUP /begin FUNCTION_LIST /end FUNCTION_LIST /begin REF_CHARACTERISTIC /end REF_CHARACTERISTIC /begin REF_MEASUREMENT VehSigCdng.PrevLtgA /end REF_MEASUREMENT /end GROUP
/begin GROUP VehSigCdng.PrevLtgAVld "MICROSAR RTE" /begin SUB_GROUP /end SUB_GROUP /begin FUNCTION_LIST /end FUNCTION_LIST /begin REF_CHARACTERISTIC /end REF_CHARACTERISTIC /begin REF_MEASUREMENT VehSigCdng.PrevLtgAVld /end REF_MEASUREMENT /end GROUP
/begin GROUP VehSigCdng.PrevVehSpd "MICROSAR RTE" /begin SUB_GROUP /end SUB_GROUP /begin FUNCTION_LIST /end FUNCTION_LIST /begin REF_CHARACTERISTIC /end REF_CHARACTERISTIC /begin REF_MEASUREMENT VehSigCdng.PrevVehSpd /end REF_MEASUREMENT /end GROUP
/begin GROUP VehSigCdng.PrevVehSpdVld "MICROSAR RTE" /begin SUB_GROUP /end SUB_GROUP /begin FUNCTION_LIST /end FUNCTION_LIST /begin REF_CHARACTERISTIC /end REF_CHARACTERISTIC /begin REF_MEASUREMENT VehSigCdng.PrevVehSpdVld /end REF_MEASUREMENT /end GROUP
/begin GROUP VehSigCdng.PrevYawRate "MICROSAR RTE" /begin SUB_GROUP /end SUB_GROUP /begin FUNCTION_LIST /end FUNCTION_LIST /begin REF_CHARACTERISTIC /end REF_CHARACTERISTIC /begin REF_MEASUREMENT VehSigCdng.PrevYawRate /end REF_MEASUREMENT /end GROUP
/begin GROUP VehSigCdng.PrevYawRateVld "MICROSAR RTE" /begin SUB_GROUP /end SUB_GROUP /begin FUNCTION_LIST /end FUNCTION_LIST /begin REF_CHARACTERISTIC /end REF_CHARACTERISTIC /begin REF_MEASUREMENT VehSigCdng.PrevYawRateVld /end REF_MEASUREMENT /end GROUP
/begin GROUP VehSigCdng.ReceiverPorts "MICROSAR RTE"
 /begin SUB_GROUP VehSigCdng.HwTq.Val VehSigCdng.VehLatASerlCom.Val VehSigCdng.VehLatAVldSerlCom.Logl VehSigCdng.VehLgtASerlCom.Val VehSigCdng.VehLgtAVldSerlCom.Logl VehSigCdng.VehSpdOvrd.Val VehSigCdng.VehSpdOvrdEna.Logl VehSigCdng.VehSpdSerlCom.Val VehSigCdng.VehSpdVldSerlCom.Logl VehSigCdng.VehYawRateSerlCom.Val VehSigCdng.VehYawRateVldSerlCom.Logl /end SUB_GROUP
 /begin FUNCTION_LIST /end FUNCTION_LIST
 /begin REF_CHARACTERISTIC /end REF_CHARACTERISTIC
 /begin REF_MEASUREMENT /end REF_MEASUREMENT
/end GROUP
/begin GROUP VehSigCdng.SenderPorts "MICROSAR RTE"
 /begin SUB_GROUP VehSigCdng.VehLatA.Val VehSigCdng.VehLatAEstimd.Val VehSigCdng.VehLatAEstimdVld.Logl VehSigCdng.VehLatAVld.Logl VehSigCdng.VehLgtA.Val VehSigCdng.VehLgtAVld.Logl VehSigCdng.VehSpd.Val VehSigCdng.VehSpdVld.Logl VehSigCdng.VehYawRate.Val VehSigCdng.VehYawRateVld.Logl /end SUB_GROUP
 /begin FUNCTION_LIST /end FUNCTION_LIST
 /begin REF_CHARACTERISTIC /end REF_CHARACTERISTIC
 /begin REF_MEASUREMENT /end REF_MEASUREMENT
/end GROUP
/begin GROUP VehSigCdng.VehLatA.Val "MICROSAR RTE" /begin SUB_GROUP /end SUB_GROUP /begin FUNCTION_LIST /end FUNCTION_LIST /begin REF_CHARACTERISTIC /end REF_CHARACTERISTIC /begin REF_MEASUREMENT VehSigCdng.VehLatA.Val /end REF_MEASUREMENT /end GROUP
/begin GROUP VehSigCdng.VehLatAEstimd.Val "MICROSAR RTE" /begin SUB_GROUP /end SUB_GROUP /begin FUNCTION_LIST /end FUNCTION_LIST /begin REF_CHARACTERISTIC /end REF_CHARACTERISTIC /begin REF_MEASUREMENT VehSigCdng.VehLatAEstimd.Val /end REF_MEASUREMENT /end GROUP
/begin GROUP VehSigCdng.VehLatAEstimdVld.Logl "MICROSAR RTE" /begin SUB_GROUP /end SUB_GROUP /begin FUNCTION_LIST /end FUNCTION_LIST /begin REF_CHARACTERISTIC /end REF_CHARACTERISTIC /begin REF_MEASUREMENT VehSigCdng.VehLatAEstimdVld.Logl /end REF_MEASUREMENT /end GROUP
/begin GROUP VehSigCdng.VehLatASerlCom.Val "MICROSAR RTE" /begin SUB_GROUP /end SUB_GROUP /begin FUNCTION_LIST /end FUNCTION_LIST /begin REF_CHARACTERISTIC /end REF_CHARACTERISTIC /begin REF_MEASUREMENT VehSigCdng.VehLatASerlCom.Val /end REF_MEASUREMENT /end GROUP
/begin GROUP VehSigCdng.VehLatAVld.Logl "MICROSAR RTE" /begin SUB_GROUP /end SUB_GROUP /begin FUNCTION_LIST /end FUNCTION_LIST /begin REF_CHARACTERISTIC /end REF_CHARACTERISTIC /begin REF_MEASUREMENT VehSigCdng.VehLatAVld.Logl /end REF_MEASUREMENT /end GROUP
/begin GROUP VehSigCdng.VehLatAVldSerlCom.Logl "MICROSAR RTE" /begin SUB_GROUP /end SUB_GROUP /begin FUNCTION_LIST /end FUNCTION_LIST /begin REF_CHARACTERISTIC /end REF_CHARACTERISTIC /begin REF_MEASUREMENT VehSigCdng.VehLatAVldSerlCom.Logl /end REF_MEASUREMENT /end GROUP
/begin GROUP VehSigCdng.VehLgtA.Val "MICROSAR RTE" /begin SUB_GROUP /end SUB_GROUP /begin FUNCTION_LIST /end FUNCTION_LIST /begin REF_CHARACTERISTIC /end REF_CHARACTERISTIC /begin REF_MEASUREMENT VehSigCdng.VehLgtA.Val /end REF_MEASUREMENT /end GROUP
/begin GROUP VehSigCdng.VehLgtASerlCom.Val "MICROSAR RTE" /begin SUB_GROUP /end SUB_GROUP /begin FUNCTION_LIST /end FUNCTION_LIST /begin REF_CHARACTERISTIC /end REF_CHARACTERISTIC /begin REF_MEASUREMENT VehSigCdng.VehLgtASerlCom.Val /end REF_MEASUREMENT /end GROUP
/begin GROUP VehSigCdng.VehLgtAVld.Logl "MICROSAR RTE" /begin SUB_GROUP /end SUB_GROUP /begin FUNCTION_LIST /end FUNCTION_LIST /begin REF_CHARACTERISTIC /end REF_CHARACTERISTIC /begin REF_MEASUREMENT VehSigCdng.VehLgtAVld.Logl /end REF_MEASUREMENT /end GROUP
/begin GROUP VehSigCdng.VehLgtAVldSerlCom.Logl "MICROSAR RTE" /begin SUB_GROUP /end SUB_GROUP /begin FUNCTION_LIST /end FUNCTION_LIST /begin REF_CHARACTERISTIC /end REF_CHARACTERISTIC /begin REF_MEASUREMENT VehSigCdng.VehLgtAVldSerlCom.Logl /end REF_MEASUREMENT /end GROUP
/begin GROUP VehSigCdng.VehSigCdngDftLatA.Val "MICROSAR RTE" /begin SUB_GROUP /end SUB_GROUP /begin FUNCTION_LIST /end FUNCTION_LIST /begin REF_CHARACTERISTIC VehSigCdng.VehSigCdngDftLatA.Val /end REF_CHARACTERISTIC /begin REF_MEASUREMENT /end REF_MEASUREMENT /end GROUP
/begin GROUP VehSigCdng.VehSigCdngDftLgtA.Val "MICROSAR RTE" /begin SUB_GROUP /end SUB_GROUP /begin FUNCTION_LIST /end FUNCTION_LIST /begin REF_CHARACTERISTIC VehSigCdng.VehSigCdngDftLgtA.Val /end REF_CHARACTERISTIC /begin REF_MEASUREMENT /end REF_MEASUREMENT /end GROUP
/begin GROUP VehSigCdng.VehSigCdngDftVehSpd.Val "MICROSAR RTE" /begin SUB_GROUP /end SUB_GROUP /begin FUNCTION_LIST /end FUNCTION_LIST /begin REF_CHARACTERISTIC VehSigCdng.VehSigCdngDftVehSpd.Val /end REF_CHARACTERISTIC /begin REF_MEASUREMENT /end REF_MEASUREMENT /end GROUP
/begin GROUP VehSigCdng.VehSigCdngDftYawRate.Val "MICROSAR RTE" /begin SUB_GROUP /end SUB_GROUP /begin FUNCTION_LIST /end FUNCTION_LIST /begin REF_CHARACTERISTIC VehSigCdng.VehSigCdngDftYawRate.Val /end REF_CHARACTERISTIC /begin REF_MEASUREMENT /end REF_MEASUREMENT /end GROUP
/begin GROUP VehSigCdng.VehSigCdngLatADifThd.Val "MICROSAR RTE" /begin SUB_GROUP /end SUB_GROUP /begin FUNCTION_LIST /end FUNCTION_LIST /begin REF_CHARACTERISTIC VehSigCdng.VehSigCdngLatADifThd.Val /end REF_CHARACTERISTIC /begin REF_MEASUREMENT /end REF_MEASUREMENT /end GROUP
/begin GROUP VehSigCdng.VehSigCdngLatAFilFrq.Val "MICROSAR RTE" /begin SUB_GROUP /end SUB_GROUP /begin FUNCTION_LIST /end FUNCTION_LIST /begin REF_CHARACTERISTIC VehSigCdng.VehSigCdngLatAFilFrq.Val /end REF_CHARACTERISTIC /begin REF_MEASUREMENT /end REF_MEASUREMENT /end GROUP
/begin GROUP VehSigCdng.VehSigCdngLatASlewRate.Val "MICROSAR RTE" /begin SUB_GROUP /end SUB_GROUP /begin FUNCTION_LIST /end FUNCTION_LIST /begin REF_CHARACTERISTIC VehSigCdng.VehSigCdngLatASlewRate.Val /end REF_CHARACTERISTIC /begin REF_MEASUREMENT /end REF_MEASUREMENT /end GROUP
/begin GROUP VehSigCdng.VehSigCdngLtgADifThd.Val "MICROSAR RTE" /begin SUB_GROUP /end SUB_GROUP /begin FUNCTION_LIST /end FUNCTION_LIST /begin REF_CHARACTERISTIC VehSigCdng.VehSigCdngLtgADifThd.Val /end REF_CHARACTERISTIC /begin REF_MEASUREMENT /end REF_MEASUREMENT /end GROUP
/begin GROUP VehSigCdng.VehSigCdngLtgASlewRate.Val "MICROSAR RTE" /begin SUB_GROUP /end SUB_GROUP /begin FUNCTION_LIST /end FUNCTION_LIST /begin REF_CHARACTERISTIC VehSigCdng.VehSigCdngLtgASlewRate.Val /end REF_CHARACTERISTIC /begin REF_MEASUREMENT /end REF_MEASUREMENT /end GROUP
/begin GROUP VehSigCdng.VehSigCdngVehSpdDifThd.Val "MICROSAR RTE" /begin SUB_GROUP /end SUB_GROUP /begin FUNCTION_LIST /end FUNCTION_LIST /begin REF_CHARACTERISTIC VehSigCdng.VehSigCdngVehSpdDifThd.Val /end REF_CHARACTERISTIC /begin REF_MEASUREMENT /end REF_MEASUREMENT /end GROUP
/begin GROUP VehSigCdng.VehSigCdngVehSpdSlewRate.Val "MICROSAR RTE" /begin SUB_GROUP /end SUB_GROUP /begin FUNCTION_LIST /end FUNCTION_LIST /begin REF_CHARACTERISTIC VehSigCdng.VehSigCdngVehSpdSlewRate.Val /end REF_CHARACTERISTIC /begin REF_MEASUREMENT /end REF_MEASUREMENT /end GROUP
/begin GROUP VehSigCdng.VehSigCdngVehYawSlewRate.Val "MICROSAR RTE" /begin SUB_GROUP /end SUB_GROUP /begin FUNCTION_LIST /end FUNCTION_LIST /begin REF_CHARACTERISTIC VehSigCdng.VehSigCdngVehYawSlewRate.Val /end REF_CHARACTERISTIC /begin REF_MEASUREMENT /end REF_MEASUREMENT /end GROUP
/begin GROUP VehSigCdng.VehSigCdngYawRateDifThd.Val "MICROSAR RTE" /begin SUB_GROUP /end SUB_GROUP /begin FUNCTION_LIST /end FUNCTION_LIST /begin REF_CHARACTERISTIC VehSigCdng.VehSigCdngYawRateDifThd.Val /end REF_CHARACTERISTIC /begin REF_MEASUREMENT /end REF_MEASUREMENT /end GROUP
/begin GROUP VehSigCdng.VehSpd.Val "MICROSAR RTE" /begin SUB_GROUP /end SUB_GROUP /begin FUNCTION_LIST /end FUNCTION_LIST /begin REF_CHARACTERISTIC /end REF_CHARACTERISTIC /begin REF_MEASUREMENT VehSigCdng.VehSpd.Val /end REF_MEASUREMENT /end GROUP
/begin GROUP VehSigCdng.VehSpdOvrd.Val "MICROSAR RTE" /begin SUB_GROUP /end SUB_GROUP /begin FUNCTION_LIST /end FUNCTION_LIST /begin REF_CHARACTERISTIC /end REF_CHARACTERISTIC /begin REF_MEASUREMENT VehSigCdng.VehSpdOvrd.Val /end REF_MEASUREMENT /end GROUP
/begin GROUP VehSigCdng.VehSpdOvrdEna.Logl "MICROSAR RTE" /begin SUB_GROUP /end SUB_GROUP /begin FUNCTION_LIST /end FUNCTION_LIST /begin REF_CHARACTERISTIC /end REF_CHARACTERISTIC /begin REF_MEASUREMENT VehSigCdng.VehSpdOvrdEna.Logl /end REF_MEASUREMENT /end GROUP
/begin GROUP VehSigCdng.VehSpdSerlCom.Val "MICROSAR RTE" /begin SUB_GROUP /end SUB_GROUP /begin FUNCTION_LIST /end FUNCTION_LIST /begin REF_CHARACTERISTIC /end REF_CHARACTERISTIC /begin REF_MEASUREMENT VehSigCdng.VehSpdSerlCom.Val /end REF_MEASUREMENT /end GROUP
/begin GROUP VehSigCdng.VehSpdVld.Logl "MICROSAR RTE" /begin SUB_GROUP /end SUB_GROUP /begin FUNCTION_LIST /end FUNCTION_LIST /begin REF_CHARACTERISTIC /end REF_CHARACTERISTIC /begin REF_MEASUREMENT VehSigCdng.VehSpdVld.Logl /end REF_MEASUREMENT /end GROUP
/begin GROUP VehSigCdng.VehSpdVldSerlCom.Logl "MICROSAR RTE" /begin SUB_GROUP /end SUB_GROUP /begin FUNCTION_LIST /end FUNCTION_LIST /begin REF_CHARACTERISTIC /end REF_CHARACTERISTIC /begin REF_MEASUREMENT VehSigCdng.VehSpdVldSerlCom.Logl /end REF_MEASUREMENT /end GROUP
/begin GROUP VehSigCdng.VehYawRate.Val "MICROSAR RTE" /begin SUB_GROUP /end SUB_GROUP /begin FUNCTION_LIST /end FUNCTION_LIST /begin REF_CHARACTERISTIC /end REF_CHARACTERISTIC /begin REF_MEASUREMENT VehSigCdng.VehYawRate.Val /end REF_MEASUREMENT /end GROUP
/begin GROUP VehSigCdng.VehYawRateSerlCom.Val "MICROSAR RTE" /begin SUB_GROUP /end SUB_GROUP /begin FUNCTION_LIST /end FUNCTION_LIST /begin REF_CHARACTERISTIC /end REF_CHARACTERISTIC /begin REF_MEASUREMENT VehSigCdng.VehYawRateSerlCom.Val /end REF_MEASUREMENT /end GROUP
/begin GROUP VehSigCdng.VehYawRateVld.Logl "MICROSAR RTE" /begin SUB_GROUP /end SUB_GROUP /begin FUNCTION_LIST /end FUNCTION_LIST /begin REF_CHARACTERISTIC /end REF_CHARACTERISTIC /begin REF_MEASUREMENT VehSigCdng.VehYawRateVld.Logl /end REF_MEASUREMENT /end GROUP
/begin GROUP VehSigCdng.VehYawRateVldSerlCom.Logl "MICROSAR RTE" /begin SUB_GROUP /end SUB_GROUP /begin FUNCTION_LIST /end FUNCTION_LIST /begin REF_CHARACTERISTIC /end REF_CHARACTERISTIC /begin REF_MEASUREMENT VehSigCdng.VehYawRateVldSerlCom.Logl /end REF_MEASUREMENT /end GROUP
/begin GROUP VehSpdLimr "MICROSAR RTE"
 /begin SUB_GROUP VehSpdLimr.CalibrationPorts VehSpdLimr.PerInstanceMemories VehSpdLimr.ReceiverPorts VehSpdLimr.SenderPorts /end SUB_GROUP
 /begin FUNCTION_LIST /end FUNCTION_LIST
 /begin REF_CHARACTERISTIC /end REF_CHARACTERISTIC
 /begin REF_MEASUREMENT /end REF_MEASUREMENT
/end GROUP
/begin GROUP VehSpdLimr.CalibrationPorts "MICROSAR RTE"
 /begin SUB_GROUP VehSpdLimr.VehSpdLimrMaxAssiX.Ary1D VehSpdLimr.VehSpdLimrMaxAssiY.Ary1D VehSpdLimr.VehSpdLimrPosMaxOffs1.Val VehSpdLimr.VehSpdLimrPosMaxOffs2.Val /end SUB_GROUP
 /begin FUNCTION_LIST /end FUNCTION_LIST
 /begin REF_CHARACTERISTIC /end REF_CHARACTERISTIC
 /begin REF_MEASUREMENT /end REF_MEASUREMENT
/end GROUP
/begin GROUP VehSpdLimr.HwAg.Val "MICROSAR RTE" /begin SUB_GROUP /end SUB_GROUP /begin FUNCTION_LIST /end FUNCTION_LIST /begin REF_CHARACTERISTIC /end REF_CHARACTERISTIC /begin REF_MEASUREMENT VehSpdLimr.HwAg.Val /end REF_MEASUREMENT /end GROUP
/begin GROUP VehSpdLimr.HwAgAuthy.Val "MICROSAR RTE" /begin SUB_GROUP /end SUB_GROUP /begin FUNCTION_LIST /end FUNCTION_LIST /begin REF_CHARACTERISTIC /end REF_CHARACTERISTIC /begin REF_MEASUREMENT VehSpdLimr.HwAgAuthy.Val /end REF_MEASUREMENT /end GROUP
/begin GROUP VehSpdLimr.HwAgEotCcw.Val "MICROSAR RTE" /begin SUB_GROUP /end SUB_GROUP /begin FUNCTION_LIST /end FUNCTION_LIST /begin REF_CHARACTERISTIC /end REF_CHARACTERISTIC /begin REF_MEASUREMENT VehSpdLimr.HwAgEotCcw.Val /end REF_MEASUREMENT /end GROUP
/begin GROUP VehSpdLimr.HwAgEotCw.Val "MICROSAR RTE" /begin SUB_GROUP /end SUB_GROUP /begin FUNCTION_LIST /end FUNCTION_LIST /begin REF_CHARACTERISTIC /end REF_CHARACTERISTIC /begin REF_MEASUREMENT VehSpdLimr.HwAgEotCw.Val /end REF_MEASUREMENT /end GROUP
/begin GROUP VehSpdLimr.PerInstanceMemories "MICROSAR RTE"
 /begin SUB_GROUP VehSpdLimr.dVehSpdLimrBreakPt1 VehSpdLimr.dVehSpdLimrBreakPt2 VehSpdLimr.dVehSpdLimrLimTerm VehSpdLimr.dVehSpdLimrZeroVehSpd /end SUB_GROUP
 /begin FUNCTION_LIST /end FUNCTION_LIST
 /begin REF_CHARACTERISTIC /end REF_CHARACTERISTIC
 /begin REF_MEASUREMENT /end REF_MEASUREMENT
/end GROUP
/begin GROUP VehSpdLimr.ReceiverPorts "MICROSAR RTE"
 /begin SUB_GROUP VehSpdLimr.HwAg.Val VehSpdLimr.HwAgAuthy.Val VehSpdLimr.HwAgEotCcw.Val VehSpdLimr.HwAgEotCw.Val VehSpdLimr.VehSpd.Val /end SUB_GROUP
 /begin FUNCTION_LIST /end FUNCTION_LIST
 /begin REF_CHARACTERISTIC /end REF_CHARACTERISTIC
 /begin REF_MEASUREMENT /end REF_MEASUREMENT
/end GROUP
/begin GROUP VehSpdLimr.SenderPorts "MICROSAR RTE" /begin SUB_GROUP VehSpdLimr.VehSpdMotTqLim.Val /end SUB_GROUP /begin FUNCTION_LIST /end FUNCTION_LIST /begin REF_CHARACTERISTIC /end REF_CHARACTERISTIC /begin REF_MEASUREMENT /end REF_MEASUREMENT /end GROUP
/begin GROUP VehSpdLimr.VehSpd.Val "MICROSAR RTE" /begin SUB_GROUP /end SUB_GROUP /begin FUNCTION_LIST /end FUNCTION_LIST /begin REF_CHARACTERISTIC /end REF_CHARACTERISTIC /begin REF_MEASUREMENT VehSpdLimr.VehSpd.Val /end REF_MEASUREMENT /end GROUP
/begin GROUP VehSpdLimr.VehSpdLimrMaxAssiX.Ary1D "MICROSAR RTE" /begin SUB_GROUP /end SUB_GROUP /begin FUNCTION_LIST /end FUNCTION_LIST /begin REF_CHARACTERISTIC VehSpdLimr.VehSpdLimrMaxAssiX.Ary1D /end REF_CHARACTERISTIC /begin REF_MEASUREMENT /end REF_MEASUREMENT /end GROUP
/begin GROUP VehSpdLimr.VehSpdLimrMaxAssiY.Ary1D "MICROSAR RTE" /begin SUB_GROUP /end SUB_GROUP /begin FUNCTION_LIST /end FUNCTION_LIST /begin REF_CHARACTERISTIC VehSpdLimr.VehSpdLimrMaxAssiY.Ary1D /end REF_CHARACTERISTIC /begin REF_MEASUREMENT /end REF_MEASUREMENT /end GROUP
/begin GROUP VehSpdLimr.VehSpdLimrPosMaxOffs1.Val "MICROSAR RTE" /begin SUB_GROUP /end SUB_GROUP /begin FUNCTION_LIST /end FUNCTION_LIST /begin REF_CHARACTERISTIC VehSpdLimr.VehSpdLimrPosMaxOffs1.Val /end REF_CHARACTERISTIC /begin REF_MEASUREMENT /end REF_MEASUREMENT /end GROUP
/begin GROUP VehSpdLimr.VehSpdLimrPosMaxOffs2.Val "MICROSAR RTE" /begin SUB_GROUP /end SUB_GROUP /begin FUNCTION_LIST /end FUNCTION_LIST /begin REF_CHARACTERISTIC VehSpdLimr.VehSpdLimrPosMaxOffs2.Val /end REF_CHARACTERISTIC /begin REF_MEASUREMENT /end REF_MEASUREMENT /end GROUP
/begin GROUP VehSpdLimr.VehSpdMotTqLim.Val "MICROSAR RTE" /begin SUB_GROUP /end SUB_GROUP /begin FUNCTION_LIST /end FUNCTION_LIST /begin REF_CHARACTERISTIC /end REF_CHARACTERISTIC /begin REF_MEASUREMENT VehSpdLimr.VehSpdMotTqLim.Val /end REF_MEASUREMENT /end GROUP
/begin GROUP VehSpdLimr.dVehSpdLimrBreakPt1 "MICROSAR RTE" /begin SUB_GROUP /end SUB_GROUP /begin FUNCTION_LIST /end FUNCTION_LIST /begin REF_CHARACTERISTIC /end REF_CHARACTERISTIC /begin REF_MEASUREMENT VehSpdLimr.dVehSpdLimrBreakPt1 /end REF_MEASUREMENT /end GROUP
/begin GROUP VehSpdLimr.dVehSpdLimrBreakPt2 "MICROSAR RTE" /begin SUB_GROUP /end SUB_GROUP /begin FUNCTION_LIST /end FUNCTION_LIST /begin REF_CHARACTERISTIC /end REF_CHARACTERISTIC /begin REF_MEASUREMENT VehSpdLimr.dVehSpdLimrBreakPt2 /end REF_MEASUREMENT /end GROUP
/begin GROUP VehSpdLimr.dVehSpdLimrLimTerm "MICROSAR RTE" /begin SUB_GROUP /end SUB_GROUP /begin FUNCTION_LIST /end FUNCTION_LIST /begin REF_CHARACTERISTIC /end REF_CHARACTERISTIC /begin REF_MEASUREMENT VehSpdLimr.dVehSpdLimrLimTerm /end REF_MEASUREMENT /end GROUP
/begin GROUP VehSpdLimr.dVehSpdLimrZeroVehSpd "MICROSAR RTE" /begin SUB_GROUP /end SUB_GROUP /begin FUNCTION_LIST /end FUNCTION_LIST /begin REF_CHARACTERISTIC /end REF_CHARACTERISTIC /begin REF_MEASUREMENT VehSpdLimr.dVehSpdLimrZeroVehSpd /end REF_MEASUREMENT /end GROUP
/begin RECORD_LAYOUT RTE_RL_UWORD FNC_VALUES 1 UWORD ROW_DIR DIRECT /end RECORD_LAYOUT
/begin RECORD_LAYOUT RTE_RL_FLOAT32_IEEE FNC_VALUES 1 FLOAT32_IEEE ROW_DIR DIRECT /end RECORD_LAYOUT
/begin RECORD_LAYOUT RTE_RL_BOOLEAN FNC_VALUES 1 UBYTE ROW_DIR DIRECT /end RECORD_LAYOUT
/**********************************************************************************************************************
* COMPU_METHOD / COMPU_VTAB_RANGE
*********************************************************************************************************************/
/begin COMPU_METHOD RTE_CM_BOOLEAN "" TAB_VERB "%3.1" "" COMPU_TAB_REF RTE_CM_BOOLEAN /end COMPU_METHOD
/begin COMPU_VTAB_RANGE RTE_CM_BOOLEAN "" 2 0 0 "false" 1 255 "true" /end COMPU_VTAB_RANGE
/begin COMPU_METHOD RTE_CM_STRING "" TAB_VERB "%.1" "" COMPU_TAB_REF RTE_CM_STRING /end COMPU_METHOD
/begin COMPU_VTAB_RANGE RTE_CM_STRING "" 97 0 31 "UNDEFINED" 32 32 " " 33 33 "!" 34 34 "\"" 35 35 "#" 36 36 "$" 37 37 "%" 38 38 "&" 39 39 "'" 40 40 "(" 41 41 ")" 42 42 "*" 43 43 "+" 44 44 "," 45 45 "-" 46 46 "." 47 47 "/" 48 48 "0" 49 49 "1" 50 50 "2" 51 51 "3" 52 52 "4" 53 53 "5" 54 54 "6" 55 55 "7" 56 56 "8" 57 57 "9" 58 58 ":" 59 59 ";" 60 60 "<" 61 61 "=" 62 62 ">" 63 63 "?" 64 64 "@" 65 65 "A" 66 66 "B" 67 67 "C" 68 68 "D" 69 69 "E" 70 70 "F" 71 71 "G" 72 72 "H" 73 73 "I" 74 74 "J" 75 75 "K" 76 76 "L" 77 77 "M" 78 78 "N" 79 79 "O" 80 80 "P" 81 81 "Q" 82 82 "R" 83 83 "S" 84 84 "T" 85 85 "U" 86 86 "V" 87 87 "W" 88 88 "X" 89 89 "Y" 90 90 "Z" 91 91 "[" 92 92 "\\" 93 93 "]" 94 94 "^" 95 95 "_" 96 96 "`" 97 97 "a" 98 98 "b" 99 99 "c" 100 100 "d" 101 101 "e" 102 102 "f" 103 103 "g" 104 104 "h" 105 105 "i" 106 106 "j" 107 107 "k" 108 108 "l" 109 109 "m" 110 110 "n" 111 111 "o" 112 112 "p" 113 113 "q" 114 114 "r" 115 115 "s" 116 116 "t" 117 117 "u" 118 118 "v" 119 119 "w" 120 120 "x" 121 121 "y" 122 122 "z" 123 123 "{" 124 124 "|" 125 125 "}" 126 126 "~" 127 255 "UNDEFINED" /end COMPU_VTAB_RANGE
/begin COMPU_METHOD RTE_CM_ENUM_SysSt1 "" TAB_VERB "%.1" "" COMPU_TAB_REF RTE_CM_ENUM_SysSt1 /end COMPU_METHOD
/begin COMPU_VTAB_RANGE RTE_CM_ENUM_SysSt1 "" 4 0 0 "SYSST_DI" 1 1 "SYSST_OFF" 2 2 "SYSST_ENA" 3 3 "SYSST_WRMININ" /end COMPU_VTAB_RANGE
