/begin CHARACTERISTIC CDD_MotAg5Meas.MotAg5MeasAmpSqdMaxThd.Val "MICROSAR RTE" VALUE 0x0 RTE_RL_FLOAT32_IEEE 0 NO_COMPU_METHOD -3.402823466e+38 3.402823466e+38 SYMBOL_LINK "Rte_CalprmRom_CalRegn01Cmn_DEFAULT_RTE_CALPRM_GROUP.MotAg5MeasAmpSqdMaxThd_Val" 0 DISPLAY_IDENTIFIER CDD_MotAg5Meas.CalibrationPorts.MotAg5MeasAmpSqdMaxThd.Val /end CHARACTERISTIC
/begin CHARACTERISTIC CDD_MotAg5Meas.MotAg5MeasAmpSqdMinThd.Val "MICROSAR RTE" VALUE 0x0 RTE_RL_FLOAT32_IEEE 0 NO_COMPU_METHOD -3.402823466e+38 3.402823466e+38 SYMBOL_LINK "Rte_CalprmRom_CalRegn01Cmn_DEFAULT_RTE_CALPRM_GROUP.MotAg5MeasAmpSqdMinThd_Val" 0 DISPLAY_IDENTIFIER CDD_MotAg5Meas.CalibrationPorts.MotAg5MeasAmpSqdMinThd.Val /end CHARACTERISTIC
/begin CHARACTERISTIC CDD_MotAg5Meas.MotAg5MeasLpFilFrq.Val "MICROSAR RTE" VALUE 0x0 RTE_RL_FLOAT32_IEEE 0 NO_COMPU_METHOD -3.402823466e+38 3.402823466e+38 SYMBOL_LINK "Rte_CalprmRom_CalRegn01Cmn_DEFAULT_RTE_CALPRM_GROUP.MotAg5MeasLpFilFrq_Val" 0 DISPLAY_IDENTIFIER CDD_MotAg5Meas.CalibrationPorts.MotAg5MeasLpFilFrq.Val /end CHARACTERISTIC
/begin CHARACTERISTIC CDD_MotAg5Meas.MotAg5MeasOffs.Val "MICROSAR RTE" VALUE 0x0 RTE_RL_UWORD 0 NO_COMPU_METHOD 0 65535 SYMBOL_LINK "Rte_CalprmRom_CalRegn01Cmn_DEFAULT_RTE_CALPRM_GROUP.MotAg5MeasOffs_Val" 0 DISPLAY_IDENTIFIER CDD_MotAg5Meas.CalibrationPorts.MotAg5MeasOffs.Val /end CHARACTERISTIC
/begin CHARACTERISTIC CDD_MotAg5Meas.MotAg5MeasRtAmpRecprLim.Val "MICROSAR RTE" VALUE 0x0 RTE_RL_FLOAT32_IEEE 0 NO_COMPU_METHOD -3.402823466e+38 3.402823466e+38 SYMBOL_LINK "Rte_CalprmRom_CalRegn01Cmn_DEFAULT_RTE_CALPRM_GROUP.MotAg5MeasRtAmpRecprLim_Val" 0 DISPLAY_IDENTIFIER CDD_MotAg5Meas.CalibrationPorts.MotAg5MeasRtAmpRecprLim.Val /end CHARACTERISTIC
/begin CHARACTERISTIC CDD_MotAg5Meas.MotAg5MeasRtFilEnaThd.Val "MICROSAR RTE" VALUE 0x0 RTE_RL_FLOAT32_IEEE 0 NO_COMPU_METHOD -3.402823466e+38 3.402823466e+38 SYMBOL_LINK "Rte_CalprmRom_CalRegn01Cmn_DEFAULT_RTE_CALPRM_GROUP.MotAg5MeasRtFilEnaThd_Val" 0 DISPLAY_IDENTIFIER CDD_MotAg5Meas.CalibrationPorts.MotAg5MeasRtFilEnaThd.Val /end CHARACTERISTIC
/begin CHARACTERISTIC CDD_MotAg5Meas.MotAg5MeasRtMotVelFilEnaThd.Val "MICROSAR RTE" VALUE 0x0 RTE_RL_FLOAT32_IEEE 0 NO_COMPU_METHOD -3.402823466e+38 3.402823466e+38 SYMBOL_LINK "Rte_CalprmRom_CalRegn01Cmn_DEFAULT_RTE_CALPRM_GROUP.MotAg5MeasRtMotVelFilEnaThd_Val" 0 DISPLAY_IDENTIFIER CDD_MotAg5Meas.CalibrationPorts.MotAg5MeasRtMotVelFilEnaThd.Val /end CHARACTERISTIC
/begin CHARACTERISTIC CDD_MotAg5Meas.MotAg5MeasRtOffsLim.Val "MICROSAR RTE" VALUE 0x0 RTE_RL_FLOAT32_IEEE 0 NO_COMPU_METHOD -3.402823466e+38 3.402823466e+38 SYMBOL_LINK "Rte_CalprmRom_CalRegn01Cmn_DEFAULT_RTE_CALPRM_GROUP.MotAg5MeasRtOffsLim_Val" 0 DISPLAY_IDENTIFIER CDD_MotAg5Meas.CalibrationPorts.MotAg5MeasRtOffsLim.Val /end CHARACTERISTIC
/begin CHARACTERISTIC CDD_MotAg5Meas.MotAg5MeasRtToNomRatLim.Val "MICROSAR RTE" VALUE 0x0 RTE_RL_FLOAT32_IEEE 0 NO_COMPU_METHOD -3.402823466e+38 3.402823466e+38 SYMBOL_LINK "Rte_CalprmRom_CalRegn01Cmn_DEFAULT_RTE_CALPRM_GROUP.MotAg5MeasRtToNomRatLim_Val" 0 DISPLAY_IDENTIFIER CDD_MotAg5Meas.CalibrationPorts.MotAg5MeasRtToNomRatLim.Val /end CHARACTERISTIC
/begin CHARACTERISTIC CDD_MotAg6Meas.MotAg6MeasAmpSqdMaxThd.Val "MICROSAR RTE" VALUE 0x0 RTE_RL_FLOAT32_IEEE 0 NO_COMPU_METHOD -3.402823466e+38 3.402823466e+38 SYMBOL_LINK "Rte_CalprmRom_CalRegn01Cmn_DEFAULT_RTE_CALPRM_GROUP.MotAg6MeasAmpSqdMaxThd_Val" 0 DISPLAY_IDENTIFIER CDD_MotAg6Meas.CalibrationPorts.MotAg6MeasAmpSqdMaxThd.Val /end CHARACTERISTIC
/begin CHARACTERISTIC CDD_MotAg6Meas.MotAg6MeasAmpSqdMinThd.Val "MICROSAR RTE" VALUE 0x0 RTE_RL_FLOAT32_IEEE 0 NO_COMPU_METHOD -3.402823466e+38 3.402823466e+38 SYMBOL_LINK "Rte_CalprmRom_CalRegn01Cmn_DEFAULT_RTE_CALPRM_GROUP.MotAg6MeasAmpSqdMinThd_Val" 0 DISPLAY_IDENTIFIER CDD_MotAg6Meas.CalibrationPorts.MotAg6MeasAmpSqdMinThd.Val /end CHARACTERISTIC
/begin CHARACTERISTIC CDD_MotAg6Meas.MotAg6MeasLpFilFrq.Val "MICROSAR RTE" VALUE 0x0 RTE_RL_FLOAT32_IEEE 0 NO_COMPU_METHOD -3.402823466e+38 3.402823466e+38 SYMBOL_LINK "Rte_CalprmRom_CalRegn01Cmn_DEFAULT_RTE_CALPRM_GROUP.MotAg6MeasLpFilFrq_Val" 0 DISPLAY_IDENTIFIER CDD_MotAg6Meas.CalibrationPorts.MotAg6MeasLpFilFrq.Val /end CHARACTERISTIC
/begin CHARACTERISTIC CDD_MotAg6Meas.MotAg6MeasOffs.Val "MICROSAR RTE" VALUE 0x0 RTE_RL_UWORD 0 NO_COMPU_METHOD 0 65535 SYMBOL_LINK "Rte_CalprmRom_CalRegn01Cmn_DEFAULT_RTE_CALPRM_GROUP.MotAg6MeasOffs_Val" 0 DISPLAY_IDENTIFIER CDD_MotAg6Meas.CalibrationPorts.MotAg6MeasOffs.Val /end CHARACTERISTIC
/begin CHARACTERISTIC CDD_MotAg6Meas.MotAg6MeasRtAmpRecprLim.Val "MICROSAR RTE" VALUE 0x0 RTE_RL_FLOAT32_IEEE 0 NO_COMPU_METHOD -3.402823466e+38 3.402823466e+38 SYMBOL_LINK "Rte_CalprmRom_CalRegn01Cmn_DEFAULT_RTE_CALPRM_GROUP.MotAg6MeasRtAmpRecprLim_Val" 0 DISPLAY_IDENTIFIER CDD_MotAg6Meas.CalibrationPorts.MotAg6MeasRtAmpRecprLim.Val /end CHARACTERISTIC
/begin CHARACTERISTIC CDD_MotAg6Meas.MotAg6MeasRtFilEnaThd.Val "MICROSAR RTE" VALUE 0x0 RTE_RL_FLOAT32_IEEE 0 NO_COMPU_METHOD -3.402823466e+38 3.402823466e+38 SYMBOL_LINK "Rte_CalprmRom_CalRegn01Cmn_DEFAULT_RTE_CALPRM_GROUP.MotAg6MeasRtFilEnaThd_Val" 0 DISPLAY_IDENTIFIER CDD_MotAg6Meas.CalibrationPorts.MotAg6MeasRtFilEnaThd.Val /end CHARACTERISTIC
/begin CHARACTERISTIC CDD_MotAg6Meas.MotAg6MeasRtMotVelFilEnaThd.Val "MICROSAR RTE" VALUE 0x0 RTE_RL_FLOAT32_IEEE 0 NO_COMPU_METHOD -3.402823466e+38 3.402823466e+38 SYMBOL_LINK "Rte_CalprmRom_CalRegn01Cmn_DEFAULT_RTE_CALPRM_GROUP.MotAg6MeasRtMotVelFilEnaThd_Val" 0 DISPLAY_IDENTIFIER CDD_MotAg6Meas.CalibrationPorts.MotAg6MeasRtMotVelFilEnaThd.Val /end CHARACTERISTIC
/begin CHARACTERISTIC CDD_MotAg6Meas.MotAg6MeasRtOffsLim.Val "MICROSAR RTE" VALUE 0x0 RTE_RL_FLOAT32_IEEE 0 NO_COMPU_METHOD -3.402823466e+38 3.402823466e+38 SYMBOL_LINK "Rte_CalprmRom_CalRegn01Cmn_DEFAULT_RTE_CALPRM_GROUP.MotAg6MeasRtOffsLim_Val" 0 DISPLAY_IDENTIFIER CDD_MotAg6Meas.CalibrationPorts.MotAg6MeasRtOffsLim.Val /end CHARACTERISTIC
/begin CHARACTERISTIC CDD_MotAg6Meas.MotAg6MeasRtToNomRatLim.Val "MICROSAR RTE" VALUE 0x0 RTE_RL_FLOAT32_IEEE 0 NO_COMPU_METHOD -3.402823466e+38 3.402823466e+38 SYMBOL_LINK "Rte_CalprmRom_CalRegn01Cmn_DEFAULT_RTE_CALPRM_GROUP.MotAg6MeasRtToNomRatLim_Val" 0 DISPLAY_IDENTIFIER CDD_MotAg6Meas.CalibrationPorts.MotAg6MeasRtToNomRatLim.Val /end CHARACTERISTIC
/begin CHARACTERISTIC CDD_MotAgCmp.MotAgCmpMotAgBackEmfDft "MICROSAR RTE" VALUE 0x0 RTE_RL_UWORD 0 RTE_CM_Ag9 0 0.9999847412 SYMBOL_LINK "Rte_CalprmRom_CDD_MotAgCmp_DEFAULT_RTE_CDATA_GROUP.MotAgCmpMotAgBackEmfDft" 0 DISPLAY_IDENTIFIER CDD_MotAgCmp.CalibrationParameters.MotAgCmpMotAgBackEmfDft /end CHARACTERISTIC
/begin CHARACTERISTIC CDD_MotAgCmp.SysGlbPrmMotPoleCnt.Val "MICROSAR RTE" VALUE 0x0 RTE_RL_UBYTE 0 NO_COMPU_METHOD 2 12 SYMBOL_LINK "Rte_CalprmRom_CalRegn01Inin00_DEFAULT_RTE_CALPRM_GROUP.SysGlbPrmMotPoleCnt_Val" 0 DISPLAY_IDENTIFIER CDD_MotAgCmp.CalibrationPorts.SysGlbPrmMotPoleCnt.Val /end CHARACTERISTIC
/begin CHARACTERISTIC CDD_MotAgCmp.SysGlbPrmSysKineRat.Val "MICROSAR RTE" VALUE 0x0 RTE_RL_FLOAT32_IEEE 0 NO_COMPU_METHOD -3.402823466e+38 3.402823466e+38 SYMBOL_LINK "Rte_CalprmRom_CalRegn02Inin00_DEFAULT_RTE_CALPRM_GROUP.SysGlbPrmSysKineRat_Val" 0 DISPLAY_IDENTIFIER CDD_MotAgCmp.CalibrationPorts.SysGlbPrmSysKineRat.Val /end CHARACTERISTIC
/begin CHARACTERISTIC CDD_MotAgSwCal.MotAgSwCalVehSpdThd.Val "MICROSAR RTE" VALUE 0x0 RTE_RL_FLOAT32_IEEE 0 NO_COMPU_METHOD -3.402823466e+38 3.402823466e+38 SYMBOL_LINK "Rte_CalprmRom_CalRegn01Cmn_DEFAULT_RTE_CALPRM_GROUP.MotAgSwCalVehSpdThd_Val" 0 DISPLAY_IDENTIFIER CDD_MotAgSwCal.CalibrationPorts.MotAgSwCalVehSpdThd.Val /end CHARACTERISTIC
/begin CHARACTERISTIC CDD_MotCurrRegVltgLimr.MotCurrRegCfgCurrLoopSecOrderTrfFctEna.Logl "MICROSAR RTE" VALUE 0x0 RTE_RL_BOOLEAN 0 RTE_CM_BOOLEAN 0 255 SYMBOL_LINK "Rte_CalprmRom_CalRegn01Cmn_DEFAULT_RTE_CALPRM_GROUP.MotCurrRegCfgCurrLoopSecOrderTrfFctEna_Logl" 0 DISPLAY_IDENTIFIER CDD_MotCurrRegVltgLimr.CalibrationPorts.MotCurrRegCfgCurrLoopSecOrderTrfFctEna.Logl /end CHARACTERISTIC
/begin CHARACTERISTIC CDD_MotCurrRegVltgLimr.MotCurrRegCfgMotRVirtDax.Val "MICROSAR RTE" VALUE 0x0 RTE_RL_FLOAT32_IEEE 0 NO_COMPU_METHOD 0.0 0.2 SYMBOL_LINK "Rte_CalprmRom_CalRegn01Cmn_DEFAULT_RTE_CALPRM_GROUP.MotCurrRegCfgMotRVirtDax_Val" 0 DISPLAY_IDENTIFIER CDD_MotCurrRegVltgLimr.CalibrationPorts.MotCurrRegCfgMotRVirtDax.Val /end CHARACTERISTIC
/begin CHARACTERISTIC CDD_MotCurrRegVltgLimr.MotCurrRegCfgMotRVirtQax.Val "MICROSAR RTE" VALUE 0x0 RTE_RL_FLOAT32_IEEE 0 NO_COMPU_METHOD 0.0 0.2 SYMBOL_LINK "Rte_CalprmRom_CalRegn01Cmn_DEFAULT_RTE_CALPRM_GROUP.MotCurrRegCfgMotRVirtQax_Val" 0 DISPLAY_IDENTIFIER CDD_MotCurrRegVltgLimr.CalibrationPorts.MotCurrRegCfgMotRVirtQax.Val /end CHARACTERISTIC
/begin CHARACTERISTIC CDD_MotCurrRegVltgLimr.MotCurrRegVltgLimrCurrLoaScarSlewRate.Val "MICROSAR RTE" VALUE 0x0 RTE_RL_FLOAT32_IEEE 0 NO_COMPU_METHOD 0.0 1000.0 SYMBOL_LINK "Rte_CalprmRom_CalRegn01Cmn_DEFAULT_RTE_CALPRM_GROUP.MotCurrRegVltgLimrCurrLoaScarSlewRate_Val" 0 DISPLAY_IDENTIFIER CDD_MotCurrRegVltgLimr.CalibrationPorts.MotCurrRegVltgLimrCurrLoaScarSlewRate.Val /end CHARACTERISTIC
/begin CHARACTERISTIC CDD_MotCurrRegVltgLimr.MotCurrRegVltgLimrDaxAntiWdupCoeff.Val "MICROSAR RTE" VALUE 0x0 RTE_RL_FLOAT32_IEEE 0 NO_COMPU_METHOD -25 25 SYMBOL_LINK "Rte_CalprmRom_CalRegn01Cmn_DEFAULT_RTE_CALPRM_GROUP.MotCurrRegVltgLimrDaxAntiWdupCoeff_Val" 0 DISPLAY_IDENTIFIER CDD_MotCurrRegVltgLimr.CalibrationPorts.MotCurrRegVltgLimrDaxAntiWdupCoeff.Val /end CHARACTERISTIC
/begin CHARACTERISTIC CDD_MotCurrRegVltgLimr.MotCurrRegVltgLimrDualEcuLoaScarSlewRate.Val "MICROSAR RTE" VALUE 0x0 RTE_RL_FLOAT32_IEEE 0 NO_COMPU_METHOD -3.402823466e+38 3.402823466e+38 SYMBOL_LINK "Rte_CalprmRom_CalRegn01Cmn_DEFAULT_RTE_CALPRM_GROUP.MotCurrRegVltgLimrDualEcuLoaScarSlewRate_Val" 0 DISPLAY_IDENTIFIER CDD_MotCurrRegVltgLimr.CalibrationPorts.MotCurrRegVltgLimrDualEcuLoaScarSlewRate.Val /end CHARACTERISTIC
/begin CHARACTERISTIC CDD_MotCurrRegVltgLimr.MotCurrRegVltgLimrFETLoaScarSlewRate.Val "MICROSAR RTE" VALUE 0x0 RTE_RL_FLOAT32_IEEE 0 NO_COMPU_METHOD -3.402823466e+38 3.402823466e+38 SYMBOL_LINK "Rte_CalprmRom_CalRegn01Cmn_DEFAULT_RTE_CALPRM_GROUP.MotCurrRegVltgLimrFETLoaScarSlewRate_Val" 0 DISPLAY_IDENTIFIER CDD_MotCurrRegVltgLimr.CalibrationPorts.MotCurrRegVltgLimrFETLoaScarSlewRate.Val /end CHARACTERISTIC
/begin CHARACTERISTIC CDD_MotCurrRegVltgLimr.MotCurrRegVltgLimrIvtrLoaScarSlewRate.Val "MICROSAR RTE" VALUE 0x0 RTE_RL_FLOAT32_IEEE 0 NO_COMPU_METHOD 0.0 1000.0 SYMBOL_LINK "Rte_CalprmRom_CalRegn01Cmn_DEFAULT_RTE_CALPRM_GROUP.MotCurrRegVltgLimrIvtrLoaScarSlewRate_Val" 0 DISPLAY_IDENTIFIER CDD_MotCurrRegVltgLimr.CalibrationPorts.MotCurrRegVltgLimrIvtrLoaScarSlewRate.Val /end CHARACTERISTIC
/begin CHARACTERISTIC CDD_MotCurrRegVltgLimr.MotCurrRegVltgLimrMotCurrPredEna.Logl "MICROSAR RTE" VALUE 0x0 RTE_RL_BOOLEAN 0 RTE_CM_BOOLEAN 0 255 SYMBOL_LINK "Rte_CalprmRom_CalRegn01Cmn_DEFAULT_RTE_CALPRM_GROUP.MotCurrRegVltgLimrMotCurrPredEna_Logl" 0 DISPLAY_IDENTIFIER CDD_MotCurrRegVltgLimr.CalibrationPorts.MotCurrRegVltgLimrMotCurrPredEna.Logl /end CHARACTERISTIC
/begin CHARACTERISTIC CDD_MotCurrRegVltgLimr.MotCurrRegVltgLimrMotCurrPredTi.Val "MICROSAR RTE" VALUE 0x0 RTE_RL_FLOAT32_IEEE 0 NO_COMPU_METHOD -3.402823466e+38 3.402823466e+38 SYMBOL_LINK "Rte_CalprmRom_CalRegn01Cmn_DEFAULT_RTE_CALPRM_GROUP.MotCurrRegVltgLimrMotCurrPredTi_Val" 0 DISPLAY_IDENTIFIER CDD_MotCurrRegVltgLimr.CalibrationPorts.MotCurrRegVltgLimrMotCurrPredTi.Val /end CHARACTERISTIC
/begin CHARACTERISTIC CDD_MotCurrRegVltgLimr.MotCurrRegVltgLimrMotCurrQaxRefMdfnRplEna.Logl "MICROSAR RTE" VALUE 0x0 RTE_RL_BOOLEAN 0 RTE_CM_BOOLEAN 0 255 SYMBOL_LINK "Rte_CalprmRom_CalRegn01Cmn_DEFAULT_RTE_CALPRM_GROUP.MotCurrRegVltgLimrMotCurrQaxRefMdfnRplEna_Logl" 0 DISPLAY_IDENTIFIER CDD_MotCurrRegVltgLimr.CalibrationPorts.MotCurrRegVltgLimrMotCurrQaxRefMdfnRplEna.Logl /end CHARACTERISTIC
/begin CHARACTERISTIC CDD_MotCurrRegVltgLimr.MotCurrRegVltgLimrMotVltgBrdgFilEna.Logl "MICROSAR RTE" VALUE 0x0 RTE_RL_BOOLEAN 0 RTE_CM_BOOLEAN 0 255 SYMBOL_LINK "Rte_CalprmRom_CalRegn01Cmn_DEFAULT_RTE_CALPRM_GROUP.MotCurrRegVltgLimrMotVltgBrdgFilEna_Logl" 0 DISPLAY_IDENTIFIER CDD_MotCurrRegVltgLimr.CalibrationPorts.MotCurrRegVltgLimrMotVltgBrdgFilEna.Logl /end CHARACTERISTIC
/begin CHARACTERISTIC CDD_MotCurrRegVltgLimr.MotCurrRegVltgLimrMotVltgBrdgLpFilFrq.Val "MICROSAR RTE" VALUE 0x0 RTE_RL_FLOAT32_IEEE 0 NO_COMPU_METHOD -3.402823466e+38 3.402823466e+38 SYMBOL_LINK "Rte_CalprmRom_CalRegn01Cmn_DEFAULT_RTE_CALPRM_GROUP.MotCurrRegVltgLimrMotVltgBrdgLpFilFrq_Val" 0 DISPLAY_IDENTIFIER CDD_MotCurrRegVltgLimr.CalibrationPorts.MotCurrRegVltgLimrMotVltgBrdgLpFilFrq.Val /end CHARACTERISTIC
/begin CHARACTERISTIC CDD_MotCurrRegVltgLimr.MotCurrRegVltgLimrMotVltgDaxIntglHiLim.Val "MICROSAR RTE" VALUE 0x0 RTE_RL_FLOAT32_IEEE 0 NO_COMPU_METHOD -3.402823466e+38 3.402823466e+38 SYMBOL_LINK "Rte_CalprmRom_CalRegn01Cmn_DEFAULT_RTE_CALPRM_GROUP.MotCurrRegVltgLimrMotVltgDaxIntglHiLim_Val" 0 DISPLAY_IDENTIFIER CDD_MotCurrRegVltgLimr.CalibrationPorts.MotCurrRegVltgLimrMotVltgDaxIntglHiLim.Val /end CHARACTERISTIC
/begin MEASUREMENT CDD_MotAg5Meas.MotAg5EolPrm.CosAmpRecpr "MICROSAR RTE" UWORD NO_COMPU_METHOD 0 0 0 65535 ECU_ADDRESS 0 SYMBOL_LINK "Rte_CDD_MotAg5Meas_MotAg5EolPrm.CosAmpRecpr" 0 DISPLAY_IDENTIFIER CDD_MotAg5Meas.PerInstanceMemories.MotAg5EolPrm.CosAmpRecpr /end MEASUREMENT
/begin MEASUREMENT CDD_MotAg5Meas.MotAg5EolPrm.CosDeltaRecpr "MICROSAR RTE" UWORD NO_COMPU_METHOD 0 0 0 65535 ECU_ADDRESS 0 SYMBOL_LINK "Rte_CDD_MotAg5Meas_MotAg5EolPrm.CosDeltaRecpr" 0 DISPLAY_IDENTIFIER CDD_MotAg5Meas.PerInstanceMemories.MotAg5EolPrm.CosDeltaRecpr /end MEASUREMENT
/begin MEASUREMENT CDD_MotAg5Meas.MotAg5EolPrm.CosGainCorrd "MICROSAR RTE" UWORD NO_COMPU_METHOD 0 0 0 65535 ECU_ADDRESS 0 SYMBOL_LINK "Rte_CDD_MotAg5Meas_MotAg5EolPrm.CosGainCorrd" 0 DISPLAY_IDENTIFIER CDD_MotAg5Meas.PerInstanceMemories.MotAg5EolPrm.CosGainCorrd /end MEASUREMENT
/begin MEASUREMENT CDD_MotAg5Meas.MotAg5EolPrm.CosHrmncTbl "MICROSAR RTE" SBYTE NO_COMPU_METHOD 0 0 -128 127 MATRIX_DIM 144 1 1 ECU_ADDRESS 0 SYMBOL_LINK "Rte_CDD_MotAg5Meas_MotAg5EolPrm.CosHrmncTbl" 0 DISPLAY_IDENTIFIER CDD_MotAg5Meas.PerInstanceMemories.MotAg5EolPrm.CosHrmncTbl /end MEASUREMENT
/begin MEASUREMENT CDD_MotAg5Meas.MotAg5EolPrm.CosOffs "MICROSAR RTE" UWORD NO_COMPU_METHOD 0 0 0 65535 ECU_ADDRESS 0 SYMBOL_LINK "Rte_CDD_MotAg5Meas_MotAg5EolPrm.CosOffs" 0 DISPLAY_IDENTIFIER CDD_MotAg5Meas.PerInstanceMemories.MotAg5EolPrm.CosOffs /end MEASUREMENT
/begin MEASUREMENT CDD_MotAg5Meas.MotAg5EolPrm.CosOffsCorrd "MICROSAR RTE" SWORD NO_COMPU_METHOD 0 0 -32768 32767 ECU_ADDRESS 0 SYMBOL_LINK "Rte_CDD_MotAg5Meas_MotAg5EolPrm.CosOffsCorrd" 0 DISPLAY_IDENTIFIER CDD_MotAg5Meas.PerInstanceMemories.MotAg5EolPrm.CosOffsCorrd /end MEASUREMENT
/begin MEASUREMENT CDD_MotAg5Meas.MotAg5EolPrm.SinAmpRecpr "MICROSAR RTE" UWORD NO_COMPU_METHOD 0 0 0 65535 ECU_ADDRESS 0 SYMBOL_LINK "Rte_CDD_MotAg5Meas_MotAg5EolPrm.SinAmpRecpr" 0 DISPLAY_IDENTIFIER CDD_MotAg5Meas.PerInstanceMemories.MotAg5EolPrm.SinAmpRecpr /end MEASUREMENT
/begin MEASUREMENT CDD_MotAg5Meas.MotAg5EolPrm.SinDelta "MICROSAR RTE" SWORD NO_COMPU_METHOD 0 0 -32768 32767 ECU_ADDRESS 0 SYMBOL_LINK "Rte_CDD_MotAg5Meas_MotAg5EolPrm.SinDelta" 0 DISPLAY_IDENTIFIER CDD_MotAg5Meas.PerInstanceMemories.MotAg5EolPrm.SinDelta /end MEASUREMENT
/begin MEASUREMENT CDD_MotAg5Meas.MotAg5EolPrm.SinGainCorrd "MICROSAR RTE" UWORD NO_COMPU_METHOD 0 0 0 65535 ECU_ADDRESS 0 SYMBOL_LINK "Rte_CDD_MotAg5Meas_MotAg5EolPrm.SinGainCorrd" 0 DISPLAY_IDENTIFIER CDD_MotAg5Meas.PerInstanceMemories.MotAg5EolPrm.SinGainCorrd /end MEASUREMENT
/begin MEASUREMENT CDD_MotAg5Meas.MotAg5EolPrm.SinHrmncTbl "MICROSAR RTE" SBYTE NO_COMPU_METHOD 0 0 -128 127 MATRIX_DIM 144 1 1 ECU_ADDRESS 0 SYMBOL_LINK "Rte_CDD_MotAg5Meas_MotAg5EolPrm.SinHrmncTbl" 0 DISPLAY_IDENTIFIER CDD_MotAg5Meas.PerInstanceMemories.MotAg5EolPrm.SinHrmncTbl /end MEASUREMENT
/begin MEASUREMENT CDD_MotAg5Meas.MotAg5EolPrm.SinOffs "MICROSAR RTE" UWORD NO_COMPU_METHOD 0 0 0 65535 ECU_ADDRESS 0 SYMBOL_LINK "Rte_CDD_MotAg5Meas_MotAg5EolPrm.SinOffs" 0 DISPLAY_IDENTIFIER CDD_MotAg5Meas.PerInstanceMemories.MotAg5EolPrm.SinOffs /end MEASUREMENT
/begin MEASUREMENT CDD_MotAg5Meas.MotAg5EolPrm.SinOffsCorrd "MICROSAR RTE" SWORD NO_COMPU_METHOD 0 0 -32768 32767 ECU_ADDRESS 0 SYMBOL_LINK "Rte_CDD_MotAg5Meas_MotAg5EolPrm.SinOffsCorrd" 0 DISPLAY_IDENTIFIER CDD_MotAg5Meas.PerInstanceMemories.MotAg5EolPrm.SinOffsCorrd /end MEASUREMENT
/begin MEASUREMENT CDD_MotAg5Meas.MotAg5MeclQlfr.Val "MICROSAR RTE" UBYTE RTE_CM_ENUM_SigQlfr1 0 0 0 255 ECU_ADDRESS 0 SYMBOL_LINK "Rte_CDD_MotAg5Meas_MotAg5MeclQlfr_Val" 0 DISPLAY_IDENTIFIER CDD_MotAg5Meas.SenderPorts.MotAg5MeclQlfr.Val /end MEASUREMENT
/begin MEASUREMENT CDD_MotAg5Meas.MotAg5MeclRollgCntr.Val "MICROSAR RTE" UBYTE NO_COMPU_METHOD 0 0 0 255 ECU_ADDRESS 0 SYMBOL_LINK "Rte_CDD_MotAg5Meas_MotAg5MeclRollgCntr_Val" 0 DISPLAY_IDENTIFIER CDD_MotAg5Meas.SenderPorts.MotAg5MeclRollgCntr.Val /end MEASUREMENT
/begin MEASUREMENT CDD_MotAg5Meas.MotAg5NvmFltEna "MICROSAR RTE" UBYTE RTE_CM_BOOLEAN 0 0 0 255 ECU_ADDRESS 0 SYMBOL_LINK "Rte_CDD_MotAg5Meas_MotAg5NvmFltEna" 0 DISPLAY_IDENTIFIER CDD_MotAg5Meas.PerInstanceMemories.MotAg5NvmFltEna /end MEASUREMENT
/begin MEASUREMENT CDD_MotAg5Meas.MotAg5PrevRollgCntr "MICROSAR RTE" UBYTE NO_COMPU_METHOD 0 0 0 255 ECU_ADDRESS 0 SYMBOL_LINK "Rte_CDD_MotAg5Meas_MotAg5PrevRollgCntr" 0 DISPLAY_IDENTIFIER CDD_MotAg5Meas.PerInstanceMemories.MotAg5PrevRollgCntr /end MEASUREMENT
/begin MEASUREMENT CDD_MotAg5Meas.MotAg5RawMecl.Val "MICROSAR RTE" UWORD NO_COMPU_METHOD 0 0 0 65535 ECU_ADDRESS 0 SYMBOL_LINK "Rte_CDD_MotCtrlMgr_MotAg5RawMecl_Val" 0 DISPLAY_IDENTIFIER CDD_MotAg5Meas.ReceiverPorts.MotAg5RawMecl.Val /end MEASUREMENT
/begin MEASUREMENT CDD_MotAg5Meas.MotAg5RtPrm.CosGainCorrd "MICROSAR RTE" FLOAT32_IEEE NO_COMPU_METHOD 0 0 -3.402823466e+38 3.402823466e+38 ECU_ADDRESS 0 SYMBOL_LINK "Rte_CDD_MotAg5Meas_MotAg5RtPrm.CosGainCorrd" 0 DISPLAY_IDENTIFIER CDD_MotAg5Meas.PerInstanceMemories.MotAg5RtPrm.CosGainCorrd /end MEASUREMENT
/begin MEASUREMENT CDD_MotAg5Meas.MotAg5RtPrm.CosOffsCorrd "MICROSAR RTE" FLOAT32_IEEE NO_COMPU_METHOD 0 0 -3.402823466e+38 3.402823466e+38 ECU_ADDRESS 0 SYMBOL_LINK "Rte_CDD_MotAg5Meas_MotAg5RtPrm.CosOffsCorrd" 0 DISPLAY_IDENTIFIER CDD_MotAg5Meas.PerInstanceMemories.MotAg5RtPrm.CosOffsCorrd /end MEASUREMENT
/begin MEASUREMENT CDD_MotAg5Meas.MotAg5RtPrm.CosRtAmpRecpr "MICROSAR RTE" FLOAT32_IEEE NO_COMPU_METHOD 0 0 -3.402823466e+38 3.402823466e+38 ECU_ADDRESS 0 SYMBOL_LINK "Rte_CDD_MotAg5Meas_MotAg5RtPrm.CosRtAmpRecpr" 0 DISPLAY_IDENTIFIER CDD_MotAg5Meas.PerInstanceMemories.MotAg5RtPrm.CosRtAmpRecpr /end MEASUREMENT
/begin MEASUREMENT CDD_MotAg5Meas.MotAg5RtPrm.CosRtOffs "MICROSAR RTE" FLOAT32_IEEE NO_COMPU_METHOD 0 0 -3.402823466e+38 3.402823466e+38 ECU_ADDRESS 0 SYMBOL_LINK "Rte_CDD_MotAg5Meas_MotAg5RtPrm.CosRtOffs" 0 DISPLAY_IDENTIFIER CDD_MotAg5Meas.PerInstanceMemories.MotAg5RtPrm.CosRtOffs /end MEASUREMENT
/begin MEASUREMENT CDD_MotAg5Meas.MotAg5RtPrm.CosSinNomRatio "MICROSAR RTE" FLOAT32_IEEE NO_COMPU_METHOD 0 0 -3.402823466e+38 3.402823466e+38 ECU_ADDRESS 0 SYMBOL_LINK "Rte_CDD_MotAg5Meas_MotAg5RtPrm.CosSinNomRatio" 0 DISPLAY_IDENTIFIER CDD_MotAg5Meas.PerInstanceMemories.MotAg5RtPrm.CosSinNomRatio /end MEASUREMENT
/begin MEASUREMENT CDD_MotAg5Meas.MotAg5RtPrm.PrevCosRtOffs "MICROSAR RTE" FLOAT32_IEEE NO_COMPU_METHOD 0 0 -3.402823466e+38 3.402823466e+38 ECU_ADDRESS 0 SYMBOL_LINK "Rte_CDD_MotAg5Meas_MotAg5RtPrm.PrevCosRtOffs" 0 DISPLAY_IDENTIFIER CDD_MotAg5Meas.PerInstanceMemories.MotAg5RtPrm.PrevCosRtOffs /end MEASUREMENT
/begin MEASUREMENT CDD_MotAg5Meas.MotAg5RtPrm.PrevSinRtOffs "MICROSAR RTE" FLOAT32_IEEE NO_COMPU_METHOD 0 0 -3.402823466e+38 3.402823466e+38 ECU_ADDRESS 0 SYMBOL_LINK "Rte_CDD_MotAg5Meas_MotAg5RtPrm.PrevSinRtOffs" 0 DISPLAY_IDENTIFIER CDD_MotAg5Meas.PerInstanceMemories.MotAg5RtPrm.PrevSinRtOffs /end MEASUREMENT
/begin MEASUREMENT CDD_MotAg5Meas.MotAg5RtPrm.RtToNomRatioHiLim "MICROSAR RTE" FLOAT32_IEEE NO_COMPU_METHOD 0 0 -3.402823466e+38 3.402823466e+38 ECU_ADDRESS 0 SYMBOL_LINK "Rte_CDD_MotAg5Meas_MotAg5RtPrm.RtToNomRatioHiLim" 0 DISPLAY_IDENTIFIER CDD_MotAg5Meas.PerInstanceMemories.MotAg5RtPrm.RtToNomRatioHiLim /end MEASUREMENT
/begin MEASUREMENT CDD_MotAg5Meas.MotAg5RtPrm.RtToNomRatioLoLim "MICROSAR RTE" FLOAT32_IEEE NO_COMPU_METHOD 0 0 -3.402823466e+38 3.402823466e+38 ECU_ADDRESS 0 SYMBOL_LINK "Rte_CDD_MotAg5Meas_MotAg5RtPrm.RtToNomRatioLoLim" 0 DISPLAY_IDENTIFIER CDD_MotAg5Meas.PerInstanceMemories.MotAg5RtPrm.RtToNomRatioLoLim /end MEASUREMENT
/begin MEASUREMENT CDD_MotAg5Meas.MotAg5RtPrm.SinCosNomRatio "MICROSAR RTE" FLOAT32_IEEE NO_COMPU_METHOD 0 0 -3.402823466e+38 3.402823466e+38 ECU_ADDRESS 0 SYMBOL_LINK "Rte_CDD_MotAg5Meas_MotAg5RtPrm.SinCosNomRatio" 0 DISPLAY_IDENTIFIER CDD_MotAg5Meas.PerInstanceMemories.MotAg5RtPrm.SinCosNomRatio /end MEASUREMENT
/begin MEASUREMENT CDD_MotAg5Meas.MotAg5RtPrm.SinGainCorrd "MICROSAR RTE" FLOAT32_IEEE NO_COMPU_METHOD 0 0 -3.402823466e+38 3.402823466e+38 ECU_ADDRESS 0 SYMBOL_LINK "Rte_CDD_MotAg5Meas_MotAg5RtPrm.SinGainCorrd" 0 DISPLAY_IDENTIFIER CDD_MotAg5Meas.PerInstanceMemories.MotAg5RtPrm.SinGainCorrd /end MEASUREMENT
/begin MEASUREMENT CDD_MotAg5Meas.MotAg5RtPrm.SinOffsCorrd "MICROSAR RTE" FLOAT32_IEEE NO_COMPU_METHOD 0 0 -3.402823466e+38 3.402823466e+38 ECU_ADDRESS 0 SYMBOL_LINK "Rte_CDD_MotAg5Meas_MotAg5RtPrm.SinOffsCorrd" 0 DISPLAY_IDENTIFIER CDD_MotAg5Meas.PerInstanceMemories.MotAg5RtPrm.SinOffsCorrd /end MEASUREMENT
/begin MEASUREMENT CDD_MotAg5Meas.MotAg5RtPrm.SinRtAmpRecpr "MICROSAR RTE" FLOAT32_IEEE NO_COMPU_METHOD 0 0 -3.402823466e+38 3.402823466e+38 ECU_ADDRESS 0 SYMBOL_LINK "Rte_CDD_MotAg5Meas_MotAg5RtPrm.SinRtAmpRecpr" 0 DISPLAY_IDENTIFIER CDD_MotAg5Meas.PerInstanceMemories.MotAg5RtPrm.SinRtAmpRecpr /end MEASUREMENT
/begin MEASUREMENT CDD_MotAg5Meas.MotAg5RtPrm.SinRtOffs "MICROSAR RTE" FLOAT32_IEEE NO_COMPU_METHOD 0 0 -3.402823466e+38 3.402823466e+38 ECU_ADDRESS 0 SYMBOL_LINK "Rte_CDD_MotAg5Meas_MotAg5RtPrm.SinRtOffs" 0 DISPLAY_IDENTIFIER CDD_MotAg5Meas.PerInstanceMemories.MotAg5RtPrm.SinRtOffs /end MEASUREMENT
/begin MEASUREMENT CDD_MotAg5Meas.MotAg5Sin.Val "MICROSAR RTE" FLOAT32_IEEE NO_COMPU_METHOD 0 0 -3.402823466e+38 3.402823466e+38 ECU_ADDRESS 0 SYMBOL_LINK "Rte_CDD_MotCtrlMgr_MotAg5Sin_Val" 0 DISPLAY_IDENTIFIER CDD_MotAg5Meas.ReceiverPorts.MotAg5Sin.Val /end MEASUREMENT
/begin MEASUREMENT CDD_MotAg5Meas.MotAg5SinAdcFaild.Logl "MICROSAR RTE" UBYTE RTE_CM_BOOLEAN 0 0 0 255 ECU_ADDRESS 0 SYMBOL_LINK "Rte_CDD_FordT3T6McuCfg_MotAg5SinAdcFaild_Logl" 0 DISPLAY_IDENTIFIER CDD_MotAg5Meas.ReceiverPorts.MotAg5SinAdcFaild.Logl /end MEASUREMENT
/begin MEASUREMENT CDD_MotAg5Meas.MotAg5SinMaxLpFil.FilGain "MICROSAR RTE" FLOAT32_IEEE NO_COMPU_METHOD 0 0 -3.402823466e+38 3.402823466e+38 ECU_ADDRESS 0 SYMBOL_LINK "Rte_CDD_MotAg5Meas_MotAg5SinMaxLpFil.FilGain" 0 DISPLAY_IDENTIFIER CDD_MotAg5Meas.PerInstanceMemories.MotAg5SinMaxLpFil.FilGain /end MEASUREMENT
/begin MEASUREMENT CDD_MotAg5Meas.MotAg5SinMaxLpFil.FilSt "MICROSAR RTE" FLOAT32_IEEE NO_COMPU_METHOD 0 0 -3.402823466e+38 3.402823466e+38 ECU_ADDRESS 0 SYMBOL_LINK "Rte_CDD_MotAg5Meas_MotAg5SinMaxLpFil.FilSt" 0 DISPLAY_IDENTIFIER CDD_MotAg5Meas.PerInstanceMemories.MotAg5SinMaxLpFil.FilSt /end MEASUREMENT
/begin MEASUREMENT CDD_MotAg5Meas.MotAg5SinMinLpFil.FilGain "MICROSAR RTE" FLOAT32_IEEE NO_COMPU_METHOD 0 0 -3.402823466e+38 3.402823466e+38 ECU_ADDRESS 0 SYMBOL_LINK "Rte_CDD_MotAg5Meas_MotAg5SinMinLpFil.FilGain" 0 DISPLAY_IDENTIFIER CDD_MotAg5Meas.PerInstanceMemories.MotAg5SinMinLpFil.FilGain /end MEASUREMENT
/begin MEASUREMENT CDD_MotAg5Meas.MotAg5SinMinLpFil.FilSt "MICROSAR RTE" FLOAT32_IEEE NO_COMPU_METHOD 0 0 -3.402823466e+38 3.402823466e+38 ECU_ADDRESS 0 SYMBOL_LINK "Rte_CDD_MotAg5Meas_MotAg5SinMinLpFil.FilSt" 0 DISPLAY_IDENTIFIER CDD_MotAg5Meas.PerInstanceMemories.MotAg5SinMinLpFil.FilSt /end MEASUREMENT
/begin MEASUREMENT CDD_MotAg5Meas.MotAg5SinRtAmpRecpr.Val "MICROSAR RTE" FLOAT32_IEEE NO_COMPU_METHOD 0 0 -3.402823466e+38 3.402823466e+38 ECU_ADDRESS 0 SYMBOL_LINK "Rte_CDD_MotAg5Meas_MotAg5SinRtAmpRecpr_Val" 0 DISPLAY_IDENTIFIER CDD_MotAg5Meas.SenderPorts.MotAg5SinRtAmpRecpr.Val /end MEASUREMENT
/begin MEASUREMENT CDD_MotAg5Meas.MotAg5SinRtOffs.Val "MICROSAR RTE" FLOAT32_IEEE NO_COMPU_METHOD 0 0 -3.402823466e+38 3.402823466e+38 ECU_ADDRESS 0 SYMBOL_LINK "Rte_CDD_MotAg5Meas_MotAg5SinRtOffs_Val" 0 DISPLAY_IDENTIFIER CDD_MotAg5Meas.SenderPorts.MotAg5SinRtOffs.Val /end MEASUREMENT
/begin MEASUREMENT CDD_MotAg5Meas.MotAg5StVari.MotAgCosMax "MICROSAR RTE" FLOAT32_IEEE NO_COMPU_METHOD 0 0 -3.402823466e+38 3.402823466e+38 ECU_ADDRESS 0 SYMBOL_LINK "Rte_CDD_MotAg5Meas_MotAg5StVari.MotAgCosMax" 0 DISPLAY_IDENTIFIER CDD_MotAg5Meas.PerInstanceMemories.MotAg5StVari.MotAgCosMax /end MEASUREMENT
/begin MEASUREMENT CDD_MotAg5Meas.MotAg5StVari.MotAgCosMin "MICROSAR RTE" FLOAT32_IEEE NO_COMPU_METHOD 0 0 -3.402823466e+38 3.402823466e+38 ECU_ADDRESS 0 SYMBOL_LINK "Rte_CDD_MotAg5Meas_MotAg5StVari.MotAgCosMin" 0 DISPLAY_IDENTIFIER CDD_MotAg5Meas.PerInstanceMemories.MotAg5StVari.MotAgCosMin /end MEASUREMENT
/begin MEASUREMENT CDD_MotAg5Meas.MotAg5StVari.MotAgSinMax "MICROSAR RTE" FLOAT32_IEEE NO_COMPU_METHOD 0 0 -3.402823466e+38 3.402823466e+38 ECU_ADDRESS 0 SYMBOL_LINK "Rte_CDD_MotAg5Meas_MotAg5StVari.MotAgSinMax" 0 DISPLAY_IDENTIFIER CDD_MotAg5Meas.PerInstanceMemories.MotAg5StVari.MotAgSinMax /end MEASUREMENT
/begin MEASUREMENT CDD_MotAg5Meas.MotAg5StVari.MotAgSinMin "MICROSAR RTE" FLOAT32_IEEE NO_COMPU_METHOD 0 0 -3.402823466e+38 3.402823466e+38 ECU_ADDRESS 0 SYMBOL_LINK "Rte_CDD_MotAg5Meas_MotAg5StVari.MotAgSinMin" 0 DISPLAY_IDENTIFIER CDD_MotAg5Meas.PerInstanceMemories.MotAg5StVari.MotAgSinMin /end MEASUREMENT
/begin MEASUREMENT CDD_MotAg5Meas.MotVelMrf.Val "MICROSAR RTE" FLOAT32_IEEE NO_COMPU_METHOD 0 0 -3.402823466e+38 3.402823466e+38 ECU_ADDRESS 0 SYMBOL_LINK "Rte_CDD_MotVel_MotVelMrf_Val" 0 DISPLAY_IDENTIFIER CDD_MotAg5Meas.ReceiverPorts.MotVelMrf.Val /end MEASUREMENT
/begin MEASUREMENT CDD_MotAg5Meas.PrevMotAg5Mecl "MICROSAR RTE" UWORD NO_COMPU_METHOD 0 0 0 65535 ECU_ADDRESS 0 SYMBOL_LINK "Rte_CDD_MotAg5Meas_PrevMotAg5Mecl" 0 DISPLAY_IDENTIFIER CDD_MotAg5Meas.PerInstanceMemories.PrevMotAg5Mecl /end MEASUREMENT
/begin MEASUREMENT CDD_MotAg5Meas.dMotAg5MeasAmpVal "MICROSAR RTE" FLOAT32_IEEE NO_COMPU_METHOD 0 0 -3.402823466e+38 3.402823466e+38 ECU_ADDRESS 0 SYMBOL_LINK "Rte_CDD_MotAg5Meas_dMotAg5MeasAmpVal" 0 DISPLAY_IDENTIFIER CDD_MotAg5Meas.PerInstanceMemories.dMotAg5MeasAmpVal /end MEASUREMENT
/begin MEASUREMENT CDD_MotAg6Meas.MotAg6Cos.Val "MICROSAR RTE" FLOAT32_IEEE NO_COMPU_METHOD 0 0 -3.402823466e+38 3.402823466e+38 ECU_ADDRESS 0 SYMBOL_LINK "Rte_CDD_MotCtrlMgr_MotAg6Cos_Val" 0 DISPLAY_IDENTIFIER CDD_MotAg6Meas.ReceiverPorts.MotAg6Cos.Val /end MEASUREMENT
/begin MEASUREMENT CDD_MotAg6Meas.MotAg6CosAdcFaild.Logl "MICROSAR RTE" UBYTE RTE_CM_BOOLEAN 0 0 0 255 ECU_ADDRESS 0 SYMBOL_LINK "Rte_CDD_FordT3T6McuCfg_MotAg6CosAdcFaild_Logl" 0 DISPLAY_IDENTIFIER CDD_MotAg6Meas.ReceiverPorts.MotAg6CosAdcFaild.Logl /end MEASUREMENT
/begin MEASUREMENT CDD_MotAg6Meas.MotAg6CosMaxLpFil.FilGain "MICROSAR RTE" FLOAT32_IEEE NO_COMPU_METHOD 0 0 -3.402823466e+38 3.402823466e+38 ECU_ADDRESS 0 SYMBOL_LINK "Rte_CDD_MotAg6Meas_MotAg6CosMaxLpFil.FilGain" 0 DISPLAY_IDENTIFIER CDD_MotAg6Meas.PerInstanceMemories.MotAg6CosMaxLpFil.FilGain /end MEASUREMENT
/begin MEASUREMENT CDD_MotAg6Meas.MotAg6CosMaxLpFil.FilSt "MICROSAR RTE" FLOAT32_IEEE NO_COMPU_METHOD 0 0 -3.402823466e+38 3.402823466e+38 ECU_ADDRESS 0 SYMBOL_LINK "Rte_CDD_MotAg6Meas_MotAg6CosMaxLpFil.FilSt" 0 DISPLAY_IDENTIFIER CDD_MotAg6Meas.PerInstanceMemories.MotAg6CosMaxLpFil.FilSt /end MEASUREMENT
/begin MEASUREMENT CDD_MotAg6Meas.MotAg6CosMinLpFil.FilGain "MICROSAR RTE" FLOAT32_IEEE NO_COMPU_METHOD 0 0 -3.402823466e+38 3.402823466e+38 ECU_ADDRESS 0 SYMBOL_LINK "Rte_CDD_MotAg6Meas_MotAg6CosMinLpFil.FilGain" 0 DISPLAY_IDENTIFIER CDD_MotAg6Meas.PerInstanceMemories.MotAg6CosMinLpFil.FilGain /end MEASUREMENT
/begin MEASUREMENT CDD_MotAg6Meas.MotAg6CosMinLpFil.FilSt "MICROSAR RTE" FLOAT32_IEEE NO_COMPU_METHOD 0 0 -3.402823466e+38 3.402823466e+38 ECU_ADDRESS 0 SYMBOL_LINK "Rte_CDD_MotAg6Meas_MotAg6CosMinLpFil.FilSt" 0 DISPLAY_IDENTIFIER CDD_MotAg6Meas.PerInstanceMemories.MotAg6CosMinLpFil.FilSt /end MEASUREMENT
/begin MEASUREMENT CDD_MotAg6Meas.MotAg6CosRtAmpRecpr.Val "MICROSAR RTE" FLOAT32_IEEE NO_COMPU_METHOD 0 0 -3.402823466e+38 3.402823466e+38 ECU_ADDRESS 0 SYMBOL_LINK "Rte_CDD_MotAg6Meas_MotAg6CosRtAmpRecpr_Val" 0 DISPLAY_IDENTIFIER CDD_MotAg6Meas.SenderPorts.MotAg6CosRtAmpRecpr.Val /end MEASUREMENT
/begin MEASUREMENT CDD_MotAg6Meas.MotAg6CosRtOffs.Val "MICROSAR RTE" FLOAT32_IEEE NO_COMPU_METHOD 0 0 -3.402823466e+38 3.402823466e+38 ECU_ADDRESS 0 SYMBOL_LINK "Rte_CDD_MotAg6Meas_MotAg6CosRtOffs_Val" 0 DISPLAY_IDENTIFIER CDD_MotAg6Meas.SenderPorts.MotAg6CosRtOffs.Val /end MEASUREMENT
/begin MEASUREMENT CDD_MotAg6Meas.MotAg6EolPrm.CosAmpRecpr "MICROSAR RTE" UWORD NO_COMPU_METHOD 0 0 0 65535 ECU_ADDRESS 0 SYMBOL_LINK "Rte_CDD_MotAg6Meas_MotAg6EolPrm.CosAmpRecpr" 0 DISPLAY_IDENTIFIER CDD_MotAg6Meas.PerInstanceMemories.MotAg6EolPrm.CosAmpRecpr /end MEASUREMENT
/begin MEASUREMENT CDD_MotAg6Meas.MotAg6EolPrm.CosDeltaRecpr "MICROSAR RTE" UWORD NO_COMPU_METHOD 0 0 0 65535 ECU_ADDRESS 0 SYMBOL_LINK "Rte_CDD_MotAg6Meas_MotAg6EolPrm.CosDeltaRecpr" 0 DISPLAY_IDENTIFIER CDD_MotAg6Meas.PerInstanceMemories.MotAg6EolPrm.CosDeltaRecpr /end MEASUREMENT
/begin MEASUREMENT CDD_MotAg6Meas.MotAg6EolPrm.CosGainCorrd "MICROSAR RTE" UWORD NO_COMPU_METHOD 0 0 0 65535 ECU_ADDRESS 0 SYMBOL_LINK "Rte_CDD_MotAg6Meas_MotAg6EolPrm.CosGainCorrd" 0 DISPLAY_IDENTIFIER CDD_MotAg6Meas.PerInstanceMemories.MotAg6EolPrm.CosGainCorrd /end MEASUREMENT
/begin MEASUREMENT CDD_MotAg6Meas.MotAg6EolPrm.CosHrmncTbl "MICROSAR RTE" SBYTE NO_COMPU_METHOD 0 0 -128 127 MATRIX_DIM 144 1 1 ECU_ADDRESS 0 SYMBOL_LINK "Rte_CDD_MotAg6Meas_MotAg6EolPrm.CosHrmncTbl" 0 DISPLAY_IDENTIFIER CDD_MotAg6Meas.PerInstanceMemories.MotAg6EolPrm.CosHrmncTbl /end MEASUREMENT
/begin MEASUREMENT CDD_MotAg6Meas.MotAg6EolPrm.CosOffs "MICROSAR RTE" UWORD NO_COMPU_METHOD 0 0 0 65535 ECU_ADDRESS 0 SYMBOL_LINK "Rte_CDD_MotAg6Meas_MotAg6EolPrm.CosOffs" 0 DISPLAY_IDENTIFIER CDD_MotAg6Meas.PerInstanceMemories.MotAg6EolPrm.CosOffs /end MEASUREMENT
/begin MEASUREMENT CDD_MotAg6Meas.MotAg6EolPrm.CosOffsCorrd "MICROSAR RTE" SWORD NO_COMPU_METHOD 0 0 -32768 32767 ECU_ADDRESS 0 SYMBOL_LINK "Rte_CDD_MotAg6Meas_MotAg6EolPrm.CosOffsCorrd" 0 DISPLAY_IDENTIFIER CDD_MotAg6Meas.PerInstanceMemories.MotAg6EolPrm.CosOffsCorrd /end MEASUREMENT
/begin MEASUREMENT CDD_MotAg6Meas.MotAg6EolPrm.SinAmpRecpr "MICROSAR RTE" UWORD NO_COMPU_METHOD 0 0 0 65535 ECU_ADDRESS 0 SYMBOL_LINK "Rte_CDD_MotAg6Meas_MotAg6EolPrm.SinAmpRecpr" 0 DISPLAY_IDENTIFIER CDD_MotAg6Meas.PerInstanceMemories.MotAg6EolPrm.SinAmpRecpr /end MEASUREMENT
/begin MEASUREMENT CDD_MotAg6Meas.MotAg6EolPrm.SinDelta "MICROSAR RTE" SWORD NO_COMPU_METHOD 0 0 -32768 32767 ECU_ADDRESS 0 SYMBOL_LINK "Rte_CDD_MotAg6Meas_MotAg6EolPrm.SinDelta" 0 DISPLAY_IDENTIFIER CDD_MotAg6Meas.PerInstanceMemories.MotAg6EolPrm.SinDelta /end MEASUREMENT
/begin MEASUREMENT CDD_MotAg6Meas.MotAg6EolPrm.SinGainCorrd "MICROSAR RTE" UWORD NO_COMPU_METHOD 0 0 0 65535 ECU_ADDRESS 0 SYMBOL_LINK "Rte_CDD_MotAg6Meas_MotAg6EolPrm.SinGainCorrd" 0 DISPLAY_IDENTIFIER CDD_MotAg6Meas.PerInstanceMemories.MotAg6EolPrm.SinGainCorrd /end MEASUREMENT
/begin MEASUREMENT CDD_MotAg6Meas.MotAg6EolPrm.SinHrmncTbl "MICROSAR RTE" SBYTE NO_COMPU_METHOD 0 0 -128 127 MATRIX_DIM 144 1 1 ECU_ADDRESS 0 SYMBOL_LINK "Rte_CDD_MotAg6Meas_MotAg6EolPrm.SinHrmncTbl" 0 DISPLAY_IDENTIFIER CDD_MotAg6Meas.PerInstanceMemories.MotAg6EolPrm.SinHrmncTbl /end MEASUREMENT
/begin MEASUREMENT CDD_MotAg6Meas.MotAg6EolPrm.SinOffs "MICROSAR RTE" UWORD NO_COMPU_METHOD 0 0 0 65535 ECU_ADDRESS 0 SYMBOL_LINK "Rte_CDD_MotAg6Meas_MotAg6EolPrm.SinOffs" 0 DISPLAY_IDENTIFIER CDD_MotAg6Meas.PerInstanceMemories.MotAg6EolPrm.SinOffs /end MEASUREMENT
/begin MEASUREMENT CDD_MotAg6Meas.MotAg6EolPrm.SinOffsCorrd "MICROSAR RTE" SWORD NO_COMPU_METHOD 0 0 -32768 32767 ECU_ADDRESS 0 SYMBOL_LINK "Rte_CDD_MotAg6Meas_MotAg6EolPrm.SinOffsCorrd" 0 DISPLAY_IDENTIFIER CDD_MotAg6Meas.PerInstanceMemories.MotAg6EolPrm.SinOffsCorrd /end MEASUREMENT
/begin MEASUREMENT CDD_MotAg6Meas.MotAg6MeclQlfr.Val "MICROSAR RTE" UBYTE RTE_CM_ENUM_SigQlfr1 0 0 0 255 ECU_ADDRESS 0 SYMBOL_LINK "Rte_CDD_MotAg6Meas_MotAg6MeclQlfr_Val" 0 DISPLAY_IDENTIFIER CDD_MotAg6Meas.SenderPorts.MotAg6MeclQlfr.Val /end MEASUREMENT
/begin MEASUREMENT CDD_MotAg6Meas.MotAg6MeclRollgCntr.Val "MICROSAR RTE" UBYTE NO_COMPU_METHOD 0 0 0 255 ECU_ADDRESS 0 SYMBOL_LINK "Rte_CDD_MotAg6Meas_MotAg6MeclRollgCntr_Val" 0 DISPLAY_IDENTIFIER CDD_MotAg6Meas.SenderPorts.MotAg6MeclRollgCntr.Val /end MEASUREMENT
/begin MEASUREMENT CDD_MotAg6Meas.MotAg6NvmFltEna "MICROSAR RTE" UBYTE RTE_CM_BOOLEAN 0 0 0 255 ECU_ADDRESS 0 SYMBOL_LINK "Rte_CDD_MotAg6Meas_MotAg6NvmFltEna" 0 DISPLAY_IDENTIFIER CDD_MotAg6Meas.PerInstanceMemories.MotAg6NvmFltEna /end MEASUREMENT
/begin MEASUREMENT CDD_MotAg6Meas.MotAg6PrevRollgCntr "MICROSAR RTE" UBYTE NO_COMPU_METHOD 0 0 0 255 ECU_ADDRESS 0 SYMBOL_LINK "Rte_CDD_MotAg6Meas_MotAg6PrevRollgCntr" 0 DISPLAY_IDENTIFIER CDD_MotAg6Meas.PerInstanceMemories.MotAg6PrevRollgCntr /end MEASUREMENT
/begin MEASUREMENT CDD_MotAg6Meas.MotAg6RawMecl.Val "MICROSAR RTE" UWORD NO_COMPU_METHOD 0 0 0 65535 ECU_ADDRESS 0 SYMBOL_LINK "Rte_CDD_MotCtrlMgr_MotAg6RawMecl_Val" 0 DISPLAY_IDENTIFIER CDD_MotAg6Meas.ReceiverPorts.MotAg6RawMecl.Val /end MEASUREMENT
/begin MEASUREMENT CDD_MotAg6Meas.MotAg6RtPrm.CosGainCorrd "MICROSAR RTE" FLOAT32_IEEE NO_COMPU_METHOD 0 0 -3.402823466e+38 3.402823466e+38 ECU_ADDRESS 0 SYMBOL_LINK "Rte_CDD_MotAg6Meas_MotAg6RtPrm.CosGainCorrd" 0 DISPLAY_IDENTIFIER CDD_MotAg6Meas.PerInstanceMemories.MotAg6RtPrm.CosGainCorrd /end MEASUREMENT
/begin MEASUREMENT CDD_MotAg6Meas.MotAg6RtPrm.CosOffsCorrd "MICROSAR RTE" FLOAT32_IEEE NO_COMPU_METHOD 0 0 -3.402823466e+38 3.402823466e+38 ECU_ADDRESS 0 SYMBOL_LINK "Rte_CDD_MotAg6Meas_MotAg6RtPrm.CosOffsCorrd" 0 DISPLAY_IDENTIFIER CDD_MotAg6Meas.PerInstanceMemories.MotAg6RtPrm.CosOffsCorrd /end MEASUREMENT
/begin MEASUREMENT CDD_MotAg6Meas.MotAg6RtPrm.CosRtAmpRecpr "MICROSAR RTE" FLOAT32_IEEE NO_COMPU_METHOD 0 0 -3.402823466e+38 3.402823466e+38 ECU_ADDRESS 0 SYMBOL_LINK "Rte_CDD_MotAg6Meas_MotAg6RtPrm.CosRtAmpRecpr" 0 DISPLAY_IDENTIFIER CDD_MotAg6Meas.PerInstanceMemories.MotAg6RtPrm.CosRtAmpRecpr /end MEASUREMENT
/begin MEASUREMENT CDD_MotAg6Meas.MotAg6RtPrm.CosRtOffs "MICROSAR RTE" FLOAT32_IEEE NO_COMPU_METHOD 0 0 -3.402823466e+38 3.402823466e+38 ECU_ADDRESS 0 SYMBOL_LINK "Rte_CDD_MotAg6Meas_MotAg6RtPrm.CosRtOffs" 0 DISPLAY_IDENTIFIER CDD_MotAg6Meas.PerInstanceMemories.MotAg6RtPrm.CosRtOffs /end MEASUREMENT
/begin MEASUREMENT CDD_MotAg6Meas.MotAg6RtPrm.CosSinNomRatio "MICROSAR RTE" FLOAT32_IEEE NO_COMPU_METHOD 0 0 -3.402823466e+38 3.402823466e+38 ECU_ADDRESS 0 SYMBOL_LINK "Rte_CDD_MotAg6Meas_MotAg6RtPrm.CosSinNomRatio" 0 DISPLAY_IDENTIFIER CDD_MotAg6Meas.PerInstanceMemories.MotAg6RtPrm.CosSinNomRatio /end MEASUREMENT
/begin MEASUREMENT CDD_MotAg6Meas.MotAg6RtPrm.PrevCosRtOffs "MICROSAR RTE" FLOAT32_IEEE NO_COMPU_METHOD 0 0 -3.402823466e+38 3.402823466e+38 ECU_ADDRESS 0 SYMBOL_LINK "Rte_CDD_MotAg6Meas_MotAg6RtPrm.PrevCosRtOffs" 0 DISPLAY_IDENTIFIER CDD_MotAg6Meas.PerInstanceMemories.MotAg6RtPrm.PrevCosRtOffs /end MEASUREMENT
/begin MEASUREMENT CDD_MotAg6Meas.MotAg6RtPrm.PrevSinRtOffs "MICROSAR RTE" FLOAT32_IEEE NO_COMPU_METHOD 0 0 -3.402823466e+38 3.402823466e+38 ECU_ADDRESS 0 SYMBOL_LINK "Rte_CDD_MotAg6Meas_MotAg6RtPrm.PrevSinRtOffs" 0 DISPLAY_IDENTIFIER CDD_MotAg6Meas.PerInstanceMemories.MotAg6RtPrm.PrevSinRtOffs /end MEASUREMENT
/begin MEASUREMENT CDD_MotAg6Meas.MotAg6RtPrm.RtToNomRatioHiLim "MICROSAR RTE" FLOAT32_IEEE NO_COMPU_METHOD 0 0 -3.402823466e+38 3.402823466e+38 ECU_ADDRESS 0 SYMBOL_LINK "Rte_CDD_MotAg6Meas_MotAg6RtPrm.RtToNomRatioHiLim" 0 DISPLAY_IDENTIFIER CDD_MotAg6Meas.PerInstanceMemories.MotAg6RtPrm.RtToNomRatioHiLim /end MEASUREMENT
/begin MEASUREMENT CDD_MotAg6Meas.MotAg6RtPrm.RtToNomRatioLoLim "MICROSAR RTE" FLOAT32_IEEE NO_COMPU_METHOD 0 0 -3.402823466e+38 3.402823466e+38 ECU_ADDRESS 0 SYMBOL_LINK "Rte_CDD_MotAg6Meas_MotAg6RtPrm.RtToNomRatioLoLim" 0 DISPLAY_IDENTIFIER CDD_MotAg6Meas.PerInstanceMemories.MotAg6RtPrm.RtToNomRatioLoLim /end MEASUREMENT
/begin MEASUREMENT CDD_MotAg6Meas.MotAg6RtPrm.SinCosNomRatio "MICROSAR RTE" FLOAT32_IEEE NO_COMPU_METHOD 0 0 -3.402823466e+38 3.402823466e+38 ECU_ADDRESS 0 SYMBOL_LINK "Rte_CDD_MotAg6Meas_MotAg6RtPrm.SinCosNomRatio" 0 DISPLAY_IDENTIFIER CDD_MotAg6Meas.PerInstanceMemories.MotAg6RtPrm.SinCosNomRatio /end MEASUREMENT
/begin MEASUREMENT CDD_MotAg6Meas.MotAg6RtPrm.SinGainCorrd "MICROSAR RTE" FLOAT32_IEEE NO_COMPU_METHOD 0 0 -3.402823466e+38 3.402823466e+38 ECU_ADDRESS 0 SYMBOL_LINK "Rte_CDD_MotAg6Meas_MotAg6RtPrm.SinGainCorrd" 0 DISPLAY_IDENTIFIER CDD_MotAg6Meas.PerInstanceMemories.MotAg6RtPrm.SinGainCorrd /end MEASUREMENT
/begin MEASUREMENT CDD_MotAg6Meas.MotAg6RtPrm.SinOffsCorrd "MICROSAR RTE" FLOAT32_IEEE NO_COMPU_METHOD 0 0 -3.402823466e+38 3.402823466e+38 ECU_ADDRESS 0 SYMBOL_LINK "Rte_CDD_MotAg6Meas_MotAg6RtPrm.SinOffsCorrd" 0 DISPLAY_IDENTIFIER CDD_MotAg6Meas.PerInstanceMemories.MotAg6RtPrm.SinOffsCorrd /end MEASUREMENT
/begin MEASUREMENT CDD_MotAg6Meas.MotAg6RtPrm.SinRtAmpRecpr "MICROSAR RTE" FLOAT32_IEEE NO_COMPU_METHOD 0 0 -3.402823466e+38 3.402823466e+38 ECU_ADDRESS 0 SYMBOL_LINK "Rte_CDD_MotAg6Meas_MotAg6RtPrm.SinRtAmpRecpr" 0 DISPLAY_IDENTIFIER CDD_MotAg6Meas.PerInstanceMemories.MotAg6RtPrm.SinRtAmpRecpr /end MEASUREMENT
/begin MEASUREMENT CDD_MotAg6Meas.MotAg6RtPrm.SinRtOffs "MICROSAR RTE" FLOAT32_IEEE NO_COMPU_METHOD 0 0 -3.402823466e+38 3.402823466e+38 ECU_ADDRESS 0 SYMBOL_LINK "Rte_CDD_MotAg6Meas_MotAg6RtPrm.SinRtOffs" 0 DISPLAY_IDENTIFIER CDD_MotAg6Meas.PerInstanceMemories.MotAg6RtPrm.SinRtOffs /end MEASUREMENT
/begin MEASUREMENT CDD_MotAg6Meas.MotAg6Sin.Val "MICROSAR RTE" FLOAT32_IEEE NO_COMPU_METHOD 0 0 -3.402823466e+38 3.402823466e+38 ECU_ADDRESS 0 SYMBOL_LINK "Rte_CDD_MotCtrlMgr_MotAg6Sin_Val" 0 DISPLAY_IDENTIFIER CDD_MotAg6Meas.ReceiverPorts.MotAg6Sin.Val /end MEASUREMENT
/begin MEASUREMENT CDD_MotAg6Meas.MotAg6SinAdcFaild.Logl "MICROSAR RTE" UBYTE RTE_CM_BOOLEAN 0 0 0 255 ECU_ADDRESS 0 SYMBOL_LINK "Rte_CDD_FordT3T6McuCfg_MotAg6SinAdcFaild_Logl" 0 DISPLAY_IDENTIFIER CDD_MotAg6Meas.ReceiverPorts.MotAg6SinAdcFaild.Logl /end MEASUREMENT
/begin MEASUREMENT CDD_MotAg6Meas.MotAg6SinMaxLpFil.FilGain "MICROSAR RTE" FLOAT32_IEEE NO_COMPU_METHOD 0 0 -3.402823466e+38 3.402823466e+38 ECU_ADDRESS 0 SYMBOL_LINK "Rte_CDD_MotAg6Meas_MotAg6SinMaxLpFil.FilGain" 0 DISPLAY_IDENTIFIER CDD_MotAg6Meas.PerInstanceMemories.MotAg6SinMaxLpFil.FilGain /end MEASUREMENT
/begin MEASUREMENT CDD_MotAg6Meas.MotAg6SinMaxLpFil.FilSt "MICROSAR RTE" FLOAT32_IEEE NO_COMPU_METHOD 0 0 -3.402823466e+38 3.402823466e+38 ECU_ADDRESS 0 SYMBOL_LINK "Rte_CDD_MotAg6Meas_MotAg6SinMaxLpFil.FilSt" 0 DISPLAY_IDENTIFIER CDD_MotAg6Meas.PerInstanceMemories.MotAg6SinMaxLpFil.FilSt /end MEASUREMENT
/begin MEASUREMENT CDD_MotAg6Meas.MotAg6SinMinLpFil.FilGain "MICROSAR RTE" FLOAT32_IEEE NO_COMPU_METHOD 0 0 -3.402823466e+38 3.402823466e+38 ECU_ADDRESS 0 SYMBOL_LINK "Rte_CDD_MotAg6Meas_MotAg6SinMinLpFil.FilGain" 0 DISPLAY_IDENTIFIER CDD_MotAg6Meas.PerInstanceMemories.MotAg6SinMinLpFil.FilGain /end MEASUREMENT
/begin MEASUREMENT CDD_MotAg6Meas.MotAg6SinMinLpFil.FilSt "MICROSAR RTE" FLOAT32_IEEE NO_COMPU_METHOD 0 0 -3.402823466e+38 3.402823466e+38 ECU_ADDRESS 0 SYMBOL_LINK "Rte_CDD_MotAg6Meas_MotAg6SinMinLpFil.FilSt" 0 DISPLAY_IDENTIFIER CDD_MotAg6Meas.PerInstanceMemories.MotAg6SinMinLpFil.FilSt /end MEASUREMENT
/begin MEASUREMENT CDD_MotAg6Meas.MotAg6SinRtAmpRecpr.Val "MICROSAR RTE" FLOAT32_IEEE NO_COMPU_METHOD 0 0 -3.402823466e+38 3.402823466e+38 ECU_ADDRESS 0 SYMBOL_LINK "Rte_CDD_MotAg6Meas_MotAg6SinRtAmpRecpr_Val" 0 DISPLAY_IDENTIFIER CDD_MotAg6Meas.SenderPorts.MotAg6SinRtAmpRecpr.Val /end MEASUREMENT
/begin MEASUREMENT CDD_MotAg6Meas.MotAg6SinRtOffs.Val "MICROSAR RTE" FLOAT32_IEEE NO_COMPU_METHOD 0 0 -3.402823466e+38 3.402823466e+38 ECU_ADDRESS 0 SYMBOL_LINK "Rte_CDD_MotAg6Meas_MotAg6SinRtOffs_Val" 0 DISPLAY_IDENTIFIER CDD_MotAg6Meas.SenderPorts.MotAg6SinRtOffs.Val /end MEASUREMENT
/begin MEASUREMENT CDD_MotAg6Meas.MotAg6StVari.MotAgCosMax "MICROSAR RTE" FLOAT32_IEEE NO_COMPU_METHOD 0 0 -3.402823466e+38 3.402823466e+38 ECU_ADDRESS 0 SYMBOL_LINK "Rte_CDD_MotAg6Meas_MotAg6StVari.MotAgCosMax" 0 DISPLAY_IDENTIFIER CDD_MotAg6Meas.PerInstanceMemories.MotAg6StVari.MotAgCosMax /end MEASUREMENT
/begin MEASUREMENT CDD_MotAg6Meas.MotAg6StVari.MotAgCosMin "MICROSAR RTE" FLOAT32_IEEE NO_COMPU_METHOD 0 0 -3.402823466e+38 3.402823466e+38 ECU_ADDRESS 0 SYMBOL_LINK "Rte_CDD_MotAg6Meas_MotAg6StVari.MotAgCosMin" 0 DISPLAY_IDENTIFIER CDD_MotAg6Meas.PerInstanceMemories.MotAg6StVari.MotAgCosMin /end MEASUREMENT
/begin MEASUREMENT CDD_MotAg6Meas.MotAg6StVari.MotAgSinMax "MICROSAR RTE" FLOAT32_IEEE NO_COMPU_METHOD 0 0 -3.402823466e+38 3.402823466e+38 ECU_ADDRESS 0 SYMBOL_LINK "Rte_CDD_MotAg6Meas_MotAg6StVari.MotAgSinMax" 0 DISPLAY_IDENTIFIER CDD_MotAg6Meas.PerInstanceMemories.MotAg6StVari.MotAgSinMax /end MEASUREMENT
/begin MEASUREMENT CDD_MotAg6Meas.MotAg6StVari.MotAgSinMin "MICROSAR RTE" FLOAT32_IEEE NO_COMPU_METHOD 0 0 -3.402823466e+38 3.402823466e+38 ECU_ADDRESS 0 SYMBOL_LINK "Rte_CDD_MotAg6Meas_MotAg6StVari.MotAgSinMin" 0 DISPLAY_IDENTIFIER CDD_MotAg6Meas.PerInstanceMemories.MotAg6StVari.MotAgSinMin /end MEASUREMENT
/begin MEASUREMENT CDD_MotAg6Meas.MotVelMrf.Val "MICROSAR RTE" FLOAT32_IEEE NO_COMPU_METHOD 0 0 -3.402823466e+38 3.402823466e+38 ECU_ADDRESS 0 SYMBOL_LINK "Rte_CDD_MotVel_MotVelMrf_Val" 0 DISPLAY_IDENTIFIER CDD_MotAg6Meas.ReceiverPorts.MotVelMrf.Val /end MEASUREMENT
/begin MEASUREMENT CDD_MotAg6Meas.PrevMotAg6Mecl "MICROSAR RTE" UWORD NO_COMPU_METHOD 0 0 0 65535 ECU_ADDRESS 0 SYMBOL_LINK "Rte_CDD_MotAg6Meas_PrevMotAg6Mecl" 0 DISPLAY_IDENTIFIER CDD_MotAg6Meas.PerInstanceMemories.PrevMotAg6Mecl /end MEASUREMENT
/begin MEASUREMENT CDD_MotAg6Meas.dMotAg6MeasAmpVal "MICROSAR RTE" FLOAT32_IEEE NO_COMPU_METHOD 0 0 -3.402823466e+38 3.402823466e+38 ECU_ADDRESS 0 SYMBOL_LINK "Rte_CDD_MotAg6Meas_dMotAg6MeasAmpVal" 0 DISPLAY_IDENTIFIER CDD_MotAg6Meas.PerInstanceMemories.dMotAg6MeasAmpVal /end MEASUREMENT
/begin MEASUREMENT CDD_MotAgArbn.MotAgARollgCntPrev "MICROSAR RTE" UBYTE NO_COMPU_METHOD 0 0 0 255 ECU_ADDRESS 0 SYMBOL_LINK "Rte_CDD_MotAgArbn_MotAgARollgCntPrev" 0 DISPLAY_IDENTIFIER CDD_MotAgArbn.PerInstanceMemories.MotAgARollgCntPrev /end MEASUREMENT
/begin MEASUREMENT CDD_MotAgArbn.MotAgAStallCntPrev "MICROSAR RTE" UBYTE NO_COMPU_METHOD 0 0 0 255 ECU_ADDRESS 0 SYMBOL_LINK "Rte_CDD_MotAgArbn_MotAgAStallCntPrev" 0 DISPLAY_IDENTIFIER CDD_MotAgArbn.PerInstanceMemories.MotAgAStallCntPrev /end MEASUREMENT
/begin MEASUREMENT CDD_MotAgArbn.MotAgBRollgCntPrev "MICROSAR RTE" UBYTE NO_COMPU_METHOD 0 0 0 255 ECU_ADDRESS 0 SYMBOL_LINK "Rte_CDD_MotAgArbn_MotAgBRollgCntPrev" 0 DISPLAY_IDENTIFIER CDD_MotAgArbn.PerInstanceMemories.MotAgBRollgCntPrev /end MEASUREMENT
/begin MEASUREMENT CDD_MotAgArbn.MotAgBStallCntPrev "MICROSAR RTE" UBYTE NO_COMPU_METHOD 0 0 0 255 ECU_ADDRESS 0 SYMBOL_LINK "Rte_CDD_MotAgArbn_MotAgBStallCntPrev" 0 DISPLAY_IDENTIFIER CDD_MotAgArbn.PerInstanceMemories.MotAgBStallCntPrev /end MEASUREMENT
/begin MEASUREMENT CDD_MotAgArbn.dMotAgArbnAAvl "MICROSAR RTE" UBYTE RTE_CM_BOOLEAN 0 0 0 255 ECU_ADDRESS 0 SYMBOL_LINK "Rte_CDD_MotAgArbn_dMotAgArbnAAvl" 0 DISPLAY_IDENTIFIER CDD_MotAgArbn.PerInstanceMemories.dMotAgArbnAAvl /end MEASUREMENT
/begin MEASUREMENT CDD_MotAgArbn.dMotAgArbnBAvl "MICROSAR RTE" UBYTE RTE_CM_BOOLEAN 0 0 0 255 ECU_ADDRESS 0 SYMBOL_LINK "Rte_CDD_MotAgArbn_dMotAgArbnBAvl" 0 DISPLAY_IDENTIFIER CDD_MotAgArbn.PerInstanceMemories.dMotAgArbnBAvl /end MEASUREMENT
/begin MEASUREMENT CDD_MotAgCmp.AssiMechPolarity.Val "MICROSAR RTE" SBYTE NO_COMPU_METHOD 0 0 -1.0 1.0 ECU_ADDRESS 0 SYMBOL_LINK "Rte_PolarityCfg_AssiMechPolarity_Val" 0 DISPLAY_IDENTIFIER CDD_MotAgCmp.ReceiverPorts.AssiMechPolarity.Val /end MEASUREMENT
/begin MEASUREMENT CDD_MotAgCmp.CmpEnaCntr "MICROSAR RTE" UBYTE NO_COMPU_METHOD 0 0 0 255 ECU_ADDRESS 0 SYMBOL_LINK "Rte_CDD_MotAgCmp_CmpEnaCntr" 0 DISPLAY_IDENTIFIER CDD_MotAgCmp.PerInstanceMemories.CmpEnaCntr /end MEASUREMENT
/begin MEASUREMENT CDD_MotAgCmp.DigMotHwPosn "MICROSAR RTE" FLOAT32_IEEE NO_COMPU_METHOD 0 0 -3.402823466e+38 3.402823466e+38 ECU_ADDRESS 0 SYMBOL_LINK "Rte_CDD_MotAgCmp_DigMotHwPosn" 0 DISPLAY_IDENTIFIER CDD_MotAgCmp.PerInstanceMemories.DigMotHwPosn /end MEASUREMENT
/begin MEASUREMENT CDD_MotAgCmp.MotAgCmpMotAgBackEmf "MICROSAR RTE" UWORD RTE_CM_Ag9 0 0 0 0.9999847412 ECU_ADDRESS 0 SYMBOL_LINK "Rte_CDD_MotAgCmp_MotAgCmpMotAgBackEmf" 0 DISPLAY_IDENTIFIER CDD_MotAgCmp.PerInstanceMemories.MotAgCmpMotAgBackEmf /end MEASUREMENT
/begin MEASUREMENT CDD_MotAgCmp.MotAgCmpMotCtrlMotAgCumvAlgndMrfRevSVPrev "MICROSAR RTE" SLONG RTE_CM_Ag8 0 0 -32768 32767.9999847411 ECU_ADDRESS 0 SYMBOL_LINK "Rte_CDD_MotAgCmp_MotAgCmpMotCtrlMotAgCumvAlgndMrfRevSVPrev" 0 DISPLAY_IDENTIFIER CDD_MotAgCmp.PerInstanceMemories.MotAgCmpMotCtrlMotAgCumvAlgndMrfRevSVPrev /end MEASUREMENT
/begin MEASUREMENT CDD_MotAgCmp.MotAgCmpMotCtrlMotAgMeclPrev "MICROSAR RTE" SLONG RTE_CM_Ag8 0 0 -32768 32767.9999847411 ECU_ADDRESS 0 SYMBOL_LINK "Rte_CDD_MotAgCmp_MotAgCmpMotCtrlMotAgMeclPrev" 0 DISPLAY_IDENTIFIER CDD_MotAgCmp.PerInstanceMemories.MotAgCmpMotCtrlMotAgMeclPrev /end MEASUREMENT
/begin MEASUREMENT CDD_MotAgCmp.MotAgCumvAlgndCrf.Val "MICROSAR RTE" SLONG RTE_CM_Ag7 0 0 -262144 262143.9998 ECU_ADDRESS 0 SYMBOL_LINK "Rte_CDD_MotAgCmp_MotAgCumvAlgndCrf_Val" 0 DISPLAY_IDENTIFIER CDD_MotAgCmp.SenderPorts.MotAgCumvAlgndCrf.Val /end MEASUREMENT
/begin MEASUREMENT CDD_MotAgCmp.MotAgCumvAlgndMrf.Val "MICROSAR RTE" SLONG RTE_CM_Ag7 0 0 -262144 262143.9998 ECU_ADDRESS 0 SYMBOL_LINK "Rte_CDD_MotAgCmp_MotAgCumvAlgndMrf_Val" 0 DISPLAY_IDENTIFIER CDD_MotAgCmp.SenderPorts.MotAgCumvAlgndMrf.Val /end MEASUREMENT
/begin MEASUREMENT CDD_MotAgCmp.MotAgCumvAlgndMrfRev.Val "MICROSAR RTE" SLONG RTE_CM_Ag8 0 0 -32768 32767.9999847411 ECU_ADDRESS 0 SYMBOL_LINK "Rte_CDD_MotCtrlMgr_MotAgCumvAlgndMrfRev_Val" 0 DISPLAY_IDENTIFIER CDD_MotAgCmp.ReceiverPorts.MotAgCumvAlgndMrfRev.Val /end MEASUREMENT
/begin MEASUREMENT CDD_MotAgCmp.MotAgCumvAlgndVld.Logl "MICROSAR RTE" UBYTE RTE_CM_BOOLEAN 0 0 0 255 ECU_ADDRESS 0 SYMBOL_LINK "Rte_CDD_MotAgCmp_MotAgCumvAlgndVld_Logl" 0 DISPLAY_IDENTIFIER CDD_MotAgCmp.SenderPorts.MotAgCumvAlgndVld.Logl /end MEASUREMENT
/begin MEASUREMENT CDD_MotAgCmp.MotAgCumvInid.Logl "MICROSAR RTE" UBYTE RTE_CM_BOOLEAN 0 0 0 255 ECU_ADDRESS 0 SYMBOL_LINK "Rte_CDD_MotCtrlMgr_MotAgCumvInid_Logl" 0 DISPLAY_IDENTIFIER CDD_MotAgCmp.ReceiverPorts.MotAgCumvInid.Logl /end MEASUREMENT
/begin MEASUREMENT CDD_MotAgSwCal.BoostModlnIdx "MICROSAR RTE" FLOAT32_IEEE NO_COMPU_METHOD 0 0 -3.402823466e+38 3.402823466e+38 ECU_ADDRESS 0 SYMBOL_LINK "Rte_CDD_MotAgSwCal_BoostModlnIdx" 0 DISPLAY_IDENTIFIER CDD_MotAgSwCal.PerInstanceMemories.BoostModlnIdx /end MEASUREMENT
/begin MEASUREMENT CDD_MotAgSwCal.BoostSlew "MICROSAR RTE" FLOAT32_IEEE NO_COMPU_METHOD 0 0 -3.402823466e+38 3.402823466e+38 ECU_ADDRESS 0 SYMBOL_LINK "Rte_CDD_MotAgSwCal_BoostSlew" 0 DISPLAY_IDENTIFIER CDD_MotAgSwCal.PerInstanceMemories.BoostSlew /end MEASUREMENT
/begin MEASUREMENT CDD_MotAgSwCal.BoostTi "MICROSAR RTE" UBYTE NO_COMPU_METHOD 0 0 0 255 ECU_ADDRESS 0 SYMBOL_LINK "Rte_CDD_MotAgSwCal_BoostTi" 0 DISPLAY_IDENTIFIER CDD_MotAgSwCal.PerInstanceMemories.BoostTi /end MEASUREMENT
/begin MEASUREMENT CDD_MotAgSwCal.BoostTiOut "MICROSAR RTE" ULONG NO_COMPU_METHOD 0 0 0 4294967295 ECU_ADDRESS 0 SYMBOL_LINK "Rte_CDD_MotAgSwCal_BoostTiOut" 0 DISPLAY_IDENTIFIER CDD_MotAgSwCal.PerInstanceMemories.BoostTiOut /end MEASUREMENT
/begin MEASUREMENT CDD_MotAgSwCal.CoolDwnModlnIdx "MICROSAR RTE" FLOAT32_IEEE NO_COMPU_METHOD 0 0 -3.402823466e+38 3.402823466e+38 ECU_ADDRESS 0 SYMBOL_LINK "Rte_CDD_MotAgSwCal_CoolDwnModlnIdx" 0 DISPLAY_IDENTIFIER CDD_MotAgSwCal.PerInstanceMemories.CoolDwnModlnIdx /end MEASUREMENT
/begin MEASUREMENT CDD_MotAgSwCal.CoolDwnSlew "MICROSAR RTE" FLOAT32_IEEE NO_COMPU_METHOD 0 0 -3.402823466e+38 3.402823466e+38 ECU_ADDRESS 0 SYMBOL_LINK "Rte_CDD_MotAgSwCal_CoolDwnSlew" 0 DISPLAY_IDENTIFIER CDD_MotAgSwCal.PerInstanceMemories.CoolDwnSlew /end MEASUREMENT
/begin MEASUREMENT CDD_MotAgSwCal.CoolDwnTi "MICROSAR RTE" UWORD NO_COMPU_METHOD 0 0 0 65535 ECU_ADDRESS 0 SYMBOL_LINK "Rte_CDD_MotAgSwCal_CoolDwnTi" 0 DISPLAY_IDENTIFIER CDD_MotAgSwCal.PerInstanceMemories.CoolDwnTi /end MEASUREMENT
/begin MEASUREMENT CDD_MotAgSwCal.CoolDwnTiOut "MICROSAR RTE" ULONG NO_COMPU_METHOD 0 0 0 4294967295 ECU_ADDRESS 0 SYMBOL_LINK "Rte_CDD_MotAgSwCal_CoolDwnTiOut" 0 DISPLAY_IDENTIFIER CDD_MotAgSwCal.PerInstanceMemories.CoolDwnTiOut /end MEASUREMENT
/begin MEASUREMENT CDD_MotAgSwCal.ElecRevCnt "MICROSAR RTE" UBYTE NO_COMPU_METHOD 0 0 0 255 ECU_ADDRESS 0 SYMBOL_LINK "Rte_CDD_MotAgSwCal_ElecRevCnt" 0 DISPLAY_IDENTIFIER CDD_MotAgSwCal.PerInstanceMemories.ElecRevCnt /end MEASUREMENT
/begin MEASUREMENT CDD_MotAgSwCal.HldModlnIdx "MICROSAR RTE" FLOAT32_IEEE NO_COMPU_METHOD 0 0 -3.402823466e+38 3.402823466e+38 ECU_ADDRESS 0 SYMBOL_LINK "Rte_CDD_MotAgSwCal_HldModlnIdx" 0 DISPLAY_IDENTIFIER CDD_MotAgSwCal.PerInstanceMemories.HldModlnIdx /end MEASUREMENT
/begin MEASUREMENT CDD_MotAgSwCal.HldSlew "MICROSAR RTE" FLOAT32_IEEE NO_COMPU_METHOD 0 0 -3.402823466e+38 3.402823466e+38 ECU_ADDRESS 0 SYMBOL_LINK "Rte_CDD_MotAgSwCal_HldSlew" 0 DISPLAY_IDENTIFIER CDD_MotAgSwCal.PerInstanceMemories.HldSlew /end MEASUREMENT
/begin MEASUREMENT CDD_MotAgSwCal.HldTi "MICROSAR RTE" UWORD NO_COMPU_METHOD 0 0 0 65535 ECU_ADDRESS 0 SYMBOL_LINK "Rte_CDD_MotAgSwCal_HldTi" 0 DISPLAY_IDENTIFIER CDD_MotAgSwCal.PerInstanceMemories.HldTi /end MEASUREMENT
/begin MEASUREMENT CDD_MotAgSwCal.HldTiOut "MICROSAR RTE" ULONG NO_COMPU_METHOD 0 0 0 4294967295 ECU_ADDRESS 0 SYMBOL_LINK "Rte_CDD_MotAgSwCal_HldTiOut" 0 DISPLAY_IDENTIFIER CDD_MotAgSwCal.PerInstanceMemories.HldTiOut /end MEASUREMENT
/begin MEASUREMENT CDD_MotAgSwCal.MotAg2CosAdcFaildCntr "MICROSAR RTE" UBYTE NO_COMPU_METHOD 0 0 0 255 ECU_ADDRESS 0 SYMBOL_LINK "Rte_CDD_MotAgSwCal_MotAg2CosAdcFaildCntr" 0 DISPLAY_IDENTIFIER CDD_MotAgSwCal.PerInstanceMemories.MotAg2CosAdcFaildCntr /end MEASUREMENT
/begin MEASUREMENT CDD_MotAgSwCal.MotAg2CosMeasAvrg "MICROSAR RTE" UWORD NO_COMPU_METHOD 0 0 0 65535 ECU_ADDRESS 0 SYMBOL_LINK "Rte_CDD_MotAgSwCal_MotAg2CosMeasAvrg" 0 DISPLAY_IDENTIFIER CDD_MotAgSwCal.PerInstanceMemories.MotAg2CosMeasAvrg /end MEASUREMENT
/begin MEASUREMENT CDD_MotAgSwCal.MotAg2CosMeasRaw "MICROSAR RTE" UWORD NO_COMPU_METHOD 0 0 0 65535 MATRIX_DIM 50 1 1 ECU_ADDRESS 0 SYMBOL_LINK "Rte_CDD_MotAgSwCal_MotAg2CosMeasRaw" 0 DISPLAY_IDENTIFIER CDD_MotAgSwCal.PerInstanceMemories.MotAg2CosMeasRaw /end MEASUREMENT
/begin MEASUREMENT CDD_MotAgSwCal.MotAg2CosMeasRawCumv "MICROSAR RTE" UWORD NO_COMPU_METHOD 0 0 0 65535 ECU_ADDRESS 0 SYMBOL_LINK "Rte_CDD_MotAgSwCal_MotAg2CosMeasRawCumv" 0 DISPLAY_IDENTIFIER CDD_MotAgSwCal.PerInstanceMemories.MotAg2CosMeasRawCumv /end MEASUREMENT
/begin MEASUREMENT CDD_MotAgSwCal.MotAg2CosMeasRawPrev "MICROSAR RTE" UWORD NO_COMPU_METHOD 0 0 0 65535 ECU_ADDRESS 0 SYMBOL_LINK "Rte_CDD_MotAgSwCal_MotAg2CosMeasRawPrev" 0 DISPLAY_IDENTIFIER CDD_MotAgSwCal.PerInstanceMemories.MotAg2CosMeasRawPrev /end MEASUREMENT
/begin MEASUREMENT CDD_MotAgSwCal.MotAg2SinAdcFaildCntr "MICROSAR RTE" UBYTE NO_COMPU_METHOD 0 0 0 255 ECU_ADDRESS 0 SYMBOL_LINK "Rte_CDD_MotAgSwCal_MotAg2SinAdcFaildCntr" 0 DISPLAY_IDENTIFIER CDD_MotAgSwCal.PerInstanceMemories.MotAg2SinAdcFaildCntr /end MEASUREMENT
/begin MEASUREMENT CDD_MotAgSwCal.MotAg2SinMeasAvrg "MICROSAR RTE" UWORD NO_COMPU_METHOD 0 0 0 65535 ECU_ADDRESS 0 SYMBOL_LINK "Rte_CDD_MotAgSwCal_MotAg2SinMeasAvrg" 0 DISPLAY_IDENTIFIER CDD_MotAgSwCal.PerInstanceMemories.MotAg2SinMeasAvrg /end MEASUREMENT
/begin MEASUREMENT CDD_MotAgSwCal.MotAg2SinMeasRaw "MICROSAR RTE" UWORD NO_COMPU_METHOD 0 0 0 65535 MATRIX_DIM 50 1 1 ECU_ADDRESS 0 SYMBOL_LINK "Rte_CDD_MotAgSwCal_MotAg2SinMeasRaw" 0 DISPLAY_IDENTIFIER CDD_MotAgSwCal.PerInstanceMemories.MotAg2SinMeasRaw /end MEASUREMENT
/begin MEASUREMENT CDD_MotAgSwCal.MotAg2SinMeasRawCumv "MICROSAR RTE" UWORD NO_COMPU_METHOD 0 0 0 65535 ECU_ADDRESS 0 SYMBOL_LINK "Rte_CDD_MotAgSwCal_MotAg2SinMeasRawCumv" 0 DISPLAY_IDENTIFIER CDD_MotAgSwCal.PerInstanceMemories.MotAg2SinMeasRawCumv /end MEASUREMENT
/begin MEASUREMENT CDD_MotAgSwCal.MotAg2SinMeasRawPrev "MICROSAR RTE" UWORD NO_COMPU_METHOD 0 0 0 65535 ECU_ADDRESS 0 SYMBOL_LINK "Rte_CDD_MotAgSwCal_MotAg2SinMeasRawPrev" 0 DISPLAY_IDENTIFIER CDD_MotAgSwCal.PerInstanceMemories.MotAg2SinMeasRawPrev /end MEASUREMENT
/begin MEASUREMENT CDD_MotAgSwCal.MotAg5CosAdcFaildCntr "MICROSAR RTE" UBYTE NO_COMPU_METHOD 0 0 0 255 ECU_ADDRESS 0 SYMBOL_LINK "Rte_CDD_MotAgSwCal_MotAg5CosAdcFaildCntr" 0 DISPLAY_IDENTIFIER CDD_MotAgSwCal.PerInstanceMemories.MotAg5CosAdcFaildCntr /end MEASUREMENT
/begin MEASUREMENT CDD_MotAgSwCal.MotAg5CosMeasAvrg "MICROSAR RTE" UWORD NO_COMPU_METHOD 0 0 0 65535 ECU_ADDRESS 0 SYMBOL_LINK "Rte_CDD_MotAgSwCal_MotAg5CosMeasAvrg" 0 DISPLAY_IDENTIFIER CDD_MotAgSwCal.PerInstanceMemories.MotAg5CosMeasAvrg /end MEASUREMENT
/begin MEASUREMENT CDD_MotAgSwCal.MotAg5CosMeasRaw "MICROSAR RTE" UWORD NO_COMPU_METHOD 0 0 0 65535 MATRIX_DIM 50 1 1 ECU_ADDRESS 0 SYMBOL_LINK "Rte_CDD_MotAgSwCal_MotAg5CosMeasRaw" 0 DISPLAY_IDENTIFIER CDD_MotAgSwCal.PerInstanceMemories.MotAg5CosMeasRaw /end MEASUREMENT
/begin MEASUREMENT CDD_MotAgSwCal.MotAg5CosMeasRawCumv "MICROSAR RTE" UWORD NO_COMPU_METHOD 0 0 0 65535 ECU_ADDRESS 0 SYMBOL_LINK "Rte_CDD_MotAgSwCal_MotAg5CosMeasRawCumv" 0 DISPLAY_IDENTIFIER CDD_MotAgSwCal.PerInstanceMemories.MotAg5CosMeasRawCumv /end MEASUREMENT
/begin MEASUREMENT CDD_MotAgSwCal.MotAg5CosMeasRawPrev "MICROSAR RTE" UWORD NO_COMPU_METHOD 0 0 0 65535 ECU_ADDRESS 0 SYMBOL_LINK "Rte_CDD_MotAgSwCal_MotAg5CosMeasRawPrev" 0 DISPLAY_IDENTIFIER CDD_MotAgSwCal.PerInstanceMemories.MotAg5CosMeasRawPrev /end MEASUREMENT
/begin MEASUREMENT CDD_MotAgSwCal.MotAg5SinAdcFaildCntr "MICROSAR RTE" UBYTE NO_COMPU_METHOD 0 0 0 255 ECU_ADDRESS 0 SYMBOL_LINK "Rte_CDD_MotAgSwCal_MotAg5SinAdcFaildCntr" 0 DISPLAY_IDENTIFIER CDD_MotAgSwCal.PerInstanceMemories.MotAg5SinAdcFaildCntr /end MEASUREMENT
/begin MEASUREMENT CDD_MotAgSwCal.MotAg5SinMeasAvrg "MICROSAR RTE" UWORD NO_COMPU_METHOD 0 0 0 65535 ECU_ADDRESS 0 SYMBOL_LINK "Rte_CDD_MotAgSwCal_MotAg5SinMeasAvrg" 0 DISPLAY_IDENTIFIER CDD_MotAgSwCal.PerInstanceMemories.MotAg5SinMeasAvrg /end MEASUREMENT
/begin MEASUREMENT CDD_MotAgSwCal.MotAg5SinMeasRaw "MICROSAR RTE" UWORD NO_COMPU_METHOD 0 0 0 65535 MATRIX_DIM 50 1 1 ECU_ADDRESS 0 SYMBOL_LINK "Rte_CDD_MotAgSwCal_MotAg5SinMeasRaw" 0 DISPLAY_IDENTIFIER CDD_MotAgSwCal.PerInstanceMemories.MotAg5SinMeasRaw /end MEASUREMENT
/begin MEASUREMENT CDD_MotAgSwCal.MotAg5SinMeasRawCumv "MICROSAR RTE" UWORD NO_COMPU_METHOD 0 0 0 65535 ECU_ADDRESS 0 SYMBOL_LINK "Rte_CDD_MotAgSwCal_MotAg5SinMeasRawCumv" 0 DISPLAY_IDENTIFIER CDD_MotAgSwCal.PerInstanceMemories.MotAg5SinMeasRawCumv /end MEASUREMENT
/begin MEASUREMENT CDD_MotAgSwCal.MotAg5SinMeasRawPrev "MICROSAR RTE" UWORD NO_COMPU_METHOD 0 0 0 65535 ECU_ADDRESS 0 SYMBOL_LINK "Rte_CDD_MotAgSwCal_MotAg5SinMeasRawPrev" 0 DISPLAY_IDENTIFIER CDD_MotAgSwCal.PerInstanceMemories.MotAg5SinMeasRawPrev /end MEASUREMENT
/begin MEASUREMENT CDD_MotAgSwCal.MotAg6CosAdcFaildCntr "MICROSAR RTE" UBYTE NO_COMPU_METHOD 0 0 0 255 ECU_ADDRESS 0 SYMBOL_LINK "Rte_CDD_MotAgSwCal_MotAg6CosAdcFaildCntr" 0 DISPLAY_IDENTIFIER CDD_MotAgSwCal.PerInstanceMemories.MotAg6CosAdcFaildCntr /end MEASUREMENT
/begin MEASUREMENT CDD_MotAgSwCal.MotAg6CosMeasAvrg "MICROSAR RTE" UWORD NO_COMPU_METHOD 0 0 0 65535 ECU_ADDRESS 0 SYMBOL_LINK "Rte_CDD_MotAgSwCal_MotAg6CosMeasAvrg" 0 DISPLAY_IDENTIFIER CDD_MotAgSwCal.PerInstanceMemories.MotAg6CosMeasAvrg /end MEASUREMENT
/begin MEASUREMENT CDD_MotAgSwCal.MotAg6CosMeasRaw "MICROSAR RTE" UWORD NO_COMPU_METHOD 0 0 0 65535 MATRIX_DIM 50 1 1 ECU_ADDRESS 0 SYMBOL_LINK "Rte_CDD_MotAgSwCal_MotAg6CosMeasRaw" 0 DISPLAY_IDENTIFIER CDD_MotAgSwCal.PerInstanceMemories.MotAg6CosMeasRaw /end MEASUREMENT
/begin MEASUREMENT CDD_MotAgSwCal.MotAg6CosMeasRawCumv "MICROSAR RTE" UWORD NO_COMPU_METHOD 0 0 0 65535 ECU_ADDRESS 0 SYMBOL_LINK "Rte_CDD_MotAgSwCal_MotAg6CosMeasRawCumv" 0 DISPLAY_IDENTIFIER CDD_MotAgSwCal.PerInstanceMemories.MotAg6CosMeasRawCumv /end MEASUREMENT
/begin MEASUREMENT CDD_MotAgSwCal.MotAg6CosMeasRawPrev "MICROSAR RTE" UWORD NO_COMPU_METHOD 0 0 0 65535 ECU_ADDRESS 0 SYMBOL_LINK "Rte_CDD_MotAgSwCal_MotAg6CosMeasRawPrev" 0 DISPLAY_IDENTIFIER CDD_MotAgSwCal.PerInstanceMemories.MotAg6CosMeasRawPrev /end MEASUREMENT
/begin MEASUREMENT CDD_MotAgSwCal.MotAg6SinAdcFaildCntr "MICROSAR RTE" UBYTE NO_COMPU_METHOD 0 0 0 255 ECU_ADDRESS 0 SYMBOL_LINK "Rte_CDD_MotAgSwCal_MotAg6SinAdcFaildCntr" 0 DISPLAY_IDENTIFIER CDD_MotAgSwCal.PerInstanceMemories.MotAg6SinAdcFaildCntr /end MEASUREMENT
/begin MEASUREMENT CDD_MotAgSwCal.MotAg6SinMeasAvrg "MICROSAR RTE" UWORD NO_COMPU_METHOD 0 0 0 65535 ECU_ADDRESS 0 SYMBOL_LINK "Rte_CDD_MotAgSwCal_MotAg6SinMeasAvrg" 0 DISPLAY_IDENTIFIER CDD_MotAgSwCal.PerInstanceMemories.MotAg6SinMeasAvrg /end MEASUREMENT
/begin MEASUREMENT CDD_MotAgSwCal.MotAg6SinMeasRaw "MICROSAR RTE" UWORD NO_COMPU_METHOD 0 0 0 65535 MATRIX_DIM 50 1 1 ECU_ADDRESS 0 SYMBOL_LINK "Rte_CDD_MotAgSwCal_MotAg6SinMeasRaw" 0 DISPLAY_IDENTIFIER CDD_MotAgSwCal.PerInstanceMemories.MotAg6SinMeasRaw /end MEASUREMENT
/begin MEASUREMENT CDD_MotAgSwCal.MotAg6SinMeasRawCumv "MICROSAR RTE" UWORD NO_COMPU_METHOD 0 0 0 65535 ECU_ADDRESS 0 SYMBOL_LINK "Rte_CDD_MotAgSwCal_MotAg6SinMeasRawCumv" 0 DISPLAY_IDENTIFIER CDD_MotAgSwCal.PerInstanceMemories.MotAg6SinMeasRawCumv /end MEASUREMENT
/begin MEASUREMENT CDD_MotAgSwCal.MotAg6SinMeasRawPrev "MICROSAR RTE" UWORD NO_COMPU_METHOD 0 0 0 65535 ECU_ADDRESS 0 SYMBOL_LINK "Rte_CDD_MotAgSwCal_MotAg6SinMeasRawPrev" 0 DISPLAY_IDENTIFIER CDD_MotAgSwCal.PerInstanceMemories.MotAg6SinMeasRawPrev /end MEASUREMENT
/begin MEASUREMENT CDD_MotAgSwCal.PosnIdx "MICROSAR RTE" ULONG NO_COMPU_METHOD 0 0 0 4294967295 ECU_ADDRESS 0 SYMBOL_LINK "Rte_CDD_MotAgSwCal_PosnIdx" 0 DISPLAY_IDENTIFIER CDD_MotAgSwCal.PerInstanceMemories.PosnIdx /end MEASUREMENT
/begin MEASUREMENT CDD_MotAgSwCal.PosnStepSize "MICROSAR RTE" UWORD NO_COMPU_METHOD 0 0 0 65535 ECU_ADDRESS 0 SYMBOL_LINK "Rte_CDD_MotAgSwCal_PosnStepSize" 0 DISPLAY_IDENTIFIER CDD_MotAgSwCal.PerInstanceMemories.PosnStepSize /end MEASUREMENT
/begin MEASUREMENT CDD_MotAgSwCal.Ramp1Ti "MICROSAR RTE" UBYTE NO_COMPU_METHOD 0 0 0 255 ECU_ADDRESS 0 SYMBOL_LINK "Rte_CDD_MotAgSwCal_Ramp1Ti" 0 DISPLAY_IDENTIFIER CDD_MotAgSwCal.PerInstanceMemories.Ramp1Ti /end MEASUREMENT
/begin MEASUREMENT CDD_MotAgSwCal.Ramp2Ti "MICROSAR RTE" UBYTE NO_COMPU_METHOD 0 0 0 255 ECU_ADDRESS 0 SYMBOL_LINK "Rte_CDD_MotAgSwCal_Ramp2Ti" 0 DISPLAY_IDENTIFIER CDD_MotAgSwCal.PerInstanceMemories.Ramp2Ti /end MEASUREMENT
/begin MEASUREMENT CDD_MotAgSwCal.Ramp3Ti "MICROSAR RTE" UBYTE NO_COMPU_METHOD 0 0 0 255 ECU_ADDRESS 0 SYMBOL_LINK "Rte_CDD_MotAgSwCal_Ramp3Ti" 0 DISPLAY_IDENTIFIER CDD_MotAgSwCal.PerInstanceMemories.Ramp3Ti /end MEASUREMENT
/begin MEASUREMENT CDD_MotAgSwCal.SampleIdx "MICROSAR RTE" UBYTE NO_COMPU_METHOD 0 0 0 255 ECU_ADDRESS 0 SYMBOL_LINK "Rte_CDD_MotAgSwCal_SampleIdx" 0 DISPLAY_IDENTIFIER CDD_MotAgSwCal.PerInstanceMemories.SampleIdx /end MEASUREMENT
/begin MEASUREMENT CDD_MotAgSwCal.SamplePosnIdx "MICROSAR RTE" ULONG NO_COMPU_METHOD 0 0 0 4294967295 ECU_ADDRESS 0 SYMBOL_LINK "Rte_CDD_MotAgSwCal_SamplePosnIdx" 0 DISPLAY_IDENTIFIER CDD_MotAgSwCal.PerInstanceMemories.SamplePosnIdx /end MEASUREMENT
/begin MEASUREMENT CDD_MotAgSwCal.SampleRdyFlg "MICROSAR RTE" UBYTE RTE_CM_BOOLEAN 0 0 0 255 ECU_ADDRESS 0 SYMBOL_LINK "Rte_CDD_MotAgSwCal_SampleRdyFlg" 0 DISPLAY_IDENTIFIER CDD_MotAgSwCal.PerInstanceMemories.SampleRdyFlg /end MEASUREMENT
/begin MEASUREMENT CDD_MotAgSwCal.SampleStopTi "MICROSAR RTE" ULONG NO_COMPU_METHOD 0 0 0 4294967295 ECU_ADDRESS 0 SYMBOL_LINK "Rte_CDD_MotAgSwCal_SampleStopTi" 0 DISPLAY_IDENTIFIER CDD_MotAgSwCal.PerInstanceMemories.SampleStopTi /end MEASUREMENT
/begin MEASUREMENT CDD_MotAgSwCal.SampleStrtTi "MICROSAR RTE" ULONG NO_COMPU_METHOD 0 0 0 4294967295 ECU_ADDRESS 0 SYMBOL_LINK "Rte_CDD_MotAgSwCal_SampleStrtTi" 0 DISPLAY_IDENTIFIER CDD_MotAgSwCal.PerInstanceMemories.SampleStrtTi /end MEASUREMENT
/begin MEASUREMENT CDD_MotAgSwCal.SwCalCycTi "MICROSAR RTE" ULONG NO_COMPU_METHOD 0 0 0 4294967295 ECU_ADDRESS 0 SYMBOL_LINK "Rte_CDD_MotAgSwCal_SwCalCycTi" 0 DISPLAY_IDENTIFIER CDD_MotAgSwCal.PerInstanceMemories.SwCalCycTi /end MEASUREMENT
/begin MEASUREMENT CDD_MotAgSwCal.SwCalEna "MICROSAR RTE" UBYTE RTE_CM_BOOLEAN 0 0 0 255 ECU_ADDRESS 0 SYMBOL_LINK "Rte_CDD_MotAgSwCal_SwCalEna" 0 DISPLAY_IDENTIFIER CDD_MotAgSwCal.PerInstanceMemories.SwCalEna /end MEASUREMENT
/begin MEASUREMENT CDD_MotAgSwCal.SwCalMotModlnIdx "MICROSAR RTE" FLOAT32_IEEE NO_COMPU_METHOD 0 0 -3.402823466e+38 3.402823466e+38 ECU_ADDRESS 0 SYMBOL_LINK "Rte_CDD_MotAgSwCal_SwCalMotModlnIdx" 0 DISPLAY_IDENTIFIER CDD_MotAgSwCal.PerInstanceMemories.SwCalMotModlnIdx /end MEASUREMENT
/begin MEASUREMENT CDD_MotAgSwCal.SwCalStepDir "MICROSAR RTE" UBYTE NO_COMPU_METHOD 0 0 0 255 ECU_ADDRESS 0 SYMBOL_LINK "Rte_CDD_MotAgSwCal_SwCalStepDir" 0 DISPLAY_IDENTIFIER CDD_MotAgSwCal.PerInstanceMemories.SwCalStepDir /end MEASUREMENT
/begin MEASUREMENT CDD_MotCtrlMgr.BrdgVltg.Val "MICROSAR RTE" FLOAT32_IEEE NO_COMPU_METHOD 0 0 -3.402823466e+38 3.402823466e+38 ECU_ADDRESS 0 SYMBOL_LINK "Rte_BattVltg_BrdgVltg_Val" 0 DISPLAY_IDENTIFIER CDD_MotCtrlMgr.ReceiverPorts.BrdgVltg.Val /end MEASUREMENT
/begin MEASUREMENT CDD_MotCtrlMgr.CurrMeasCorrlnSts.Val "MICROSAR RTE" UBYTE NO_COMPU_METHOD 0 0 0 255 ECU_ADDRESS 0 SYMBOL_LINK "Rte_CurrMeasCorrln_CurrMeasCorrlnSts_Val" 0 DISPLAY_IDENTIFIER CDD_MotCtrlMgr.ReceiverPorts.CurrMeasCorrlnSts.Val /end MEASUREMENT
/begin MEASUREMENT CDD_MotCtrlMgr.CurrMeasWrmIninTestCmpl.Logl "MICROSAR RTE" UBYTE RTE_CM_BOOLEAN 0 0 0 255 ECU_ADDRESS 0 SYMBOL_LINK "Rte_CDD_CurrMeas_CurrMeasWrmIninTestCmpl_Logl" 0 DISPLAY_IDENTIFIER CDD_MotCtrlMgr.ReceiverPorts.CurrMeasWrmIninTestCmpl.Logl /end MEASUREMENT
/begin MEASUREMENT CDD_MotCtrlMgr.DiagcStsIvtr1Inactv.Logl "MICROSAR RTE" UBYTE RTE_CM_BOOLEAN 0 0 0 255 ECU_ADDRESS 0 SYMBOL_LINK "Rte_GateDrv0Ctrl_DiagcStsIvtr1Inactv_Logl" 0 DISPLAY_IDENTIFIER CDD_MotCtrlMgr.ReceiverPorts.DiagcStsIvtr1Inactv.Logl /end MEASUREMENT
/begin MEASUREMENT CDD_MotCtrlMgr.DualEcuMotCtrlMtgtnEna.Logl "MICROSAR RTE" UBYTE RTE_CM_BOOLEAN 0 0 0 255 ECU_ADDRESS 0 SYMBOL_LINK "Rte_DualCtrlrOutpMgr_DualEcuMotCtrlMtgtnEna_Logl" 0 DISPLAY_IDENTIFIER CDD_MotCtrlMgr.ReceiverPorts.DualEcuMotCtrlMtgtnEna.Logl /end MEASUREMENT
/begin MEASUREMENT CDD_MotCtrlMgr.EcuTFild.Val "MICROSAR RTE" FLOAT32_IEEE NO_COMPU_METHOD 0 0 -3.402823466e+38 3.402823466e+38 ECU_ADDRESS 0 SYMBOL_LINK "Rte_EcuTMeas_EcuTFild_Val" 0 DISPLAY_IDENTIFIER CDD_MotCtrlMgr.ReceiverPorts.EcuTFild.Val /end MEASUREMENT
/begin MEASUREMENT CDD_MotCtrlMgr.FastLoopCntr.Val "MICROSAR RTE" UWORD NO_COMPU_METHOD 0 0 0 65535 ECU_ADDRESS 0 SYMBOL_LINK "Rte_CDD_MotCtrlMgr_FastLoopCntr_Val" 0 DISPLAY_IDENTIFIER CDD_MotCtrlMgr.SenderPorts.FastLoopCntr.Val /end MEASUREMENT
/begin MEASUREMENT CDD_MotCtrlMgr.IvtrFetFltPha.Val "MICROSAR RTE" UBYTE RTE_CM_ENUM_IvtrFetFltPha1 0 0 0 255 ECU_ADDRESS 0 SYMBOL_LINK "Rte_GateDrv0Ctrl_IvtrFetFltPha_Val" 0 DISPLAY_IDENTIFIER CDD_MotCtrlMgr.ReceiverPorts.IvtrFetFltPha.Val /end MEASUREMENT
/begin MEASUREMENT CDD_MotCtrlMgr.IvtrFetFltTyp.Val "MICROSAR RTE" UBYTE RTE_CM_ENUM_IvtrFetFltTyp1 0 0 0 255 ECU_ADDRESS 0 SYMBOL_LINK "Rte_GateDrv0Ctrl_IvtrFetFltTyp_Val" 0 DISPLAY_IDENTIFIER CDD_MotCtrlMgr.ReceiverPorts.IvtrFetFltTyp.Val /end MEASUREMENT
/begin MEASUREMENT CDD_MotCtrlMgr.LoopCntr2MilliSec.Val "MICROSAR RTE" UWORD NO_COMPU_METHOD 0 0 0 65535 ECU_ADDRESS 0 SYMBOL_LINK "Rte_CDD_McuDiagc_LoopCntr2MilliSec_Val" 0 DISPLAY_IDENTIFIER CDD_MotCtrlMgr.ReceiverPorts.LoopCntr2MilliSec.Val /end MEASUREMENT
/begin MEASUREMENT CDD_MotCtrlMgr.MotAg2Cos.Val "MICROSAR RTE" FLOAT32_IEEE NO_COMPU_METHOD 0 0 -3.402823466e+38 3.402823466e+38 ECU_ADDRESS 0 SYMBOL_LINK "Rte_CDD_FordT3T6McuCfg_MotAg2Cos_Val" 0 DISPLAY_IDENTIFIER CDD_MotCtrlMgr.ReceiverPorts.MotAg2Cos.Val /end MEASUREMENT
/begin MEASUREMENT CDD_MotCtrlMgr.MotAg2CosAdcFaild.Logl "MICROSAR RTE" UBYTE RTE_CM_BOOLEAN 0 0 0 255 ECU_ADDRESS 0 SYMBOL_LINK "Rte_CDD_FordT3T6McuCfg_MotAg2CosAdcFaild_Logl" 0 DISPLAY_IDENTIFIER CDD_MotCtrlMgr.ReceiverPorts.MotAg2CosAdcFaild.Logl /end MEASUREMENT
/begin MEASUREMENT CDD_MotCtrlMgr.MotAg2Sin.Val "MICROSAR RTE" FLOAT32_IEEE NO_COMPU_METHOD 0 0 -3.402823466e+38 3.402823466e+38 ECU_ADDRESS 0 SYMBOL_LINK "Rte_CDD_FordT3T6McuCfg_MotAg2Sin_Val" 0 DISPLAY_IDENTIFIER CDD_MotCtrlMgr.ReceiverPorts.MotAg2Sin.Val /end MEASUREMENT
/begin MEASUREMENT CDD_MotCtrlMgr.MotAg2SinAdcFaild.Logl "MICROSAR RTE" UBYTE RTE_CM_BOOLEAN 0 0 0 255 ECU_ADDRESS 0 SYMBOL_LINK "Rte_CDD_FordT3T6McuCfg_MotAg2SinAdcFaild_Logl" 0 DISPLAY_IDENTIFIER CDD_MotCtrlMgr.ReceiverPorts.MotAg2SinAdcFaild.Logl /end MEASUREMENT
/begin MEASUREMENT CDD_MotCtrlMgr.MotAg5Cos.Val "MICROSAR RTE" FLOAT32_IEEE NO_COMPU_METHOD 0 0 -3.402823466e+38 3.402823466e+38 ECU_ADDRESS 0 SYMBOL_LINK "Rte_CDD_MotCtrlMgr_MotAg5Cos_Val" 0 DISPLAY_IDENTIFIER CDD_MotCtrlMgr.SenderPorts.MotAg5Cos.Val /end MEASUREMENT
/begin MEASUREMENT CDD_MotCtrlMgr.MotAg5CosAdcFaild.Logl "MICROSAR RTE" UBYTE RTE_CM_BOOLEAN 0 0 0 255 ECU_ADDRESS 0 SYMBOL_LINK "Rte_CDD_FordT3T6McuCfg_MotAg5CosAdcFaild_Logl" 0 DISPLAY_IDENTIFIER CDD_MotCtrlMgr.ReceiverPorts.MotAg5CosAdcFaild.Logl /end MEASUREMENT
/begin MEASUREMENT CDD_MotCtrlMgr.MotAg5CosRtAmpRecpr.Val "MICROSAR RTE" FLOAT32_IEEE NO_COMPU_METHOD 0 0 -3.402823466e+38 3.402823466e+38 ECU_ADDRESS 0 SYMBOL_LINK "Rte_CDD_MotAg5Meas_MotAg5CosRtAmpRecpr_Val" 0 DISPLAY_IDENTIFIER CDD_MotCtrlMgr.ReceiverPorts.MotAg5CosRtAmpRecpr.Val /end MEASUREMENT
/begin MEASUREMENT CDD_MotCtrlMgr.MotAg5CosRtOffs.Val "MICROSAR RTE" FLOAT32_IEEE NO_COMPU_METHOD 0 0 -3.402823466e+38 3.402823466e+38 ECU_ADDRESS 0 SYMBOL_LINK "Rte_CDD_MotAg5Meas_MotAg5CosRtOffs_Val" 0 DISPLAY_IDENTIFIER CDD_MotCtrlMgr.ReceiverPorts.MotAg5CosRtOffs.Val /end MEASUREMENT
/begin MEASUREMENT CDD_MotCtrlMgr.MotAg5Mecl.Val "MICROSAR RTE" UWORD NO_COMPU_METHOD 0 0 0 65535 ECU_ADDRESS 0 SYMBOL_LINK "Rte_CDD_MotCtrlMgr_MotAg5Mecl_Val" 0 DISPLAY_IDENTIFIER CDD_MotCtrlMgr.SenderPorts.MotAg5Mecl.Val /end MEASUREMENT
/begin MEASUREMENT CDD_MotCtrlMgr.MotAg5MeclQlfr.Val "MICROSAR RTE" UBYTE RTE_CM_ENUM_SigQlfr1 0 0 0 255 ECU_ADDRESS 0 SYMBOL_LINK "Rte_CDD_MotAg5Meas_MotAg5MeclQlfr_Val" 0 DISPLAY_IDENTIFIER CDD_MotCtrlMgr.ReceiverPorts.MotAg5MeclQlfr.Val /end MEASUREMENT
/begin MEASUREMENT CDD_MotCtrlMgr.MotAg5MeclRollgCntr.Val "MICROSAR RTE" UBYTE NO_COMPU_METHOD 0 0 0 255 ECU_ADDRESS 0 SYMBOL_LINK "Rte_CDD_MotAg5Meas_MotAg5MeclRollgCntr_Val" 0 DISPLAY_IDENTIFIER CDD_MotCtrlMgr.ReceiverPorts.MotAg5MeclRollgCntr.Val /end MEASUREMENT
/begin MEASUREMENT CDD_MotCtrlMgr.MotAg5RawMecl.Val "MICROSAR RTE" UWORD NO_COMPU_METHOD 0 0 0 65535 ECU_ADDRESS 0 SYMBOL_LINK "Rte_CDD_MotCtrlMgr_MotAg5RawMecl_Val" 0 DISPLAY_IDENTIFIER CDD_MotCtrlMgr.SenderPorts.MotAg5RawMecl.Val /end MEASUREMENT
/begin MEASUREMENT CDD_MotCtrlMgr.MotAg5Sin.Val "MICROSAR RTE" FLOAT32_IEEE NO_COMPU_METHOD 0 0 -3.402823466e+38 3.402823466e+38 ECU_ADDRESS 0 SYMBOL_LINK "Rte_CDD_MotCtrlMgr_MotAg5Sin_Val" 0 DISPLAY_IDENTIFIER CDD_MotCtrlMgr.SenderPorts.MotAg5Sin.Val /end MEASUREMENT
/begin MEASUREMENT CDD_MotCtrlMgr.MotAg5SinAdcFaild.Logl "MICROSAR RTE" UBYTE RTE_CM_BOOLEAN 0 0 0 255 ECU_ADDRESS 0 SYMBOL_LINK "Rte_CDD_FordT3T6McuCfg_MotAg5SinAdcFaild_Logl" 0 DISPLAY_IDENTIFIER CDD_MotCtrlMgr.ReceiverPorts.MotAg5SinAdcFaild.Logl /end MEASUREMENT
/begin MEASUREMENT CDD_MotCtrlMgr.MotAg5SinRtAmpRecpr.Val "MICROSAR RTE" FLOAT32_IEEE NO_COMPU_METHOD 0 0 -3.402823466e+38 3.402823466e+38 ECU_ADDRESS 0 SYMBOL_LINK "Rte_CDD_MotAg5Meas_MotAg5SinRtAmpRecpr_Val" 0 DISPLAY_IDENTIFIER CDD_MotCtrlMgr.ReceiverPorts.MotAg5SinRtAmpRecpr.Val /end MEASUREMENT
/begin MEASUREMENT CDD_MotCtrlMgr.MotAg5SinRtOffs.Val "MICROSAR RTE" FLOAT32_IEEE NO_COMPU_METHOD 0 0 -3.402823466e+38 3.402823466e+38 ECU_ADDRESS 0 SYMBOL_LINK "Rte_CDD_MotAg5Meas_MotAg5SinRtOffs_Val" 0 DISPLAY_IDENTIFIER CDD_MotCtrlMgr.ReceiverPorts.MotAg5SinRtOffs.Val /end MEASUREMENT
/begin MEASUREMENT CDD_MotCtrlMgr.MotAg6Cos.Val "MICROSAR RTE" FLOAT32_IEEE NO_COMPU_METHOD 0 0 -3.402823466e+38 3.402823466e+38 ECU_ADDRESS 0 SYMBOL_LINK "Rte_CDD_MotCtrlMgr_MotAg6Cos_Val" 0 DISPLAY_IDENTIFIER CDD_MotCtrlMgr.SenderPorts.MotAg6Cos.Val /end MEASUREMENT
/begin MEASUREMENT CDD_MotCtrlMgr.MotAg6CosAdcFaild.Logl "MICROSAR RTE" UBYTE RTE_CM_BOOLEAN 0 0 0 255 ECU_ADDRESS 0 SYMBOL_LINK "Rte_CDD_FordT3T6McuCfg_MotAg6CosAdcFaild_Logl" 0 DISPLAY_IDENTIFIER CDD_MotCtrlMgr.ReceiverPorts.MotAg6CosAdcFaild.Logl /end MEASUREMENT
/begin MEASUREMENT CDD_MotCtrlMgr.MotAg6CosRtAmpRecpr.Val "MICROSAR RTE" FLOAT32_IEEE NO_COMPU_METHOD 0 0 -3.402823466e+38 3.402823466e+38 ECU_ADDRESS 0 SYMBOL_LINK "Rte_CDD_MotAg6Meas_MotAg6CosRtAmpRecpr_Val" 0 DISPLAY_IDENTIFIER CDD_MotCtrlMgr.ReceiverPorts.MotAg6CosRtAmpRecpr.Val /end MEASUREMENT
/begin MEASUREMENT CDD_MotCtrlMgr.MotAg6CosRtOffs.Val "MICROSAR RTE" FLOAT32_IEEE NO_COMPU_METHOD 0 0 -3.402823466e+38 3.402823466e+38 ECU_ADDRESS 0 SYMBOL_LINK "Rte_CDD_MotAg6Meas_MotAg6CosRtOffs_Val" 0 DISPLAY_IDENTIFIER CDD_MotCtrlMgr.ReceiverPorts.MotAg6CosRtOffs.Val /end MEASUREMENT
/begin MEASUREMENT CDD_MotCtrlMgr.MotAg6Mecl.Val "MICROSAR RTE" UWORD NO_COMPU_METHOD 0 0 0 65535 ECU_ADDRESS 0 SYMBOL_LINK "Rte_CDD_MotCtrlMgr_MotAg6Mecl_Val" 0 DISPLAY_IDENTIFIER CDD_MotCtrlMgr.SenderPorts.MotAg6Mecl.Val /end MEASUREMENT
/begin MEASUREMENT CDD_MotCtrlMgr.MotAg6MeclQlfr.Val "MICROSAR RTE" UBYTE RTE_CM_ENUM_SigQlfr1 0 0 0 255 ECU_ADDRESS 0 SYMBOL_LINK "Rte_CDD_MotAg6Meas_MotAg6MeclQlfr_Val" 0 DISPLAY_IDENTIFIER CDD_MotCtrlMgr.ReceiverPorts.MotAg6MeclQlfr.Val /end MEASUREMENT
/begin MEASUREMENT CDD_MotCtrlMgr.MotAg6MeclRollgCntr.Val "MICROSAR RTE" UBYTE NO_COMPU_METHOD 0 0 0 255 ECU_ADDRESS 0 SYMBOL_LINK "Rte_CDD_MotAg6Meas_MotAg6MeclRollgCntr_Val" 0 DISPLAY_IDENTIFIER CDD_MotCtrlMgr.ReceiverPorts.MotAg6MeclRollgCntr.Val /end MEASUREMENT
/begin MEASUREMENT CDD_MotCtrlMgr.MotAg6RawMecl.Val "MICROSAR RTE" UWORD NO_COMPU_METHOD 0 0 0 65535 ECU_ADDRESS 0 SYMBOL_LINK "Rte_CDD_MotCtrlMgr_MotAg6RawMecl_Val" 0 DISPLAY_IDENTIFIER CDD_MotCtrlMgr.SenderPorts.MotAg6RawMecl.Val /end MEASUREMENT
/begin MEASUREMENT CDD_MotCtrlMgr.MotAg6Sin.Val "MICROSAR RTE" FLOAT32_IEEE NO_COMPU_METHOD 0 0 -3.402823466e+38 3.402823466e+38 ECU_ADDRESS 0 SYMBOL_LINK "Rte_CDD_MotCtrlMgr_MotAg6Sin_Val" 0 DISPLAY_IDENTIFIER CDD_MotCtrlMgr.SenderPorts.MotAg6Sin.Val /end MEASUREMENT
/begin MEASUREMENT CDD_MotCtrlMgr.MotAg6SinAdcFaild.Logl "MICROSAR RTE" UBYTE RTE_CM_BOOLEAN 0 0 0 255 ECU_ADDRESS 0 SYMBOL_LINK "Rte_CDD_FordT3T6McuCfg_MotAg6SinAdcFaild_Logl" 0 DISPLAY_IDENTIFIER CDD_MotCtrlMgr.ReceiverPorts.MotAg6SinAdcFaild.Logl /end MEASUREMENT
/begin MEASUREMENT CDD_MotCtrlMgr.MotAg6SinRtAmpRecpr.Val "MICROSAR RTE" FLOAT32_IEEE NO_COMPU_METHOD 0 0 -3.402823466e+38 3.402823466e+38 ECU_ADDRESS 0 SYMBOL_LINK "Rte_CDD_MotAg6Meas_MotAg6SinRtAmpRecpr_Val" 0 DISPLAY_IDENTIFIER CDD_MotCtrlMgr.ReceiverPorts.MotAg6SinRtAmpRecpr.Val /end MEASUREMENT
/begin MEASUREMENT CDD_MotCtrlMgr.MotAg6SinRtOffs.Val "MICROSAR RTE" FLOAT32_IEEE NO_COMPU_METHOD 0 0 -3.402823466e+38 3.402823466e+38 ECU_ADDRESS 0 SYMBOL_LINK "Rte_CDD_MotAg6Meas_MotAg6SinRtOffs_Val" 0 DISPLAY_IDENTIFIER CDD_MotCtrlMgr.ReceiverPorts.MotAg6SinRtOffs.Val /end MEASUREMENT
/begin MEASUREMENT CDD_MotCtrlMgr.MotAgBuf.Ary1D "MICROSAR RTE" UWORD RTE_CM_Ag5 0 0 0 0.9999847412 MATRIX_DIM 8 1 1 ECU_ADDRESS 0 SYMBOL_LINK "Rte_CDD_MotCtrlMgr_MotAgBuf_Ary1D" 0 DISPLAY_IDENTIFIER CDD_MotCtrlMgr.SenderPorts.MotAgBuf.Ary1D /end MEASUREMENT
/begin MEASUREMENT CDD_MotCtrlMgr.MotAgBufIdx.Val "MICROSAR RTE" UBYTE NO_COMPU_METHOD 0 0 0 255 ECU_ADDRESS 0 SYMBOL_LINK "Rte_CDD_MotCtrlMgr_MotAgBufIdx_Val" 0 DISPLAY_IDENTIFIER CDD_MotCtrlMgr.SenderPorts.MotAgBufIdx.Val /end MEASUREMENT
/begin MEASUREMENT CDD_MotCtrlMgr.MotAgCumvAlgndMrfRev.Val "MICROSAR RTE" SLONG RTE_CM_Ag8 0 0 -32768 32767.9999847411 ECU_ADDRESS 0 SYMBOL_LINK "Rte_CDD_MotCtrlMgr_MotAgCumvAlgndMrfRev_Val" 0 DISPLAY_IDENTIFIER CDD_MotCtrlMgr.SenderPorts.MotAgCumvAlgndMrfRev.Val /end MEASUREMENT
/begin MEASUREMENT CDD_MotCtrlMgr.MotAgCumvInid.Logl "MICROSAR RTE" UBYTE RTE_CM_BOOLEAN 0 0 0 255 ECU_ADDRESS 0 SYMBOL_LINK "Rte_CDD_MotCtrlMgr_MotAgCumvInid_Logl" 0 DISPLAY_IDENTIFIER CDD_MotCtrlMgr.SenderPorts.MotAgCumvInid.Logl /end MEASUREMENT
/begin MEASUREMENT CDD_MotCtrlMgr.MotAgElecDly.Val "MICROSAR RTE" FLOAT32_IEEE NO_COMPU_METHOD 0 0 -3.402823466e+38 3.402823466e+38 ECU_ADDRESS 0 SYMBOL_LINK "Rte_MotCurrRegCfg_MotAgElecDly_Val" 0 DISPLAY_IDENTIFIER CDD_MotCtrlMgr.ReceiverPorts.MotAgElecDly.Val /end MEASUREMENT
/begin MEASUREMENT CDD_MotCtrlMgr.MotAgElecDlyRpl.Val "MICROSAR RTE" FLOAT32_IEEE NO_COMPU_METHOD 0 0 -3.402823466e+38 3.402823466e+38 ECU_ADDRESS 0 SYMBOL_LINK "Rte_MotRplCoggCfg_MotAgElecDlyRpl_Val" 0 DISPLAY_IDENTIFIER CDD_MotCtrlMgr.ReceiverPorts.MotAgElecDlyRpl.Val /end MEASUREMENT
/begin MEASUREMENT CDD_MotCtrlMgr.MotAgMecl5Polarity.Val "MICROSAR RTE" SBYTE NO_COMPU_METHOD 0 0 -128 127 ECU_ADDRESS 0 SYMBOL_LINK "Rte_PolarityCfg_MotAgMecl5Polarity_Val" 0 DISPLAY_IDENTIFIER CDD_MotCtrlMgr.ReceiverPorts.MotAgMecl5Polarity.Val /end MEASUREMENT
/begin MEASUREMENT CDD_MotCtrlMgr.MotAgMecl6Polarity.Val "MICROSAR RTE" SBYTE NO_COMPU_METHOD 0 0 -128 127 ECU_ADDRESS 0 SYMBOL_LINK "Rte_PolarityCfg_MotAgMecl6Polarity_Val" 0 DISPLAY_IDENTIFIER CDD_MotCtrlMgr.ReceiverPorts.MotAgMecl6Polarity.Val /end MEASUREMENT
/begin MEASUREMENT CDD_MotCtrlMgr.MotAgMeclCorrlnSt.Val "MICROSAR RTE" UBYTE NO_COMPU_METHOD 0 0 0 7 ECU_ADDRESS 0 SYMBOL_LINK "Rte_MotAgCorrln_MotAgMeclCorrlnSt_Val" 0 DISPLAY_IDENTIFIER CDD_MotCtrlMgr.ReceiverPorts.MotAgMeclCorrlnSt.Val /end MEASUREMENT
/begin MEASUREMENT CDD_MotCtrlMgr.MotAgTiBuf.Ary1D "MICROSAR RTE" ULONG NO_COMPU_METHOD 0 0 0 4294967295 MATRIX_DIM 8 1 1 ECU_ADDRESS 0 SYMBOL_LINK "Rte_CDD_MotCtrlMgr_MotAgTiBuf_Ary1D" 0 DISPLAY_IDENTIFIER CDD_MotCtrlMgr.SenderPorts.MotAgTiBuf.Ary1D /end MEASUREMENT
/begin MEASUREMENT CDD_MotCtrlMgr.MotAndThermProtnLoaMod.Val "MICROSAR RTE" UBYTE NO_COMPU_METHOD 0 0 0 255 ECU_ADDRESS 0 SYMBOL_LINK "Rte_LoaMgr_MotAndThermProtnLoaMod_Val" 0 DISPLAY_IDENTIFIER CDD_MotCtrlMgr.ReceiverPorts.MotAndThermProtnLoaMod.Val /end MEASUREMENT
/begin MEASUREMENT CDD_MotCtrlMgr.MotBackEmfVltg.Val "MICROSAR RTE" FLOAT32_IEEE NO_COMPU_METHOD 0 0 -3.402823466e+38 3.402823466e+38 ECU_ADDRESS 0 SYMBOL_LINK "Rte_MotRefMdl_MotBackEmfVltg_Val" 0 DISPLAY_IDENTIFIER CDD_MotCtrlMgr.ReceiverPorts.MotBackEmfVltg.Val /end MEASUREMENT
/begin MEASUREMENT CDD_MotCtrlMgr.MotCurrAdcVlyA.Val "MICROSAR RTE" FLOAT32_IEEE NO_COMPU_METHOD 0 0 0.0 5.0 ECU_ADDRESS 0 SYMBOL_LINK "Rte_CDD_MotCtrlMgr_MotCurrAdcVlyA_Val" 0 DISPLAY_IDENTIFIER CDD_MotCtrlMgr.SenderPorts.MotCurrAdcVlyA.Val /end MEASUREMENT
/begin MEASUREMENT CDD_MotCtrlMgr.MotCurrAdcVlyAAdcFaild.Logl "MICROSAR RTE" UBYTE RTE_CM_BOOLEAN 0 0 0 255 ECU_ADDRESS 0 SYMBOL_LINK "Rte_CDD_FordT3T6McuCfg_MotCurrAdcVlyAAdcFaild_Logl" 0 DISPLAY_IDENTIFIER CDD_MotCtrlMgr.ReceiverPorts.MotCurrAdcVlyAAdcFaild.Logl /end MEASUREMENT
/begin MEASUREMENT CDD_MotCtrlMgr.MotCurrAdcVlyB.Val "MICROSAR RTE" FLOAT32_IEEE NO_COMPU_METHOD 0 0 0.0 5.0 ECU_ADDRESS 0 SYMBOL_LINK "Rte_CDD_MotCtrlMgr_MotCurrAdcVlyB_Val" 0 DISPLAY_IDENTIFIER CDD_MotCtrlMgr.SenderPorts.MotCurrAdcVlyB.Val /end MEASUREMENT
/begin MEASUREMENT CDD_MotCtrlMgr.MotCurrAdcVlyBAdcFaild.Logl "MICROSAR RTE" UBYTE RTE_CM_BOOLEAN 0 0 0 255 ECU_ADDRESS 0 SYMBOL_LINK "Rte_CDD_FordT3T6McuCfg_MotCurrAdcVlyBAdcFaild_Logl" 0 DISPLAY_IDENTIFIER CDD_MotCtrlMgr.ReceiverPorts.MotCurrAdcVlyBAdcFaild.Logl /end MEASUREMENT
/begin MEASUREMENT CDD_MotCtrlMgr.MotCurrAdcVlyC.Val "MICROSAR RTE" FLOAT32_IEEE NO_COMPU_METHOD 0 0 0.0 5.0 ECU_ADDRESS 0 SYMBOL_LINK "Rte_CDD_MotCtrlMgr_MotCurrAdcVlyC_Val" 0 DISPLAY_IDENTIFIER CDD_MotCtrlMgr.SenderPorts.MotCurrAdcVlyC.Val /end MEASUREMENT
/begin MEASUREMENT CDD_MotCtrlMgr.MotCurrAdcVlyCAdcFaild.Logl "MICROSAR RTE" UBYTE RTE_CM_BOOLEAN 0 0 0 255 ECU_ADDRESS 0 SYMBOL_LINK "Rte_CDD_FordT3T6McuCfg_MotCurrAdcVlyCAdcFaild_Logl" 0 DISPLAY_IDENTIFIER CDD_MotCtrlMgr.ReceiverPorts.MotCurrAdcVlyCAdcFaild.Logl /end MEASUREMENT
/begin MEASUREMENT CDD_MotCtrlMgr.MotCurrCorrdA.Val "MICROSAR RTE" FLOAT32_IEEE NO_COMPU_METHOD 0 0 -145.0 145.0 ECU_ADDRESS 0 SYMBOL_LINK "Rte_CDD_MotCtrlMgr_MotCurrCorrdA_Val" 0 DISPLAY_IDENTIFIER CDD_MotCtrlMgr.SenderPorts.MotCurrCorrdA.Val /end MEASUREMENT
/begin MEASUREMENT CDD_MotCtrlMgr.MotCurrCorrdB.Val "MICROSAR RTE" FLOAT32_IEEE NO_COMPU_METHOD 0 0 -145.0 145.0 ECU_ADDRESS 0 SYMBOL_LINK "Rte_CDD_MotCtrlMgr_MotCurrCorrdB_Val" 0 DISPLAY_IDENTIFIER CDD_MotCtrlMgr.SenderPorts.MotCurrCorrdB.Val /end MEASUREMENT
/begin MEASUREMENT CDD_MotCtrlMgr.MotCurrCorrdC.Val "MICROSAR RTE" FLOAT32_IEEE NO_COMPU_METHOD 0 0 -145.0 145.0 ECU_ADDRESS 0 SYMBOL_LINK "Rte_CDD_MotCtrlMgr_MotCurrCorrdC_Val" 0 DISPLAY_IDENTIFIER CDD_MotCtrlMgr.SenderPorts.MotCurrCorrdC.Val /end MEASUREMENT
/begin MEASUREMENT CDD_MotCtrlMgr.MotCurrDax.Val "MICROSAR RTE" FLOAT32_IEEE NO_COMPU_METHOD 0 0 -3.402823466e+38 3.402823466e+38 ECU_ADDRESS 0 SYMBOL_LINK "Rte_CDD_MotCtrlMgr_MotCurrDax_Val" 0 DISPLAY_IDENTIFIER CDD_MotCtrlMgr.SenderPorts.MotCurrDax.Val /end MEASUREMENT
/begin MEASUREMENT CDD_MotCtrlMgr.MotCurrDaxCmd.Val "MICROSAR RTE" FLOAT32_IEEE NO_COMPU_METHOD 0 0 -3.402823466e+38 3.402823466e+38 ECU_ADDRESS 0 SYMBOL_LINK "Rte_MotRefMdl_MotCurrDaxCmd_Val" 0 DISPLAY_IDENTIFIER CDD_MotCtrlMgr.ReceiverPorts.MotCurrDaxCmd.Val /end MEASUREMENT
/begin MEASUREMENT CDD_MotCtrlMgr.MotCurrDaxMax.Val "MICROSAR RTE" FLOAT32_IEEE NO_COMPU_METHOD 0 0 -3.402823466e+38 3.402823466e+38 ECU_ADDRESS 0 SYMBOL_LINK "Rte_MotRefMdl_MotCurrDaxMax_Val" 0 DISPLAY_IDENTIFIER CDD_MotCtrlMgr.ReceiverPorts.MotCurrDaxMax.Val /end MEASUREMENT
/begin MEASUREMENT CDD_MotCtrlMgr.MotCurrEolCalSt.Val "MICROSAR RTE" UBYTE RTE_CM_ENUM_MotCurrEolCalSt2 0 0 0 255 ECU_ADDRESS 0 SYMBOL_LINK "Rte_CDD_CurrMeas_MotCurrEolCalSt_Val" 0 DISPLAY_IDENTIFIER CDD_MotCtrlMgr.ReceiverPorts.MotCurrEolCalSt.Val /end MEASUREMENT
/begin MEASUREMENT CDD_MotCtrlMgr.MotCurrQax.Val "MICROSAR RTE" FLOAT32_IEEE NO_COMPU_METHOD 0 0 -3.402823466e+38 3.402823466e+38 ECU_ADDRESS 0 SYMBOL_LINK "Rte_CDD_MotCtrlMgr_MotCurrQax_Val" 0 DISPLAY_IDENTIFIER CDD_MotCtrlMgr.SenderPorts.MotCurrQax.Val /end MEASUREMENT
/begin MEASUREMENT CDD_MotCtrlMgr.MotCurrQaxCmd.Val "MICROSAR RTE" FLOAT32_IEEE NO_COMPU_METHOD 0 0 -3.402823466e+38 3.402823466e+38 ECU_ADDRESS 0 SYMBOL_LINK "Rte_MotRefMdl_MotCurrQaxCmd_Val" 0 DISPLAY_IDENTIFIER CDD_MotCtrlMgr.ReceiverPorts.MotCurrQaxCmd.Val /end MEASUREMENT
/begin MEASUREMENT CDD_MotCtrlMgr.MotCurrQaxToMotTqGain.Val "MICROSAR RTE" FLOAT32_IEEE NO_COMPU_METHOD 0 0 -3.402823466e+38 3.402823466e+38 ECU_ADDRESS 0 SYMBOL_LINK "Rte_MotRplCoggCfg_MotCurrQaxToMotTqGain_Val" 0 DISPLAY_IDENTIFIER CDD_MotCtrlMgr.ReceiverPorts.MotCurrQaxToMotTqGain.Val /end MEASUREMENT
/begin MEASUREMENT CDD_MotCtrlMgr.MotCurrQlfr1.Val "MICROSAR RTE" UBYTE RTE_CM_ENUM_SigQlfr1 0 0 0 255 ECU_ADDRESS 0 SYMBOL_LINK "Rte_CDD_CurrMeas_MotCurrQlfr1_Val" 0 DISPLAY_IDENTIFIER CDD_MotCtrlMgr.ReceiverPorts.MotCurrQlfr1.Val /end MEASUREMENT
/begin MEASUREMENT CDD_MotCtrlMgr.MotCurrRollgCntr1.Val "MICROSAR RTE" UBYTE NO_COMPU_METHOD 0 0 0 255 ECU_ADDRESS 0 SYMBOL_LINK "Rte_CDD_MotCtrlMgr_MotCurrRollgCntr1_Val" 0 DISPLAY_IDENTIFIER CDD_MotCtrlMgr.SenderPorts.MotCurrRollgCntr1.Val /end MEASUREMENT
/begin MEASUREMENT CDD_MotCtrlMgr.MotDampgDax.Val "MICROSAR RTE" FLOAT32_IEEE NO_COMPU_METHOD 0 0 -3.402823466e+38 3.402823466e+38 ECU_ADDRESS 0 SYMBOL_LINK "Rte_MotCurrRegCfg_MotDampgDax_Val" 0 DISPLAY_IDENTIFIER CDD_MotCtrlMgr.ReceiverPorts.MotDampgDax.Val /end MEASUREMENT
/begin MEASUREMENT CDD_MotCtrlMgr.MotDampgQax.Val "MICROSAR RTE" FLOAT32_IEEE NO_COMPU_METHOD 0 0 -3.402823466e+38 3.402823466e+38 ECU_ADDRESS 0 SYMBOL_LINK "Rte_MotCurrRegCfg_MotDampgQax_Val" 0 DISPLAY_IDENTIFIER CDD_MotCtrlMgr.ReceiverPorts.MotDampgQax.Val /end MEASUREMENT
/begin MEASUREMENT CDD_MotCtrlMgr.MotElecMeclPolarity.Val "MICROSAR RTE" SBYTE NO_COMPU_METHOD 0 0 -128 127 ECU_ADDRESS 0 SYMBOL_LINK "Rte_PolarityCfg_MotElecMeclPolarity_Val" 0 DISPLAY_IDENTIFIER CDD_MotCtrlMgr.ReceiverPorts.MotElecMeclPolarity.Val /end MEASUREMENT
/begin MEASUREMENT CDD_MotCtrlMgr.MotInduDaxEstimdIvs.Val "MICROSAR RTE" FLOAT32_IEEE NO_COMPU_METHOD 0 0 -3.402823466e+38 3.402823466e+38 ECU_ADDRESS 0 SYMBOL_LINK "Rte_MotCtrlPrmEstimn_MotInduDaxEstimdIvs_Val" 0 DISPLAY_IDENTIFIER CDD_MotCtrlMgr.ReceiverPorts.MotInduDaxEstimdIvs.Val /end MEASUREMENT
/begin MEASUREMENT CDD_MotCtrlMgr.MotInduQaxEstimdIvs.Val "MICROSAR RTE" FLOAT32_IEEE NO_COMPU_METHOD 0 0 -3.402823466e+38 3.402823466e+38 ECU_ADDRESS 0 SYMBOL_LINK "Rte_MotCtrlPrmEstimn_MotInduQaxEstimdIvs_Val" 0 DISPLAY_IDENTIFIER CDD_MotCtrlMgr.ReceiverPorts.MotInduQaxEstimdIvs.Val /end MEASUREMENT
/begin MEASUREMENT CDD_MotCtrlMgr.MotIntglGainDax.Val "MICROSAR RTE" FLOAT32_IEEE NO_COMPU_METHOD 0 0 -3.402823466e+38 3.402823466e+38 ECU_ADDRESS 0 SYMBOL_LINK "Rte_MotCurrRegCfg_MotIntglGainDax_Val" 0 DISPLAY_IDENTIFIER CDD_MotCtrlMgr.ReceiverPorts.MotIntglGainDax.Val /end MEASUREMENT
/begin MEASUREMENT CDD_MotCtrlMgr.MotIntglGainQax.Val "MICROSAR RTE" FLOAT32_IEEE NO_COMPU_METHOD 0 0 -3.402823466e+38 3.402823466e+38 ECU_ADDRESS 0 SYMBOL_LINK "Rte_MotCurrRegCfg_MotIntglGainQax_Val" 0 DISPLAY_IDENTIFIER CDD_MotCtrlMgr.ReceiverPorts.MotIntglGainQax.Val /end MEASUREMENT
/begin MEASUREMENT CDD_MotCtrlMgr.MotPropGainDax.Val "MICROSAR RTE" FLOAT32_IEEE NO_COMPU_METHOD 0 0 -3.402823466e+38 3.402823466e+38 ECU_ADDRESS 0 SYMBOL_LINK "Rte_MotCurrRegCfg_MotPropGainDax_Val" 0 DISPLAY_IDENTIFIER CDD_MotCtrlMgr.ReceiverPorts.MotPropGainDax.Val /end MEASUREMENT
/begin MEASUREMENT CDD_MotCtrlMgr.MotPropGainQax.Val "MICROSAR RTE" FLOAT32_IEEE NO_COMPU_METHOD 0 0 -3.402823466e+38 3.402823466e+38 ECU_ADDRESS 0 SYMBOL_LINK "Rte_MotCurrRegCfg_MotPropGainQax_Val" 0 DISPLAY_IDENTIFIER CDD_MotCtrlMgr.ReceiverPorts.MotPropGainQax.Val /end MEASUREMENT
/begin MEASUREMENT CDD_MotCtrlMgr.MotREstimd.Val "MICROSAR RTE" FLOAT32_IEEE NO_COMPU_METHOD 0 0 -3.402823466e+38 3.402823466e+38 ECU_ADDRESS 0 SYMBOL_LINK "Rte_MotCtrlPrmEstimn_MotREstimd_Val" 0 DISPLAY_IDENTIFIER CDD_MotCtrlMgr.ReceiverPorts.MotREstimd.Val /end MEASUREMENT
/begin MEASUREMENT CDD_MotCtrlMgr.MotReacncDax.Val "MICROSAR RTE" FLOAT32_IEEE NO_COMPU_METHOD 0 0 -3.402823466e+38 3.402823466e+38 ECU_ADDRESS 0 SYMBOL_LINK "Rte_MotRefMdl_MotReacncDax_Val" 0 DISPLAY_IDENTIFIER CDD_MotCtrlMgr.ReceiverPorts.MotReacncDax.Val /end MEASUREMENT
/begin MEASUREMENT CDD_MotCtrlMgr.MotReacncQax.Val "MICROSAR RTE" FLOAT32_IEEE NO_COMPU_METHOD 0 0 -3.402823466e+38 3.402823466e+38 ECU_ADDRESS 0 SYMBOL_LINK "Rte_MotRefMdl_MotReacncQax_Val" 0 DISPLAY_IDENTIFIER CDD_MotCtrlMgr.ReceiverPorts.MotReacncQax.Val /end MEASUREMENT
/begin MEASUREMENT CDD_MotCtrlMgr.MotTqRplCoggOrder1Mgn.Val "MICROSAR RTE" FLOAT32_IEEE NO_COMPU_METHOD 0 0 -3.402823466e+38 3.402823466e+38 ECU_ADDRESS 0 SYMBOL_LINK "Rte_MotRplCoggCfg_MotTqRplCoggOrder1Mgn_Val" 0 DISPLAY_IDENTIFIER CDD_MotCtrlMgr.ReceiverPorts.MotTqRplCoggOrder1Mgn.Val /end MEASUREMENT
/begin MEASUREMENT CDD_MotCtrlMgr.MotTqRplCoggOrder1Pha.Val "MICROSAR RTE" FLOAT32_IEEE NO_COMPU_METHOD 0 0 -3.402823466e+38 3.402823466e+38 ECU_ADDRESS 0 SYMBOL_LINK "Rte_MotRplCoggCfg_MotTqRplCoggOrder1Pha_Val" 0 DISPLAY_IDENTIFIER CDD_MotCtrlMgr.ReceiverPorts.MotTqRplCoggOrder1Pha.Val /end MEASUREMENT
/begin MEASUREMENT CDD_MotCtrlMgr.MotTqRplCoggOrder2Mgn.Val "MICROSAR RTE" FLOAT32_IEEE NO_COMPU_METHOD 0 0 -3.402823466e+38 3.402823466e+38 ECU_ADDRESS 0 SYMBOL_LINK "Rte_MotRplCoggCfg_MotTqRplCoggOrder2Mgn_Val" 0 DISPLAY_IDENTIFIER CDD_MotCtrlMgr.ReceiverPorts.MotTqRplCoggOrder2Mgn.Val /end MEASUREMENT
/begin MEASUREMENT CDD_MotCtrlMgr.MotTqRplCoggOrder2Pha.Val "MICROSAR RTE" FLOAT32_IEEE NO_COMPU_METHOD 0 0 -3.402823466e+38 3.402823466e+38 ECU_ADDRESS 0 SYMBOL_LINK "Rte_MotRplCoggCfg_MotTqRplCoggOrder2Pha_Val" 0 DISPLAY_IDENTIFIER CDD_MotCtrlMgr.ReceiverPorts.MotTqRplCoggOrder2Pha.Val /end MEASUREMENT
/begin MEASUREMENT CDD_MotCtrlMgr.MotTqRplCoggOrder3Mgn.Val "MICROSAR RTE" FLOAT32_IEEE NO_COMPU_METHOD 0 0 -3.402823466e+38 3.402823466e+38 ECU_ADDRESS 0 SYMBOL_LINK "Rte_MotRplCoggCfg_MotTqRplCoggOrder3Mgn_Val" 0 DISPLAY_IDENTIFIER CDD_MotCtrlMgr.ReceiverPorts.MotTqRplCoggOrder3Mgn.Val /end MEASUREMENT
/begin MEASUREMENT CDD_MotCtrlMgr.MotTqRplCoggOrder3Pha.Val "MICROSAR RTE" FLOAT32_IEEE NO_COMPU_METHOD 0 0 -3.402823466e+38 3.402823466e+38 ECU_ADDRESS 0 SYMBOL_LINK "Rte_MotRplCoggCfg_MotTqRplCoggOrder3Pha_Val" 0 DISPLAY_IDENTIFIER CDD_MotCtrlMgr.ReceiverPorts.MotTqRplCoggOrder3Pha.Val /end MEASUREMENT
/begin MEASUREMENT CDD_MotCtrlMgr.MotVelMrf.Val "MICROSAR RTE" FLOAT32_IEEE NO_COMPU_METHOD 0 0 -3.402823466e+38 3.402823466e+38 ECU_ADDRESS 0 SYMBOL_LINK "Rte_CDD_MotVel_MotVelMrf_Val" 0 DISPLAY_IDENTIFIER CDD_MotCtrlMgr.ReceiverPorts.MotVelMrf.Val /end MEASUREMENT
/begin MEASUREMENT CDD_MotCtrlMgr.MotVltgDax.Val "MICROSAR RTE" FLOAT32_IEEE NO_COMPU_METHOD 0 0 -3.402823466e+38 3.402823466e+38 ECU_ADDRESS 0 SYMBOL_LINK "Rte_CDD_MotCtrlMgr_MotVltgDax_Val" 0 DISPLAY_IDENTIFIER CDD_MotCtrlMgr.SenderPorts.MotVltgDax.Val /end MEASUREMENT
/begin MEASUREMENT CDD_MotCtrlMgr.MotVltgDaxFf.Val "MICROSAR RTE" FLOAT32_IEEE NO_COMPU_METHOD 0 0 -3.402823466e+38 3.402823466e+38 ECU_ADDRESS 0 SYMBOL_LINK "Rte_MotRefMdl_MotVltgDaxFf_Val" 0 DISPLAY_IDENTIFIER CDD_MotCtrlMgr.ReceiverPorts.MotVltgDaxFf.Val /end MEASUREMENT
/begin MEASUREMENT CDD_MotCtrlMgr.MotVltgDaxFild.Val "MICROSAR RTE" FLOAT32_IEEE NO_COMPU_METHOD 0 0 -3.402823466e+38 3.402823466e+38 ECU_ADDRESS 0 SYMBOL_LINK "Rte_CDD_MotCtrlMgr_MotVltgDaxFild_Val" 0 DISPLAY_IDENTIFIER CDD_MotCtrlMgr.SenderPorts.MotVltgDaxFild.Val /end MEASUREMENT
/begin MEASUREMENT CDD_MotCtrlMgr.MotVltgQax.Val "MICROSAR RTE" FLOAT32_IEEE NO_COMPU_METHOD 0 0 -3.402823466e+38 3.402823466e+38 ECU_ADDRESS 0 SYMBOL_LINK "Rte_CDD_MotCtrlMgr_MotVltgQax_Val" 0 DISPLAY_IDENTIFIER CDD_MotCtrlMgr.SenderPorts.MotVltgQax.Val /end MEASUREMENT
/begin MEASUREMENT CDD_MotCtrlMgr.MotVltgQaxFf.Val "MICROSAR RTE" FLOAT32_IEEE NO_COMPU_METHOD 0 0 -3.402823466e+38 3.402823466e+38 ECU_ADDRESS 0 SYMBOL_LINK "Rte_MotRefMdl_MotVltgQaxFf_Val" 0 DISPLAY_IDENTIFIER CDD_MotCtrlMgr.ReceiverPorts.MotVltgQaxFf.Val /end MEASUREMENT
/begin MEASUREMENT CDD_MotCtrlMgr.MotVltgQaxFild.Val "MICROSAR RTE" FLOAT32_IEEE NO_COMPU_METHOD 0 0 -3.402823466e+38 3.402823466e+38 ECU_ADDRESS 0 SYMBOL_LINK "Rte_CDD_MotCtrlMgr_MotVltgQaxFild_Val" 0 DISPLAY_IDENTIFIER CDD_MotCtrlMgr.SenderPorts.MotVltgQaxFild.Val /end MEASUREMENT
/begin MEASUREMENT CDD_MotCtrlMgr.Ntc5DErrCnt.Val "MICROSAR RTE" UWORD NO_COMPU_METHOD 0 0 0 65535 ECU_ADDRESS 0 SYMBOL_LINK "Rte_CDD_MotCtrlMgr_Ntc5DErrCnt_Val" 0 DISPLAY_IDENTIFIER CDD_MotCtrlMgr.SenderPorts.Ntc5DErrCnt.Val /end MEASUREMENT
/begin MEASUREMENT CDD_MotCtrlMgr.PhaOnTiSumA.Val "MICROSAR RTE" ULONG NO_COMPU_METHOD 0 0 0 4294967295 ECU_ADDRESS 0 SYMBOL_LINK "Rte_CDD_MotCtrlMgr_PhaOnTiSumA_Val" 0 DISPLAY_IDENTIFIER CDD_MotCtrlMgr.SenderPorts.PhaOnTiSumA.Val /end MEASUREMENT
/begin MEASUREMENT CDD_MotCtrlMgr.PhaOnTiSumB.Val "MICROSAR RTE" ULONG NO_COMPU_METHOD 0 0 0 4294967295 ECU_ADDRESS 0 SYMBOL_LINK "Rte_CDD_MotCtrlMgr_PhaOnTiSumB_Val" 0 DISPLAY_IDENTIFIER CDD_MotCtrlMgr.SenderPorts.PhaOnTiSumB.Val /end MEASUREMENT
/begin MEASUREMENT CDD_MotCtrlMgr.PhaOnTiSumC.Val "MICROSAR RTE" ULONG NO_COMPU_METHOD 0 0 0 4294967295 ECU_ADDRESS 0 SYMBOL_LINK "Rte_CDD_MotCtrlMgr_PhaOnTiSumC_Val" 0 DISPLAY_IDENTIFIER CDD_MotCtrlMgr.SenderPorts.PhaOnTiSumC.Val /end MEASUREMENT
/begin MEASUREMENT CDD_MotCtrlMgr.SlowLoopCntr.Val "MICROSAR RTE" UWORD NO_COMPU_METHOD 0 0 0 65535 ECU_ADDRESS 0 SYMBOL_LINK "Rte_CDD_MotCtrlMgr_SlowLoopCntr_Val" 0 DISPLAY_IDENTIFIER CDD_MotCtrlMgr.SenderPorts.SlowLoopCntr.Val /end MEASUREMENT
/begin MEASUREMENT CDD_MotCtrlMgr.SysSt.Val "MICROSAR RTE" UBYTE RTE_CM_ENUM_SysSt1 0 0 0 255 ECU_ADDRESS 0 SYMBOL_LINK "Rte_SysStMod_SysSt_Val" 0 DISPLAY_IDENTIFIER CDD_MotCtrlMgr.ReceiverPorts.SysSt.Val /end MEASUREMENT
/begin MEASUREMENT CDD_MotCtrlMgr.VehSpd.Val "MICROSAR RTE" FLOAT32_IEEE NO_COMPU_METHOD 0 0 -3.402823466e+38 3.402823466e+38 ECU_ADDRESS 0 SYMBOL_LINK "Rte_VehSigCdng_VehSpd_Val" 0 DISPLAY_IDENTIFIER CDD_MotCtrlMgr.ReceiverPorts.VehSpd.Val /end MEASUREMENT
/begin MEASUREMENT CDD_MotCurrRegVltgLimr.AntiWdupCmdScaDax "MICROSAR RTE" FLOAT32_IEEE NO_COMPU_METHOD 0 0 0.0 1.0 ECU_ADDRESS 0 SYMBOL_LINK "Rte_CDD_MotCurrRegVltgLimr_AntiWdupCmdScaDax" 0 DISPLAY_IDENTIFIER CDD_MotCurrRegVltgLimr.PerInstanceMemories.AntiWdupCmdScaDax /end MEASUREMENT
/begin MEASUREMENT CDD_MotCurrRegVltgLimr.AntiWdupCmdScaQax "MICROSAR RTE" FLOAT32_IEEE NO_COMPU_METHOD 0 0 0.0 1.0 ECU_ADDRESS 0 SYMBOL_LINK "Rte_CDD_MotCurrRegVltgLimr_AntiWdupCmdScaQax" 0 DISPLAY_IDENTIFIER CDD_MotCurrRegVltgLimr.PerInstanceMemories.AntiWdupCmdScaQax /end MEASUREMENT
/begin MEASUREMENT CDD_MotCurrRegVltgLimr.CurrLoaScarPrev "MICROSAR RTE" FLOAT32_IEEE NO_COMPU_METHOD 0 0 0.0 1.0 ECU_ADDRESS 0 SYMBOL_LINK "Rte_CDD_MotCurrRegVltgLimr_CurrLoaScarPrev" 0 DISPLAY_IDENTIFIER CDD_MotCurrRegVltgLimr.PerInstanceMemories.CurrLoaScarPrev /end MEASUREMENT
/begin MEASUREMENT CDD_MotCurrRegVltgLimr.DualEcuLoaScarPrev "MICROSAR RTE" FLOAT32_IEEE NO_COMPU_METHOD 0 0 -3.402823466e+38 3.402823466e+38 ECU_ADDRESS 0 SYMBOL_LINK "Rte_CDD_MotCurrRegVltgLimr_DualEcuLoaScarPrev" 0 DISPLAY_IDENTIFIER CDD_MotCurrRegVltgLimr.PerInstanceMemories.DualEcuLoaScarPrev /end MEASUREMENT
/begin MEASUREMENT CDD_MotCurrRegVltgLimr.FETLoaScarPrev "MICROSAR RTE" FLOAT32_IEEE NO_COMPU_METHOD 0 0 -3.402823466e+38 3.402823466e+38 ECU_ADDRESS 0 SYMBOL_LINK "Rte_CDD_MotCurrRegVltgLimr_FETLoaScarPrev" 0 DISPLAY_IDENTIFIER CDD_MotCurrRegVltgLimr.PerInstanceMemories.FETLoaScarPrev /end MEASUREMENT
/begin MEASUREMENT CDD_MotCurrRegVltgLimr.IvtrLoaScarPrev "MICROSAR RTE" FLOAT32_IEEE NO_COMPU_METHOD 0 0 0.0 1.0 ECU_ADDRESS 0 SYMBOL_LINK "Rte_CDD_MotCurrRegVltgLimr_IvtrLoaScarPrev" 0 DISPLAY_IDENTIFIER CDD_MotCurrRegVltgLimr.PerInstanceMemories.IvtrLoaScarPrev /end MEASUREMENT
/begin MEASUREMENT CDD_MotCurrRegVltgLimr.MotCtrlMotVltgDaxPrev "MICROSAR RTE" FLOAT32_IEEE NO_COMPU_METHOD 0 0 -3.402823466e+38 3.402823466e+38 ECU_ADDRESS 0 SYMBOL_LINK "Rte_CDD_MotCurrRegVltgLimr_MotCtrlMotVltgDaxPrev" 0 DISPLAY_IDENTIFIER CDD_MotCurrRegVltgLimr.PerInstanceMemories.MotCtrlMotVltgDaxPrev /end MEASUREMENT
/begin MEASUREMENT CDD_MotCurrRegVltgLimr.MotCtrlMotVltgQaxPrev "MICROSAR RTE" FLOAT32_IEEE NO_COMPU_METHOD 0 0 -3.402823466e+38 3.402823466e+38 ECU_ADDRESS 0 SYMBOL_LINK "Rte_CDD_MotCurrRegVltgLimr_MotCtrlMotVltgQaxPrev" 0 DISPLAY_IDENTIFIER CDD_MotCurrRegVltgLimr.PerInstanceMemories.MotCtrlMotVltgQaxPrev /end MEASUREMENT
/begin GROUP CDD_MotAg5Meas.MotAg5EolPrm "MICROSAR RTE" /begin SUB_GROUP /end SUB_GROUP /begin FUNCTION_LIST /end FUNCTION_LIST /begin REF_CHARACTERISTIC /end REF_CHARACTERISTIC
 /begin REF_MEASUREMENT CDD_MotAg5Meas.MotAg5EolPrm.CosAmpRecpr CDD_MotAg5Meas.MotAg5EolPrm.CosDeltaRecpr CDD_MotAg5Meas.MotAg5EolPrm.CosGainCorrd CDD_MotAg5Meas.MotAg5EolPrm.CosHrmncTbl CDD_MotAg5Meas.MotAg5EolPrm.CosOffs CDD_MotAg5Meas.MotAg5EolPrm.CosOffsCorrd CDD_MotAg5Meas.MotAg5EolPrm.SinAmpRecpr CDD_MotAg5Meas.MotAg5EolPrm.SinDelta CDD_MotAg5Meas.MotAg5EolPrm.SinGainCorrd CDD_MotAg5Meas.MotAg5EolPrm.SinHrmncTbl CDD_MotAg5Meas.MotAg5EolPrm.SinOffs CDD_MotAg5Meas.MotAg5EolPrm.SinOffsCorrd /end REF_MEASUREMENT
/end GROUP
/begin GROUP CDD_MotAg5Meas.MotAg5MeasAmpSqdMaxThd.Val "MICROSAR RTE" /begin SUB_GROUP /end SUB_GROUP /begin FUNCTION_LIST /end FUNCTION_LIST /begin REF_CHARACTERISTIC CDD_MotAg5Meas.MotAg5MeasAmpSqdMaxThd.Val /end REF_CHARACTERISTIC /begin REF_MEASUREMENT /end REF_MEASUREMENT /end GROUP
/begin GROUP CDD_MotAg5Meas.MotAg5MeasAmpSqdMinThd.Val "MICROSAR RTE" /begin SUB_GROUP /end SUB_GROUP /begin FUNCTION_LIST /end FUNCTION_LIST /begin REF_CHARACTERISTIC CDD_MotAg5Meas.MotAg5MeasAmpSqdMinThd.Val /end REF_CHARACTERISTIC /begin REF_MEASUREMENT /end REF_MEASUREMENT /end GROUP
/begin GROUP CDD_MotAg5Meas.MotAg5MeasLpFilFrq.Val "MICROSAR RTE" /begin SUB_GROUP /end SUB_GROUP /begin FUNCTION_LIST /end FUNCTION_LIST /begin REF_CHARACTERISTIC CDD_MotAg5Meas.MotAg5MeasLpFilFrq.Val /end REF_CHARACTERISTIC /begin REF_MEASUREMENT /end REF_MEASUREMENT /end GROUP
/begin GROUP CDD_MotAg5Meas.MotAg5MeasOffs.Val "MICROSAR RTE" /begin SUB_GROUP /end SUB_GROUP /begin FUNCTION_LIST /end FUNCTION_LIST /begin REF_CHARACTERISTIC CDD_MotAg5Meas.MotAg5MeasOffs.Val /end REF_CHARACTERISTIC /begin REF_MEASUREMENT /end REF_MEASUREMENT /end GROUP
/begin GROUP CDD_MotAg5Meas.MotAg5MeasRtAmpRecprLim.Val "MICROSAR RTE" /begin SUB_GROUP /end SUB_GROUP /begin FUNCTION_LIST /end FUNCTION_LIST /begin REF_CHARACTERISTIC CDD_MotAg5Meas.MotAg5MeasRtAmpRecprLim.Val /end REF_CHARACTERISTIC /begin REF_MEASUREMENT /end REF_MEASUREMENT /end GROUP
/begin GROUP CDD_MotAg5Meas.MotAg5MeasRtFilEnaThd.Val "MICROSAR RTE" /begin SUB_GROUP /end SUB_GROUP /begin FUNCTION_LIST /end FUNCTION_LIST /begin REF_CHARACTERISTIC CDD_MotAg5Meas.MotAg5MeasRtFilEnaThd.Val /end REF_CHARACTERISTIC /begin REF_MEASUREMENT /end REF_MEASUREMENT /end GROUP
/begin GROUP CDD_MotAg5Meas.MotAg5MeasRtMotVelFilEnaThd.Val "MICROSAR RTE" /begin SUB_GROUP /end SUB_GROUP /begin FUNCTION_LIST /end FUNCTION_LIST /begin REF_CHARACTERISTIC CDD_MotAg5Meas.MotAg5MeasRtMotVelFilEnaThd.Val /end REF_CHARACTERISTIC /begin REF_MEASUREMENT /end REF_MEASUREMENT /end GROUP
/begin GROUP CDD_MotAg5Meas.MotAg5MeasRtOffsLim.Val "MICROSAR RTE" /begin SUB_GROUP /end SUB_GROUP /begin FUNCTION_LIST /end FUNCTION_LIST /begin REF_CHARACTERISTIC CDD_MotAg5Meas.MotAg5MeasRtOffsLim.Val /end REF_CHARACTERISTIC /begin REF_MEASUREMENT /end REF_MEASUREMENT /end GROUP
/begin GROUP CDD_MotAg5Meas.MotAg5MeasRtToNomRatLim.Val "MICROSAR RTE" /begin SUB_GROUP /end SUB_GROUP /begin FUNCTION_LIST /end FUNCTION_LIST /begin REF_CHARACTERISTIC CDD_MotAg5Meas.MotAg5MeasRtToNomRatLim.Val /end REF_CHARACTERISTIC /begin REF_MEASUREMENT /end REF_MEASUREMENT /end GROUP
/begin GROUP CDD_MotAg5Meas.MotAg5MeclQlfr.Val "MICROSAR RTE" /begin SUB_GROUP /end SUB_GROUP /begin FUNCTION_LIST /end FUNCTION_LIST /begin REF_CHARACTERISTIC /end REF_CHARACTERISTIC /begin REF_MEASUREMENT CDD_MotAg5Meas.MotAg5MeclQlfr.Val /end REF_MEASUREMENT /end GROUP
/begin GROUP CDD_MotAg5Meas.MotAg5MeclRollgCntr.Val "MICROSAR RTE" /begin SUB_GROUP /end SUB_GROUP /begin FUNCTION_LIST /end FUNCTION_LIST /begin REF_CHARACTERISTIC /end REF_CHARACTERISTIC /begin REF_MEASUREMENT CDD_MotAg5Meas.MotAg5MeclRollgCntr.Val /end REF_MEASUREMENT /end GROUP
/begin GROUP CDD_MotAg5Meas.MotAg5NvmFltEna "MICROSAR RTE" /begin SUB_GROUP /end SUB_GROUP /begin FUNCTION_LIST /end FUNCTION_LIST /begin REF_CHARACTERISTIC /end REF_CHARACTERISTIC /begin REF_MEASUREMENT CDD_MotAg5Meas.MotAg5NvmFltEna /end REF_MEASUREMENT /end GROUP
/begin GROUP CDD_MotAg5Meas.MotAg5PrevRollgCntr "MICROSAR RTE" /begin SUB_GROUP /end SUB_GROUP /begin FUNCTION_LIST /end FUNCTION_LIST /begin REF_CHARACTERISTIC /end REF_CHARACTERISTIC /begin REF_MEASUREMENT CDD_MotAg5Meas.MotAg5PrevRollgCntr /end REF_MEASUREMENT /end GROUP
/begin GROUP CDD_MotAg5Meas.MotAg5RawMecl.Val "MICROSAR RTE" /begin SUB_GROUP /end SUB_GROUP /begin FUNCTION_LIST /end FUNCTION_LIST /begin REF_CHARACTERISTIC /end REF_CHARACTERISTIC /begin REF_MEASUREMENT CDD_MotAg5Meas.MotAg5RawMecl.Val /end REF_MEASUREMENT /end GROUP
/begin GROUP CDD_MotAg5Meas.MotAg5RtPrm "MICROSAR RTE" /begin SUB_GROUP /end SUB_GROUP /begin FUNCTION_LIST /end FUNCTION_LIST /begin REF_CHARACTERISTIC /end REF_CHARACTERISTIC
 /begin REF_MEASUREMENT CDD_MotAg5Meas.MotAg5RtPrm.CosGainCorrd CDD_MotAg5Meas.MotAg5RtPrm.CosOffsCorrd CDD_MotAg5Meas.MotAg5RtPrm.CosRtAmpRecpr CDD_MotAg5Meas.MotAg5RtPrm.CosRtOffs CDD_MotAg5Meas.MotAg5RtPrm.CosSinNomRatio CDD_MotAg5Meas.MotAg5RtPrm.PrevCosRtOffs CDD_MotAg5Meas.MotAg5RtPrm.PrevSinRtOffs CDD_MotAg5Meas.MotAg5RtPrm.RtToNomRatioHiLim CDD_MotAg5Meas.MotAg5RtPrm.RtToNomRatioLoLim CDD_MotAg5Meas.MotAg5RtPrm.SinCosNomRatio CDD_MotAg5Meas.MotAg5RtPrm.SinGainCorrd CDD_MotAg5Meas.MotAg5RtPrm.SinOffsCorrd CDD_MotAg5Meas.MotAg5RtPrm.SinRtAmpRecpr CDD_MotAg5Meas.MotAg5RtPrm.SinRtOffs /end REF_MEASUREMENT
/end GROUP
/begin GROUP CDD_MotAg5Meas.MotAg5Sin.Val "MICROSAR RTE" /begin SUB_GROUP /end SUB_GROUP /begin FUNCTION_LIST /end FUNCTION_LIST /begin REF_CHARACTERISTIC /end REF_CHARACTERISTIC /begin REF_MEASUREMENT CDD_MotAg5Meas.MotAg5Sin.Val /end REF_MEASUREMENT /end GROUP
/begin GROUP CDD_MotAg5Meas.MotAg5SinAdcFaild.Logl "MICROSAR RTE" /begin SUB_GROUP /end SUB_GROUP /begin FUNCTION_LIST /end FUNCTION_LIST /begin REF_CHARACTERISTIC /end REF_CHARACTERISTIC /begin REF_MEASUREMENT CDD_MotAg5Meas.MotAg5SinAdcFaild.Logl /end REF_MEASUREMENT /end GROUP
/begin GROUP CDD_MotAg5Meas.MotAg5SinMaxLpFil "MICROSAR RTE" /begin SUB_GROUP /end SUB_GROUP /begin FUNCTION_LIST /end FUNCTION_LIST /begin REF_CHARACTERISTIC /end REF_CHARACTERISTIC
 /begin REF_MEASUREMENT CDD_MotAg5Meas.MotAg5SinMaxLpFil.FilGain CDD_MotAg5Meas.MotAg5SinMaxLpFil.FilSt /end REF_MEASUREMENT
/end GROUP
/begin GROUP CDD_MotAg5Meas.MotAg5SinMinLpFil "MICROSAR RTE" /begin SUB_GROUP /end SUB_GROUP /begin FUNCTION_LIST /end FUNCTION_LIST /begin REF_CHARACTERISTIC /end REF_CHARACTERISTIC
 /begin REF_MEASUREMENT CDD_MotAg5Meas.MotAg5SinMinLpFil.FilGain CDD_MotAg5Meas.MotAg5SinMinLpFil.FilSt /end REF_MEASUREMENT
/end GROUP
/begin GROUP CDD_MotAg5Meas.MotAg5SinRtAmpRecpr.Val "MICROSAR RTE" /begin SUB_GROUP /end SUB_GROUP /begin FUNCTION_LIST /end FUNCTION_LIST /begin REF_CHARACTERISTIC /end REF_CHARACTERISTIC /begin REF_MEASUREMENT CDD_MotAg5Meas.MotAg5SinRtAmpRecpr.Val /end REF_MEASUREMENT /end GROUP
/begin GROUP CDD_MotAg5Meas.MotAg5SinRtOffs.Val "MICROSAR RTE" /begin SUB_GROUP /end SUB_GROUP /begin FUNCTION_LIST /end FUNCTION_LIST /begin REF_CHARACTERISTIC /end REF_CHARACTERISTIC /begin REF_MEASUREMENT CDD_MotAg5Meas.MotAg5SinRtOffs.Val /end REF_MEASUREMENT /end GROUP
/begin GROUP CDD_MotAg5Meas.MotAg5StVari "MICROSAR RTE" /begin SUB_GROUP /end SUB_GROUP /begin FUNCTION_LIST /end FUNCTION_LIST /begin REF_CHARACTERISTIC /end REF_CHARACTERISTIC
 /begin REF_MEASUREMENT CDD_MotAg5Meas.MotAg5StVari.MotAgCosMax CDD_MotAg5Meas.MotAg5StVari.MotAgCosMin CDD_MotAg5Meas.MotAg5StVari.MotAgSinMax CDD_MotAg5Meas.MotAg5StVari.MotAgSinMin /end REF_MEASUREMENT
/end GROUP
/begin GROUP CDD_MotAg5Meas.MotVelMrf.Val "MICROSAR RTE" /begin SUB_GROUP /end SUB_GROUP /begin FUNCTION_LIST /end FUNCTION_LIST /begin REF_CHARACTERISTIC /end REF_CHARACTERISTIC /begin REF_MEASUREMENT CDD_MotAg5Meas.MotVelMrf.Val /end REF_MEASUREMENT /end GROUP
/begin GROUP CDD_MotAg5Meas.PerInstanceMemories "MICROSAR RTE"
 /begin SUB_GROUP CDD_MotAg5Meas.MotAg5CosMaxLpFil CDD_MotAg5Meas.MotAg5CosMinLpFil CDD_MotAg5Meas.MotAg5EolPrm CDD_MotAg5Meas.MotAg5NvmFltEna CDD_MotAg5Meas.MotAg5PrevRollgCntr CDD_MotAg5Meas.MotAg5RtPrm CDD_MotAg5Meas.MotAg5SinMaxLpFil CDD_MotAg5Meas.MotAg5SinMinLpFil CDD_MotAg5Meas.MotAg5StVari CDD_MotAg5Meas.PrevMotAg5Mecl CDD_MotAg5Meas.dMotAg5MeasAmpVal /end SUB_GROUP
 /begin FUNCTION_LIST /end FUNCTION_LIST
 /begin REF_CHARACTERISTIC /end REF_CHARACTERISTIC
 /begin REF_MEASUREMENT /end REF_MEASUREMENT
/end GROUP
/begin GROUP CDD_MotAg5Meas.PrevMotAg5Mecl "MICROSAR RTE" /begin SUB_GROUP /end SUB_GROUP /begin FUNCTION_LIST /end FUNCTION_LIST /begin REF_CHARACTERISTIC /end REF_CHARACTERISTIC /begin REF_MEASUREMENT CDD_MotAg5Meas.PrevMotAg5Mecl /end REF_MEASUREMENT /end GROUP
/begin GROUP CDD_MotAg5Meas.ReceiverPorts "MICROSAR RTE"
 /begin SUB_GROUP CDD_MotAg5Meas.MotAg5Cos.Val CDD_MotAg5Meas.MotAg5CosAdcFaild.Logl CDD_MotAg5Meas.MotAg5RawMecl.Val CDD_MotAg5Meas.MotAg5Sin.Val CDD_MotAg5Meas.MotAg5SinAdcFaild.Logl CDD_MotAg5Meas.MotVelMrf.Val /end SUB_GROUP
 /begin FUNCTION_LIST /end FUNCTION_LIST
 /begin REF_CHARACTERISTIC /end REF_CHARACTERISTIC
 /begin REF_MEASUREMENT /end REF_MEASUREMENT
/end GROUP
/begin GROUP CDD_MotAg5Meas.SenderPorts "MICROSAR RTE"
 /begin SUB_GROUP CDD_MotAg5Meas.MotAg5CosRtAmpRecpr.Val CDD_MotAg5Meas.MotAg5CosRtOffs.Val CDD_MotAg5Meas.MotAg5MeclQlfr.Val CDD_MotAg5Meas.MotAg5MeclRollgCntr.Val CDD_MotAg5Meas.MotAg5SinRtAmpRecpr.Val CDD_MotAg5Meas.MotAg5SinRtOffs.Val /end SUB_GROUP
 /begin FUNCTION_LIST /end FUNCTION_LIST
 /begin REF_CHARACTERISTIC /end REF_CHARACTERISTIC
 /begin REF_MEASUREMENT /end REF_MEASUREMENT
/end GROUP
/begin GROUP CDD_MotAg5Meas.dMotAg5MeasAmpVal "MICROSAR RTE" /begin SUB_GROUP /end SUB_GROUP /begin FUNCTION_LIST /end FUNCTION_LIST /begin REF_CHARACTERISTIC /end REF_CHARACTERISTIC /begin REF_MEASUREMENT CDD_MotAg5Meas.dMotAg5MeasAmpVal /end REF_MEASUREMENT /end GROUP
/begin GROUP CDD_MotAg6Meas "MICROSAR RTE"
 /begin SUB_GROUP CDD_MotAg6Meas.CalibrationPorts CDD_MotAg6Meas.PerInstanceMemories CDD_MotAg6Meas.ReceiverPorts CDD_MotAg6Meas.SenderPorts /end SUB_GROUP
 /begin FUNCTION_LIST /end FUNCTION_LIST
 /begin REF_CHARACTERISTIC /end REF_CHARACTERISTIC
 /begin REF_MEASUREMENT /end REF_MEASUREMENT
/end GROUP
/begin GROUP CDD_MotAg6Meas.CalibrationPorts "MICROSAR RTE"
 /begin SUB_GROUP CDD_MotAg6Meas.MotAg6MeasAmpSqdMaxThd.Val CDD_MotAg6Meas.MotAg6MeasAmpSqdMinThd.Val CDD_MotAg6Meas.MotAg6MeasLpFilFrq.Val CDD_MotAg6Meas.MotAg6MeasOffs.Val CDD_MotAg6Meas.MotAg6MeasRtAmpRecprLim.Val CDD_MotAg6Meas.MotAg6MeasRtFilEnaThd.Val CDD_MotAg6Meas.MotAg6MeasRtMotVelFilEnaThd.Val CDD_MotAg6Meas.MotAg6MeasRtOffsLim.Val CDD_MotAg6Meas.MotAg6MeasRtToNomRatLim.Val /end SUB_GROUP
 /begin FUNCTION_LIST /end FUNCTION_LIST
 /begin REF_CHARACTERISTIC /end REF_CHARACTERISTIC
 /begin REF_MEASUREMENT /end REF_MEASUREMENT
/end GROUP
/begin GROUP CDD_MotAg6Meas.MotAg6Cos.Val "MICROSAR RTE" /begin SUB_GROUP /end SUB_GROUP /begin FUNCTION_LIST /end FUNCTION_LIST /begin REF_CHARACTERISTIC /end REF_CHARACTERISTIC /begin REF_MEASUREMENT CDD_MotAg6Meas.MotAg6Cos.Val /end REF_MEASUREMENT /end GROUP
/begin GROUP CDD_MotAg6Meas.MotAg6CosAdcFaild.Logl "MICROSAR RTE" /begin SUB_GROUP /end SUB_GROUP /begin FUNCTION_LIST /end FUNCTION_LIST /begin REF_CHARACTERISTIC /end REF_CHARACTERISTIC /begin REF_MEASUREMENT CDD_MotAg6Meas.MotAg6CosAdcFaild.Logl /end REF_MEASUREMENT /end GROUP
/begin GROUP CDD_MotAg6Meas.MotAg6CosMaxLpFil "MICROSAR RTE" /begin SUB_GROUP /end SUB_GROUP /begin FUNCTION_LIST /end FUNCTION_LIST /begin REF_CHARACTERISTIC /end REF_CHARACTERISTIC
 /begin REF_MEASUREMENT CDD_MotAg6Meas.MotAg6CosMaxLpFil.FilGain CDD_MotAg6Meas.MotAg6CosMaxLpFil.FilSt /end REF_MEASUREMENT
/end GROUP
/begin GROUP CDD_MotAg6Meas.MotAg6CosMinLpFil "MICROSAR RTE" /begin SUB_GROUP /end SUB_GROUP /begin FUNCTION_LIST /end FUNCTION_LIST /begin REF_CHARACTERISTIC /end REF_CHARACTERISTIC
 /begin REF_MEASUREMENT CDD_MotAg6Meas.MotAg6CosMinLpFil.FilGain CDD_MotAg6Meas.MotAg6CosMinLpFil.FilSt /end REF_MEASUREMENT
/end GROUP
/begin GROUP CDD_MotAg6Meas.MotAg6CosRtAmpRecpr.Val "MICROSAR RTE" /begin SUB_GROUP /end SUB_GROUP /begin FUNCTION_LIST /end FUNCTION_LIST /begin REF_CHARACTERISTIC /end REF_CHARACTERISTIC /begin REF_MEASUREMENT CDD_MotAg6Meas.MotAg6CosRtAmpRecpr.Val /end REF_MEASUREMENT /end GROUP
/begin GROUP CDD_MotAg6Meas.MotAg6CosRtOffs.Val "MICROSAR RTE" /begin SUB_GROUP /end SUB_GROUP /begin FUNCTION_LIST /end FUNCTION_LIST /begin REF_CHARACTERISTIC /end REF_CHARACTERISTIC /begin REF_MEASUREMENT CDD_MotAg6Meas.MotAg6CosRtOffs.Val /end REF_MEASUREMENT /end GROUP
/begin GROUP CDD_MotAg6Meas.MotAg6EolPrm "MICROSAR RTE" /begin SUB_GROUP /end SUB_GROUP /begin FUNCTION_LIST /end FUNCTION_LIST /begin REF_CHARACTERISTIC /end REF_CHARACTERISTIC
 /begin REF_MEASUREMENT CDD_MotAg6Meas.MotAg6EolPrm.CosAmpRecpr CDD_MotAg6Meas.MotAg6EolPrm.CosDeltaRecpr CDD_MotAg6Meas.MotAg6EolPrm.CosGainCorrd CDD_MotAg6Meas.MotAg6EolPrm.CosHrmncTbl CDD_MotAg6Meas.MotAg6EolPrm.CosOffs CDD_MotAg6Meas.MotAg6EolPrm.CosOffsCorrd CDD_MotAg6Meas.MotAg6EolPrm.SinAmpRecpr CDD_MotAg6Meas.MotAg6EolPrm.SinDelta CDD_MotAg6Meas.MotAg6EolPrm.SinGainCorrd CDD_MotAg6Meas.MotAg6EolPrm.SinHrmncTbl CDD_MotAg6Meas.MotAg6EolPrm.SinOffs CDD_MotAg6Meas.MotAg6EolPrm.SinOffsCorrd /end REF_MEASUREMENT
/end GROUP
/begin GROUP CDD_MotAg6Meas.MotAg6MeasAmpSqdMaxThd.Val "MICROSAR RTE" /begin SUB_GROUP /end SUB_GROUP /begin FUNCTION_LIST /end FUNCTION_LIST /begin REF_CHARACTERISTIC CDD_MotAg6Meas.MotAg6MeasAmpSqdMaxThd.Val /end REF_CHARACTERISTIC /begin REF_MEASUREMENT /end REF_MEASUREMENT /end GROUP
/begin GROUP CDD_MotAg6Meas.MotAg6MeasAmpSqdMinThd.Val "MICROSAR RTE" /begin SUB_GROUP /end SUB_GROUP /begin FUNCTION_LIST /end FUNCTION_LIST /begin REF_CHARACTERISTIC CDD_MotAg6Meas.MotAg6MeasAmpSqdMinThd.Val /end REF_CHARACTERISTIC /begin REF_MEASUREMENT /end REF_MEASUREMENT /end GROUP
/begin GROUP CDD_MotAg6Meas.MotAg6MeasLpFilFrq.Val "MICROSAR RTE" /begin SUB_GROUP /end SUB_GROUP /begin FUNCTION_LIST /end FUNCTION_LIST /begin REF_CHARACTERISTIC CDD_MotAg6Meas.MotAg6MeasLpFilFrq.Val /end REF_CHARACTERISTIC /begin REF_MEASUREMENT /end REF_MEASUREMENT /end GROUP
/begin GROUP CDD_MotAg6Meas.MotAg6MeasOffs.Val "MICROSAR RTE" /begin SUB_GROUP /end SUB_GROUP /begin FUNCTION_LIST /end FUNCTION_LIST /begin REF_CHARACTERISTIC CDD_MotAg6Meas.MotAg6MeasOffs.Val /end REF_CHARACTERISTIC /begin REF_MEASUREMENT /end REF_MEASUREMENT /end GROUP
/begin GROUP CDD_MotAg6Meas.MotAg6MeasRtAmpRecprLim.Val "MICROSAR RTE" /begin SUB_GROUP /end SUB_GROUP /begin FUNCTION_LIST /end FUNCTION_LIST /begin REF_CHARACTERISTIC CDD_MotAg6Meas.MotAg6MeasRtAmpRecprLim.Val /end REF_CHARACTERISTIC /begin REF_MEASUREMENT /end REF_MEASUREMENT /end GROUP
/begin GROUP CDD_MotAg6Meas.MotAg6MeasRtFilEnaThd.Val "MICROSAR RTE" /begin SUB_GROUP /end SUB_GROUP /begin FUNCTION_LIST /end FUNCTION_LIST /begin REF_CHARACTERISTIC CDD_MotAg6Meas.MotAg6MeasRtFilEnaThd.Val /end REF_CHARACTERISTIC /begin REF_MEASUREMENT /end REF_MEASUREMENT /end GROUP
/begin GROUP CDD_MotAg6Meas.MotAg6MeasRtMotVelFilEnaThd.Val "MICROSAR RTE" /begin SUB_GROUP /end SUB_GROUP /begin FUNCTION_LIST /end FUNCTION_LIST /begin REF_CHARACTERISTIC CDD_MotAg6Meas.MotAg6MeasRtMotVelFilEnaThd.Val /end REF_CHARACTERISTIC /begin REF_MEASUREMENT /end REF_MEASUREMENT /end GROUP
/begin GROUP CDD_MotAg6Meas.MotAg6MeasRtOffsLim.Val "MICROSAR RTE" /begin SUB_GROUP /end SUB_GROUP /begin FUNCTION_LIST /end FUNCTION_LIST /begin REF_CHARACTERISTIC CDD_MotAg6Meas.MotAg6MeasRtOffsLim.Val /end REF_CHARACTERISTIC /begin REF_MEASUREMENT /end REF_MEASUREMENT /end GROUP
/begin GROUP CDD_MotAg6Meas.MotAg6MeasRtToNomRatLim.Val "MICROSAR RTE" /begin SUB_GROUP /end SUB_GROUP /begin FUNCTION_LIST /end FUNCTION_LIST /begin REF_CHARACTERISTIC CDD_MotAg6Meas.MotAg6MeasRtToNomRatLim.Val /end REF_CHARACTERISTIC /begin REF_MEASUREMENT /end REF_MEASUREMENT /end GROUP
/begin GROUP CDD_MotAg6Meas.MotAg6MeclQlfr.Val "MICROSAR RTE" /begin SUB_GROUP /end SUB_GROUP /begin FUNCTION_LIST /end FUNCTION_LIST /begin REF_CHARACTERISTIC /end REF_CHARACTERISTIC /begin REF_MEASUREMENT CDD_MotAg6Meas.MotAg6MeclQlfr.Val /end REF_MEASUREMENT /end GROUP
/begin GROUP CDD_MotAg6Meas.MotAg6MeclRollgCntr.Val "MICROSAR RTE" /begin SUB_GROUP /end SUB_GROUP /begin FUNCTION_LIST /end FUNCTION_LIST /begin REF_CHARACTERISTIC /end REF_CHARACTERISTIC /begin REF_MEASUREMENT CDD_MotAg6Meas.MotAg6MeclRollgCntr.Val /end REF_MEASUREMENT /end GROUP
/begin GROUP CDD_MotAg6Meas.MotAg6NvmFltEna "MICROSAR RTE" /begin SUB_GROUP /end SUB_GROUP /begin FUNCTION_LIST /end FUNCTION_LIST /begin REF_CHARACTERISTIC /end REF_CHARACTERISTIC /begin REF_MEASUREMENT CDD_MotAg6Meas.MotAg6NvmFltEna /end REF_MEASUREMENT /end GROUP
/begin GROUP CDD_MotAg6Meas.MotAg6PrevRollgCntr "MICROSAR RTE" /begin SUB_GROUP /end SUB_GROUP /begin FUNCTION_LIST /end FUNCTION_LIST /begin REF_CHARACTERISTIC /end REF_CHARACTERISTIC /begin REF_MEASUREMENT CDD_MotAg6Meas.MotAg6PrevRollgCntr /end REF_MEASUREMENT /end GROUP
/begin GROUP CDD_MotAg6Meas.MotAg6RawMecl.Val "MICROSAR RTE" /begin SUB_GROUP /end SUB_GROUP /begin FUNCTION_LIST /end FUNCTION_LIST /begin REF_CHARACTERISTIC /end REF_CHARACTERISTIC /begin REF_MEASUREMENT CDD_MotAg6Meas.MotAg6RawMecl.Val /end REF_MEASUREMENT /end GROUP
/begin GROUP CDD_MotAg6Meas.MotAg6RtPrm "MICROSAR RTE" /begin SUB_GROUP /end SUB_GROUP /begin FUNCTION_LIST /end FUNCTION_LIST /begin REF_CHARACTERISTIC /end REF_CHARACTERISTIC
 /begin REF_MEASUREMENT CDD_MotAg6Meas.MotAg6RtPrm.CosGainCorrd CDD_MotAg6Meas.MotAg6RtPrm.CosOffsCorrd CDD_MotAg6Meas.MotAg6RtPrm.CosRtAmpRecpr CDD_MotAg6Meas.MotAg6RtPrm.CosRtOffs CDD_MotAg6Meas.MotAg6RtPrm.CosSinNomRatio CDD_MotAg6Meas.MotAg6RtPrm.PrevCosRtOffs CDD_MotAg6Meas.MotAg6RtPrm.PrevSinRtOffs CDD_MotAg6Meas.MotAg6RtPrm.RtToNomRatioHiLim CDD_MotAg6Meas.MotAg6RtPrm.RtToNomRatioLoLim CDD_MotAg6Meas.MotAg6RtPrm.SinCosNomRatio CDD_MotAg6Meas.MotAg6RtPrm.SinGainCorrd CDD_MotAg6Meas.MotAg6RtPrm.SinOffsCorrd CDD_MotAg6Meas.MotAg6RtPrm.SinRtAmpRecpr CDD_MotAg6Meas.MotAg6RtPrm.SinRtOffs /end REF_MEASUREMENT
/end GROUP
/begin GROUP CDD_MotAg6Meas.MotAg6Sin.Val "MICROSAR RTE" /begin SUB_GROUP /end SUB_GROUP /begin FUNCTION_LIST /end FUNCTION_LIST /begin REF_CHARACTERISTIC /end REF_CHARACTERISTIC /begin REF_MEASUREMENT CDD_MotAg6Meas.MotAg6Sin.Val /end REF_MEASUREMENT /end GROUP
/begin GROUP CDD_MotAg6Meas.MotAg6SinAdcFaild.Logl "MICROSAR RTE" /begin SUB_GROUP /end SUB_GROUP /begin FUNCTION_LIST /end FUNCTION_LIST /begin REF_CHARACTERISTIC /end REF_CHARACTERISTIC /begin REF_MEASUREMENT CDD_MotAg6Meas.MotAg6SinAdcFaild.Logl /end REF_MEASUREMENT /end GROUP
/begin GROUP CDD_MotAg6Meas.MotAg6SinMaxLpFil "MICROSAR RTE" /begin SUB_GROUP /end SUB_GROUP /begin FUNCTION_LIST /end FUNCTION_LIST /begin REF_CHARACTERISTIC /end REF_CHARACTERISTIC
 /begin REF_MEASUREMENT CDD_MotAg6Meas.MotAg6SinMaxLpFil.FilGain CDD_MotAg6Meas.MotAg6SinMaxLpFil.FilSt /end REF_MEASUREMENT
/end GROUP
/begin GROUP CDD_MotAg6Meas.MotAg6SinMinLpFil "MICROSAR RTE" /begin SUB_GROUP /end SUB_GROUP /begin FUNCTION_LIST /end FUNCTION_LIST /begin REF_CHARACTERISTIC /end REF_CHARACTERISTIC
 /begin REF_MEASUREMENT CDD_MotAg6Meas.MotAg6SinMinLpFil.FilGain CDD_MotAg6Meas.MotAg6SinMinLpFil.FilSt /end REF_MEASUREMENT
/end GROUP
/begin GROUP CDD_MotAg6Meas.MotAg6SinRtAmpRecpr.Val "MICROSAR RTE" /begin SUB_GROUP /end SUB_GROUP /begin FUNCTION_LIST /end FUNCTION_LIST /begin REF_CHARACTERISTIC /end REF_CHARACTERISTIC /begin REF_MEASUREMENT CDD_MotAg6Meas.MotAg6SinRtAmpRecpr.Val /end REF_MEASUREMENT /end GROUP
/begin GROUP CDD_MotAg6Meas.MotAg6SinRtOffs.Val "MICROSAR RTE" /begin SUB_GROUP /end SUB_GROUP /begin FUNCTION_LIST /end FUNCTION_LIST /begin REF_CHARACTERISTIC /end REF_CHARACTERISTIC /begin REF_MEASUREMENT CDD_MotAg6Meas.MotAg6SinRtOffs.Val /end REF_MEASUREMENT /end GROUP
/begin GROUP CDD_MotAg6Meas.MotAg6StVari "MICROSAR RTE" /begin SUB_GROUP /end SUB_GROUP /begin FUNCTION_LIST /end FUNCTION_LIST /begin REF_CHARACTERISTIC /end REF_CHARACTERISTIC
 /begin REF_MEASUREMENT CDD_MotAg6Meas.MotAg6StVari.MotAgCosMax CDD_MotAg6Meas.MotAg6StVari.MotAgCosMin CDD_MotAg6Meas.MotAg6StVari.MotAgSinMax CDD_MotAg6Meas.MotAg6StVari.MotAgSinMin /end REF_MEASUREMENT
/end GROUP
/begin GROUP CDD_MotAg6Meas.MotVelMrf.Val "MICROSAR RTE" /begin SUB_GROUP /end SUB_GROUP /begin FUNCTION_LIST /end FUNCTION_LIST /begin REF_CHARACTERISTIC /end REF_CHARACTERISTIC /begin REF_MEASUREMENT CDD_MotAg6Meas.MotVelMrf.Val /end REF_MEASUREMENT /end GROUP
/begin GROUP CDD_MotAg6Meas.PerInstanceMemories "MICROSAR RTE"
 /begin SUB_GROUP CDD_MotAg6Meas.MotAg6CosMaxLpFil CDD_MotAg6Meas.MotAg6CosMinLpFil CDD_MotAg6Meas.MotAg6EolPrm CDD_MotAg6Meas.MotAg6NvmFltEna CDD_MotAg6Meas.MotAg6PrevRollgCntr CDD_MotAg6Meas.MotAg6RtPrm CDD_MotAg6Meas.MotAg6SinMaxLpFil CDD_MotAg6Meas.MotAg6SinMinLpFil CDD_MotAg6Meas.MotAg6StVari CDD_MotAg6Meas.PrevMotAg6Mecl CDD_MotAg6Meas.dMotAg6MeasAmpVal /end SUB_GROUP
 /begin FUNCTION_LIST /end FUNCTION_LIST
 /begin REF_CHARACTERISTIC /end REF_CHARACTERISTIC
 /begin REF_MEASUREMENT /end REF_MEASUREMENT
/end GROUP
/begin GROUP CDD_MotAg6Meas.PrevMotAg6Mecl "MICROSAR RTE" /begin SUB_GROUP /end SUB_GROUP /begin FUNCTION_LIST /end FUNCTION_LIST /begin REF_CHARACTERISTIC /end REF_CHARACTERISTIC /begin REF_MEASUREMENT CDD_MotAg6Meas.PrevMotAg6Mecl /end REF_MEASUREMENT /end GROUP
/begin GROUP CDD_MotAg6Meas.ReceiverPorts "MICROSAR RTE"
 /begin SUB_GROUP CDD_MotAg6Meas.MotAg6Cos.Val CDD_MotAg6Meas.MotAg6CosAdcFaild.Logl CDD_MotAg6Meas.MotAg6RawMecl.Val CDD_MotAg6Meas.MotAg6Sin.Val CDD_MotAg6Meas.MotAg6SinAdcFaild.Logl CDD_MotAg6Meas.MotVelMrf.Val /end SUB_GROUP
 /begin FUNCTION_LIST /end FUNCTION_LIST
 /begin REF_CHARACTERISTIC /end REF_CHARACTERISTIC
 /begin REF_MEASUREMENT /end REF_MEASUREMENT
/end GROUP
/begin GROUP CDD_MotAg6Meas.SenderPorts "MICROSAR RTE"
 /begin SUB_GROUP CDD_MotAg6Meas.MotAg6CosRtAmpRecpr.Val CDD_MotAg6Meas.MotAg6CosRtOffs.Val CDD_MotAg6Meas.MotAg6MeclQlfr.Val CDD_MotAg6Meas.MotAg6MeclRollgCntr.Val CDD_MotAg6Meas.MotAg6SinRtAmpRecpr.Val CDD_MotAg6Meas.MotAg6SinRtOffs.Val /end SUB_GROUP
 /begin FUNCTION_LIST /end FUNCTION_LIST
 /begin REF_CHARACTERISTIC /end REF_CHARACTERISTIC
 /begin REF_MEASUREMENT /end REF_MEASUREMENT
/end GROUP
/begin GROUP CDD_MotAg6Meas.dMotAg6MeasAmpVal "MICROSAR RTE" /begin SUB_GROUP /end SUB_GROUP /begin FUNCTION_LIST /end FUNCTION_LIST /begin REF_CHARACTERISTIC /end REF_CHARACTERISTIC /begin REF_MEASUREMENT CDD_MotAg6Meas.dMotAg6MeasAmpVal /end REF_MEASUREMENT /end GROUP
/begin GROUP CDD_MotAgArbn "MICROSAR RTE" /begin SUB_GROUP CDD_MotAgArbn.PerInstanceMemories /end SUB_GROUP /begin FUNCTION_LIST /end FUNCTION_LIST /begin REF_CHARACTERISTIC /end REF_CHARACTERISTIC /begin REF_MEASUREMENT /end REF_MEASUREMENT /end GROUP
/begin GROUP CDD_MotAgArbn.MotAgARollgCntPrev "MICROSAR RTE" /begin SUB_GROUP /end SUB_GROUP /begin FUNCTION_LIST /end FUNCTION_LIST /begin REF_CHARACTERISTIC /end REF_CHARACTERISTIC /begin REF_MEASUREMENT CDD_MotAgArbn.MotAgARollgCntPrev /end REF_MEASUREMENT /end GROUP
/begin GROUP CDD_MotAgArbn.MotAgAStallCntPrev "MICROSAR RTE" /begin SUB_GROUP /end SUB_GROUP /begin FUNCTION_LIST /end FUNCTION_LIST /begin REF_CHARACTERISTIC /end REF_CHARACTERISTIC /begin REF_MEASUREMENT CDD_MotAgArbn.MotAgAStallCntPrev /end REF_MEASUREMENT /end GROUP
/begin GROUP CDD_MotAgArbn.MotAgBRollgCntPrev "MICROSAR RTE" /begin SUB_GROUP /end SUB_GROUP /begin FUNCTION_LIST /end FUNCTION_LIST /begin REF_CHARACTERISTIC /end REF_CHARACTERISTIC /begin REF_MEASUREMENT CDD_MotAgArbn.MotAgBRollgCntPrev /end REF_MEASUREMENT /end GROUP
/begin GROUP CDD_MotAgArbn.MotAgBStallCntPrev "MICROSAR RTE" /begin SUB_GROUP /end SUB_GROUP /begin FUNCTION_LIST /end FUNCTION_LIST /begin REF_CHARACTERISTIC /end REF_CHARACTERISTIC /begin REF_MEASUREMENT CDD_MotAgArbn.MotAgBStallCntPrev /end REF_MEASUREMENT /end GROUP
/begin GROUP CDD_MotAgArbn.PerInstanceMemories "MICROSAR RTE"
 /begin SUB_GROUP CDD_MotAgArbn.MotAgARollgCntPrev CDD_MotAgArbn.MotAgAStallCntPrev CDD_MotAgArbn.MotAgBRollgCntPrev CDD_MotAgArbn.MotAgBStallCntPrev CDD_MotAgArbn.dMotAgArbnAAvl CDD_MotAgArbn.dMotAgArbnBAvl /end SUB_GROUP
 /begin FUNCTION_LIST /end FUNCTION_LIST
 /begin REF_CHARACTERISTIC /end REF_CHARACTERISTIC
 /begin REF_MEASUREMENT /end REF_MEASUREMENT
/end GROUP
/begin GROUP CDD_MotAgArbn.dMotAgArbnAAvl "MICROSAR RTE" /begin SUB_GROUP /end SUB_GROUP /begin FUNCTION_LIST /end FUNCTION_LIST /begin REF_CHARACTERISTIC /end REF_CHARACTERISTIC /begin REF_MEASUREMENT CDD_MotAgArbn.dMotAgArbnAAvl /end REF_MEASUREMENT /end GROUP
/begin GROUP CDD_MotAgArbn.dMotAgArbnBAvl "MICROSAR RTE" /begin SUB_GROUP /end SUB_GROUP /begin FUNCTION_LIST /end FUNCTION_LIST /begin REF_CHARACTERISTIC /end REF_CHARACTERISTIC /begin REF_MEASUREMENT CDD_MotAgArbn.dMotAgArbnBAvl /end REF_MEASUREMENT /end GROUP
/begin GROUP CDD_MotAgCmp "MICROSAR RTE"
 /begin SUB_GROUP CDD_MotAgCmp.CalibrationParameters CDD_MotAgCmp.CalibrationPorts CDD_MotAgCmp.PerInstanceMemories CDD_MotAgCmp.ReceiverPorts CDD_MotAgCmp.SenderPorts /end SUB_GROUP
 /begin FUNCTION_LIST /end FUNCTION_LIST
 /begin REF_CHARACTERISTIC /end REF_CHARACTERISTIC
 /begin REF_MEASUREMENT /end REF_MEASUREMENT
/end GROUP
/begin GROUP CDD_MotAgCmp.AssiMechPolarity.Val "MICROSAR RTE" /begin SUB_GROUP /end SUB_GROUP /begin FUNCTION_LIST /end FUNCTION_LIST /begin REF_CHARACTERISTIC /end REF_CHARACTERISTIC /begin REF_MEASUREMENT CDD_MotAgCmp.AssiMechPolarity.Val /end REF_MEASUREMENT /end GROUP
/begin GROUP CDD_MotAgCmp.CalibrationParameters "MICROSAR RTE" /begin SUB_GROUP CDD_MotAgCmp.MotAgCmpMotAgBackEmfDft /end SUB_GROUP /begin FUNCTION_LIST /end FUNCTION_LIST /begin REF_CHARACTERISTIC /end REF_CHARACTERISTIC /begin REF_MEASUREMENT /end REF_MEASUREMENT /end GROUP
/begin GROUP CDD_MotAgCmp.CalibrationPorts "MICROSAR RTE"
 /begin SUB_GROUP CDD_MotAgCmp.SysGlbPrmMotPoleCnt.Val CDD_MotAgCmp.SysGlbPrmSysKineRat.Val /end SUB_GROUP
 /begin FUNCTION_LIST /end FUNCTION_LIST
 /begin REF_CHARACTERISTIC /end REF_CHARACTERISTIC
 /begin REF_MEASUREMENT /end REF_MEASUREMENT
/end GROUP
/begin GROUP CDD_MotAgCmp.CmpEnaCntr "MICROSAR RTE" /begin SUB_GROUP /end SUB_GROUP /begin FUNCTION_LIST /end FUNCTION_LIST /begin REF_CHARACTERISTIC /end REF_CHARACTERISTIC /begin REF_MEASUREMENT CDD_MotAgCmp.CmpEnaCntr /end REF_MEASUREMENT /end GROUP
/begin GROUP CDD_MotAgCmp.DigMotHwPosn "MICROSAR RTE" /begin SUB_GROUP /end SUB_GROUP /begin FUNCTION_LIST /end FUNCTION_LIST /begin REF_CHARACTERISTIC /end REF_CHARACTERISTIC /begin REF_MEASUREMENT CDD_MotAgCmp.DigMotHwPosn /end REF_MEASUREMENT /end GROUP
/begin GROUP CDD_MotAgCmp.MotAgCmpMotAgBackEmf "MICROSAR RTE" /begin SUB_GROUP /end SUB_GROUP /begin FUNCTION_LIST /end FUNCTION_LIST /begin REF_CHARACTERISTIC /end REF_CHARACTERISTIC /begin REF_MEASUREMENT CDD_MotAgCmp.MotAgCmpMotAgBackEmf /end REF_MEASUREMENT /end GROUP
/begin GROUP CDD_MotAgCmp.MotAgCmpMotAgBackEmfDft "MICROSAR RTE" /begin SUB_GROUP /end SUB_GROUP /begin FUNCTION_LIST /end FUNCTION_LIST /begin REF_CHARACTERISTIC CDD_MotAgCmp.MotAgCmpMotAgBackEmfDft /end REF_CHARACTERISTIC /begin REF_MEASUREMENT /end REF_MEASUREMENT /end GROUP
/begin GROUP CDD_MotAgCmp.MotAgCmpMotCtrlMotAgCumvAlgndMrfRevSVPrev "MICROSAR RTE" /begin SUB_GROUP /end SUB_GROUP /begin FUNCTION_LIST /end FUNCTION_LIST /begin REF_CHARACTERISTIC /end REF_CHARACTERISTIC /begin REF_MEASUREMENT CDD_MotAgCmp.MotAgCmpMotCtrlMotAgCumvAlgndMrfRevSVPrev /end REF_MEASUREMENT /end GROUP
/begin GROUP CDD_MotAgCmp.MotAgCmpMotCtrlMotAgMeclPrev "MICROSAR RTE" /begin SUB_GROUP /end SUB_GROUP /begin FUNCTION_LIST /end FUNCTION_LIST /begin REF_CHARACTERISTIC /end REF_CHARACTERISTIC /begin REF_MEASUREMENT CDD_MotAgCmp.MotAgCmpMotCtrlMotAgMeclPrev /end REF_MEASUREMENT /end GROUP
/begin GROUP CDD_MotAgCmp.MotAgCumvAlgndCrf.Val "MICROSAR RTE" /begin SUB_GROUP /end SUB_GROUP /begin FUNCTION_LIST /end FUNCTION_LIST /begin REF_CHARACTERISTIC /end REF_CHARACTERISTIC /begin REF_MEASUREMENT CDD_MotAgCmp.MotAgCumvAlgndCrf.Val /end REF_MEASUREMENT /end GROUP
/begin GROUP CDD_MotAgCmp.MotAgCumvAlgndMrf.Val "MICROSAR RTE" /begin SUB_GROUP /end SUB_GROUP /begin FUNCTION_LIST /end FUNCTION_LIST /begin REF_CHARACTERISTIC /end REF_CHARACTERISTIC /begin REF_MEASUREMENT CDD_MotAgCmp.MotAgCumvAlgndMrf.Val /end REF_MEASUREMENT /end GROUP
/begin GROUP CDD_MotAgCmp.MotAgCumvAlgndMrfRev.Val "MICROSAR RTE" /begin SUB_GROUP /end SUB_GROUP /begin FUNCTION_LIST /end FUNCTION_LIST /begin REF_CHARACTERISTIC /end REF_CHARACTERISTIC /begin REF_MEASUREMENT CDD_MotAgCmp.MotAgCumvAlgndMrfRev.Val /end REF_MEASUREMENT /end GROUP
/begin GROUP CDD_MotAgCmp.MotAgCumvAlgndVld.Logl "MICROSAR RTE" /begin SUB_GROUP /end SUB_GROUP /begin FUNCTION_LIST /end FUNCTION_LIST /begin REF_CHARACTERISTIC /end REF_CHARACTERISTIC /begin REF_MEASUREMENT CDD_MotAgCmp.MotAgCumvAlgndVld.Logl /end REF_MEASUREMENT /end GROUP
/begin GROUP CDD_MotAgCmp.MotAgCumvInid.Logl "MICROSAR RTE" /begin SUB_GROUP /end SUB_GROUP /begin FUNCTION_LIST /end FUNCTION_LIST /begin REF_CHARACTERISTIC /end REF_CHARACTERISTIC /begin REF_MEASUREMENT CDD_MotAgCmp.MotAgCumvInid.Logl /end REF_MEASUREMENT /end GROUP
/begin GROUP CDD_MotAgCmp.PerInstanceMemories "MICROSAR RTE"
 /begin SUB_GROUP CDD_MotAgCmp.CmpEnaCntr CDD_MotAgCmp.DigMotHwPosn CDD_MotAgCmp.MotAgCmpMotAgBackEmf CDD_MotAgCmp.MotAgCmpMotCtrlMotAgCumvAlgndMrfRevSVPrev CDD_MotAgCmp.MotAgCmpMotCtrlMotAgMeclPrev /end SUB_GROUP
 /begin FUNCTION_LIST /end FUNCTION_LIST
 /begin REF_CHARACTERISTIC /end REF_CHARACTERISTIC
 /begin REF_MEASUREMENT /end REF_MEASUREMENT
/end GROUP
/begin GROUP CDD_MotAgCmp.ReceiverPorts "MICROSAR RTE"
 /begin SUB_GROUP CDD_MotAgCmp.AssiMechPolarity.Val CDD_MotAgCmp.MotAgCumvAlgndMrfRev.Val CDD_MotAgCmp.MotAgCumvInid.Logl /end SUB_GROUP
 /begin FUNCTION_LIST /end FUNCTION_LIST
 /begin REF_CHARACTERISTIC /end REF_CHARACTERISTIC
 /begin REF_MEASUREMENT /end REF_MEASUREMENT
/end GROUP
/begin GROUP CDD_MotAgCmp.SenderPorts "MICROSAR RTE"
 /begin SUB_GROUP CDD_MotAgCmp.MotAgCumvAlgndCrf.Val CDD_MotAgCmp.MotAgCumvAlgndMrf.Val CDD_MotAgCmp.MotAgCumvAlgndVld.Logl /end SUB_GROUP
 /begin FUNCTION_LIST /end FUNCTION_LIST
 /begin REF_CHARACTERISTIC /end REF_CHARACTERISTIC
 /begin REF_MEASUREMENT /end REF_MEASUREMENT
/end GROUP
/begin GROUP CDD_MotAgCmp.SysGlbPrmMotPoleCnt.Val "MICROSAR RTE" /begin SUB_GROUP /end SUB_GROUP /begin FUNCTION_LIST /end FUNCTION_LIST /begin REF_CHARACTERISTIC CDD_MotAgCmp.SysGlbPrmMotPoleCnt.Val /end REF_CHARACTERISTIC /begin REF_MEASUREMENT /end REF_MEASUREMENT /end GROUP
/begin GROUP CDD_MotAgCmp.SysGlbPrmSysKineRat.Val "MICROSAR RTE" /begin SUB_GROUP /end SUB_GROUP /begin FUNCTION_LIST /end FUNCTION_LIST /begin REF_CHARACTERISTIC CDD_MotAgCmp.SysGlbPrmSysKineRat.Val /end REF_CHARACTERISTIC /begin REF_MEASUREMENT /end REF_MEASUREMENT /end GROUP
/begin GROUP CDD_MotAgSwCal "MICROSAR RTE"
 /begin SUB_GROUP CDD_MotAgSwCal.CalibrationPorts CDD_MotAgSwCal.PerInstanceMemories /end SUB_GROUP
 /begin FUNCTION_LIST /end FUNCTION_LIST
 /begin REF_CHARACTERISTIC /end REF_CHARACTERISTIC
 /begin REF_MEASUREMENT /end REF_MEASUREMENT
/end GROUP
/begin GROUP CDD_MotAgSwCal.BoostModlnIdx "MICROSAR RTE" /begin SUB_GROUP /end SUB_GROUP /begin FUNCTION_LIST /end FUNCTION_LIST /begin REF_CHARACTERISTIC /end REF_CHARACTERISTIC /begin REF_MEASUREMENT CDD_MotAgSwCal.BoostModlnIdx /end REF_MEASUREMENT /end GROUP
/begin GROUP CDD_MotAgSwCal.BoostSlew "MICROSAR RTE" /begin SUB_GROUP /end SUB_GROUP /begin FUNCTION_LIST /end FUNCTION_LIST /begin REF_CHARACTERISTIC /end REF_CHARACTERISTIC /begin REF_MEASUREMENT CDD_MotAgSwCal.BoostSlew /end REF_MEASUREMENT /end GROUP
/begin GROUP CDD_MotAgSwCal.BoostTi "MICROSAR RTE" /begin SUB_GROUP /end SUB_GROUP /begin FUNCTION_LIST /end FUNCTION_LIST /begin REF_CHARACTERISTIC /end REF_CHARACTERISTIC /begin REF_MEASUREMENT CDD_MotAgSwCal.BoostTi /end REF_MEASUREMENT /end GROUP
/begin GROUP CDD_MotAgSwCal.BoostTiOut "MICROSAR RTE" /begin SUB_GROUP /end SUB_GROUP /begin FUNCTION_LIST /end FUNCTION_LIST /begin REF_CHARACTERISTIC /end REF_CHARACTERISTIC /begin REF_MEASUREMENT CDD_MotAgSwCal.BoostTiOut /end REF_MEASUREMENT /end GROUP
/begin GROUP CDD_MotAgSwCal.CalibrationPorts "MICROSAR RTE" /begin SUB_GROUP CDD_MotAgSwCal.MotAgSwCalVehSpdThd.Val /end SUB_GROUP /begin FUNCTION_LIST /end FUNCTION_LIST /begin REF_CHARACTERISTIC /end REF_CHARACTERISTIC /begin REF_MEASUREMENT /end REF_MEASUREMENT /end GROUP
/begin GROUP CDD_MotAgSwCal.CoolDwnModlnIdx "MICROSAR RTE" /begin SUB_GROUP /end SUB_GROUP /begin FUNCTION_LIST /end FUNCTION_LIST /begin REF_CHARACTERISTIC /end REF_CHARACTERISTIC /begin REF_MEASUREMENT CDD_MotAgSwCal.CoolDwnModlnIdx /end REF_MEASUREMENT /end GROUP
/begin GROUP CDD_MotAgSwCal.CoolDwnSlew "MICROSAR RTE" /begin SUB_GROUP /end SUB_GROUP /begin FUNCTION_LIST /end FUNCTION_LIST /begin REF_CHARACTERISTIC /end REF_CHARACTERISTIC /begin REF_MEASUREMENT CDD_MotAgSwCal.CoolDwnSlew /end REF_MEASUREMENT /end GROUP
/begin GROUP CDD_MotAgSwCal.CoolDwnTi "MICROSAR RTE" /begin SUB_GROUP /end SUB_GROUP /begin FUNCTION_LIST /end FUNCTION_LIST /begin REF_CHARACTERISTIC /end REF_CHARACTERISTIC /begin REF_MEASUREMENT CDD_MotAgSwCal.CoolDwnTi /end REF_MEASUREMENT /end GROUP
/begin GROUP CDD_MotAgSwCal.CoolDwnTiOut "MICROSAR RTE" /begin SUB_GROUP /end SUB_GROUP /begin FUNCTION_LIST /end FUNCTION_LIST /begin REF_CHARACTERISTIC /end REF_CHARACTERISTIC /begin REF_MEASUREMENT CDD_MotAgSwCal.CoolDwnTiOut /end REF_MEASUREMENT /end GROUP
/begin GROUP CDD_MotAgSwCal.ElecRevCnt "MICROSAR RTE" /begin SUB_GROUP /end SUB_GROUP /begin FUNCTION_LIST /end FUNCTION_LIST /begin REF_CHARACTERISTIC /end REF_CHARACTERISTIC /begin REF_MEASUREMENT CDD_MotAgSwCal.ElecRevCnt /end REF_MEASUREMENT /end GROUP
/begin GROUP CDD_MotAgSwCal.HldModlnIdx "MICROSAR RTE" /begin SUB_GROUP /end SUB_GROUP /begin FUNCTION_LIST /end FUNCTION_LIST /begin REF_CHARACTERISTIC /end REF_CHARACTERISTIC /begin REF_MEASUREMENT CDD_MotAgSwCal.HldModlnIdx /end REF_MEASUREMENT /end GROUP
/begin GROUP CDD_MotAgSwCal.HldSlew "MICROSAR RTE" /begin SUB_GROUP /end SUB_GROUP /begin FUNCTION_LIST /end FUNCTION_LIST /begin REF_CHARACTERISTIC /end REF_CHARACTERISTIC /begin REF_MEASUREMENT CDD_MotAgSwCal.HldSlew /end REF_MEASUREMENT /end GROUP
/begin GROUP CDD_MotAgSwCal.HldTi "MICROSAR RTE" /begin SUB_GROUP /end SUB_GROUP /begin FUNCTION_LIST /end FUNCTION_LIST /begin REF_CHARACTERISTIC /end REF_CHARACTERISTIC /begin REF_MEASUREMENT CDD_MotAgSwCal.HldTi /end REF_MEASUREMENT /end GROUP
/begin GROUP CDD_MotAgSwCal.HldTiOut "MICROSAR RTE" /begin SUB_GROUP /end SUB_GROUP /begin FUNCTION_LIST /end FUNCTION_LIST /begin REF_CHARACTERISTIC /end REF_CHARACTERISTIC /begin REF_MEASUREMENT CDD_MotAgSwCal.HldTiOut /end REF_MEASUREMENT /end GROUP
/begin GROUP CDD_MotAgSwCal.MotAg2CosAdcFaildCntr "MICROSAR RTE" /begin SUB_GROUP /end SUB_GROUP /begin FUNCTION_LIST /end FUNCTION_LIST /begin REF_CHARACTERISTIC /end REF_CHARACTERISTIC /begin REF_MEASUREMENT CDD_MotAgSwCal.MotAg2CosAdcFaildCntr /end REF_MEASUREMENT /end GROUP
/begin GROUP CDD_MotAgSwCal.MotAg2CosMeasAvrg "MICROSAR RTE" /begin SUB_GROUP /end SUB_GROUP /begin FUNCTION_LIST /end FUNCTION_LIST /begin REF_CHARACTERISTIC /end REF_CHARACTERISTIC /begin REF_MEASUREMENT CDD_MotAgSwCal.MotAg2CosMeasAvrg /end REF_MEASUREMENT /end GROUP
/begin GROUP CDD_MotAgSwCal.MotAg2CosMeasRaw "MICROSAR RTE" /begin SUB_GROUP /end SUB_GROUP /begin FUNCTION_LIST /end FUNCTION_LIST /begin REF_CHARACTERISTIC /end REF_CHARACTERISTIC /begin REF_MEASUREMENT CDD_MotAgSwCal.MotAg2CosMeasRaw /end REF_MEASUREMENT /end GROUP
/begin GROUP CDD_MotAgSwCal.MotAg2CosMeasRawCumv "MICROSAR RTE" /begin SUB_GROUP /end SUB_GROUP /begin FUNCTION_LIST /end FUNCTION_LIST /begin REF_CHARACTERISTIC /end REF_CHARACTERISTIC /begin REF_MEASUREMENT CDD_MotAgSwCal.MotAg2CosMeasRawCumv /end REF_MEASUREMENT /end GROUP
/begin GROUP CDD_MotAgSwCal.MotAg2CosMeasRawPrev "MICROSAR RTE" /begin SUB_GROUP /end SUB_GROUP /begin FUNCTION_LIST /end FUNCTION_LIST /begin REF_CHARACTERISTIC /end REF_CHARACTERISTIC /begin REF_MEASUREMENT CDD_MotAgSwCal.MotAg2CosMeasRawPrev /end REF_MEASUREMENT /end GROUP
/begin GROUP CDD_MotAgSwCal.MotAg2SinAdcFaildCntr "MICROSAR RTE" /begin SUB_GROUP /end SUB_GROUP /begin FUNCTION_LIST /end FUNCTION_LIST /begin REF_CHARACTERISTIC /end REF_CHARACTERISTIC /begin REF_MEASUREMENT CDD_MotAgSwCal.MotAg2SinAdcFaildCntr /end REF_MEASUREMENT /end GROUP
/begin GROUP CDD_MotAgSwCal.MotAg2SinMeasAvrg "MICROSAR RTE" /begin SUB_GROUP /end SUB_GROUP /begin FUNCTION_LIST /end FUNCTION_LIST /begin REF_CHARACTERISTIC /end REF_CHARACTERISTIC /begin REF_MEASUREMENT CDD_MotAgSwCal.MotAg2SinMeasAvrg /end REF_MEASUREMENT /end GROUP
/begin GROUP CDD_MotAgSwCal.MotAg2SinMeasRaw "MICROSAR RTE" /begin SUB_GROUP /end SUB_GROUP /begin FUNCTION_LIST /end FUNCTION_LIST /begin REF_CHARACTERISTIC /end REF_CHARACTERISTIC /begin REF_MEASUREMENT CDD_MotAgSwCal.MotAg2SinMeasRaw /end REF_MEASUREMENT /end GROUP
/begin GROUP CDD_MotAgSwCal.MotAg2SinMeasRawCumv "MICROSAR RTE" /begin SUB_GROUP /end SUB_GROUP /begin FUNCTION_LIST /end FUNCTION_LIST /begin REF_CHARACTERISTIC /end REF_CHARACTERISTIC /begin REF_MEASUREMENT CDD_MotAgSwCal.MotAg2SinMeasRawCumv /end REF_MEASUREMENT /end GROUP
/begin GROUP CDD_MotAgSwCal.MotAg2SinMeasRawPrev "MICROSAR RTE" /begin SUB_GROUP /end SUB_GROUP /begin FUNCTION_LIST /end FUNCTION_LIST /begin REF_CHARACTERISTIC /end REF_CHARACTERISTIC /begin REF_MEASUREMENT CDD_MotAgSwCal.MotAg2SinMeasRawPrev /end REF_MEASUREMENT /end GROUP
/begin GROUP CDD_MotAgSwCal.MotAg5CosAdcFaildCntr "MICROSAR RTE" /begin SUB_GROUP /end SUB_GROUP /begin FUNCTION_LIST /end FUNCTION_LIST /begin REF_CHARACTERISTIC /end REF_CHARACTERISTIC /begin REF_MEASUREMENT CDD_MotAgSwCal.MotAg5CosAdcFaildCntr /end REF_MEASUREMENT /end GROUP
/begin GROUP CDD_MotAgSwCal.MotAg5CosMeasAvrg "MICROSAR RTE" /begin SUB_GROUP /end SUB_GROUP /begin FUNCTION_LIST /end FUNCTION_LIST /begin REF_CHARACTERISTIC /end REF_CHARACTERISTIC /begin REF_MEASUREMENT CDD_MotAgSwCal.MotAg5CosMeasAvrg /end REF_MEASUREMENT /end GROUP
/begin GROUP CDD_MotAgSwCal.MotAg5CosMeasRaw "MICROSAR RTE" /begin SUB_GROUP /end SUB_GROUP /begin FUNCTION_LIST /end FUNCTION_LIST /begin REF_CHARACTERISTIC /end REF_CHARACTERISTIC /begin REF_MEASUREMENT CDD_MotAgSwCal.MotAg5CosMeasRaw /end REF_MEASUREMENT /end GROUP
/begin GROUP CDD_MotAgSwCal.MotAg5CosMeasRawCumv "MICROSAR RTE" /begin SUB_GROUP /end SUB_GROUP /begin FUNCTION_LIST /end FUNCTION_LIST /begin REF_CHARACTERISTIC /end REF_CHARACTERISTIC /begin REF_MEASUREMENT CDD_MotAgSwCal.MotAg5CosMeasRawCumv /end REF_MEASUREMENT /end GROUP
/begin GROUP CDD_MotAgSwCal.MotAg5CosMeasRawPrev "MICROSAR RTE" /begin SUB_GROUP /end SUB_GROUP /begin FUNCTION_LIST /end FUNCTION_LIST /begin REF_CHARACTERISTIC /end REF_CHARACTERISTIC /begin REF_MEASUREMENT CDD_MotAgSwCal.MotAg5CosMeasRawPrev /end REF_MEASUREMENT /end GROUP
/begin GROUP CDD_MotAgSwCal.MotAg5SinAdcFaildCntr "MICROSAR RTE" /begin SUB_GROUP /end SUB_GROUP /begin FUNCTION_LIST /end FUNCTION_LIST /begin REF_CHARACTERISTIC /end REF_CHARACTERISTIC /begin REF_MEASUREMENT CDD_MotAgSwCal.MotAg5SinAdcFaildCntr /end REF_MEASUREMENT /end GROUP
/begin GROUP CDD_MotAgSwCal.MotAg5SinMeasAvrg "MICROSAR RTE" /begin SUB_GROUP /end SUB_GROUP /begin FUNCTION_LIST /end FUNCTION_LIST /begin REF_CHARACTERISTIC /end REF_CHARACTERISTIC /begin REF_MEASUREMENT CDD_MotAgSwCal.MotAg5SinMeasAvrg /end REF_MEASUREMENT /end GROUP
/begin GROUP CDD_MotAgSwCal.MotAg5SinMeasRaw "MICROSAR RTE" /begin SUB_GROUP /end SUB_GROUP /begin FUNCTION_LIST /end FUNCTION_LIST /begin REF_CHARACTERISTIC /end REF_CHARACTERISTIC /begin REF_MEASUREMENT CDD_MotAgSwCal.MotAg5SinMeasRaw /end REF_MEASUREMENT /end GROUP
/begin GROUP CDD_MotAgSwCal.MotAg5SinMeasRawCumv "MICROSAR RTE" /begin SUB_GROUP /end SUB_GROUP /begin FUNCTION_LIST /end FUNCTION_LIST /begin REF_CHARACTERISTIC /end REF_CHARACTERISTIC /begin REF_MEASUREMENT CDD_MotAgSwCal.MotAg5SinMeasRawCumv /end REF_MEASUREMENT /end GROUP
/begin GROUP CDD_MotAgSwCal.MotAg5SinMeasRawPrev "MICROSAR RTE" /begin SUB_GROUP /end SUB_GROUP /begin FUNCTION_LIST /end FUNCTION_LIST /begin REF_CHARACTERISTIC /end REF_CHARACTERISTIC /begin REF_MEASUREMENT CDD_MotAgSwCal.MotAg5SinMeasRawPrev /end REF_MEASUREMENT /end GROUP
/begin GROUP CDD_MotAgSwCal.MotAg6CosAdcFaildCntr "MICROSAR RTE" /begin SUB_GROUP /end SUB_GROUP /begin FUNCTION_LIST /end FUNCTION_LIST /begin REF_CHARACTERISTIC /end REF_CHARACTERISTIC /begin REF_MEASUREMENT CDD_MotAgSwCal.MotAg6CosAdcFaildCntr /end REF_MEASUREMENT /end GROUP
/begin GROUP CDD_MotAgSwCal.MotAg6CosMeasAvrg "MICROSAR RTE" /begin SUB_GROUP /end SUB_GROUP /begin FUNCTION_LIST /end FUNCTION_LIST /begin REF_CHARACTERISTIC /end REF_CHARACTERISTIC /begin REF_MEASUREMENT CDD_MotAgSwCal.MotAg6CosMeasAvrg /end REF_MEASUREMENT /end GROUP
/begin GROUP CDD_MotAgSwCal.MotAg6CosMeasRaw "MICROSAR RTE" /begin SUB_GROUP /end SUB_GROUP /begin FUNCTION_LIST /end FUNCTION_LIST /begin REF_CHARACTERISTIC /end REF_CHARACTERISTIC /begin REF_MEASUREMENT CDD_MotAgSwCal.MotAg6CosMeasRaw /end REF_MEASUREMENT /end GROUP
/begin GROUP CDD_MotAgSwCal.MotAg6CosMeasRawCumv "MICROSAR RTE" /begin SUB_GROUP /end SUB_GROUP /begin FUNCTION_LIST /end FUNCTION_LIST /begin REF_CHARACTERISTIC /end REF_CHARACTERISTIC /begin REF_MEASUREMENT CDD_MotAgSwCal.MotAg6CosMeasRawCumv /end REF_MEASUREMENT /end GROUP
/begin GROUP CDD_MotAgSwCal.MotAg6CosMeasRawPrev "MICROSAR RTE" /begin SUB_GROUP /end SUB_GROUP /begin FUNCTION_LIST /end FUNCTION_LIST /begin REF_CHARACTERISTIC /end REF_CHARACTERISTIC /begin REF_MEASUREMENT CDD_MotAgSwCal.MotAg6CosMeasRawPrev /end REF_MEASUREMENT /end GROUP
/begin GROUP CDD_MotAgSwCal.MotAg6SinAdcFaildCntr "MICROSAR RTE" /begin SUB_GROUP /end SUB_GROUP /begin FUNCTION_LIST /end FUNCTION_LIST /begin REF_CHARACTERISTIC /end REF_CHARACTERISTIC /begin REF_MEASUREMENT CDD_MotAgSwCal.MotAg6SinAdcFaildCntr /end REF_MEASUREMENT /end GROUP
/begin GROUP CDD_MotAgSwCal.MotAg6SinMeasAvrg "MICROSAR RTE" /begin SUB_GROUP /end SUB_GROUP /begin FUNCTION_LIST /end FUNCTION_LIST /begin REF_CHARACTERISTIC /end REF_CHARACTERISTIC /begin REF_MEASUREMENT CDD_MotAgSwCal.MotAg6SinMeasAvrg /end REF_MEASUREMENT /end GROUP
/begin GROUP CDD_MotAgSwCal.MotAg6SinMeasRaw "MICROSAR RTE" /begin SUB_GROUP /end SUB_GROUP /begin FUNCTION_LIST /end FUNCTION_LIST /begin REF_CHARACTERISTIC /end REF_CHARACTERISTIC /begin REF_MEASUREMENT CDD_MotAgSwCal.MotAg6SinMeasRaw /end REF_MEASUREMENT /end GROUP
/begin GROUP CDD_MotAgSwCal.MotAg6SinMeasRawCumv "MICROSAR RTE" /begin SUB_GROUP /end SUB_GROUP /begin FUNCTION_LIST /end FUNCTION_LIST /begin REF_CHARACTERISTIC /end REF_CHARACTERISTIC /begin REF_MEASUREMENT CDD_MotAgSwCal.MotAg6SinMeasRawCumv /end REF_MEASUREMENT /end GROUP
/begin GROUP CDD_MotAgSwCal.MotAg6SinMeasRawPrev "MICROSAR RTE" /begin SUB_GROUP /end SUB_GROUP /begin FUNCTION_LIST /end FUNCTION_LIST /begin REF_CHARACTERISTIC /end REF_CHARACTERISTIC /begin REF_MEASUREMENT CDD_MotAgSwCal.MotAg6SinMeasRawPrev /end REF_MEASUREMENT /end GROUP
/begin GROUP CDD_MotAgSwCal.MotAgSwCalVehSpdThd.Val "MICROSAR RTE" /begin SUB_GROUP /end SUB_GROUP /begin FUNCTION_LIST /end FUNCTION_LIST /begin REF_CHARACTERISTIC CDD_MotAgSwCal.MotAgSwCalVehSpdThd.Val /end REF_CHARACTERISTIC /begin REF_MEASUREMENT /end REF_MEASUREMENT /end GROUP
/begin GROUP CDD_MotAgSwCal.PerInstanceMemories "MICROSAR RTE"
 /begin SUB_GROUP CDD_MotAgSwCal.BoostModlnIdx CDD_MotAgSwCal.BoostSlew CDD_MotAgSwCal.BoostTi CDD_MotAgSwCal.BoostTiOut CDD_MotAgSwCal.CoolDwnModlnIdx CDD_MotAgSwCal.CoolDwnSlew CDD_MotAgSwCal.CoolDwnTi CDD_MotAgSwCal.CoolDwnTiOut CDD_MotAgSwCal.ElecRevCnt CDD_MotAgSwCal.HldModlnIdx CDD_MotAgSwCal.HldSlew CDD_MotAgSwCal.HldTi CDD_MotAgSwCal.HldTiOut CDD_MotAgSwCal.MotAg2CosAdcFaildCntr CDD_MotAgSwCal.MotAg2CosMeasAvrg CDD_MotAgSwCal.MotAg2CosMeasRaw CDD_MotAgSwCal.MotAg2CosMeasRawCumv CDD_MotAgSwCal.MotAg2CosMeasRawPrev CDD_MotAgSwCal.MotAg2SinAdcFaildCntr CDD_MotAgSwCal.MotAg2SinMeasAvrg CDD_MotAgSwCal.MotAg2SinMeasRaw CDD_MotAgSwCal.MotAg2SinMeasRawCumv CDD_MotAgSwCal.MotAg2SinMeasRawPrev CDD_MotAgSwCal.MotAg5CosAdcFaildCntr CDD_MotAgSwCal.MotAg5CosMeasAvrg CDD_MotAgSwCal.MotAg5CosMeasRaw CDD_MotAgSwCal.MotAg5CosMeasRawCumv CDD_MotAgSwCal.MotAg5CosMeasRawPrev CDD_MotAgSwCal.MotAg5SinAdcFaildCntr CDD_MotAgSwCal.MotAg5SinMeasAvrg CDD_MotAgSwCal.MotAg5SinMeasRaw CDD_MotAgSwCal.MotAg5SinMeasRawCumv CDD_MotAgSwCal.MotAg5SinMeasRawPrev CDD_MotAgSwCal.MotAg6CosAdcFaildCntr CDD_MotAgSwCal.MotAg6CosMeasAvrg CDD_MotAgSwCal.MotAg6CosMeasRaw CDD_MotAgSwCal.MotAg6CosMeasRawCumv CDD_MotAgSwCal.MotAg6CosMeasRawPrev CDD_MotAgSwCal.MotAg6SinAdcFaildCntr CDD_MotAgSwCal.MotAg6SinMeasAvrg CDD_MotAgSwCal.MotAg6SinMeasRaw CDD_MotAgSwCal.MotAg6SinMeasRawCumv CDD_MotAgSwCal.MotAg6SinMeasRawPrev CDD_MotAgSwCal.PosnIdx CDD_MotAgSwCal.PosnStepSize CDD_MotAgSwCal.Ramp1Ti CDD_MotAgSwCal.Ramp2Ti CDD_MotAgSwCal.Ramp3Ti CDD_MotAgSwCal.SampleIdx CDD_MotAgSwCal.SamplePosnIdx CDD_MotAgSwCal.SampleRdyFlg CDD_MotAgSwCal.SampleStopTi CDD_MotAgSwCal.SampleStrtTi CDD_MotAgSwCal.SwCalCycTi CDD_MotAgSwCal.SwCalEna CDD_MotAgSwCal.SwCalMotModlnIdx CDD_MotAgSwCal.SwCalStepDir /end SUB_GROUP
 /begin FUNCTION_LIST /end FUNCTION_LIST
 /begin REF_CHARACTERISTIC /end REF_CHARACTERISTIC
 /begin REF_MEASUREMENT /end REF_MEASUREMENT
/end GROUP
/begin GROUP CDD_MotAgSwCal.PosnIdx "MICROSAR RTE" /begin SUB_GROUP /end SUB_GROUP /begin FUNCTION_LIST /end FUNCTION_LIST /begin REF_CHARACTERISTIC /end REF_CHARACTERISTIC /begin REF_MEASUREMENT CDD_MotAgSwCal.PosnIdx /end REF_MEASUREMENT /end GROUP
/begin GROUP CDD_MotAgSwCal.PosnStepSize "MICROSAR RTE" /begin SUB_GROUP /end SUB_GROUP /begin FUNCTION_LIST /end FUNCTION_LIST /begin REF_CHARACTERISTIC /end REF_CHARACTERISTIC /begin REF_MEASUREMENT CDD_MotAgSwCal.PosnStepSize /end REF_MEASUREMENT /end GROUP
/begin GROUP CDD_MotAgSwCal.Ramp1Ti "MICROSAR RTE" /begin SUB_GROUP /end SUB_GROUP /begin FUNCTION_LIST /end FUNCTION_LIST /begin REF_CHARACTERISTIC /end REF_CHARACTERISTIC /begin REF_MEASUREMENT CDD_MotAgSwCal.Ramp1Ti /end REF_MEASUREMENT /end GROUP
/begin GROUP CDD_MotAgSwCal.Ramp2Ti "MICROSAR RTE" /begin SUB_GROUP /end SUB_GROUP /begin FUNCTION_LIST /end FUNCTION_LIST /begin REF_CHARACTERISTIC /end REF_CHARACTERISTIC /begin REF_MEASUREMENT CDD_MotAgSwCal.Ramp2Ti /end REF_MEASUREMENT /end GROUP
/begin GROUP CDD_MotAgSwCal.Ramp3Ti "MICROSAR RTE" /begin SUB_GROUP /end SUB_GROUP /begin FUNCTION_LIST /end FUNCTION_LIST /begin REF_CHARACTERISTIC /end REF_CHARACTERISTIC /begin REF_MEASUREMENT CDD_MotAgSwCal.Ramp3Ti /end REF_MEASUREMENT /end GROUP
/begin GROUP CDD_MotAgSwCal.SampleIdx "MICROSAR RTE" /begin SUB_GROUP /end SUB_GROUP /begin FUNCTION_LIST /end FUNCTION_LIST /begin REF_CHARACTERISTIC /end REF_CHARACTERISTIC /begin REF_MEASUREMENT CDD_MotAgSwCal.SampleIdx /end REF_MEASUREMENT /end GROUP
/begin GROUP CDD_MotAgSwCal.SamplePosnIdx "MICROSAR RTE" /begin SUB_GROUP /end SUB_GROUP /begin FUNCTION_LIST /end FUNCTION_LIST /begin REF_CHARACTERISTIC /end REF_CHARACTERISTIC /begin REF_MEASUREMENT CDD_MotAgSwCal.SamplePosnIdx /end REF_MEASUREMENT /end GROUP
/begin GROUP CDD_MotAgSwCal.SampleRdyFlg "MICROSAR RTE" /begin SUB_GROUP /end SUB_GROUP /begin FUNCTION_LIST /end FUNCTION_LIST /begin REF_CHARACTERISTIC /end REF_CHARACTERISTIC /begin REF_MEASUREMENT CDD_MotAgSwCal.SampleRdyFlg /end REF_MEASUREMENT /end GROUP
/begin GROUP CDD_MotAgSwCal.SampleStopTi "MICROSAR RTE" /begin SUB_GROUP /end SUB_GROUP /begin FUNCTION_LIST /end FUNCTION_LIST /begin REF_CHARACTERISTIC /end REF_CHARACTERISTIC /begin REF_MEASUREMENT CDD_MotAgSwCal.SampleStopTi /end REF_MEASUREMENT /end GROUP
/begin GROUP CDD_MotAgSwCal.SampleStrtTi "MICROSAR RTE" /begin SUB_GROUP /end SUB_GROUP /begin FUNCTION_LIST /end FUNCTION_LIST /begin REF_CHARACTERISTIC /end REF_CHARACTERISTIC /begin REF_MEASUREMENT CDD_MotAgSwCal.SampleStrtTi /end REF_MEASUREMENT /end GROUP
/begin GROUP CDD_MotAgSwCal.SwCalCycTi "MICROSAR RTE" /begin SUB_GROUP /end SUB_GROUP /begin FUNCTION_LIST /end FUNCTION_LIST /begin REF_CHARACTERISTIC /end REF_CHARACTERISTIC /begin REF_MEASUREMENT CDD_MotAgSwCal.SwCalCycTi /end REF_MEASUREMENT /end GROUP
/begin GROUP CDD_MotAgSwCal.SwCalEna "MICROSAR RTE" /begin SUB_GROUP /end SUB_GROUP /begin FUNCTION_LIST /end FUNCTION_LIST /begin REF_CHARACTERISTIC /end REF_CHARACTERISTIC /begin REF_MEASUREMENT CDD_MotAgSwCal.SwCalEna /end REF_MEASUREMENT /end GROUP
/begin GROUP CDD_MotAgSwCal.SwCalMotModlnIdx "MICROSAR RTE" /begin SUB_GROUP /end SUB_GROUP /begin FUNCTION_LIST /end FUNCTION_LIST /begin REF_CHARACTERISTIC /end REF_CHARACTERISTIC /begin REF_MEASUREMENT CDD_MotAgSwCal.SwCalMotModlnIdx /end REF_MEASUREMENT /end GROUP
/begin GROUP CDD_MotAgSwCal.SwCalStepDir "MICROSAR RTE" /begin SUB_GROUP /end SUB_GROUP /begin FUNCTION_LIST /end FUNCTION_LIST /begin REF_CHARACTERISTIC /end REF_CHARACTERISTIC /begin REF_MEASUREMENT CDD_MotAgSwCal.SwCalStepDir /end REF_MEASUREMENT /end GROUP
/begin GROUP CDD_MotCtrlMgr "MICROSAR RTE" /begin SUB_GROUP CDD_MotCtrlMgr.ReceiverPorts CDD_MotCtrlMgr.SenderPorts /end SUB_GROUP /begin FUNCTION_LIST /end FUNCTION_LIST /begin REF_CHARACTERISTIC /end REF_CHARACTERISTIC /begin REF_MEASUREMENT /end REF_MEASUREMENT /end GROUP
/begin GROUP CDD_MotCtrlMgr.BrdgVltg.Val "MICROSAR RTE" /begin SUB_GROUP /end SUB_GROUP /begin FUNCTION_LIST /end FUNCTION_LIST /begin REF_CHARACTERISTIC /end REF_CHARACTERISTIC /begin REF_MEASUREMENT CDD_MotCtrlMgr.BrdgVltg.Val /end REF_MEASUREMENT /end GROUP
/begin GROUP CDD_MotCtrlMgr.CurrMeasCorrlnSts.Val "MICROSAR RTE" /begin SUB_GROUP /end SUB_GROUP /begin FUNCTION_LIST /end FUNCTION_LIST /begin REF_CHARACTERISTIC /end REF_CHARACTERISTIC /begin REF_MEASUREMENT CDD_MotCtrlMgr.CurrMeasCorrlnSts.Val /end REF_MEASUREMENT /end GROUP
/begin GROUP CDD_MotCtrlMgr.CurrMeasWrmIninTestCmpl.Logl "MICROSAR RTE" /begin SUB_GROUP /end SUB_GROUP /begin FUNCTION_LIST /end FUNCTION_LIST /begin REF_CHARACTERISTIC /end REF_CHARACTERISTIC /begin REF_MEASUREMENT CDD_MotCtrlMgr.CurrMeasWrmIninTestCmpl.Logl /end REF_MEASUREMENT /end GROUP
/begin GROUP CDD_MotCtrlMgr.DiagcStsIvtr1Inactv.Logl "MICROSAR RTE" /begin SUB_GROUP /end SUB_GROUP /begin FUNCTION_LIST /end FUNCTION_LIST /begin REF_CHARACTERISTIC /end REF_CHARACTERISTIC /begin REF_MEASUREMENT CDD_MotCtrlMgr.DiagcStsIvtr1Inactv.Logl /end REF_MEASUREMENT /end GROUP
/begin GROUP CDD_MotCtrlMgr.DualEcuMotCtrlMtgtnEna.Logl "MICROSAR RTE" /begin SUB_GROUP /end SUB_GROUP /begin FUNCTION_LIST /end FUNCTION_LIST /begin REF_CHARACTERISTIC /end REF_CHARACTERISTIC /begin REF_MEASUREMENT CDD_MotCtrlMgr.DualEcuMotCtrlMtgtnEna.Logl /end REF_MEASUREMENT /end GROUP
/begin GROUP CDD_MotCtrlMgr.EcuTFild.Val "MICROSAR RTE" /begin SUB_GROUP /end SUB_GROUP /begin FUNCTION_LIST /end FUNCTION_LIST /begin REF_CHARACTERISTIC /end REF_CHARACTERISTIC /begin REF_MEASUREMENT CDD_MotCtrlMgr.EcuTFild.Val /end REF_MEASUREMENT /end GROUP
/begin GROUP CDD_MotCtrlMgr.FastLoopCntr.Val "MICROSAR RTE" /begin SUB_GROUP /end SUB_GROUP /begin FUNCTION_LIST /end FUNCTION_LIST /begin REF_CHARACTERISTIC /end REF_CHARACTERISTIC /begin REF_MEASUREMENT CDD_MotCtrlMgr.FastLoopCntr.Val /end REF_MEASUREMENT /end GROUP
/begin GROUP CDD_MotCtrlMgr.IvtrFetFltPha.Val "MICROSAR RTE" /begin SUB_GROUP /end SUB_GROUP /begin FUNCTION_LIST /end FUNCTION_LIST /begin REF_CHARACTERISTIC /end REF_CHARACTERISTIC /begin REF_MEASUREMENT CDD_MotCtrlMgr.IvtrFetFltPha.Val /end REF_MEASUREMENT /end GROUP
/begin GROUP CDD_MotCtrlMgr.IvtrFetFltTyp.Val "MICROSAR RTE" /begin SUB_GROUP /end SUB_GROUP /begin FUNCTION_LIST /end FUNCTION_LIST /begin REF_CHARACTERISTIC /end REF_CHARACTERISTIC /begin REF_MEASUREMENT CDD_MotCtrlMgr.IvtrFetFltTyp.Val /end REF_MEASUREMENT /end GROUP
/begin GROUP CDD_MotCtrlMgr.LoopCntr2MilliSec.Val "MICROSAR RTE" /begin SUB_GROUP /end SUB_GROUP /begin FUNCTION_LIST /end FUNCTION_LIST /begin REF_CHARACTERISTIC /end REF_CHARACTERISTIC /begin REF_MEASUREMENT CDD_MotCtrlMgr.LoopCntr2MilliSec.Val /end REF_MEASUREMENT /end GROUP
/begin GROUP CDD_MotCtrlMgr.MotAg2Cos.Val "MICROSAR RTE" /begin SUB_GROUP /end SUB_GROUP /begin FUNCTION_LIST /end FUNCTION_LIST /begin REF_CHARACTERISTIC /end REF_CHARACTERISTIC /begin REF_MEASUREMENT CDD_MotCtrlMgr.MotAg2Cos.Val /end REF_MEASUREMENT /end GROUP
/begin GROUP CDD_MotCtrlMgr.MotAg2CosAdcFaild.Logl "MICROSAR RTE" /begin SUB_GROUP /end SUB_GROUP /begin FUNCTION_LIST /end FUNCTION_LIST /begin REF_CHARACTERISTIC /end REF_CHARACTERISTIC /begin REF_MEASUREMENT CDD_MotCtrlMgr.MotAg2CosAdcFaild.Logl /end REF_MEASUREMENT /end GROUP
/begin GROUP CDD_MotCtrlMgr.MotAg2Sin.Val "MICROSAR RTE" /begin SUB_GROUP /end SUB_GROUP /begin FUNCTION_LIST /end FUNCTION_LIST /begin REF_CHARACTERISTIC /end REF_CHARACTERISTIC /begin REF_MEASUREMENT CDD_MotCtrlMgr.MotAg2Sin.Val /end REF_MEASUREMENT /end GROUP
/begin GROUP CDD_MotCtrlMgr.MotAg2SinAdcFaild.Logl "MICROSAR RTE" /begin SUB_GROUP /end SUB_GROUP /begin FUNCTION_LIST /end FUNCTION_LIST /begin REF_CHARACTERISTIC /end REF_CHARACTERISTIC /begin REF_MEASUREMENT CDD_MotCtrlMgr.MotAg2SinAdcFaild.Logl /end REF_MEASUREMENT /end GROUP
/begin GROUP CDD_MotCtrlMgr.MotAg5Cos.Val "MICROSAR RTE" /begin SUB_GROUP /end SUB_GROUP /begin FUNCTION_LIST /end FUNCTION_LIST /begin REF_CHARACTERISTIC /end REF_CHARACTERISTIC /begin REF_MEASUREMENT CDD_MotCtrlMgr.MotAg5Cos.Val /end REF_MEASUREMENT /end GROUP
/begin GROUP CDD_MotCtrlMgr.MotAg5CosAdcFaild.Logl "MICROSAR RTE" /begin SUB_GROUP /end SUB_GROUP /begin FUNCTION_LIST /end FUNCTION_LIST /begin REF_CHARACTERISTIC /end REF_CHARACTERISTIC /begin REF_MEASUREMENT CDD_MotCtrlMgr.MotAg5CosAdcFaild.Logl /end REF_MEASUREMENT /end GROUP
/begin GROUP CDD_MotCtrlMgr.MotAg5CosRtAmpRecpr.Val "MICROSAR RTE" /begin SUB_GROUP /end SUB_GROUP /begin FUNCTION_LIST /end FUNCTION_LIST /begin REF_CHARACTERISTIC /end REF_CHARACTERISTIC /begin REF_MEASUREMENT CDD_MotCtrlMgr.MotAg5CosRtAmpRecpr.Val /end REF_MEASUREMENT /end GROUP
/begin GROUP CDD_MotCtrlMgr.MotAg5CosRtOffs.Val "MICROSAR RTE" /begin SUB_GROUP /end SUB_GROUP /begin FUNCTION_LIST /end FUNCTION_LIST /begin REF_CHARACTERISTIC /end REF_CHARACTERISTIC /begin REF_MEASUREMENT CDD_MotCtrlMgr.MotAg5CosRtOffs.Val /end REF_MEASUREMENT /end GROUP
/begin GROUP CDD_MotCtrlMgr.MotAg5Mecl.Val "MICROSAR RTE" /begin SUB_GROUP /end SUB_GROUP /begin FUNCTION_LIST /end FUNCTION_LIST /begin REF_CHARACTERISTIC /end REF_CHARACTERISTIC /begin REF_MEASUREMENT CDD_MotCtrlMgr.MotAg5Mecl.Val /end REF_MEASUREMENT /end GROUP
/begin GROUP CDD_MotCtrlMgr.MotAg5MeclQlfr.Val "MICROSAR RTE" /begin SUB_GROUP /end SUB_GROUP /begin FUNCTION_LIST /end FUNCTION_LIST /begin REF_CHARACTERISTIC /end REF_CHARACTERISTIC /begin REF_MEASUREMENT CDD_MotCtrlMgr.MotAg5MeclQlfr.Val /end REF_MEASUREMENT /end GROUP
/begin GROUP CDD_MotCtrlMgr.MotAg5MeclRollgCntr.Val "MICROSAR RTE" /begin SUB_GROUP /end SUB_GROUP /begin FUNCTION_LIST /end FUNCTION_LIST /begin REF_CHARACTERISTIC /end REF_CHARACTERISTIC /begin REF_MEASUREMENT CDD_MotCtrlMgr.MotAg5MeclRollgCntr.Val /end REF_MEASUREMENT /end GROUP
/begin GROUP CDD_MotCtrlMgr.MotAg5RawMecl.Val "MICROSAR RTE" /begin SUB_GROUP /end SUB_GROUP /begin FUNCTION_LIST /end FUNCTION_LIST /begin REF_CHARACTERISTIC /end REF_CHARACTERISTIC /begin REF_MEASUREMENT CDD_MotCtrlMgr.MotAg5RawMecl.Val /end REF_MEASUREMENT /end GROUP
/begin GROUP CDD_MotCtrlMgr.MotAg5Sin.Val "MICROSAR RTE" /begin SUB_GROUP /end SUB_GROUP /begin FUNCTION_LIST /end FUNCTION_LIST /begin REF_CHARACTERISTIC /end REF_CHARACTERISTIC /begin REF_MEASUREMENT CDD_MotCtrlMgr.MotAg5Sin.Val /end REF_MEASUREMENT /end GROUP
/begin GROUP CDD_MotCtrlMgr.MotAg5SinAdcFaild.Logl "MICROSAR RTE" /begin SUB_GROUP /end SUB_GROUP /begin FUNCTION_LIST /end FUNCTION_LIST /begin REF_CHARACTERISTIC /end REF_CHARACTERISTIC /begin REF_MEASUREMENT CDD_MotCtrlMgr.MotAg5SinAdcFaild.Logl /end REF_MEASUREMENT /end GROUP
/begin GROUP CDD_MotCtrlMgr.MotAg5SinRtAmpRecpr.Val "MICROSAR RTE" /begin SUB_GROUP /end SUB_GROUP /begin FUNCTION_LIST /end FUNCTION_LIST /begin REF_CHARACTERISTIC /end REF_CHARACTERISTIC /begin REF_MEASUREMENT CDD_MotCtrlMgr.MotAg5SinRtAmpRecpr.Val /end REF_MEASUREMENT /end GROUP
/begin GROUP CDD_MotCtrlMgr.MotAg5SinRtOffs.Val "MICROSAR RTE" /begin SUB_GROUP /end SUB_GROUP /begin FUNCTION_LIST /end FUNCTION_LIST /begin REF_CHARACTERISTIC /end REF_CHARACTERISTIC /begin REF_MEASUREMENT CDD_MotCtrlMgr.MotAg5SinRtOffs.Val /end REF_MEASUREMENT /end GROUP
/begin GROUP CDD_MotCtrlMgr.MotAg6Cos.Val "MICROSAR RTE" /begin SUB_GROUP /end SUB_GROUP /begin FUNCTION_LIST /end FUNCTION_LIST /begin REF_CHARACTERISTIC /end REF_CHARACTERISTIC /begin REF_MEASUREMENT CDD_MotCtrlMgr.MotAg6Cos.Val /end REF_MEASUREMENT /end GROUP
/begin GROUP CDD_MotCtrlMgr.MotAg6CosAdcFaild.Logl "MICROSAR RTE" /begin SUB_GROUP /end SUB_GROUP /begin FUNCTION_LIST /end FUNCTION_LIST /begin REF_CHARACTERISTIC /end REF_CHARACTERISTIC /begin REF_MEASUREMENT CDD_MotCtrlMgr.MotAg6CosAdcFaild.Logl /end REF_MEASUREMENT /end GROUP
/begin GROUP CDD_MotCtrlMgr.MotAg6CosRtAmpRecpr.Val "MICROSAR RTE" /begin SUB_GROUP /end SUB_GROUP /begin FUNCTION_LIST /end FUNCTION_LIST /begin REF_CHARACTERISTIC /end REF_CHARACTERISTIC /begin REF_MEASUREMENT CDD_MotCtrlMgr.MotAg6CosRtAmpRecpr.Val /end REF_MEASUREMENT /end GROUP
/begin GROUP CDD_MotCtrlMgr.MotAg6CosRtOffs.Val "MICROSAR RTE" /begin SUB_GROUP /end SUB_GROUP /begin FUNCTION_LIST /end FUNCTION_LIST /begin REF_CHARACTERISTIC /end REF_CHARACTERISTIC /begin REF_MEASUREMENT CDD_MotCtrlMgr.MotAg6CosRtOffs.Val /end REF_MEASUREMENT /end GROUP
/begin GROUP CDD_MotCtrlMgr.MotAg6Mecl.Val "MICROSAR RTE" /begin SUB_GROUP /end SUB_GROUP /begin FUNCTION_LIST /end FUNCTION_LIST /begin REF_CHARACTERISTIC /end REF_CHARACTERISTIC /begin REF_MEASUREMENT CDD_MotCtrlMgr.MotAg6Mecl.Val /end REF_MEASUREMENT /end GROUP
/begin GROUP CDD_MotCtrlMgr.MotAg6MeclQlfr.Val "MICROSAR RTE" /begin SUB_GROUP /end SUB_GROUP /begin FUNCTION_LIST /end FUNCTION_LIST /begin REF_CHARACTERISTIC /end REF_CHARACTERISTIC /begin REF_MEASUREMENT CDD_MotCtrlMgr.MotAg6MeclQlfr.Val /end REF_MEASUREMENT /end GROUP
/begin GROUP CDD_MotCtrlMgr.MotAg6MeclRollgCntr.Val "MICROSAR RTE" /begin SUB_GROUP /end SUB_GROUP /begin FUNCTION_LIST /end FUNCTION_LIST /begin REF_CHARACTERISTIC /end REF_CHARACTERISTIC /begin REF_MEASUREMENT CDD_MotCtrlMgr.MotAg6MeclRollgCntr.Val /end REF_MEASUREMENT /end GROUP
/begin GROUP CDD_MotCtrlMgr.MotAg6RawMecl.Val "MICROSAR RTE" /begin SUB_GROUP /end SUB_GROUP /begin FUNCTION_LIST /end FUNCTION_LIST /begin REF_CHARACTERISTIC /end REF_CHARACTERISTIC /begin REF_MEASUREMENT CDD_MotCtrlMgr.MotAg6RawMecl.Val /end REF_MEASUREMENT /end GROUP
/begin GROUP CDD_MotCtrlMgr.MotAg6Sin.Val "MICROSAR RTE" /begin SUB_GROUP /end SUB_GROUP /begin FUNCTION_LIST /end FUNCTION_LIST /begin REF_CHARACTERISTIC /end REF_CHARACTERISTIC /begin REF_MEASUREMENT CDD_MotCtrlMgr.MotAg6Sin.Val /end REF_MEASUREMENT /end GROUP
/begin GROUP CDD_MotCtrlMgr.MotAg6SinAdcFaild.Logl "MICROSAR RTE" /begin SUB_GROUP /end SUB_GROUP /begin FUNCTION_LIST /end FUNCTION_LIST /begin REF_CHARACTERISTIC /end REF_CHARACTERISTIC /begin REF_MEASUREMENT CDD_MotCtrlMgr.MotAg6SinAdcFaild.Logl /end REF_MEASUREMENT /end GROUP
/begin GROUP CDD_MotCtrlMgr.MotAg6SinRtAmpRecpr.Val "MICROSAR RTE" /begin SUB_GROUP /end SUB_GROUP /begin FUNCTION_LIST /end FUNCTION_LIST /begin REF_CHARACTERISTIC /end REF_CHARACTERISTIC /begin REF_MEASUREMENT CDD_MotCtrlMgr.MotAg6SinRtAmpRecpr.Val /end REF_MEASUREMENT /end GROUP
/begin GROUP CDD_MotCtrlMgr.MotAg6SinRtOffs.Val "MICROSAR RTE" /begin SUB_GROUP /end SUB_GROUP /begin FUNCTION_LIST /end FUNCTION_LIST /begin REF_CHARACTERISTIC /end REF_CHARACTERISTIC /begin REF_MEASUREMENT CDD_MotCtrlMgr.MotAg6SinRtOffs.Val /end REF_MEASUREMENT /end GROUP
/begin GROUP CDD_MotCtrlMgr.MotAgBuf.Ary1D "MICROSAR RTE" /begin SUB_GROUP /end SUB_GROUP /begin FUNCTION_LIST /end FUNCTION_LIST /begin REF_CHARACTERISTIC /end REF_CHARACTERISTIC /begin REF_MEASUREMENT CDD_MotCtrlMgr.MotAgBuf.Ary1D /end REF_MEASUREMENT /end GROUP
/begin GROUP CDD_MotCtrlMgr.MotAgBufIdx.Val "MICROSAR RTE" /begin SUB_GROUP /end SUB_GROUP /begin FUNCTION_LIST /end FUNCTION_LIST /begin REF_CHARACTERISTIC /end REF_CHARACTERISTIC /begin REF_MEASUREMENT CDD_MotCtrlMgr.MotAgBufIdx.Val /end REF_MEASUREMENT /end GROUP
/begin GROUP CDD_MotCtrlMgr.MotAgCumvAlgndMrfRev.Val "MICROSAR RTE" /begin SUB_GROUP /end SUB_GROUP /begin FUNCTION_LIST /end FUNCTION_LIST /begin REF_CHARACTERISTIC /end REF_CHARACTERISTIC /begin REF_MEASUREMENT CDD_MotCtrlMgr.MotAgCumvAlgndMrfRev.Val /end REF_MEASUREMENT /end GROUP
/begin GROUP CDD_MotCtrlMgr.MotAgCumvInid.Logl "MICROSAR RTE" /begin SUB_GROUP /end SUB_GROUP /begin FUNCTION_LIST /end FUNCTION_LIST /begin REF_CHARACTERISTIC /end REF_CHARACTERISTIC /begin REF_MEASUREMENT CDD_MotCtrlMgr.MotAgCumvInid.Logl /end REF_MEASUREMENT /end GROUP
/begin GROUP CDD_MotCtrlMgr.MotAgElecDly.Val "MICROSAR RTE" /begin SUB_GROUP /end SUB_GROUP /begin FUNCTION_LIST /end FUNCTION_LIST /begin REF_CHARACTERISTIC /end REF_CHARACTERISTIC /begin REF_MEASUREMENT CDD_MotCtrlMgr.MotAgElecDly.Val /end REF_MEASUREMENT /end GROUP
/begin GROUP CDD_MotCtrlMgr.MotAgElecDlyRpl.Val "MICROSAR RTE" /begin SUB_GROUP /end SUB_GROUP /begin FUNCTION_LIST /end FUNCTION_LIST /begin REF_CHARACTERISTIC /end REF_CHARACTERISTIC /begin REF_MEASUREMENT CDD_MotCtrlMgr.MotAgElecDlyRpl.Val /end REF_MEASUREMENT /end GROUP
/begin GROUP CDD_MotCtrlMgr.MotAgMecl5Polarity.Val "MICROSAR RTE" /begin SUB_GROUP /end SUB_GROUP /begin FUNCTION_LIST /end FUNCTION_LIST /begin REF_CHARACTERISTIC /end REF_CHARACTERISTIC /begin REF_MEASUREMENT CDD_MotCtrlMgr.MotAgMecl5Polarity.Val /end REF_MEASUREMENT /end GROUP
/begin GROUP CDD_MotCtrlMgr.MotAgMecl6Polarity.Val "MICROSAR RTE" /begin SUB_GROUP /end SUB_GROUP /begin FUNCTION_LIST /end FUNCTION_LIST /begin REF_CHARACTERISTIC /end REF_CHARACTERISTIC /begin REF_MEASUREMENT CDD_MotCtrlMgr.MotAgMecl6Polarity.Val /end REF_MEASUREMENT /end GROUP
/begin GROUP CDD_MotCtrlMgr.MotAgMeclCorrlnSt.Val "MICROSAR RTE" /begin SUB_GROUP /end SUB_GROUP /begin FUNCTION_LIST /end FUNCTION_LIST /begin REF_CHARACTERISTIC /end REF_CHARACTERISTIC /begin REF_MEASUREMENT CDD_MotCtrlMgr.MotAgMeclCorrlnSt.Val /end REF_MEASUREMENT /end GROUP
/begin GROUP CDD_MotCtrlMgr.MotAgTiBuf.Ary1D "MICROSAR RTE" /begin SUB_GROUP /end SUB_GROUP /begin FUNCTION_LIST /end FUNCTION_LIST /begin REF_CHARACTERISTIC /end REF_CHARACTERISTIC /begin REF_MEASUREMENT CDD_MotCtrlMgr.MotAgTiBuf.Ary1D /end REF_MEASUREMENT /end GROUP
/begin GROUP CDD_MotCtrlMgr.MotAndThermProtnLoaMod.Val "MICROSAR RTE" /begin SUB_GROUP /end SUB_GROUP /begin FUNCTION_LIST /end FUNCTION_LIST /begin REF_CHARACTERISTIC /end REF_CHARACTERISTIC /begin REF_MEASUREMENT CDD_MotCtrlMgr.MotAndThermProtnLoaMod.Val /end REF_MEASUREMENT /end GROUP
/begin GROUP CDD_MotCtrlMgr.MotBackEmfVltg.Val "MICROSAR RTE" /begin SUB_GROUP /end SUB_GROUP /begin FUNCTION_LIST /end FUNCTION_LIST /begin REF_CHARACTERISTIC /end REF_CHARACTERISTIC /begin REF_MEASUREMENT CDD_MotCtrlMgr.MotBackEmfVltg.Val /end REF_MEASUREMENT /end GROUP
/begin GROUP CDD_MotCtrlMgr.MotCurrAdcVlyA.Val "MICROSAR RTE" /begin SUB_GROUP /end SUB_GROUP /begin FUNCTION_LIST /end FUNCTION_LIST /begin REF_CHARACTERISTIC /end REF_CHARACTERISTIC /begin REF_MEASUREMENT CDD_MotCtrlMgr.MotCurrAdcVlyA.Val /end REF_MEASUREMENT /end GROUP
/begin GROUP CDD_MotCtrlMgr.MotCurrAdcVlyAAdcFaild.Logl "MICROSAR RTE" /begin SUB_GROUP /end SUB_GROUP /begin FUNCTION_LIST /end FUNCTION_LIST /begin REF_CHARACTERISTIC /end REF_CHARACTERISTIC /begin REF_MEASUREMENT CDD_MotCtrlMgr.MotCurrAdcVlyAAdcFaild.Logl /end REF_MEASUREMENT /end GROUP
/begin GROUP CDD_MotCtrlMgr.MotCurrAdcVlyB.Val "MICROSAR RTE" /begin SUB_GROUP /end SUB_GROUP /begin FUNCTION_LIST /end FUNCTION_LIST /begin REF_CHARACTERISTIC /end REF_CHARACTERISTIC /begin REF_MEASUREMENT CDD_MotCtrlMgr.MotCurrAdcVlyB.Val /end REF_MEASUREMENT /end GROUP
/begin GROUP CDD_MotCtrlMgr.MotCurrAdcVlyBAdcFaild.Logl "MICROSAR RTE" /begin SUB_GROUP /end SUB_GROUP /begin FUNCTION_LIST /end FUNCTION_LIST /begin REF_CHARACTERISTIC /end REF_CHARACTERISTIC /begin REF_MEASUREMENT CDD_MotCtrlMgr.MotCurrAdcVlyBAdcFaild.Logl /end REF_MEASUREMENT /end GROUP
/begin GROUP CDD_MotCtrlMgr.MotCurrAdcVlyC.Val "MICROSAR RTE" /begin SUB_GROUP /end SUB_GROUP /begin FUNCTION_LIST /end FUNCTION_LIST /begin REF_CHARACTERISTIC /end REF_CHARACTERISTIC /begin REF_MEASUREMENT CDD_MotCtrlMgr.MotCurrAdcVlyC.Val /end REF_MEASUREMENT /end GROUP
/begin GROUP CDD_MotCtrlMgr.MotCurrAdcVlyCAdcFaild.Logl "MICROSAR RTE" /begin SUB_GROUP /end SUB_GROUP /begin FUNCTION_LIST /end FUNCTION_LIST /begin REF_CHARACTERISTIC /end REF_CHARACTERISTIC /begin REF_MEASUREMENT CDD_MotCtrlMgr.MotCurrAdcVlyCAdcFaild.Logl /end REF_MEASUREMENT /end GROUP
/begin GROUP CDD_MotCtrlMgr.MotCurrCorrdA.Val "MICROSAR RTE" /begin SUB_GROUP /end SUB_GROUP /begin FUNCTION_LIST /end FUNCTION_LIST /begin REF_CHARACTERISTIC /end REF_CHARACTERISTIC /begin REF_MEASUREMENT CDD_MotCtrlMgr.MotCurrCorrdA.Val /end REF_MEASUREMENT /end GROUP
/begin GROUP CDD_MotCtrlMgr.MotCurrCorrdB.Val "MICROSAR RTE" /begin SUB_GROUP /end SUB_GROUP /begin FUNCTION_LIST /end FUNCTION_LIST /begin REF_CHARACTERISTIC /end REF_CHARACTERISTIC /begin REF_MEASUREMENT CDD_MotCtrlMgr.MotCurrCorrdB.Val /end REF_MEASUREMENT /end GROUP
/begin GROUP CDD_MotCtrlMgr.MotCurrCorrdC.Val "MICROSAR RTE" /begin SUB_GROUP /end SUB_GROUP /begin FUNCTION_LIST /end FUNCTION_LIST /begin REF_CHARACTERISTIC /end REF_CHARACTERISTIC /begin REF_MEASUREMENT CDD_MotCtrlMgr.MotCurrCorrdC.Val /end REF_MEASUREMENT /end GROUP
/begin GROUP CDD_MotCtrlMgr.MotCurrDax.Val "MICROSAR RTE" /begin SUB_GROUP /end SUB_GROUP /begin FUNCTION_LIST /end FUNCTION_LIST /begin REF_CHARACTERISTIC /end REF_CHARACTERISTIC /begin REF_MEASUREMENT CDD_MotCtrlMgr.MotCurrDax.Val /end REF_MEASUREMENT /end GROUP
/begin GROUP CDD_MotCtrlMgr.MotCurrDaxCmd.Val "MICROSAR RTE" /begin SUB_GROUP /end SUB_GROUP /begin FUNCTION_LIST /end FUNCTION_LIST /begin REF_CHARACTERISTIC /end REF_CHARACTERISTIC /begin REF_MEASUREMENT CDD_MotCtrlMgr.MotCurrDaxCmd.Val /end REF_MEASUREMENT /end GROUP
/begin GROUP CDD_MotCtrlMgr.MotCurrDaxMax.Val "MICROSAR RTE" /begin SUB_GROUP /end SUB_GROUP /begin FUNCTION_LIST /end FUNCTION_LIST /begin REF_CHARACTERISTIC /end REF_CHARACTERISTIC /begin REF_MEASUREMENT CDD_MotCtrlMgr.MotCurrDaxMax.Val /end REF_MEASUREMENT /end GROUP
/begin GROUP CDD_MotCtrlMgr.MotCurrEolCalSt.Val "MICROSAR RTE" /begin SUB_GROUP /end SUB_GROUP /begin FUNCTION_LIST /end FUNCTION_LIST /begin REF_CHARACTERISTIC /end REF_CHARACTERISTIC /begin REF_MEASUREMENT CDD_MotCtrlMgr.MotCurrEolCalSt.Val /end REF_MEASUREMENT /end GROUP
/begin GROUP CDD_MotCtrlMgr.MotCurrQax.Val "MICROSAR RTE" /begin SUB_GROUP /end SUB_GROUP /begin FUNCTION_LIST /end FUNCTION_LIST /begin REF_CHARACTERISTIC /end REF_CHARACTERISTIC /begin REF_MEASUREMENT CDD_MotCtrlMgr.MotCurrQax.Val /end REF_MEASUREMENT /end GROUP
/begin GROUP CDD_MotCtrlMgr.MotCurrQaxCmd.Val "MICROSAR RTE" /begin SUB_GROUP /end SUB_GROUP /begin FUNCTION_LIST /end FUNCTION_LIST /begin REF_CHARACTERISTIC /end REF_CHARACTERISTIC /begin REF_MEASUREMENT CDD_MotCtrlMgr.MotCurrQaxCmd.Val /end REF_MEASUREMENT /end GROUP
/begin GROUP CDD_MotCtrlMgr.MotCurrQaxToMotTqGain.Val "MICROSAR RTE" /begin SUB_GROUP /end SUB_GROUP /begin FUNCTION_LIST /end FUNCTION_LIST /begin REF_CHARACTERISTIC /end REF_CHARACTERISTIC /begin REF_MEASUREMENT CDD_MotCtrlMgr.MotCurrQaxToMotTqGain.Val /end REF_MEASUREMENT /end GROUP
/begin GROUP CDD_MotCtrlMgr.MotCurrQlfr1.Val "MICROSAR RTE" /begin SUB_GROUP /end SUB_GROUP /begin FUNCTION_LIST /end FUNCTION_LIST /begin REF_CHARACTERISTIC /end REF_CHARACTERISTIC /begin REF_MEASUREMENT CDD_MotCtrlMgr.MotCurrQlfr1.Val /end REF_MEASUREMENT /end GROUP
/begin GROUP CDD_MotCtrlMgr.MotCurrRollgCntr1.Val "MICROSAR RTE" /begin SUB_GROUP /end SUB_GROUP /begin FUNCTION_LIST /end FUNCTION_LIST /begin REF_CHARACTERISTIC /end REF_CHARACTERISTIC /begin REF_MEASUREMENT CDD_MotCtrlMgr.MotCurrRollgCntr1.Val /end REF_MEASUREMENT /end GROUP
/begin GROUP CDD_MotCtrlMgr.MotDampgDax.Val "MICROSAR RTE" /begin SUB_GROUP /end SUB_GROUP /begin FUNCTION_LIST /end FUNCTION_LIST /begin REF_CHARACTERISTIC /end REF_CHARACTERISTIC /begin REF_MEASUREMENT CDD_MotCtrlMgr.MotDampgDax.Val /end REF_MEASUREMENT /end GROUP
/begin GROUP CDD_MotCtrlMgr.MotDampgQax.Val "MICROSAR RTE" /begin SUB_GROUP /end SUB_GROUP /begin FUNCTION_LIST /end FUNCTION_LIST /begin REF_CHARACTERISTIC /end REF_CHARACTERISTIC /begin REF_MEASUREMENT CDD_MotCtrlMgr.MotDampgQax.Val /end REF_MEASUREMENT /end GROUP
/begin GROUP CDD_MotCtrlMgr.MotElecMeclPolarity.Val "MICROSAR RTE" /begin SUB_GROUP /end SUB_GROUP /begin FUNCTION_LIST /end FUNCTION_LIST /begin REF_CHARACTERISTIC /end REF_CHARACTERISTIC /begin REF_MEASUREMENT CDD_MotCtrlMgr.MotElecMeclPolarity.Val /end REF_MEASUREMENT /end GROUP
/begin GROUP CDD_MotCtrlMgr.MotInduDaxEstimdIvs.Val "MICROSAR RTE" /begin SUB_GROUP /end SUB_GROUP /begin FUNCTION_LIST /end FUNCTION_LIST /begin REF_CHARACTERISTIC /end REF_CHARACTERISTIC /begin REF_MEASUREMENT CDD_MotCtrlMgr.MotInduDaxEstimdIvs.Val /end REF_MEASUREMENT /end GROUP
/begin GROUP CDD_MotCtrlMgr.MotInduQaxEstimdIvs.Val "MICROSAR RTE" /begin SUB_GROUP /end SUB_GROUP /begin FUNCTION_LIST /end FUNCTION_LIST /begin REF_CHARACTERISTIC /end REF_CHARACTERISTIC /begin REF_MEASUREMENT CDD_MotCtrlMgr.MotInduQaxEstimdIvs.Val /end REF_MEASUREMENT /end GROUP
/begin GROUP CDD_MotCtrlMgr.MotIntglGainDax.Val "MICROSAR RTE" /begin SUB_GROUP /end SUB_GROUP /begin FUNCTION_LIST /end FUNCTION_LIST /begin REF_CHARACTERISTIC /end REF_CHARACTERISTIC /begin REF_MEASUREMENT CDD_MotCtrlMgr.MotIntglGainDax.Val /end REF_MEASUREMENT /end GROUP
/begin GROUP CDD_MotCtrlMgr.MotIntglGainQax.Val "MICROSAR RTE" /begin SUB_GROUP /end SUB_GROUP /begin FUNCTION_LIST /end FUNCTION_LIST /begin REF_CHARACTERISTIC /end REF_CHARACTERISTIC /begin REF_MEASUREMENT CDD_MotCtrlMgr.MotIntglGainQax.Val /end REF_MEASUREMENT /end GROUP
/begin GROUP CDD_MotCtrlMgr.MotPropGainDax.Val "MICROSAR RTE" /begin SUB_GROUP /end SUB_GROUP /begin FUNCTION_LIST /end FUNCTION_LIST /begin REF_CHARACTERISTIC /end REF_CHARACTERISTIC /begin REF_MEASUREMENT CDD_MotCtrlMgr.MotPropGainDax.Val /end REF_MEASUREMENT /end GROUP
/begin GROUP CDD_MotCtrlMgr.MotPropGainQax.Val "MICROSAR RTE" /begin SUB_GROUP /end SUB_GROUP /begin FUNCTION_LIST /end FUNCTION_LIST /begin REF_CHARACTERISTIC /end REF_CHARACTERISTIC /begin REF_MEASUREMENT CDD_MotCtrlMgr.MotPropGainQax.Val /end REF_MEASUREMENT /end GROUP
/begin GROUP CDD_MotCtrlMgr.MotREstimd.Val "MICROSAR RTE" /begin SUB_GROUP /end SUB_GROUP /begin FUNCTION_LIST /end FUNCTION_LIST /begin REF_CHARACTERISTIC /end REF_CHARACTERISTIC /begin REF_MEASUREMENT CDD_MotCtrlMgr.MotREstimd.Val /end REF_MEASUREMENT /end GROUP
/begin GROUP CDD_MotCtrlMgr.MotReacncDax.Val "MICROSAR RTE" /begin SUB_GROUP /end SUB_GROUP /begin FUNCTION_LIST /end FUNCTION_LIST /begin REF_CHARACTERISTIC /end REF_CHARACTERISTIC /begin REF_MEASUREMENT CDD_MotCtrlMgr.MotReacncDax.Val /end REF_MEASUREMENT /end GROUP
/begin GROUP CDD_MotCtrlMgr.MotReacncQax.Val "MICROSAR RTE" /begin SUB_GROUP /end SUB_GROUP /begin FUNCTION_LIST /end FUNCTION_LIST /begin REF_CHARACTERISTIC /end REF_CHARACTERISTIC /begin REF_MEASUREMENT CDD_MotCtrlMgr.MotReacncQax.Val /end REF_MEASUREMENT /end GROUP
/begin GROUP CDD_MotCtrlMgr.MotTqRplCoggOrder1Mgn.Val "MICROSAR RTE" /begin SUB_GROUP /end SUB_GROUP /begin FUNCTION_LIST /end FUNCTION_LIST /begin REF_CHARACTERISTIC /end REF_CHARACTERISTIC /begin REF_MEASUREMENT CDD_MotCtrlMgr.MotTqRplCoggOrder1Mgn.Val /end REF_MEASUREMENT /end GROUP
/begin GROUP CDD_MotCtrlMgr.MotTqRplCoggOrder1Pha.Val "MICROSAR RTE" /begin SUB_GROUP /end SUB_GROUP /begin FUNCTION_LIST /end FUNCTION_LIST /begin REF_CHARACTERISTIC /end REF_CHARACTERISTIC /begin REF_MEASUREMENT CDD_MotCtrlMgr.MotTqRplCoggOrder1Pha.Val /end REF_MEASUREMENT /end GROUP
/begin GROUP CDD_MotCtrlMgr.MotTqRplCoggOrder2Mgn.Val "MICROSAR RTE" /begin SUB_GROUP /end SUB_GROUP /begin FUNCTION_LIST /end FUNCTION_LIST /begin REF_CHARACTERISTIC /end REF_CHARACTERISTIC /begin REF_MEASUREMENT CDD_MotCtrlMgr.MotTqRplCoggOrder2Mgn.Val /end REF_MEASUREMENT /end GROUP
/begin GROUP CDD_MotCtrlMgr.MotTqRplCoggOrder2Pha.Val "MICROSAR RTE" /begin SUB_GROUP /end SUB_GROUP /begin FUNCTION_LIST /end FUNCTION_LIST /begin REF_CHARACTERISTIC /end REF_CHARACTERISTIC /begin REF_MEASUREMENT CDD_MotCtrlMgr.MotTqRplCoggOrder2Pha.Val /end REF_MEASUREMENT /end GROUP
/begin GROUP CDD_MotCtrlMgr.MotTqRplCoggOrder3Mgn.Val "MICROSAR RTE" /begin SUB_GROUP /end SUB_GROUP /begin FUNCTION_LIST /end FUNCTION_LIST /begin REF_CHARACTERISTIC /end REF_CHARACTERISTIC /begin REF_MEASUREMENT CDD_MotCtrlMgr.MotTqRplCoggOrder3Mgn.Val /end REF_MEASUREMENT /end GROUP
/begin GROUP CDD_MotCtrlMgr.MotTqRplCoggOrder3Pha.Val "MICROSAR RTE" /begin SUB_GROUP /end SUB_GROUP /begin FUNCTION_LIST /end FUNCTION_LIST /begin REF_CHARACTERISTIC /end REF_CHARACTERISTIC /begin REF_MEASUREMENT CDD_MotCtrlMgr.MotTqRplCoggOrder3Pha.Val /end REF_MEASUREMENT /end GROUP
/begin GROUP CDD_MotCtrlMgr.MotVelMrf.Val "MICROSAR RTE" /begin SUB_GROUP /end SUB_GROUP /begin FUNCTION_LIST /end FUNCTION_LIST /begin REF_CHARACTERISTIC /end REF_CHARACTERISTIC /begin REF_MEASUREMENT CDD_MotCtrlMgr.MotVelMrf.Val /end REF_MEASUREMENT /end GROUP
/begin GROUP CDD_MotCtrlMgr.MotVltgDax.Val "MICROSAR RTE" /begin SUB_GROUP /end SUB_GROUP /begin FUNCTION_LIST /end FUNCTION_LIST /begin REF_CHARACTERISTIC /end REF_CHARACTERISTIC /begin REF_MEASUREMENT CDD_MotCtrlMgr.MotVltgDax.Val /end REF_MEASUREMENT /end GROUP
/begin GROUP CDD_MotCtrlMgr.MotVltgDaxFf.Val "MICROSAR RTE" /begin SUB_GROUP /end SUB_GROUP /begin FUNCTION_LIST /end FUNCTION_LIST /begin REF_CHARACTERISTIC /end REF_CHARACTERISTIC /begin REF_MEASUREMENT CDD_MotCtrlMgr.MotVltgDaxFf.Val /end REF_MEASUREMENT /end GROUP
/begin GROUP CDD_MotCtrlMgr.MotVltgDaxFild.Val "MICROSAR RTE" /begin SUB_GROUP /end SUB_GROUP /begin FUNCTION_LIST /end FUNCTION_LIST /begin REF_CHARACTERISTIC /end REF_CHARACTERISTIC /begin REF_MEASUREMENT CDD_MotCtrlMgr.MotVltgDaxFild.Val /end REF_MEASUREMENT /end GROUP
/begin GROUP CDD_MotCtrlMgr.MotVltgQax.Val "MICROSAR RTE" /begin SUB_GROUP /end SUB_GROUP /begin FUNCTION_LIST /end FUNCTION_LIST /begin REF_CHARACTERISTIC /end REF_CHARACTERISTIC /begin REF_MEASUREMENT CDD_MotCtrlMgr.MotVltgQax.Val /end REF_MEASUREMENT /end GROUP
/begin GROUP CDD_MotCtrlMgr.MotVltgQaxFf.Val "MICROSAR RTE" /begin SUB_GROUP /end SUB_GROUP /begin FUNCTION_LIST /end FUNCTION_LIST /begin REF_CHARACTERISTIC /end REF_CHARACTERISTIC /begin REF_MEASUREMENT CDD_MotCtrlMgr.MotVltgQaxFf.Val /end REF_MEASUREMENT /end GROUP
/begin GROUP CDD_MotCtrlMgr.MotVltgQaxFild.Val "MICROSAR RTE" /begin SUB_GROUP /end SUB_GROUP /begin FUNCTION_LIST /end FUNCTION_LIST /begin REF_CHARACTERISTIC /end REF_CHARACTERISTIC /begin REF_MEASUREMENT CDD_MotCtrlMgr.MotVltgQaxFild.Val /end REF_MEASUREMENT /end GROUP
/begin GROUP CDD_MotCtrlMgr.Ntc5DErrCnt.Val "MICROSAR RTE" /begin SUB_GROUP /end SUB_GROUP /begin FUNCTION_LIST /end FUNCTION_LIST /begin REF_CHARACTERISTIC /end REF_CHARACTERISTIC /begin REF_MEASUREMENT CDD_MotCtrlMgr.Ntc5DErrCnt.Val /end REF_MEASUREMENT /end GROUP
/begin GROUP CDD_MotCtrlMgr.PhaOnTiSumA.Val "MICROSAR RTE" /begin SUB_GROUP /end SUB_GROUP /begin FUNCTION_LIST /end FUNCTION_LIST /begin REF_CHARACTERISTIC /end REF_CHARACTERISTIC /begin REF_MEASUREMENT CDD_MotCtrlMgr.PhaOnTiSumA.Val /end REF_MEASUREMENT /end GROUP
/begin GROUP CDD_MotCtrlMgr.PhaOnTiSumB.Val "MICROSAR RTE" /begin SUB_GROUP /end SUB_GROUP /begin FUNCTION_LIST /end FUNCTION_LIST /begin REF_CHARACTERISTIC /end REF_CHARACTERISTIC /begin REF_MEASUREMENT CDD_MotCtrlMgr.PhaOnTiSumB.Val /end REF_MEASUREMENT /end GROUP
/begin GROUP CDD_MotCtrlMgr.PhaOnTiSumC.Val "MICROSAR RTE" /begin SUB_GROUP /end SUB_GROUP /begin FUNCTION_LIST /end FUNCTION_LIST /begin REF_CHARACTERISTIC /end REF_CHARACTERISTIC /begin REF_MEASUREMENT CDD_MotCtrlMgr.PhaOnTiSumC.Val /end REF_MEASUREMENT /end GROUP
/begin GROUP CDD_MotCtrlMgr.ReceiverPorts "MICROSAR RTE"
 /begin SUB_GROUP CDD_MotCtrlMgr.BrdgVltg.Val CDD_MotCtrlMgr.CurrMeasCorrlnSts.Val CDD_MotCtrlMgr.CurrMeasWrmIninTestCmpl.Logl CDD_MotCtrlMgr.DiagcStsIvtr1Inactv.Logl CDD_MotCtrlMgr.DualEcuMotCtrlMtgtnEna.Logl CDD_MotCtrlMgr.EcuTFild.Val CDD_MotCtrlMgr.IvtrFetFltPha.Val CDD_MotCtrlMgr.IvtrFetFltTyp.Val CDD_MotCtrlMgr.LoopCntr2MilliSec.Val CDD_MotCtrlMgr.MotAg2Cos.Val CDD_MotCtrlMgr.MotAg2CosAdcFaild.Logl CDD_MotCtrlMgr.MotAg2Sin.Val CDD_MotCtrlMgr.MotAg2SinAdcFaild.Logl CDD_MotCtrlMgr.MotAg5CosAdcFaild.Logl CDD_MotCtrlMgr.MotAg5CosRtAmpRecpr.Val CDD_MotCtrlMgr.MotAg5CosRtOffs.Val CDD_MotCtrlMgr.MotAg5MeclQlfr.Val CDD_MotCtrlMgr.MotAg5MeclRollgCntr.Val CDD_MotCtrlMgr.MotAg5SinAdcFaild.Logl CDD_MotCtrlMgr.MotAg5SinRtAmpRecpr.Val CDD_MotCtrlMgr.MotAg5SinRtOffs.Val CDD_MotCtrlMgr.MotAg6CosAdcFaild.Logl CDD_MotCtrlMgr.MotAg6CosRtAmpRecpr.Val CDD_MotCtrlMgr.MotAg6CosRtOffs.Val CDD_MotCtrlMgr.MotAg6MeclQlfr.Val CDD_MotCtrlMgr.MotAg6MeclRollgCntr.Val CDD_MotCtrlMgr.MotAg6SinAdcFaild.Logl CDD_MotCtrlMgr.MotAg6SinRtAmpRecpr.Val CDD_MotCtrlMgr.MotAg6SinRtOffs.Val CDD_MotCtrlMgr.MotAgElecDly.Val CDD_MotCtrlMgr.MotAgElecDlyRpl.Val CDD_MotCtrlMgr.MotAgMecl5Polarity.Val CDD_MotCtrlMgr.MotAgMecl6Polarity.Val CDD_MotCtrlMgr.MotAgMeclCorrlnSt.Val CDD_MotCtrlMgr.MotAndThermProtnLoaMod.Val CDD_MotCtrlMgr.MotBackEmfVltg.Val CDD_MotCtrlMgr.MotCurrAdcVlyAAdcFaild.Logl CDD_MotCtrlMgr.MotCurrAdcVlyBAdcFaild.Logl CDD_MotCtrlMgr.MotCurrAdcVlyCAdcFaild.Logl CDD_MotCtrlMgr.MotCurrDaxCmd.Val CDD_MotCtrlMgr.MotCurrDaxMax.Val CDD_MotCtrlMgr.MotCurrEolCalSt.Val CDD_MotCtrlMgr.MotCurrQaxCmd.Val CDD_MotCtrlMgr.MotCurrQaxToMotTqGain.Val CDD_MotCtrlMgr.MotCurrQlfr1.Val CDD_MotCtrlMgr.MotDampgDax.Val CDD_MotCtrlMgr.MotDampgQax.Val CDD_MotCtrlMgr.MotElecMeclPolarity.Val CDD_MotCtrlMgr.MotInduDaxEstimdIvs.Val CDD_MotCtrlMgr.MotInduQaxEstimdIvs.Val CDD_MotCtrlMgr.MotIntglGainDax.Val CDD_MotCtrlMgr.MotIntglGainQax.Val CDD_MotCtrlMgr.MotPropGainDax.Val CDD_MotCtrlMgr.MotPropGainQax.Val CDD_MotCtrlMgr.MotREstimd.Val CDD_MotCtrlMgr.MotReacncDax.Val CDD_MotCtrlMgr.MotReacncQax.Val CDD_MotCtrlMgr.MotTqRplCoggOrder1Mgn.Val CDD_MotCtrlMgr.MotTqRplCoggOrder1Pha.Val CDD_MotCtrlMgr.MotTqRplCoggOrder2Mgn.Val CDD_MotCtrlMgr.MotTqRplCoggOrder2Pha.Val CDD_MotCtrlMgr.MotTqRplCoggOrder3Mgn.Val CDD_MotCtrlMgr.MotTqRplCoggOrder3Pha.Val CDD_MotCtrlMgr.MotVelMrf.Val CDD_MotCtrlMgr.MotVltgDaxFf.Val CDD_MotCtrlMgr.MotVltgQaxFf.Val CDD_MotCtrlMgr.SysSt.Val CDD_MotCtrlMgr.VehSpd.Val /end SUB_GROUP
 /begin FUNCTION_LIST /end FUNCTION_LIST
 /begin REF_CHARACTERISTIC /end REF_CHARACTERISTIC
 /begin REF_MEASUREMENT /end REF_MEASUREMENT
/end GROUP
/begin GROUP CDD_MotCtrlMgr.SenderPorts "MICROSAR RTE"
 /begin SUB_GROUP CDD_MotCtrlMgr.FastLoopCntr.Val CDD_MotCtrlMgr.MotAg5Cos.Val CDD_MotCtrlMgr.MotAg5Mecl.Val CDD_MotCtrlMgr.MotAg5RawMecl.Val CDD_MotCtrlMgr.MotAg5Sin.Val CDD_MotCtrlMgr.MotAg6Cos.Val CDD_MotCtrlMgr.MotAg6Mecl.Val CDD_MotCtrlMgr.MotAg6RawMecl.Val CDD_MotCtrlMgr.MotAg6Sin.Val CDD_MotCtrlMgr.MotAgBuf.Ary1D CDD_MotCtrlMgr.MotAgBufIdx.Val CDD_MotCtrlMgr.MotAgCumvAlgndMrfRev.Val CDD_MotCtrlMgr.MotAgCumvInid.Logl CDD_MotCtrlMgr.MotAgTiBuf.Ary1D CDD_MotCtrlMgr.MotCurrAdcVlyA.Val CDD_MotCtrlMgr.MotCurrAdcVlyB.Val CDD_MotCtrlMgr.MotCurrAdcVlyC.Val CDD_MotCtrlMgr.MotCurrCorrdA.Val CDD_MotCtrlMgr.MotCurrCorrdB.Val CDD_MotCtrlMgr.MotCurrCorrdC.Val CDD_MotCtrlMgr.MotCurrDax.Val CDD_MotCtrlMgr.MotCurrQax.Val CDD_MotCtrlMgr.MotCurrRollgCntr1.Val CDD_MotCtrlMgr.MotVltgDax.Val CDD_MotCtrlMgr.MotVltgDaxFild.Val CDD_MotCtrlMgr.MotVltgQax.Val CDD_MotCtrlMgr.MotVltgQaxFild.Val CDD_MotCtrlMgr.Ntc5DErrCnt.Val CDD_MotCtrlMgr.PhaOnTiSumA.Val CDD_MotCtrlMgr.PhaOnTiSumB.Val CDD_MotCtrlMgr.PhaOnTiSumC.Val CDD_MotCtrlMgr.SlowLoopCntr.Val /end SUB_GROUP
 /begin FUNCTION_LIST /end FUNCTION_LIST
 /begin REF_CHARACTERISTIC /end REF_CHARACTERISTIC
 /begin REF_MEASUREMENT /end REF_MEASUREMENT
/end GROUP
/begin GROUP CDD_MotCtrlMgr.SlowLoopCntr.Val "MICROSAR RTE" /begin SUB_GROUP /end SUB_GROUP /begin FUNCTION_LIST /end FUNCTION_LIST /begin REF_CHARACTERISTIC /end REF_CHARACTERISTIC /begin REF_MEASUREMENT CDD_MotCtrlMgr.SlowLoopCntr.Val /end REF_MEASUREMENT /end GROUP
/begin GROUP CDD_MotCtrlMgr.SysSt.Val "MICROSAR RTE" /begin SUB_GROUP /end SUB_GROUP /begin FUNCTION_LIST /end FUNCTION_LIST /begin REF_CHARACTERISTIC /end REF_CHARACTERISTIC /begin REF_MEASUREMENT CDD_MotCtrlMgr.SysSt.Val /end REF_MEASUREMENT /end GROUP
/begin GROUP CDD_MotCtrlMgr.VehSpd.Val "MICROSAR RTE" /begin SUB_GROUP /end SUB_GROUP /begin FUNCTION_LIST /end FUNCTION_LIST /begin REF_CHARACTERISTIC /end REF_CHARACTERISTIC /begin REF_MEASUREMENT CDD_MotCtrlMgr.VehSpd.Val /end REF_MEASUREMENT /end GROUP
/begin GROUP CDD_MotCurrRegVltgLimr "MICROSAR RTE"
 /begin SUB_GROUP CDD_MotCurrRegVltgLimr.CalibrationPorts CDD_MotCurrRegVltgLimr.PerInstanceMemories /end SUB_GROUP
 /begin FUNCTION_LIST /end FUNCTION_LIST
 /begin REF_CHARACTERISTIC /end REF_CHARACTERISTIC
 /begin REF_MEASUREMENT /end REF_MEASUREMENT
/end GROUP
/begin GROUP CDD_MotCurrRegVltgLimr.AntiWdupCmdScaDax "MICROSAR RTE" /begin SUB_GROUP /end SUB_GROUP /begin FUNCTION_LIST /end FUNCTION_LIST /begin REF_CHARACTERISTIC /end REF_CHARACTERISTIC /begin REF_MEASUREMENT CDD_MotCurrRegVltgLimr.AntiWdupCmdScaDax /end REF_MEASUREMENT /end GROUP
/begin GROUP CDD_MotCurrRegVltgLimr.AntiWdupCmdScaQax "MICROSAR RTE" /begin SUB_GROUP /end SUB_GROUP /begin FUNCTION_LIST /end FUNCTION_LIST /begin REF_CHARACTERISTIC /end REF_CHARACTERISTIC /begin REF_MEASUREMENT CDD_MotCurrRegVltgLimr.AntiWdupCmdScaQax /end REF_MEASUREMENT /end GROUP
/begin GROUP CDD_MotCurrRegVltgLimr.CalibrationPorts "MICROSAR RTE"
 /begin SUB_GROUP CDD_MotCurrRegVltgLimr.MotCurrRegCfgCurrLoopSecOrderTrfFctEna.Logl CDD_MotCurrRegVltgLimr.MotCurrRegCfgMotRVirtDax.Val CDD_MotCurrRegVltgLimr.MotCurrRegCfgMotRVirtQax.Val CDD_MotCurrRegVltgLimr.MotCurrRegVltgLimrCurrLoaScarSlewRate.Val CDD_MotCurrRegVltgLimr.MotCurrRegVltgLimrDaxAntiWdupCoeff.Val CDD_MotCurrRegVltgLimr.MotCurrRegVltgLimrDualEcuLoaScarSlewRate.Val CDD_MotCurrRegVltgLimr.MotCurrRegVltgLimrFETLoaScarSlewRate.Val CDD_MotCurrRegVltgLimr.MotCurrRegVltgLimrIvtrLoaScarSlewRate.Val CDD_MotCurrRegVltgLimr.MotCurrRegVltgLimrMotCurrPredEna.Logl CDD_MotCurrRegVltgLimr.MotCurrRegVltgLimrMotCurrPredTi.Val CDD_MotCurrRegVltgLimr.MotCurrRegVltgLimrMotCurrQaxRefMdfnRplEna.Logl CDD_MotCurrRegVltgLimr.MotCurrRegVltgLimrMotVltgBrdgFilEna.Logl CDD_MotCurrRegVltgLimr.MotCurrRegVltgLimrMotVltgBrdgLpFilFrq.Val CDD_MotCurrRegVltgLimr.MotCurrRegVltgLimrMotVltgDaxIntglHiLim.Val CDD_MotCurrRegVltgLimr.MotCurrRegVltgLimrMotVltgDaxIntglLoLim.Val CDD_MotCurrRegVltgLimr.MotCurrRegVltgLimrMotVltgQaxFfFilEna.Logl CDD_MotCurrRegVltgLimr.MotCurrRegVltgLimrMotVltgQaxFfLpFilFrq.Val CDD_MotCurrRegVltgLimr.MotCurrRegVltgLimrMotVltgQaxIntglHiLim.Val CDD_MotCurrRegVltgLimr.MotCurrRegVltgLimrMotVltgQaxIntglLoLim.Val CDD_MotCurrRegVltgLimr.MotCurrRegVltgLimrQaxAntiWdupCoeff.Val CDD_MotCurrRegVltgLimr.MotCurrRegVltgLimrQaxAntiWdupScagDi.Logl CDD_MotCurrRegVltgLimr.MotRefMdlFbCtrlDi.Logl CDD_MotCurrRegVltgLimr.MotRefMdlIvtrDeadTiBrdgVltgSca.Val /end SUB_GROUP
 /begin FUNCTION_LIST /end FUNCTION_LIST
 /begin REF_CHARACTERISTIC /end REF_CHARACTERISTIC
 /begin REF_MEASUREMENT /end REF_MEASUREMENT
/end GROUP
/begin GROUP CDD_MotCurrRegVltgLimr.CurrLoaScarPrev "MICROSAR RTE" /begin SUB_GROUP /end SUB_GROUP /begin FUNCTION_LIST /end FUNCTION_LIST /begin REF_CHARACTERISTIC /end REF_CHARACTERISTIC /begin REF_MEASUREMENT CDD_MotCurrRegVltgLimr.CurrLoaScarPrev /end REF_MEASUREMENT /end GROUP
/begin GROUP CDD_MotCurrRegVltgLimr.DualEcuLoaScarPrev "MICROSAR RTE" /begin SUB_GROUP /end SUB_GROUP /begin FUNCTION_LIST /end FUNCTION_LIST /begin REF_CHARACTERISTIC /end REF_CHARACTERISTIC /begin REF_MEASUREMENT CDD_MotCurrRegVltgLimr.DualEcuLoaScarPrev /end REF_MEASUREMENT /end GROUP
/begin GROUP CDD_MotCurrRegVltgLimr.FETLoaScarPrev "MICROSAR RTE" /begin SUB_GROUP /end SUB_GROUP /begin FUNCTION_LIST /end FUNCTION_LIST /begin REF_CHARACTERISTIC /end REF_CHARACTERISTIC /begin REF_MEASUREMENT CDD_MotCurrRegVltgLimr.FETLoaScarPrev /end REF_MEASUREMENT /end GROUP
/begin GROUP CDD_MotCurrRegVltgLimr.IvtrLoaScarPrev "MICROSAR RTE" /begin SUB_GROUP /end SUB_GROUP /begin FUNCTION_LIST /end FUNCTION_LIST /begin REF_CHARACTERISTIC /end REF_CHARACTERISTIC /begin REF_MEASUREMENT CDD_MotCurrRegVltgLimr.IvtrLoaScarPrev /end REF_MEASUREMENT /end GROUP
/begin GROUP CDD_MotCurrRegVltgLimr.MotCtrlMotVltgDaxPrev "MICROSAR RTE" /begin SUB_GROUP /end SUB_GROUP /begin FUNCTION_LIST /end FUNCTION_LIST /begin REF_CHARACTERISTIC /end REF_CHARACTERISTIC /begin REF_MEASUREMENT CDD_MotCurrRegVltgLimr.MotCtrlMotVltgDaxPrev /end REF_MEASUREMENT /end GROUP
/begin GROUP CDD_MotCurrRegVltgLimr.MotCtrlMotVltgQaxPrev "MICROSAR RTE" /begin SUB_GROUP /end SUB_GROUP /begin FUNCTION_LIST /end FUNCTION_LIST /begin REF_CHARACTERISTIC /end REF_CHARACTERISTIC /begin REF_MEASUREMENT CDD_MotCurrRegVltgLimr.MotCtrlMotVltgQaxPrev /end REF_MEASUREMENT /end GROUP
/begin GROUP CDD_MotCurrRegVltgLimr.MotCurrRegCfgCurrLoopSecOrderTrfFctEna.Logl "MICROSAR RTE" /begin SUB_GROUP /end SUB_GROUP /begin FUNCTION_LIST /end FUNCTION_LIST
 /begin REF_CHARACTERISTIC CDD_MotCurrRegVltgLimr.MotCurrRegCfgCurrLoopSecOrderTrfFctEna.Logl /end REF_CHARACTERISTIC
 /begin REF_MEASUREMENT /end REF_MEASUREMENT
/end GROUP
/begin GROUP CDD_MotCurrRegVltgLimr.MotCurrRegCfgMotRVirtDax.Val "MICROSAR RTE" /begin SUB_GROUP /end SUB_GROUP /begin FUNCTION_LIST /end FUNCTION_LIST /begin REF_CHARACTERISTIC CDD_MotCurrRegVltgLimr.MotCurrRegCfgMotRVirtDax.Val /end REF_CHARACTERISTIC /begin REF_MEASUREMENT /end REF_MEASUREMENT /end GROUP
/begin GROUP CDD_MotCurrRegVltgLimr.MotCurrRegCfgMotRVirtQax.Val "MICROSAR RTE" /begin SUB_GROUP /end SUB_GROUP /begin FUNCTION_LIST /end FUNCTION_LIST /begin REF_CHARACTERISTIC CDD_MotCurrRegVltgLimr.MotCurrRegCfgMotRVirtQax.Val /end REF_CHARACTERISTIC /begin REF_MEASUREMENT /end REF_MEASUREMENT /end GROUP
/begin GROUP CDD_MotCurrRegVltgLimr.MotCurrRegVltgLimrCurrLoaScarSlewRate.Val "MICROSAR RTE" /begin SUB_GROUP /end SUB_GROUP /begin FUNCTION_LIST /end FUNCTION_LIST
 /begin REF_CHARACTERISTIC CDD_MotCurrRegVltgLimr.MotCurrRegVltgLimrCurrLoaScarSlewRate.Val /end REF_CHARACTERISTIC
 /begin REF_MEASUREMENT /end REF_MEASUREMENT
/end GROUP
/begin GROUP CDD_MotCurrRegVltgLimr.MotCurrRegVltgLimrDaxAntiWdupCoeff.Val "MICROSAR RTE" /begin SUB_GROUP /end SUB_GROUP /begin FUNCTION_LIST /end FUNCTION_LIST
 /begin REF_CHARACTERISTIC CDD_MotCurrRegVltgLimr.MotCurrRegVltgLimrDaxAntiWdupCoeff.Val /end REF_CHARACTERISTIC
 /begin REF_MEASUREMENT /end REF_MEASUREMENT
/end GROUP
/begin GROUP CDD_MotCurrRegVltgLimr.MotCurrRegVltgLimrDualEcuLoaScarSlewRate.Val "MICROSAR RTE" /begin SUB_GROUP /end SUB_GROUP /begin FUNCTION_LIST /end FUNCTION_LIST
 /begin REF_CHARACTERISTIC CDD_MotCurrRegVltgLimr.MotCurrRegVltgLimrDualEcuLoaScarSlewRate.Val /end REF_CHARACTERISTIC
 /begin REF_MEASUREMENT /end REF_MEASUREMENT
/end GROUP
/begin GROUP CDD_MotCurrRegVltgLimr.MotCurrRegVltgLimrFETLoaScarSlewRate.Val "MICROSAR RTE" /begin SUB_GROUP /end SUB_GROUP /begin FUNCTION_LIST /end FUNCTION_LIST
 /begin REF_CHARACTERISTIC CDD_MotCurrRegVltgLimr.MotCurrRegVltgLimrFETLoaScarSlewRate.Val /end REF_CHARACTERISTIC
 /begin REF_MEASUREMENT /end REF_MEASUREMENT
/end GROUP
/begin GROUP CDD_MotCurrRegVltgLimr.MotCurrRegVltgLimrIvtrLoaScarSlewRate.Val "MICROSAR RTE" /begin SUB_GROUP /end SUB_GROUP /begin FUNCTION_LIST /end FUNCTION_LIST
 /begin REF_CHARACTERISTIC CDD_MotCurrRegVltgLimr.MotCurrRegVltgLimrIvtrLoaScarSlewRate.Val /end REF_CHARACTERISTIC
 /begin REF_MEASUREMENT /end REF_MEASUREMENT
/end GROUP
/begin GROUP CDD_MotCurrRegVltgLimr.MotCurrRegVltgLimrMotCurrPredEna.Logl "MICROSAR RTE" /begin SUB_GROUP /end SUB_GROUP /begin FUNCTION_LIST /end FUNCTION_LIST
 /begin REF_CHARACTERISTIC CDD_MotCurrRegVltgLimr.MotCurrRegVltgLimrMotCurrPredEna.Logl /end REF_CHARACTERISTIC
 /begin REF_MEASUREMENT /end REF_MEASUREMENT
/end GROUP
/begin GROUP CDD_MotCurrRegVltgLimr.MotCurrRegVltgLimrMotCurrPredTi.Val "MICROSAR RTE" /begin SUB_GROUP /end SUB_GROUP /begin FUNCTION_LIST /end FUNCTION_LIST /begin REF_CHARACTERISTIC CDD_MotCurrRegVltgLimr.MotCurrRegVltgLimrMotCurrPredTi.Val /end REF_CHARACTERISTIC /begin REF_MEASUREMENT /end REF_MEASUREMENT /end GROUP
/begin GROUP CDD_MotCurrRegVltgLimr.MotCurrRegVltgLimrMotCurrQaxRefMdfnRplEna.Logl "MICROSAR RTE" /begin SUB_GROUP /end SUB_GROUP /begin FUNCTION_LIST /end FUNCTION_LIST
 /begin REF_CHARACTERISTIC CDD_MotCurrRegVltgLimr.MotCurrRegVltgLimrMotCurrQaxRefMdfnRplEna.Logl /end REF_CHARACTERISTIC
 /begin REF_MEASUREMENT /end REF_MEASUREMENT
/end GROUP
/begin GROUP CDD_MotCurrRegVltgLimr.MotCurrRegVltgLimrMotVltgBrdgFilEna.Logl "MICROSAR RTE" /begin SUB_GROUP /end SUB_GROUP /begin FUNCTION_LIST /end FUNCTION_LIST
 /begin REF_CHARACTERISTIC CDD_MotCurrRegVltgLimr.MotCurrRegVltgLimrMotVltgBrdgFilEna.Logl /end REF_CHARACTERISTIC
 /begin REF_MEASUREMENT /end REF_MEASUREMENT
/end GROUP
/begin GROUP CDD_MotCurrRegVltgLimr.MotCurrRegVltgLimrMotVltgBrdgLpFilFrq.Val "MICROSAR RTE" /begin SUB_GROUP /end SUB_GROUP /begin FUNCTION_LIST /end FUNCTION_LIST
 /begin REF_CHARACTERISTIC CDD_MotCurrRegVltgLimr.MotCurrRegVltgLimrMotVltgBrdgLpFilFrq.Val /end REF_CHARACTERISTIC
 /begin REF_MEASUREMENT /end REF_MEASUREMENT
/end GROUP
/begin GROUP CDD_MotCurrRegVltgLimr.MotCurrRegVltgLimrMotVltgDaxIntglHiLim.Val "MICROSAR RTE" /begin SUB_GROUP /end SUB_GROUP /begin FUNCTION_LIST /end FUNCTION_LIST
 /begin REF_CHARACTERISTIC CDD_MotCurrRegVltgLimr.MotCurrRegVltgLimrMotVltgDaxIntglHiLim.Val /end REF_CHARACTERISTIC
 /begin REF_MEASUREMENT /end REF_MEASUREMENT
/end GROUP
/**********************************************************************************************************************
* RECORD_LAYOUT
*********************************************************************************************************************/
/begin RECORD_LAYOUT RTE_RL_UBYTE FNC_VALUES 1 UBYTE ROW_DIR DIRECT /end RECORD_LAYOUT
/begin RECORD_LAYOUT RTE_RL_UWORD FNC_VALUES 1 UWORD ROW_DIR DIRECT /end RECORD_LAYOUT
/begin RECORD_LAYOUT RTE_RL_FLOAT32_IEEE FNC_VALUES 1 FLOAT32_IEEE ROW_DIR DIRECT /end RECORD_LAYOUT
/begin RECORD_LAYOUT RTE_RL_BOOLEAN FNC_VALUES 1 UBYTE ROW_DIR DIRECT /end RECORD_LAYOUT
/**********************************************************************************************************************
* COMPU_METHOD / COMPU_VTAB_RANGE
*********************************************************************************************************************/
/begin COMPU_METHOD RTE_CM_BOOLEAN "" TAB_VERB "%3.1" "" COMPU_TAB_REF RTE_CM_BOOLEAN /end COMPU_METHOD
/begin COMPU_VTAB_RANGE RTE_CM_BOOLEAN "" 2 0 0 "false" 1 255 "true" /end COMPU_VTAB_RANGE
/begin COMPU_METHOD RTE_CM_ENUM_SysSt1 "" TAB_VERB "%.1" "" COMPU_TAB_REF RTE_CM_ENUM_SysSt1 /end COMPU_METHOD
/begin COMPU_VTAB_RANGE RTE_CM_ENUM_SysSt1 "" 4 0 0 "SYSST_DI" 1 1 "SYSST_OFF" 2 2 "SYSST_ENA" 3 3 "SYSST_WRMININ" /end COMPU_VTAB_RANGE
/begin COMPU_METHOD RTE_CM_ENUM_SigQlfr1 "" TAB_VERB "%.1" "" COMPU_TAB_REF RTE_CM_ENUM_SigQlfr1 /end COMPU_METHOD
/begin COMPU_VTAB_RANGE RTE_CM_ENUM_SigQlfr1 "" 3 0 0 "SIGQLFR_NORES" 1 1 "SIGQLFR_PASSD" 2 2 "SIGQLFR_FAILD" /end COMPU_VTAB_RANGE
/begin COMPU_METHOD RTE_CM_ENUM_MotCurrEolCalSt2 "" TAB_VERB "%.1" "" COMPU_TAB_REF RTE_CM_ENUM_MotCurrEolCalSt2 /end COMPU_METHOD
/begin COMPU_VTAB_RANGE RTE_CM_ENUM_MotCurrEolCalSt2 "" 9 0 0 "MCECS_OFFSCMDSTRT" 1 1 "MCECS_OFFSCMDHI" 2 2 "MCECS_OFFSCMDLO" 3 3 "MCECS_OFFSCMDZERO" 4 4 "MCECS_OFFSCMDEND" 5 5 "MCECS_GAINCMDAD" 6 6 "MCECS_GAINCMDBE" 7 7 "MCECS_GAINCMDCF" 8 8 "MCECS_CMDSAFEST" /end COMPU_VTAB_RANGE
/begin COMPU_METHOD RTE_CM_ENUM_IvtrFetFltPha1 "" TAB_VERB "%.1" "" COMPU_TAB_REF RTE_CM_ENUM_IvtrFetFltPha1 /end COMPU_METHOD
/begin COMPU_VTAB_RANGE RTE_CM_ENUM_IvtrFetFltPha1 "" 4 0 0 "IVTRFETFLTPHA_NOPHASNGFETFLT" 1 1 "IVTRFETFLTPHA_PHAASNGFETFLT" 2 2 "IVTRFETFLTPHA_PHABSNGFETFLT" 4 4 "IVTRFETFLTPHA_PHACSNGFETFLT" /end COMPU_VTAB_RANGE
/begin COMPU_METHOD RTE_CM_Ag9 "" RAT_FUNC "%.1" "MotRevElec" COEFFS 0 65536 0 0 0 1 /end COMPU_METHOD
/begin COMPU_METHOD RTE_CM_Ag8 "" RAT_FUNC "%.1" "MotRev" COEFFS 0 65536 0 0 0 1 /end COMPU_METHOD
/begin COMPU_METHOD RTE_CM_Ag7 "" RAT_FUNC "%.1" "MotDeg" COEFFS 0 8192 0 0 0 1 /end COMPU_METHOD
/begin COMPU_METHOD RTE_CM_ENUM_IvtrFetFltTyp1 "" TAB_VERB "%.1" "" COMPU_TAB_REF RTE_CM_ENUM_IvtrFetFltTyp1 /end COMPU_METHOD
/begin COMPU_VTAB_RANGE RTE_CM_ENUM_IvtrFetFltTyp1 "" 4 0 0 "IVTRFETFLTTYP_NOFETFLT" 1 1 "IVTRFETFLTTYP_LOWRFETFLT" 2 2 "IVTRFETFLTTYP_UPPRFETFLT" 4 4 "IVTRFETFLTTYP_MPLFETFLT" /end COMPU_VTAB_RANGE
/begin COMPU_METHOD RTE_CM_Ag5 "" RAT_FUNC "%.1" "MotRev" COEFFS 0 65536 0 0 0 1 /end COMPU_METHOD
