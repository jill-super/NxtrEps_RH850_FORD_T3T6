/begin CHARACTERISTIC CDD_CurrMeas.CurrMeasEolFixdPwmPerd.Val "MICROSAR RTE" VALUE 0x0 RTE_RL_ULONG 0 NO_COMPU_METHOD 0 4294967295 SYMBOL_LINK "Rte_CalprmRom_CalRegn01Cmn_DEFAULT_RTE_CALPRM_GROUP.CurrMeasEolFixdPwmPerd_Val" 0 DISPLAY_IDENTIFIER CDD_CurrMeas.CalibrationPorts.CurrMeasEolFixdPwmPerd.Val /end CHARACTERISTIC
/begin CHARACTERISTIC CDD_CurrMeas.CurrMeasEolGainCalSetABCDft.CurrMeasMotCurrEolGainA "MICROSAR RTE" VALUE 0x0 RTE_RL_FLOAT32_IEEE 0 NO_COMPU_METHOD -3.402823466e+38 3.402823466e+38 SYMBOL_LINK "Rte_CalprmRom_CDD_CurrMeas_DEFAULT_RTE_CDATA_GROUP.CurrMeasEolGainCalSetABCDft.CurrMeasMotCurrEolGainA" 0 DISPLAY_IDENTIFIER CDD_CurrMeas.CalibrationParameters.CurrMeasEolGainCalSetABCDft.CurrMeasMotCurrEolGainA /end CHARACTERISTIC
/begin CHARACTERISTIC CDD_CurrMeas.CurrMeasEolGainCalSetABCDft.CurrMeasMotCurrEolGainB "MICROSAR RTE" VALUE 0x0 RTE_RL_FLOAT32_IEEE 0 NO_COMPU_METHOD -3.402823466e+38 3.402823466e+38 SYMBOL_LINK "Rte_CalprmRom_CDD_CurrMeas_DEFAULT_RTE_CDATA_GROUP.CurrMeasEolGainCalSetABCDft.CurrMeasMotCurrEolGainB" 0 DISPLAY_IDENTIFIER CDD_CurrMeas.CalibrationParameters.CurrMeasEolGainCalSetABCDft.CurrMeasMotCurrEolGainB /end CHARACTERISTIC
/begin CHARACTERISTIC CDD_CurrMeas.CurrMeasEolGainCalSetABCDft.CurrMeasMotCurrEolGainC "MICROSAR RTE" VALUE 0x0 RTE_RL_FLOAT32_IEEE 0 NO_COMPU_METHOD -3.402823466e+38 3.402823466e+38 SYMBOL_LINK "Rte_CalprmRom_CDD_CurrMeas_DEFAULT_RTE_CDATA_GROUP.CurrMeasEolGainCalSetABCDft.CurrMeasMotCurrEolGainC" 0 DISPLAY_IDENTIFIER CDD_CurrMeas.CalibrationParameters.CurrMeasEolGainCalSetABCDft.CurrMeasMotCurrEolGainC /end CHARACTERISTIC
/begin CHARACTERISTIC CDD_CurrMeas.CurrMeasEolGainMax.Val "MICROSAR RTE" VALUE 0x0 RTE_RL_FLOAT32_IEEE 0 NO_COMPU_METHOD -3.402823466e+38 3.402823466e+38 SYMBOL_LINK "Rte_CalprmRom_CalRegn01Cmn_DEFAULT_RTE_CALPRM_GROUP.CurrMeasEolGainMax_Val" 0 DISPLAY_IDENTIFIER CDD_CurrMeas.CalibrationPorts.CurrMeasEolGainMax.Val /end CHARACTERISTIC
/begin CHARACTERISTIC CDD_CurrMeas.CurrMeasEolGainMin.Val "MICROSAR RTE" VALUE 0x0 RTE_RL_FLOAT32_IEEE 0 NO_COMPU_METHOD -3.402823466e+38 3.402823466e+38 SYMBOL_LINK "Rte_CalprmRom_CalRegn01Cmn_DEFAULT_RTE_CALPRM_GROUP.CurrMeasEolGainMin_Val" 0 DISPLAY_IDENTIFIER CDD_CurrMeas.CalibrationPorts.CurrMeasEolGainMin.Val /end CHARACTERISTIC
/begin CHARACTERISTIC CDD_CurrMeas.CurrMeasEolGainNom.Val "MICROSAR RTE" VALUE 0x0 RTE_RL_FLOAT32_IEEE 0 NO_COMPU_METHOD -3.402823466e+38 3.402823466e+38 SYMBOL_LINK "Rte_CalprmRom_CalRegn01Cmn_DEFAULT_RTE_CALPRM_GROUP.CurrMeasEolGainNom_Val" 0 DISPLAY_IDENTIFIER CDD_CurrMeas.CalibrationPorts.CurrMeasEolGainNom.Val /end CHARACTERISTIC
/begin CHARACTERISTIC CDD_CurrMeas.CurrMeasEolGainNrOfSample.Val "MICROSAR RTE" VALUE 0x0 RTE_RL_UWORD 0 NO_COMPU_METHOD 0 65535 SYMBOL_LINK "Rte_CalprmRom_CalRegn01Cmn_DEFAULT_RTE_CALPRM_GROUP.CurrMeasEolGainNrOfSample_Val" 0 DISPLAY_IDENTIFIER CDD_CurrMeas.CalibrationPorts.CurrMeasEolGainNrOfSample.Val /end CHARACTERISTIC
/begin CHARACTERISTIC CDD_CurrMeas.CurrMeasEolGainNumer.Val "MICROSAR RTE" VALUE 0x0 RTE_RL_FLOAT32_IEEE 0 NO_COMPU_METHOD -3.402823466e+38 3.402823466e+38 SYMBOL_LINK "Rte_CalprmRom_CalRegn01Cmn_DEFAULT_RTE_CALPRM_GROUP.CurrMeasEolGainNumer_Val" 0 DISPLAY_IDENTIFIER CDD_CurrMeas.CalibrationPorts.CurrMeasEolGainNumer.Val /end CHARACTERISTIC
/begin CHARACTERISTIC CDD_CurrMeas.CurrMeasEolMaxMotVel.Val "MICROSAR RTE" VALUE 0x0 RTE_RL_FLOAT32_IEEE 0 NO_COMPU_METHOD -3.402823466e+38 3.402823466e+38 SYMBOL_LINK "Rte_CalprmRom_CalRegn01Cmn_DEFAULT_RTE_CALPRM_GROUP.CurrMeasEolMaxMotVel_Val" 0 DISPLAY_IDENTIFIER CDD_CurrMeas.CalibrationPorts.CurrMeasEolMaxMotVel.Val /end CHARACTERISTIC
/begin CHARACTERISTIC CDD_CurrMeas.CurrMeasEolOffsCalSetABCDft.CurrMeasEolOffsHiBrdgVltg "MICROSAR RTE" VALUE 0x0 RTE_RL_FLOAT32_IEEE 0 NO_COMPU_METHOD -3.402823466e+38 3.402823466e+38 SYMBOL_LINK "Rte_CalprmRom_CDD_CurrMeas_DEFAULT_RTE_CDATA_GROUP.CurrMeasEolOffsCalSetABCDft.CurrMeasEolOffsHiBrdgVltg" 0 DISPLAY_IDENTIFIER CDD_CurrMeas.CalibrationParameters.CurrMeasEolOffsCalSetABCDft.CurrMeasEolOffsHiBrdgVltg /end CHARACTERISTIC
/begin CHARACTERISTIC CDD_CurrMeas.CurrMeasEolOffsCalSetABCDft.CurrMeasMotCurrEolOffsDifA "MICROSAR RTE" VALUE 0x0 RTE_RL_FLOAT32_IEEE 0 NO_COMPU_METHOD -3.402823466e+38 3.402823466e+38 SYMBOL_LINK "Rte_CalprmRom_CDD_CurrMeas_DEFAULT_RTE_CDATA_GROUP.CurrMeasEolOffsCalSetABCDft.CurrMeasMotCurrEolOffsDifA" 0 DISPLAY_IDENTIFIER CDD_CurrMeas.CalibrationParameters.CurrMeasEolOffsCalSetABCDft.CurrMeasMotCurrEolOffsDifA /end CHARACTERISTIC
/begin CHARACTERISTIC CDD_CurrMeas.CurrMeasEolOffsCalSetABCDft.CurrMeasMotCurrEolOffsDifB "MICROSAR RTE" VALUE 0x0 RTE_RL_FLOAT32_IEEE 0 NO_COMPU_METHOD -3.402823466e+38 3.402823466e+38 SYMBOL_LINK "Rte_CalprmRom_CDD_CurrMeas_DEFAULT_RTE_CDATA_GROUP.CurrMeasEolOffsCalSetABCDft.CurrMeasMotCurrEolOffsDifB" 0 DISPLAY_IDENTIFIER CDD_CurrMeas.CalibrationParameters.CurrMeasEolOffsCalSetABCDft.CurrMeasMotCurrEolOffsDifB /end CHARACTERISTIC
/begin CHARACTERISTIC CDD_CurrMeas.CurrMeasEolOffsCalSetABCDft.CurrMeasMotCurrEolOffsDifC "MICROSAR RTE" VALUE 0x0 RTE_RL_FLOAT32_IEEE 0 NO_COMPU_METHOD -3.402823466e+38 3.402823466e+38 SYMBOL_LINK "Rte_CalprmRom_CDD_CurrMeas_DEFAULT_RTE_CDATA_GROUP.CurrMeasEolOffsCalSetABCDft.CurrMeasMotCurrEolOffsDifC" 0 DISPLAY_IDENTIFIER CDD_CurrMeas.CalibrationParameters.CurrMeasEolOffsCalSetABCDft.CurrMeasMotCurrEolOffsDifC /end CHARACTERISTIC
/begin CHARACTERISTIC CDD_CurrMeas.CurrMeasEolOffsCalSetABCDft.CurrMeasMotCurrOffsLoAvrgA "MICROSAR RTE" VALUE 0x0 RTE_RL_FLOAT32_IEEE 0 NO_COMPU_METHOD -3.402823466e+38 3.402823466e+38 SYMBOL_LINK "Rte_CalprmRom_CDD_CurrMeas_DEFAULT_RTE_CDATA_GROUP.CurrMeasEolOffsCalSetABCDft.CurrMeasMotCurrOffsLoAvrgA" 0 DISPLAY_IDENTIFIER CDD_CurrMeas.CalibrationParameters.CurrMeasEolOffsCalSetABCDft.CurrMeasMotCurrOffsLoAvrgA /end CHARACTERISTIC
/begin CHARACTERISTIC CDD_CurrMeas.CurrMeasEolOffsCalSetABCDft.CurrMeasMotCurrOffsLoAvrgB "MICROSAR RTE" VALUE 0x0 RTE_RL_FLOAT32_IEEE 0 NO_COMPU_METHOD -3.402823466e+38 3.402823466e+38 SYMBOL_LINK "Rte_CalprmRom_CDD_CurrMeas_DEFAULT_RTE_CDATA_GROUP.CurrMeasEolOffsCalSetABCDft.CurrMeasMotCurrOffsLoAvrgB" 0 DISPLAY_IDENTIFIER CDD_CurrMeas.CalibrationParameters.CurrMeasEolOffsCalSetABCDft.CurrMeasMotCurrOffsLoAvrgB /end CHARACTERISTIC
/begin CHARACTERISTIC CDD_CurrMeas.CurrMeasEolOffsCalSetABCDft.CurrMeasMotCurrOffsLoAvrgC "MICROSAR RTE" VALUE 0x0 RTE_RL_FLOAT32_IEEE 0 NO_COMPU_METHOD -3.402823466e+38 3.402823466e+38 SYMBOL_LINK "Rte_CalprmRom_CDD_CurrMeas_DEFAULT_RTE_CDATA_GROUP.CurrMeasEolOffsCalSetABCDft.CurrMeasMotCurrOffsLoAvrgC" 0 DISPLAY_IDENTIFIER CDD_CurrMeas.CalibrationParameters.CurrMeasEolOffsCalSetABCDft.CurrMeasMotCurrOffsLoAvrgC /end CHARACTERISTIC
/begin CHARACTERISTIC CDD_CurrMeas.CurrMeasEolOffsHiBrdgVltgMin.Val "MICROSAR RTE" VALUE 0x0 RTE_RL_FLOAT32_IEEE 0 NO_COMPU_METHOD -3.402823466e+38 3.402823466e+38 SYMBOL_LINK "Rte_CalprmRom_CalRegn01Cmn_DEFAULT_RTE_CALPRM_GROUP.CurrMeasEolOffsHiBrdgVltgMin_Val" 0 DISPLAY_IDENTIFIER CDD_CurrMeas.CalibrationPorts.CurrMeasEolOffsHiBrdgVltgMin.Val /end CHARACTERISTIC
/begin CHARACTERISTIC CDD_CurrMeas.CurrMeasEolOffsHiCmuOffs.Val "MICROSAR RTE" VALUE 0x0 RTE_RL_ULONG 0 NO_COMPU_METHOD 0 4294967295 SYMBOL_LINK "Rte_CalprmRom_CalRegn01Cmn_DEFAULT_RTE_CALPRM_GROUP.CurrMeasEolOffsHiCmuOffs_Val" 0 DISPLAY_IDENTIFIER CDD_CurrMeas.CalibrationPorts.CurrMeasEolOffsHiCmuOffs.Val /end CHARACTERISTIC
/begin CHARACTERISTIC CDD_CurrMeas.CurrMeasEolOffsLoCmuOffs.Val "MICROSAR RTE" VALUE 0x0 RTE_RL_ULONG 0 NO_COMPU_METHOD 0 4294967295 SYMBOL_LINK "Rte_CalprmRom_CalRegn01Cmn_DEFAULT_RTE_CALPRM_GROUP.CurrMeasEolOffsLoCmuOffs_Val" 0 DISPLAY_IDENTIFIER CDD_CurrMeas.CalibrationPorts.CurrMeasEolOffsLoCmuOffs.Val /end CHARACTERISTIC
/begin CHARACTERISTIC CDD_CurrMeas.CurrMeasEolOffsMax.Val "MICROSAR RTE" VALUE 0x0 RTE_RL_FLOAT32_IEEE 0 NO_COMPU_METHOD -3.402823466e+38 3.402823466e+38 SYMBOL_LINK "Rte_CalprmRom_CalRegn01Cmn_DEFAULT_RTE_CALPRM_GROUP.CurrMeasEolOffsMax_Val" 0 DISPLAY_IDENTIFIER CDD_CurrMeas.CalibrationPorts.CurrMeasEolOffsMax.Val /end CHARACTERISTIC
/begin CHARACTERISTIC CDD_CurrMeas.CurrMeasEolOffsMin.Val "MICROSAR RTE" VALUE 0x0 RTE_RL_FLOAT32_IEEE 0 NO_COMPU_METHOD -3.402823466e+38 3.402823466e+38 SYMBOL_LINK "Rte_CalprmRom_CalRegn01Cmn_DEFAULT_RTE_CALPRM_GROUP.CurrMeasEolOffsMin_Val" 0 DISPLAY_IDENTIFIER CDD_CurrMeas.CalibrationPorts.CurrMeasEolOffsMin.Val /end CHARACTERISTIC
/begin CHARACTERISTIC CDD_CurrMeas.CurrMeasEolOffsNom.Val "MICROSAR RTE" VALUE 0x0 RTE_RL_FLOAT32_IEEE 0 NO_COMPU_METHOD -3.402823466e+38 3.402823466e+38 SYMBOL_LINK "Rte_CalprmRom_CalRegn01Cmn_DEFAULT_RTE_CALPRM_GROUP.CurrMeasEolOffsNom_Val" 0 DISPLAY_IDENTIFIER CDD_CurrMeas.CalibrationPorts.CurrMeasEolOffsNom.Val /end CHARACTERISTIC
/begin CHARACTERISTIC CDD_CurrMeas.CurrMeasEolOffsNrOfSample.Val "MICROSAR RTE" VALUE 0x0 RTE_RL_UWORD 0 NO_COMPU_METHOD 0 65535 SYMBOL_LINK "Rte_CalprmRom_CalRegn01Cmn_DEFAULT_RTE_CALPRM_GROUP.CurrMeasEolOffsNrOfSample_Val" 0 DISPLAY_IDENTIFIER CDD_CurrMeas.CalibrationPorts.CurrMeasEolOffsNrOfSample.Val /end CHARACTERISTIC
/begin CHARACTERISTIC CDD_CurrMeas.CurrMeasEolTranCntrThd.Val "MICROSAR RTE" VALUE 0x0 RTE_RL_UBYTE 0 NO_COMPU_METHOD 0 255 SYMBOL_LINK "Rte_CalprmRom_CalRegn01Cmn_DEFAULT_RTE_CALPRM_GROUP.CurrMeasEolTranCntrThd_Val" 0 DISPLAY_IDENTIFIER CDD_CurrMeas.CalibrationPorts.CurrMeasEolTranCntrThd.Val /end CHARACTERISTIC
/begin CHARACTERISTIC CDD_CurrMeas.CurrMeasMinRqrdPhaOnTi.Val "MICROSAR RTE" VALUE 0x0 RTE_RL_ULONG 0 NO_COMPU_METHOD 0 4294967295 SYMBOL_LINK "Rte_CalprmRom_CalRegn01Cmn_DEFAULT_RTE_CALPRM_GROUP.CurrMeasMinRqrdPhaOnTi_Val" 0 DISPLAY_IDENTIFIER CDD_CurrMeas.CalibrationPorts.CurrMeasMinRqrdPhaOnTi.Val /end CHARACTERISTIC
/begin CHARACTERISTIC CDD_CurrMeas.CurrMeasMotAgCompuDly.Val "MICROSAR RTE" VALUE 0x0 RTE_RL_ULONG 0 NO_COMPU_METHOD 0 4294967295 SYMBOL_LINK "Rte_CalprmRom_CalRegn01Cmn_DEFAULT_RTE_CALPRM_GROUP.CurrMeasMotAgCompuDly_Val" 0 DISPLAY_IDENTIFIER CDD_CurrMeas.CalibrationPorts.CurrMeasMotAgCompuDly.Val /end CHARACTERISTIC
/begin CHARACTERISTIC CDD_CurrMeas.CurrMeasMotCurrAdcVlyWrmIninMax.Val "MICROSAR RTE" VALUE 0x0 RTE_RL_FLOAT32_IEEE 0 NO_COMPU_METHOD -3.402823466e+38 3.402823466e+38 SYMBOL_LINK "Rte_CalprmRom_CalRegn01Cmn_DEFAULT_RTE_CALPRM_GROUP.CurrMeasMotCurrAdcVlyWrmIninMax_Val" 0 DISPLAY_IDENTIFIER CDD_CurrMeas.CalibrationPorts.CurrMeasMotCurrAdcVlyWrmIninMax.Val /end CHARACTERISTIC
/begin CHARACTERISTIC CDD_CurrMeas.CurrMeasMotCurrAdcVlyWrmIninMin.Val "MICROSAR RTE" VALUE 0x0 RTE_RL_FLOAT32_IEEE 0 NO_COMPU_METHOD -3.402823466e+38 3.402823466e+38 SYMBOL_LINK "Rte_CalprmRom_CalRegn01Cmn_DEFAULT_RTE_CALPRM_GROUP.CurrMeasMotCurrAdcVlyWrmIninMin_Val" 0 DISPLAY_IDENTIFIER CDD_CurrMeas.CalibrationPorts.CurrMeasMotCurrAdcVlyWrmIninMin.Val /end CHARACTERISTIC
/begin CHARACTERISTIC CDD_CurrMeas.CurrMeasNtc0x05DFailStep.Val "MICROSAR RTE" VALUE 0x0 RTE_RL_UWORD 0 NO_COMPU_METHOD 0 65535 SYMBOL_LINK "Rte_CalprmRom_CalRegn01Cmn_DEFAULT_RTE_CALPRM_GROUP.CurrMeasNtc0x05DFailStep_Val" 0 DISPLAY_IDENTIFIER CDD_CurrMeas.CalibrationPorts.CurrMeasNtc0x05DFailStep.Val /end CHARACTERISTIC
/begin CHARACTERISTIC CDD_CurrMeas.CurrMeasNtc0x05DPassStep.Val "MICROSAR RTE" VALUE 0x0 RTE_RL_UWORD 0 NO_COMPU_METHOD 0 65535 SYMBOL_LINK "Rte_CalprmRom_CalRegn01Cmn_DEFAULT_RTE_CALPRM_GROUP.CurrMeasNtc0x05DPassStep_Val" 0 DISPLAY_IDENTIFIER CDD_CurrMeas.CalibrationPorts.CurrMeasNtc0x05DPassStep.Val /end CHARACTERISTIC
/begin CHARACTERISTIC CDD_CurrMeas.SysGlbPrmMotPoleCnt.Val "MICROSAR RTE" VALUE 0x0 RTE_RL_UBYTE 0 NO_COMPU_METHOD 0 255 SYMBOL_LINK "Rte_CalprmRom_CalRegn01Inin00_DEFAULT_RTE_CALPRM_GROUP.SysGlbPrmMotPoleCnt_Val" 0 DISPLAY_IDENTIFIER CDD_CurrMeas.CalibrationPorts.SysGlbPrmMotPoleCnt.Val /end CHARACTERISTIC
/begin CHARACTERISTIC CDD_CurrMeasArbn.CurrMeasArbnMaxStallCntr.Val "MICROSAR RTE" VALUE 0x0 RTE_RL_UBYTE 0 NO_COMPU_METHOD 0 255 SYMBOL_LINK "Rte_CalprmRom_CalRegn01Cmn_DEFAULT_RTE_CALPRM_GROUP.CurrMeasArbnMaxStallCntr_Val" 0 DISPLAY_IDENTIFIER CDD_CurrMeasArbn.CalibrationPorts.CurrMeasArbnMaxStallCntr.Val /end CHARACTERISTIC
/begin CHARACTERISTIC CDD_FordBlaBoxIfCmn.FordBlaBoxIfCmnVehSteerRat.Val "MICROSAR RTE" VALUE 0x0 RTE_RL_UWORD 0 NO_COMPU_METHOD 0 65535 SYMBOL_LINK "Rte_CalprmRom_CalRegn02Cmn_DEFAULT_RTE_CALPRM_GROUP.FordBlaBoxIfCmnVehSteerRat_Val" 0 DISPLAY_IDENTIFIER CDD_FordBlaBoxIfCmn.CalibrationPorts.FordBlaBoxIfCmnVehSteerRat.Val /end CHARACTERISTIC
/begin CHARACTERISTIC CDD_FordBlaBoxIfCmn.FordBlaBoxIfCmnVehWhlBas.Val "MICROSAR RTE" VALUE 0x0 RTE_RL_UWORD 0 NO_COMPU_METHOD 0 65535 SYMBOL_LINK "Rte_CalprmRom_CalRegn02Cmn_DEFAULT_RTE_CALPRM_GROUP.FordBlaBoxIfCmnVehWhlBas_Val" 0 DISPLAY_IDENTIFIER CDD_FordBlaBoxIfCmn.CalibrationPorts.FordBlaBoxIfCmnVehWhlBas.Val /end CHARACTERISTIC
/begin MEASUREMENT BattVltgCorrln.dBattVltgCorrlnNtc0x03CQlfrSts "MICROSAR RTE" UBYTE RTE_CM_ENUM_SigQlfr1 0 0 0 255 ECU_ADDRESS 0 SYMBOL_LINK "Rte_BattVltgCorrln_dBattVltgCorrlnNtc0x03CQlfrSts" 0 DISPLAY_IDENTIFIER BattVltgCorrln.PerInstanceMemories.dBattVltgCorrlnNtc0x03CQlfrSts /end MEASUREMENT
/begin MEASUREMENT BattVltgCorrln.dBattVltgCorrlnNtc0x044QlfrSts "MICROSAR RTE" UBYTE RTE_CM_ENUM_SigQlfr1 0 0 0 255 ECU_ADDRESS 0 SYMBOL_LINK "Rte_BattVltgCorrln_dBattVltgCorrlnNtc0x044QlfrSts" 0 DISPLAY_IDENTIFIER BattVltgCorrln.PerInstanceMemories.dBattVltgCorrlnNtc0x044QlfrSts /end MEASUREMENT
/begin MEASUREMENT BswM.Notification_SwcModeNotification_BswM_MDGP_BswMEcuResetMod.BswM_MDGP_BswMEcuResetMod "MICROSAR RTE" UBYTE RTE_CM_ENUM_BswMEcuResetMod 0 0 0 255 ECU_ADDRESS 0 SYMBOL_LINK "Rte_ModeMachine_CustDiag_BswM_MSI_BswMEcuResetMod_BswM_MDGP_BswMEcuResetMod" 0 DISPLAY_IDENTIFIER BswM.ModeRequirePorts.Notification_SwcModeNotification_BswM_MDGP_BswMEcuResetMod.BswM_MDGP_BswMEcuResetMod /end MEASUREMENT
/begin MEASUREMENT CDD_Adcf0CfgAndUse.Adcf0DiagcEndPtr "MICROSAR RTE" UBYTE NO_COMPU_METHOD 0 0 0 255 ECU_ADDRESS 0 SYMBOL_LINK "Rte_CDD_Adcf0CfgAndUse_Adcf0DiagcEndPtr" 0 DISPLAY_IDENTIFIER CDD_Adcf0CfgAndUse.PerInstanceMemories.Adcf0DiagcEndPtr /end MEASUREMENT
/begin MEASUREMENT CDD_Adcf0CfgAndUse.Adcf0DiagcStrtPtr "MICROSAR RTE" UBYTE NO_COMPU_METHOD 0 0 0 255 ECU_ADDRESS 0 SYMBOL_LINK "Rte_CDD_Adcf0CfgAndUse_Adcf0DiagcStrtPtr" 0 DISPLAY_IDENTIFIER CDD_Adcf0CfgAndUse.PerInstanceMemories.Adcf0DiagcStrtPtr /end MEASUREMENT
/begin MEASUREMENT CDD_CoreVltgMonr.CoreVltgMonrStrtUpFltPrmByte "MICROSAR RTE" UBYTE NO_COMPU_METHOD 0 0 0 255 ECU_ADDRESS 0 SYMBOL_LINK "Rte_CDD_CoreVltgMonr_CoreVltgMonrStrtUpFltPrmByte" 0 DISPLAY_IDENTIFIER CDD_CoreVltgMonr.PerInstanceMemories.CoreVltgMonrStrtUpFltPrmByte /end MEASUREMENT
/begin MEASUREMENT CDD_CoreVltgMonr.dCoreVltgMonrStrtUpTestCmpl "MICROSAR RTE" UBYTE RTE_CM_BOOLEAN 0 0 0 255 ECU_ADDRESS 0 SYMBOL_LINK "Rte_CDD_CoreVltgMonr_dCoreVltgMonrStrtUpTestCmpl" 0 DISPLAY_IDENTIFIER CDD_CoreVltgMonr.PerInstanceMemories.dCoreVltgMonrStrtUpTestCmpl /end MEASUREMENT
/begin MEASUREMENT CDD_CurrMeas.BrdgVltg.Val "MICROSAR RTE" FLOAT32_IEEE NO_COMPU_METHOD 0 0 -3.402823466e+38 3.402823466e+38 ECU_ADDRESS 0 SYMBOL_LINK "Rte_BattVltg_BrdgVltg_Val" 0 DISPLAY_IDENTIFIER CDD_CurrMeas.ReceiverPorts.BrdgVltg.Val /end MEASUREMENT
/begin MEASUREMENT CDD_CurrMeas.BrdgVltgSumPrev "MICROSAR RTE" FLOAT32_IEEE NO_COMPU_METHOD 0 0 -3.402823466e+38 3.402823466e+38 ECU_ADDRESS 0 SYMBOL_LINK "Rte_CDD_CurrMeas_BrdgVltgSumPrev" 0 DISPLAY_IDENTIFIER CDD_CurrMeas.PerInstanceMemories.BrdgVltgSumPrev /end MEASUREMENT
/begin MEASUREMENT CDD_CurrMeas.CurrMeasEolGainCalSetABC.CurrMeasMotCurrEolGainA "MICROSAR RTE" FLOAT32_IEEE NO_COMPU_METHOD 0 0 -3.402823466e+38 3.402823466e+38 ECU_ADDRESS 0 SYMBOL_LINK "Rte_CDD_CurrMeas_CurrMeasEolGainCalSetABC.CurrMeasMotCurrEolGainA" 0 DISPLAY_IDENTIFIER CDD_CurrMeas.PerInstanceMemories.CurrMeasEolGainCalSetABC.CurrMeasMotCurrEolGainA /end MEASUREMENT
/begin MEASUREMENT CDD_CurrMeas.CurrMeasEolGainCalSetABC.CurrMeasMotCurrEolGainB "MICROSAR RTE" FLOAT32_IEEE NO_COMPU_METHOD 0 0 -3.402823466e+38 3.402823466e+38 ECU_ADDRESS 0 SYMBOL_LINK "Rte_CDD_CurrMeas_CurrMeasEolGainCalSetABC.CurrMeasMotCurrEolGainB" 0 DISPLAY_IDENTIFIER CDD_CurrMeas.PerInstanceMemories.CurrMeasEolGainCalSetABC.CurrMeasMotCurrEolGainB /end MEASUREMENT
/begin MEASUREMENT CDD_CurrMeas.CurrMeasEolGainCalSetABC.CurrMeasMotCurrEolGainC "MICROSAR RTE" FLOAT32_IEEE NO_COMPU_METHOD 0 0 -3.402823466e+38 3.402823466e+38 ECU_ADDRESS 0 SYMBOL_LINK "Rte_CDD_CurrMeas_CurrMeasEolGainCalSetABC.CurrMeasMotCurrEolGainC" 0 DISPLAY_IDENTIFIER CDD_CurrMeas.PerInstanceMemories.CurrMeasEolGainCalSetABC.CurrMeasMotCurrEolGainC /end MEASUREMENT
/begin MEASUREMENT CDD_CurrMeas.CurrMeasEolOffsCalSetABC.CurrMeasEolOffsHiBrdgVltg "MICROSAR RTE" FLOAT32_IEEE NO_COMPU_METHOD 0 0 -3.402823466e+38 3.402823466e+38 ECU_ADDRESS 0 SYMBOL_LINK "Rte_CDD_CurrMeas_CurrMeasEolOffsCalSetABC.CurrMeasEolOffsHiBrdgVltg" 0 DISPLAY_IDENTIFIER CDD_CurrMeas.PerInstanceMemories.CurrMeasEolOffsCalSetABC.CurrMeasEolOffsHiBrdgVltg /end MEASUREMENT
/begin MEASUREMENT CDD_CurrMeas.CurrMeasEolOffsCalSetABC.CurrMeasMotCurrEolOffsDifA "MICROSAR RTE" FLOAT32_IEEE NO_COMPU_METHOD 0 0 -3.402823466e+38 3.402823466e+38 ECU_ADDRESS 0 SYMBOL_LINK "Rte_CDD_CurrMeas_CurrMeasEolOffsCalSetABC.CurrMeasMotCurrEolOffsDifA" 0 DISPLAY_IDENTIFIER CDD_CurrMeas.PerInstanceMemories.CurrMeasEolOffsCalSetABC.CurrMeasMotCurrEolOffsDifA /end MEASUREMENT
/begin MEASUREMENT CDD_CurrMeas.CurrMeasEolOffsCalSetABC.CurrMeasMotCurrEolOffsDifB "MICROSAR RTE" FLOAT32_IEEE NO_COMPU_METHOD 0 0 -3.402823466e+38 3.402823466e+38 ECU_ADDRESS 0 SYMBOL_LINK "Rte_CDD_CurrMeas_CurrMeasEolOffsCalSetABC.CurrMeasMotCurrEolOffsDifB" 0 DISPLAY_IDENTIFIER CDD_CurrMeas.PerInstanceMemories.CurrMeasEolOffsCalSetABC.CurrMeasMotCurrEolOffsDifB /end MEASUREMENT
/begin MEASUREMENT CDD_CurrMeas.CurrMeasEolOffsCalSetABC.CurrMeasMotCurrEolOffsDifC "MICROSAR RTE" FLOAT32_IEEE NO_COMPU_METHOD 0 0 -3.402823466e+38 3.402823466e+38 ECU_ADDRESS 0 SYMBOL_LINK "Rte_CDD_CurrMeas_CurrMeasEolOffsCalSetABC.CurrMeasMotCurrEolOffsDifC" 0 DISPLAY_IDENTIFIER CDD_CurrMeas.PerInstanceMemories.CurrMeasEolOffsCalSetABC.CurrMeasMotCurrEolOffsDifC /end MEASUREMENT
/begin MEASUREMENT CDD_CurrMeas.CurrMeasEolOffsCalSetABC.CurrMeasMotCurrOffsLoAvrgA "MICROSAR RTE" FLOAT32_IEEE NO_COMPU_METHOD 0 0 -3.402823466e+38 3.402823466e+38 ECU_ADDRESS 0 SYMBOL_LINK "Rte_CDD_CurrMeas_CurrMeasEolOffsCalSetABC.CurrMeasMotCurrOffsLoAvrgA" 0 DISPLAY_IDENTIFIER CDD_CurrMeas.PerInstanceMemories.CurrMeasEolOffsCalSetABC.CurrMeasMotCurrOffsLoAvrgA /end MEASUREMENT
/begin MEASUREMENT CDD_CurrMeas.CurrMeasEolOffsCalSetABC.CurrMeasMotCurrOffsLoAvrgB "MICROSAR RTE" FLOAT32_IEEE NO_COMPU_METHOD 0 0 -3.402823466e+38 3.402823466e+38 ECU_ADDRESS 0 SYMBOL_LINK "Rte_CDD_CurrMeas_CurrMeasEolOffsCalSetABC.CurrMeasMotCurrOffsLoAvrgB" 0 DISPLAY_IDENTIFIER CDD_CurrMeas.PerInstanceMemories.CurrMeasEolOffsCalSetABC.CurrMeasMotCurrOffsLoAvrgB /end MEASUREMENT
/begin MEASUREMENT CDD_CurrMeas.CurrMeasEolOffsCalSetABC.CurrMeasMotCurrOffsLoAvrgC "MICROSAR RTE" FLOAT32_IEEE NO_COMPU_METHOD 0 0 -3.402823466e+38 3.402823466e+38 ECU_ADDRESS 0 SYMBOL_LINK "Rte_CDD_CurrMeas_CurrMeasEolOffsCalSetABC.CurrMeasMotCurrOffsLoAvrgC" 0 DISPLAY_IDENTIFIER CDD_CurrMeas.PerInstanceMemories.CurrMeasEolOffsCalSetABC.CurrMeasMotCurrOffsLoAvrgC /end MEASUREMENT
/begin MEASUREMENT CDD_CurrMeas.CurrMeasWrmIninTestCmpl.Logl "MICROSAR RTE" UBYTE RTE_CM_BOOLEAN 0 0 0 255 ECU_ADDRESS 0 SYMBOL_LINK "Rte_CDD_CurrMeas_CurrMeasWrmIninTestCmpl_Logl" 0 DISPLAY_IDENTIFIER CDD_CurrMeas.SenderPorts.CurrMeasWrmIninTestCmpl.Logl /end MEASUREMENT
/begin MEASUREMENT CDD_CurrMeas.DiagcStsIvtr1Inactv.Logl "MICROSAR RTE" UBYTE RTE_CM_BOOLEAN 0 0 0 255 ECU_ADDRESS 0 SYMBOL_LINK "Rte_GateDrv0Ctrl_DiagcStsIvtr1Inactv_Logl" 0 DISPLAY_IDENTIFIER CDD_CurrMeas.ReceiverPorts.DiagcStsIvtr1Inactv.Logl /end MEASUREMENT
/begin MEASUREMENT CDD_CurrMeas.EolGainSts "MICROSAR RTE" UBYTE NO_COMPU_METHOD 0 0 0 255 ECU_ADDRESS 0 SYMBOL_LINK "Rte_CDD_CurrMeas_EolGainSts" 0 DISPLAY_IDENTIFIER CDD_CurrMeas.PerInstanceMemories.EolGainSts /end MEASUREMENT
/begin MEASUREMENT CDD_CurrMeas.EolGainTranCntrPrev "MICROSAR RTE" UBYTE NO_COMPU_METHOD 0 0 0 255 ECU_ADDRESS 0 SYMBOL_LINK "Rte_CDD_CurrMeas_EolGainTranCntrPrev" 0 DISPLAY_IDENTIFIER CDD_CurrMeas.PerInstanceMemories.EolGainTranCntrPrev /end MEASUREMENT
/begin MEASUREMENT CDD_CurrMeas.EolOffsHiBrdgVltg "MICROSAR RTE" FLOAT32_IEEE NO_COMPU_METHOD 0 0 -3.402823466e+38 3.402823466e+38 ECU_ADDRESS 0 SYMBOL_LINK "Rte_CDD_CurrMeas_EolOffsHiBrdgVltg" 0 DISPLAY_IDENTIFIER CDD_CurrMeas.PerInstanceMemories.EolOffsHiBrdgVltg /end MEASUREMENT
/begin MEASUREMENT CDD_CurrMeas.EolOffsSts "MICROSAR RTE" UBYTE NO_COMPU_METHOD 0 0 0 255 ECU_ADDRESS 0 SYMBOL_LINK "Rte_CDD_CurrMeas_EolOffsSts" 0 DISPLAY_IDENTIFIER CDD_CurrMeas.PerInstanceMemories.EolOffsSts /end MEASUREMENT
/begin MEASUREMENT CDD_CurrMeas.EolOffsTranCntrPrev "MICROSAR RTE" UBYTE NO_COMPU_METHOD 0 0 0 255 ECU_ADDRESS 0 SYMBOL_LINK "Rte_CDD_CurrMeas_EolOffsTranCntrPrev" 0 DISPLAY_IDENTIFIER CDD_CurrMeas.PerInstanceMemories.EolOffsTranCntrPrev /end MEASUREMENT
/begin MEASUREMENT CDD_CurrMeas.GainEolAvrgCntrPrev "MICROSAR RTE" UWORD NO_COMPU_METHOD 0 0 0 65535 ECU_ADDRESS 0 SYMBOL_LINK "Rte_CDD_CurrMeas_GainEolAvrgCntrPrev" 0 DISPLAY_IDENTIFIER CDD_CurrMeas.PerInstanceMemories.GainEolAvrgCntrPrev /end MEASUREMENT
/begin MEASUREMENT CDD_CurrMeas.MotCtrlNtc5DErrCntPrev "MICROSAR RTE" UWORD NO_COMPU_METHOD 0 0 0 65535 ECU_ADDRESS 0 SYMBOL_LINK "Rte_CDD_CurrMeas_MotCtrlNtc5DErrCntPrev" 0 DISPLAY_IDENTIFIER CDD_CurrMeas.PerInstanceMemories.MotCtrlNtc5DErrCntPrev /end MEASUREMENT
/begin MEASUREMENT CDD_CurrMeas.MotCurrAdcVlyA.Val "MICROSAR RTE" FLOAT32_IEEE NO_COMPU_METHOD 0 0 -3.402823466e+38 3.402823466e+38 ECU_ADDRESS 0 SYMBOL_LINK "Rte_CDD_MotCtrlMgr_MotCurrAdcVlyA_Val" 0 DISPLAY_IDENTIFIER CDD_CurrMeas.ReceiverPorts.MotCurrAdcVlyA.Val /end MEASUREMENT
/begin MEASUREMENT CDD_CurrMeas.MotCurrAdcVlyB.Val "MICROSAR RTE" FLOAT32_IEEE NO_COMPU_METHOD 0 0 -3.402823466e+38 3.402823466e+38 ECU_ADDRESS 0 SYMBOL_LINK "Rte_CDD_MotCtrlMgr_MotCurrAdcVlyB_Val" 0 DISPLAY_IDENTIFIER CDD_CurrMeas.ReceiverPorts.MotCurrAdcVlyB.Val /end MEASUREMENT
/begin MEASUREMENT CDD_CurrMeas.MotCurrAdcVlyC.Val "MICROSAR RTE" FLOAT32_IEEE NO_COMPU_METHOD 0 0 -3.402823466e+38 3.402823466e+38 ECU_ADDRESS 0 SYMBOL_LINK "Rte_CDD_MotCtrlMgr_MotCurrAdcVlyC_Val" 0 DISPLAY_IDENTIFIER CDD_CurrMeas.ReceiverPorts.MotCurrAdcVlyC.Val /end MEASUREMENT
/begin MEASUREMENT CDD_CurrMeas.MotCurrEolCalSt.Val "MICROSAR RTE" UBYTE RTE_CM_ENUM_MotCurrEolCalSt2 0 0 0 255 ECU_ADDRESS 0 SYMBOL_LINK "Rte_CDD_CurrMeas_MotCurrEolCalSt_Val" 0 DISPLAY_IDENTIFIER CDD_CurrMeas.SenderPorts.MotCurrEolCalSt.Val /end MEASUREMENT
/begin MEASUREMENT CDD_CurrMeas.MotCurrEolCalStPrev "MICROSAR RTE" UBYTE RTE_CM_ENUM_MotCurrEolCalSt2 0 0 0 255 ECU_ADDRESS 0 SYMBOL_LINK "Rte_CDD_CurrMeas_MotCurrEolCalStPrev" 0 DISPLAY_IDENTIFIER CDD_CurrMeas.PerInstanceMemories.MotCurrEolCalStPrev /end MEASUREMENT
/begin MEASUREMENT CDD_CurrMeas.MotCurrEolGainA "MICROSAR RTE" FLOAT32_IEEE NO_COMPU_METHOD 0 0 -3.402823466e+38 3.402823466e+38 ECU_ADDRESS 0 SYMBOL_LINK "Rte_CDD_CurrMeas_MotCurrEolGainA" 0 DISPLAY_IDENTIFIER CDD_CurrMeas.PerInstanceMemories.MotCurrEolGainA /end MEASUREMENT
/begin MEASUREMENT CDD_CurrMeas.MotCurrEolGainB "MICROSAR RTE" FLOAT32_IEEE NO_COMPU_METHOD 0 0 -3.402823466e+38 3.402823466e+38 ECU_ADDRESS 0 SYMBOL_LINK "Rte_CDD_CurrMeas_MotCurrEolGainB" 0 DISPLAY_IDENTIFIER CDD_CurrMeas.PerInstanceMemories.MotCurrEolGainB /end MEASUREMENT
/begin MEASUREMENT CDD_CurrMeas.MotCurrEolGainC "MICROSAR RTE" FLOAT32_IEEE NO_COMPU_METHOD 0 0 -3.402823466e+38 3.402823466e+38 ECU_ADDRESS 0 SYMBOL_LINK "Rte_CDD_CurrMeas_MotCurrEolGainC" 0 DISPLAY_IDENTIFIER CDD_CurrMeas.PerInstanceMemories.MotCurrEolGainC /end MEASUREMENT
/begin MEASUREMENT CDD_CurrMeas.MotCurrEolOffsProcFlg "MICROSAR RTE" UBYTE RTE_CM_BOOLEAN 0 0 0 255 ECU_ADDRESS 0 SYMBOL_LINK "Rte_CDD_CurrMeas_MotCurrEolOffsProcFlg" 0 DISPLAY_IDENTIFIER CDD_CurrMeas.PerInstanceMemories.MotCurrEolOffsProcFlg /end MEASUREMENT
/begin MEASUREMENT CDD_CurrMeas.MotCurrOffsDeltaA "MICROSAR RTE" FLOAT32_IEEE NO_COMPU_METHOD 0 0 -3.402823466e+38 3.402823466e+38 ECU_ADDRESS 0 SYMBOL_LINK "Rte_CDD_CurrMeas_MotCurrOffsDeltaA" 0 DISPLAY_IDENTIFIER CDD_CurrMeas.PerInstanceMemories.MotCurrOffsDeltaA /end MEASUREMENT
/begin MEASUREMENT CDD_CurrMeas.MotCurrOffsDeltaB "MICROSAR RTE" FLOAT32_IEEE NO_COMPU_METHOD 0 0 -3.402823466e+38 3.402823466e+38 ECU_ADDRESS 0 SYMBOL_LINK "Rte_CDD_CurrMeas_MotCurrOffsDeltaB" 0 DISPLAY_IDENTIFIER CDD_CurrMeas.PerInstanceMemories.MotCurrOffsDeltaB /end MEASUREMENT
/begin MEASUREMENT CDD_CurrMeas.MotCurrOffsDeltaC "MICROSAR RTE" FLOAT32_IEEE NO_COMPU_METHOD 0 0 -3.402823466e+38 3.402823466e+38 ECU_ADDRESS 0 SYMBOL_LINK "Rte_CDD_CurrMeas_MotCurrOffsDeltaC" 0 DISPLAY_IDENTIFIER CDD_CurrMeas.PerInstanceMemories.MotCurrOffsDeltaC /end MEASUREMENT
/begin MEASUREMENT CDD_CurrMeas.MotCurrOffsHiAvrgA "MICROSAR RTE" FLOAT32_IEEE NO_COMPU_METHOD 0 0 -3.402823466e+38 3.402823466e+38 ECU_ADDRESS 0 SYMBOL_LINK "Rte_CDD_CurrMeas_MotCurrOffsHiAvrgA" 0 DISPLAY_IDENTIFIER CDD_CurrMeas.PerInstanceMemories.MotCurrOffsHiAvrgA /end MEASUREMENT
/begin MEASUREMENT CDD_CurrMeas.MotCurrOffsHiAvrgB "MICROSAR RTE" FLOAT32_IEEE NO_COMPU_METHOD 0 0 -3.402823466e+38 3.402823466e+38 ECU_ADDRESS 0 SYMBOL_LINK "Rte_CDD_CurrMeas_MotCurrOffsHiAvrgB" 0 DISPLAY_IDENTIFIER CDD_CurrMeas.PerInstanceMemories.MotCurrOffsHiAvrgB /end MEASUREMENT
/begin MEASUREMENT CDD_CurrMeas.MotCurrOffsHiAvrgC "MICROSAR RTE" FLOAT32_IEEE NO_COMPU_METHOD 0 0 -3.402823466e+38 3.402823466e+38 ECU_ADDRESS 0 SYMBOL_LINK "Rte_CDD_CurrMeas_MotCurrOffsHiAvrgC" 0 DISPLAY_IDENTIFIER CDD_CurrMeas.PerInstanceMemories.MotCurrOffsHiAvrgC /end MEASUREMENT
/begin MEASUREMENT CDD_CurrMeas.MotCurrOffsLoAvrgA "MICROSAR RTE" FLOAT32_IEEE NO_COMPU_METHOD 0 0 -3.402823466e+38 3.402823466e+38 ECU_ADDRESS 0 SYMBOL_LINK "Rte_CDD_CurrMeas_MotCurrOffsLoAvrgA" 0 DISPLAY_IDENTIFIER CDD_CurrMeas.PerInstanceMemories.MotCurrOffsLoAvrgA /end MEASUREMENT
/begin MEASUREMENT CDD_CurrMeas.MotCurrOffsLoAvrgB "MICROSAR RTE" FLOAT32_IEEE NO_COMPU_METHOD 0 0 -3.402823466e+38 3.402823466e+38 ECU_ADDRESS 0 SYMBOL_LINK "Rte_CDD_CurrMeas_MotCurrOffsLoAvrgB" 0 DISPLAY_IDENTIFIER CDD_CurrMeas.PerInstanceMemories.MotCurrOffsLoAvrgB /end MEASUREMENT
/begin MEASUREMENT CDD_CurrMeas.MotCurrOffsLoAvrgC "MICROSAR RTE" FLOAT32_IEEE NO_COMPU_METHOD 0 0 -3.402823466e+38 3.402823466e+38 ECU_ADDRESS 0 SYMBOL_LINK "Rte_CDD_CurrMeas_MotCurrOffsLoAvrgC" 0 DISPLAY_IDENTIFIER CDD_CurrMeas.PerInstanceMemories.MotCurrOffsLoAvrgC /end MEASUREMENT
/begin MEASUREMENT CDD_CurrMeas.MotCurrOffsZeroAvrgA "MICROSAR RTE" FLOAT32_IEEE NO_COMPU_METHOD 0 0 -3.402823466e+38 3.402823466e+38 ECU_ADDRESS 0 SYMBOL_LINK "Rte_CDD_CurrMeas_MotCurrOffsZeroAvrgA" 0 DISPLAY_IDENTIFIER CDD_CurrMeas.PerInstanceMemories.MotCurrOffsZeroAvrgA /end MEASUREMENT
/begin MEASUREMENT CDD_CurrMeas.MotCurrOffsZeroAvrgB "MICROSAR RTE" FLOAT32_IEEE NO_COMPU_METHOD 0 0 -3.402823466e+38 3.402823466e+38 ECU_ADDRESS 0 SYMBOL_LINK "Rte_CDD_CurrMeas_MotCurrOffsZeroAvrgB" 0 DISPLAY_IDENTIFIER CDD_CurrMeas.PerInstanceMemories.MotCurrOffsZeroAvrgB /end MEASUREMENT
/begin MEASUREMENT CDD_CurrMeas.MotCurrOffsZeroAvrgC "MICROSAR RTE" FLOAT32_IEEE NO_COMPU_METHOD 0 0 -3.402823466e+38 3.402823466e+38 ECU_ADDRESS 0 SYMBOL_LINK "Rte_CDD_CurrMeas_MotCurrOffsZeroAvrgC" 0 DISPLAY_IDENTIFIER CDD_CurrMeas.PerInstanceMemories.MotCurrOffsZeroAvrgC /end MEASUREMENT
/begin MEASUREMENT CDD_CurrMeas.MotCurrQlfr1.Val "MICROSAR RTE" UBYTE RTE_CM_ENUM_SigQlfr1 0 0 0 255 ECU_ADDRESS 0 SYMBOL_LINK "Rte_CDD_CurrMeas_MotCurrQlfr1_Val" 0 DISPLAY_IDENTIFIER CDD_CurrMeas.SenderPorts.MotCurrQlfr1.Val /end MEASUREMENT
/begin MEASUREMENT CDD_CurrMeas.MotCurrRollgCnt1Prev "MICROSAR RTE" UBYTE NO_COMPU_METHOD 0 0 0 255 ECU_ADDRESS 0 SYMBOL_LINK "Rte_CDD_CurrMeas_MotCurrRollgCnt1Prev" 0 DISPLAY_IDENTIFIER CDD_CurrMeas.PerInstanceMemories.MotCurrRollgCnt1Prev /end MEASUREMENT
/begin MEASUREMENT CDD_CurrMeas.MotCurrSumAPrev "MICROSAR RTE" FLOAT32_IEEE NO_COMPU_METHOD 0 0 -3.402823466e+38 3.402823466e+38 ECU_ADDRESS 0 SYMBOL_LINK "Rte_CDD_CurrMeas_MotCurrSumAPrev" 0 DISPLAY_IDENTIFIER CDD_CurrMeas.PerInstanceMemories.MotCurrSumAPrev /end MEASUREMENT
/begin MEASUREMENT CDD_CurrMeas.MotCurrSumBPrev "MICROSAR RTE" FLOAT32_IEEE NO_COMPU_METHOD 0 0 -3.402823466e+38 3.402823466e+38 ECU_ADDRESS 0 SYMBOL_LINK "Rte_CDD_CurrMeas_MotCurrSumBPrev" 0 DISPLAY_IDENTIFIER CDD_CurrMeas.PerInstanceMemories.MotCurrSumBPrev /end MEASUREMENT
/begin MEASUREMENT CDD_CurrMeas.MotCurrSumCPrev "MICROSAR RTE" FLOAT32_IEEE NO_COMPU_METHOD 0 0 -3.402823466e+38 3.402823466e+38 ECU_ADDRESS 0 SYMBOL_LINK "Rte_CDD_CurrMeas_MotCurrSumCPrev" 0 DISPLAY_IDENTIFIER CDD_CurrMeas.PerInstanceMemories.MotCurrSumCPrev /end MEASUREMENT
/begin MEASUREMENT CDD_CurrMeas.MotVelMrf.Val "MICROSAR RTE" FLOAT32_IEEE NO_COMPU_METHOD 0 0 -3.402823466e+38 3.402823466e+38 ECU_ADDRESS 0 SYMBOL_LINK "Rte_CDD_MotVel_MotVelMrf_Val" 0 DISPLAY_IDENTIFIER CDD_CurrMeas.ReceiverPorts.MotVelMrf.Val /end MEASUREMENT
/begin MEASUREMENT CDD_CurrMeas.Ntc5DErrCnt.Val "MICROSAR RTE" UWORD NO_COMPU_METHOD 0 0 0 65535 ECU_ADDRESS 0 SYMBOL_LINK "Rte_CDD_MotCtrlMgr_Ntc5DErrCnt_Val" 0 DISPLAY_IDENTIFIER CDD_CurrMeas.ReceiverPorts.Ntc5DErrCnt.Val /end MEASUREMENT
/begin MEASUREMENT CDD_CurrMeas.Ntc5DErrCnt2MilliSecPrev "MICROSAR RTE" UWORD NO_COMPU_METHOD 0 0 0 65535 ECU_ADDRESS 0 SYMBOL_LINK "Rte_CDD_CurrMeas_Ntc5DErrCnt2MilliSecPrev" 0 DISPLAY_IDENTIFIER CDD_CurrMeas.PerInstanceMemories.Ntc5DErrCnt2MilliSecPrev /end MEASUREMENT
/begin MEASUREMENT CDD_CurrMeas.OffsEolAvrgCntrPrev "MICROSAR RTE" UWORD NO_COMPU_METHOD 0 0 0 65535 ECU_ADDRESS 0 SYMBOL_LINK "Rte_CDD_CurrMeas_OffsEolAvrgCntrPrev" 0 DISPLAY_IDENTIFIER CDD_CurrMeas.PerInstanceMemories.OffsEolAvrgCntrPrev /end MEASUREMENT
/begin MEASUREMENT CDD_CurrMeas.PhaOnTiErrCntPrev "MICROSAR RTE" UWORD NO_COMPU_METHOD 0 0 0 65535 ECU_ADDRESS 0 SYMBOL_LINK "Rte_CDD_CurrMeas_PhaOnTiErrCntPrev" 0 DISPLAY_IDENTIFIER CDD_CurrMeas.PerInstanceMemories.PhaOnTiErrCntPrev /end MEASUREMENT
/begin MEASUREMENT CDD_CurrMeas.StrtUpSt.Val "MICROSAR RTE" UBYTE NO_COMPU_METHOD 0 0 0 255 ECU_ADDRESS 0 SYMBOL_LINK "Rte_PwrUpSeq_StrtUpSt_Val" 0 DISPLAY_IDENTIFIER CDD_CurrMeas.ReceiverPorts.StrtUpSt.Val /end MEASUREMENT
/begin MEASUREMENT CDD_CurrMeas.SysSt.Val "MICROSAR RTE" UBYTE RTE_CM_ENUM_SysSt1 0 0 0 255 ECU_ADDRESS 0 SYMBOL_LINK "Rte_SysStMod_SysSt_Val" 0 DISPLAY_IDENTIFIER CDD_CurrMeas.ReceiverPorts.SysSt.Val /end MEASUREMENT
/begin MEASUREMENT CDD_CurrMeas.TmpMotCurrAdcVlySum1Prev "MICROSAR RTE" FLOAT32_IEEE NO_COMPU_METHOD 0 0 -3.402823466e+38 3.402823466e+38 ECU_ADDRESS 0 SYMBOL_LINK "Rte_CDD_CurrMeas_TmpMotCurrAdcVlySum1Prev" 0 DISPLAY_IDENTIFIER CDD_CurrMeas.PerInstanceMemories.TmpMotCurrAdcVlySum1Prev /end MEASUREMENT
/begin MEASUREMENT CDD_CurrMeas.VehSpd.Val "MICROSAR RTE" FLOAT32_IEEE NO_COMPU_METHOD 0 0 -3.402823466e+38 3.402823466e+38 ECU_ADDRESS 0 SYMBOL_LINK "Rte_ImcSigArbn_VehSpdImcCorrd_Val" 0 DISPLAY_IDENTIFIER CDD_CurrMeas.ReceiverPorts.VehSpd.Val /end MEASUREMENT
/begin MEASUREMENT CDD_CurrMeas.VehSpdVld.Logl "MICROSAR RTE" UBYTE RTE_CM_BOOLEAN 0 0 0 255 ECU_ADDRESS 0 SYMBOL_LINK "Rte_VehSigCdng_VehSpdVld_Logl" 0 DISPLAY_IDENTIFIER CDD_CurrMeas.ReceiverPorts.VehSpdVld.Logl /end MEASUREMENT
/begin MEASUREMENT CDD_CurrMeas.WrmIninTestCmplPrev "MICROSAR RTE" UBYTE RTE_CM_BOOLEAN 0 0 0 255 ECU_ADDRESS 0 SYMBOL_LINK "Rte_CDD_CurrMeas_WrmIninTestCmplPrev" 0 DISPLAY_IDENTIFIER CDD_CurrMeas.PerInstanceMemories.WrmIninTestCmplPrev /end MEASUREMENT
/begin MEASUREMENT CDD_CurrMeasArbn.CurrMeasArbnSens0RollgCntPrev "MICROSAR RTE" UBYTE NO_COMPU_METHOD 0 0 0 255 ECU_ADDRESS 0 SYMBOL_LINK "Rte_CDD_CurrMeasArbn_CurrMeasArbnSens0RollgCntPrev" 0 DISPLAY_IDENTIFIER CDD_CurrMeasArbn.PerInstanceMemories.CurrMeasArbnSens0RollgCntPrev /end MEASUREMENT
/begin MEASUREMENT CDD_CurrMeasArbn.CurrMeasArbnSens0StallCntPrev "MICROSAR RTE" UBYTE NO_COMPU_METHOD 0 0 0 255 ECU_ADDRESS 0 SYMBOL_LINK "Rte_CDD_CurrMeasArbn_CurrMeasArbnSens0StallCntPrev" 0 DISPLAY_IDENTIFIER CDD_CurrMeasArbn.PerInstanceMemories.CurrMeasArbnSens0StallCntPrev /end MEASUREMENT
/begin MEASUREMENT CDD_CurrMeasArbn.CurrMeasArbnSens1RollgCntPrev "MICROSAR RTE" UBYTE NO_COMPU_METHOD 0 0 0 255 ECU_ADDRESS 0 SYMBOL_LINK "Rte_CDD_CurrMeasArbn_CurrMeasArbnSens1RollgCntPrev" 0 DISPLAY_IDENTIFIER CDD_CurrMeasArbn.PerInstanceMemories.CurrMeasArbnSens1RollgCntPrev /end MEASUREMENT
/begin MEASUREMENT CDD_CurrMeasArbn.CurrMeasArbnSens1StallCntPrev "MICROSAR RTE" UBYTE NO_COMPU_METHOD 0 0 0 255 ECU_ADDRESS 0 SYMBOL_LINK "Rte_CDD_CurrMeasArbn_CurrMeasArbnSens1StallCntPrev" 0 DISPLAY_IDENTIFIER CDD_CurrMeasArbn.PerInstanceMemories.CurrMeasArbnSens1StallCntPrev /end MEASUREMENT
/begin MEASUREMENT CDD_DmaCfgAndUse.DmaCfgAndUse2MilliSecAdcMaxDmaTrfTi "Display variable used to help understand the Maximum Dma Transfer time" ULONG NO_COMPU_METHOD 0 0 0 4294967295 ECU_ADDRESS 0 SYMBOL_LINK "Rte_CDD_DmaCfgAndUse_DmaCfgAndUse2MilliSecAdcMaxDmaTrfTi" 0 DISPLAY_IDENTIFIER CDD_DmaCfgAndUse.PerInstanceMemories.DmaCfgAndUse2MilliSecAdcMaxDmaTrfTi /end MEASUREMENT
/begin MEASUREMENT CDD_DmaCfgAndUse.DmaCfgAndUse2MilliSecAdcStrtTi "ADC Conversion transfer start time" ULONG NO_COMPU_METHOD 0 0 0 4294967295 ECU_ADDRESS 0 SYMBOL_LINK "Rte_CDD_DmaCfgAndUse_DmaCfgAndUse2MilliSecAdcStrtTi" 0 DISPLAY_IDENTIFIER CDD_DmaCfgAndUse.PerInstanceMemories.DmaCfgAndUse2MilliSecAdcStrtTi /end MEASUREMENT
/begin MEASUREMENT CDD_DmaCfgAndUse.d2MilliSecAdcActDmaTrfTi "Display variable used to help understand the Actual Dma Transfer time" ULONG NO_COMPU_METHOD 0 0 0 4294967295 ECU_ADDRESS 0 SYMBOL_LINK "Rte_CDD_DmaCfgAndUse_d2MilliSecAdcActDmaTrfTi" 0 DISPLAY_IDENTIFIER CDD_DmaCfgAndUse.PerInstanceMemories.d2MilliSecAdcActDmaTrfTi /end MEASUREMENT
/begin MEASUREMENT CDD_EcmOutpAndDiagc.dEcmVrfyErrOutpCtrlCmpl "MICROSAR RTE" UBYTE RTE_CM_BOOLEAN 0 0 0 255 ECU_ADDRESS 0 SYMBOL_LINK "Rte_CDD_EcmOutpAndDiagc_dEcmVrfyErrOutpCtrlCmpl" 0 DISPLAY_IDENTIFIER CDD_EcmOutpAndDiagc.PerInstanceMemories.dEcmVrfyErrOutpCtrlCmpl /end MEASUREMENT
/begin MEASUREMENT CDD_EcmOutpAndDiagc.dEcmVrfyIntrptGennCmpl "MICROSAR RTE" UBYTE RTE_CM_BOOLEAN 0 0 0 255 ECU_ADDRESS 0 SYMBOL_LINK "Rte_CDD_EcmOutpAndDiagc_dEcmVrfyIntrptGennCmpl" 0 DISPLAY_IDENTIFIER CDD_EcmOutpAndDiagc.PerInstanceMemories.dEcmVrfyIntrptGennCmpl /end MEASUREMENT
/begin MEASUREMENT CDD_ExcpnHndlg.McuDiagcData "MICROSAR RTE" ULONG NO_COMPU_METHOD 0 0 0 4294967295 MATRIX_DIM 4 1 1 ECU_ADDRESS 0 SYMBOL_LINK "Rte_CDD_ExcpnHndlg_McuDiagcData" 0 DISPLAY_IDENTIFIER CDD_ExcpnHndlg.PerInstanceMemories.McuDiagcData /end MEASUREMENT
/begin MEASUREMENT CDD_FlsMem.CodFlsCrcChkCmpl.Logl "MICROSAR RTE" UBYTE RTE_CM_BOOLEAN 0 0 0 255 ECU_ADDRESS 0 SYMBOL_LINK "Rte_CDD_FlsMem_CodFlsCrcChkCmpl_Logl" 0 DISPLAY_IDENTIFIER CDD_FlsMem.SenderPorts.CodFlsCrcChkCmpl.Logl /end MEASUREMENT
/begin MEASUREMENT CDD_FlsMem.CodFlsCrcChkStrtTi "MICROSAR RTE" ULONG NO_COMPU_METHOD 0 0 0 4294967295 ECU_ADDRESS 0 SYMBOL_LINK "Rte_CDD_FlsMem_CodFlsCrcChkStrtTi" 0 DISPLAY_IDENTIFIER CDD_FlsMem.PerInstanceMemories.CodFlsCrcChkStrtTi /end MEASUREMENT
/begin MEASUREMENT CDD_FlsMem.CodFlsDummyRead1 "MICROSAR RTE" ULONG NO_COMPU_METHOD 0 0 0 4294967295 ECU_ADDRESS 0 SYMBOL_LINK "Rte_CDD_FlsMem_CodFlsDummyRead1" 0 DISPLAY_IDENTIFIER CDD_FlsMem.PerInstanceMemories.CodFlsDummyRead1 /end MEASUREMENT
/begin MEASUREMENT CDD_FlsMem.CodFlsDummyRead2 "MICROSAR RTE" ULONG NO_COMPU_METHOD 0 0 0 4294967295 ECU_ADDRESS 0 SYMBOL_LINK "Rte_CDD_FlsMem_CodFlsDummyRead2" 0 DISPLAY_IDENTIFIER CDD_FlsMem.PerInstanceMemories.CodFlsDummyRead2 /end MEASUREMENT
/begin MEASUREMENT CDD_FlsMem.CodFlsDummyRead3 "MICROSAR RTE" ULONG NO_COMPU_METHOD 0 0 0 4294967295 ECU_ADDRESS 0 SYMBOL_LINK "Rte_CDD_FlsMem_CodFlsDummyRead3" 0 DISPLAY_IDENTIFIER CDD_FlsMem.PerInstanceMemories.CodFlsDummyRead3 /end MEASUREMENT
/begin MEASUREMENT CDD_FlsMem.CodFlsDummyRead4 "MICROSAR RTE" ULONG NO_COMPU_METHOD 0 0 0 4294967295 ECU_ADDRESS 0 SYMBOL_LINK "Rte_CDD_FlsMem_CodFlsDummyRead4" 0 DISPLAY_IDENTIFIER CDD_FlsMem.PerInstanceMemories.CodFlsDummyRead4 /end MEASUREMENT
/begin MEASUREMENT CDD_FlsMem.CodFlsSngBitErr "MICROSAR RTE" UBYTE RTE_CM_BOOLEAN 0 0 0 255 ECU_ADDRESS 0 SYMBOL_LINK "Rte_CDD_FlsMem_CodFlsSngBitErr" 0 DISPLAY_IDENTIFIER CDD_FlsMem.PerInstanceMemories.CodFlsSngBitErr /end MEASUREMENT
/begin MEASUREMENT CDD_FlsMem.CrcChkCmpl "MICROSAR RTE" UBYTE RTE_CM_BOOLEAN 0 0 0 255 ECU_ADDRESS 0 SYMBOL_LINK "Rte_CDD_FlsMem_CrcChkCmpl" 0 DISPLAY_IDENTIFIER CDD_FlsMem.PerInstanceMemories.CrcChkCmpl /end MEASUREMENT
/begin MEASUREMENT CDD_FlsMem.CrcHwIdxKey "MICROSAR RTE" ULONG NO_COMPU_METHOD 0 0 0 4294967295 ECU_ADDRESS 0 SYMBOL_LINK "Rte_CDD_FlsMem_CrcHwIdxKey" 0 DISPLAY_IDENTIFIER CDD_FlsMem.PerInstanceMemories.CrcHwIdxKey /end MEASUREMENT
/begin MEASUREMENT CDD_FlsMem.PwrOnRstCrcChkCmpl "MICROSAR RTE" UBYTE RTE_CM_BOOLEAN 0 0 0 255 ECU_ADDRESS 0 SYMBOL_LINK "Rte_CDD_FlsMem_PwrOnRstCrcChkCmpl" 0 DISPLAY_IDENTIFIER CDD_FlsMem.PerInstanceMemories.PwrOnRstCrcChkCmpl /end MEASUREMENT
/begin MEASUREMENT CDD_FlsMem.SwApplCrc.Val "MICROSAR RTE" ULONG NO_COMPU_METHOD 0 0 0 4294967295 ECU_ADDRESS 0 SYMBOL_LINK "Rte_CDD_FlsMem_SwApplCrc_Val" 0 DISPLAY_IDENTIFIER CDD_FlsMem.SenderPorts.SwApplCrc.Val /end MEASUREMENT
/begin MEASUREMENT CDD_FlsMem.dFlsMemVrfyCrcInitCmpl "MICROSAR RTE" UBYTE RTE_CM_BOOLEAN 0 0 0 255 ECU_ADDRESS 0 SYMBOL_LINK "Rte_CDD_FlsMem_dFlsMemVrfyCrcInitCmpl" 0 DISPLAY_IDENTIFIER CDD_FlsMem.PerInstanceMemories.dFlsMemVrfyCrcInitCmpl /end MEASUREMENT
/begin MEASUREMENT CDD_FordBlaBoxIfCmn.ActvParkAssiTqFild.Val "MICROSAR RTE" FLOAT32_IEEE NO_COMPU_METHOD 0 0 -3.402823466e+38 3.402823466e+38 ECU_ADDRESS 0 SYMBOL_LINK "Rte_CDD_FordBlaBoxIfCmn_ActvParkAssiTqFild_Val" 0 DISPLAY_IDENTIFIER CDD_FordBlaBoxIfCmn.ReceiverPorts.ActvParkAssiTqFild.Val /end MEASUREMENT
/begin MEASUREMENT CDD_FordBlaBoxIfCmn.EcuId.Val "MICROSAR RTE" UBYTE NO_COMPU_METHOD 0 0 0 255 ECU_ADDRESS 0 SYMBOL_LINK "Rte_DualEcuIdn_EcuId_Val" 0 DISPLAY_IDENTIFIER CDD_FordBlaBoxIfCmn.ReceiverPorts.EcuId.Val /end MEASUREMENT
/begin MEASUREMENT CDD_FordBlaBoxIfCmn.EngTqClass.Val "MICROSAR RTE" UBYTE NO_COMPU_METHOD 0 0 0 255 ECU_ADDRESS 0 SYMBOL_LINK "Rte_CustDiag_FordEngTqClass_Val" 0 DISPLAY_IDENTIFIER CDD_FordBlaBoxIfCmn.ReceiverPorts.EngTqClass.Val /end MEASUREMENT
/begin MEASUREMENT CDD_FordBlaBoxIfCmn.FildVehSpdVld.Logl "MICROSAR RTE" UBYTE RTE_CM_BOOLEAN 0 0 0 255 ECU_ADDRESS 0 SYMBOL_LINK "Rte_CDD_FordBlaBoxIfCmn_FildVehSpdVld_Logl" 0 DISPLAY_IDENTIFIER CDD_FordBlaBoxIfCmn.ReceiverPorts.FildVehSpdVld.Logl /end MEASUREMENT
/begin MEASUREMENT CDD_FordBlaBoxIfCmn.FordActvNiblCtrlEnad.Logl "MICROSAR RTE" UBYTE RTE_CM_BOOLEAN 0 0 0 255 ECU_ADDRESS 0 SYMBOL_LINK "Rte_CustDiag_FordActvNiblCtrlEnad_Logl" 0 DISPLAY_IDENTIFIER CDD_FordBlaBoxIfCmn.ReceiverPorts.FordActvNiblCtrlEnad.Logl /end MEASUREMENT
/begin MEASUREMENT CDD_FordBlaBoxIfCmn.FordAppldFinalMotTq.Val "MICROSAR RTE" SLONG NO_COMPU_METHOD 0 0 -2147483648 2147483647 ECU_ADDRESS 0 SYMBOL_LINK "Rte_FordHwTqCdng_FordAppldFinalMotTq_Val" 0 DISPLAY_IDENTIFIER CDD_FordBlaBoxIfCmn.ReceiverPorts.FordAppldFinalMotTq.Val /end MEASUREMENT
/begin MEASUREMENT CDD_FordBlaBoxIfCmn.FordAppldFinalMotTqVld.Logl "MICROSAR RTE" UBYTE RTE_CM_BOOLEAN 0 0 0 255 ECU_ADDRESS 0 SYMBOL_LINK "Rte_FordHwTqCdng_FordAppldFinalMotTqVld_Logl" 0 DISPLAY_IDENTIFIER CDD_FordBlaBoxIfCmn.ReceiverPorts.FordAppldFinalMotTqVld.Logl /end MEASUREMENT
/begin MEASUREMENT CDD_FordBlaBoxIfCmn.FordBoostCrvAssiTq.Val "MICROSAR RTE" SWORD NO_COMPU_METHOD 0 0 -32768 32767 ECU_ADDRESS 0 SYMBOL_LINK "Rte_FordHwTqCdng_FordBoostCrvAssiTq_Val" 0 DISPLAY_IDENTIFIER CDD_FordBlaBoxIfCmn.ReceiverPorts.FordBoostCrvAssiTq.Val /end MEASUREMENT
/begin MEASUREMENT CDD_FordBlaBoxIfCmn.FordBoostCrvInpTq.Val "MICROSAR RTE" SWORD NO_COMPU_METHOD 0 0 -32768 32767 ECU_ADDRESS 0 SYMBOL_LINK "Rte_FordHwTqCdng_FordBoostCrvInpTq_Val" 0 DISPLAY_IDENTIFIER CDD_FordBlaBoxIfCmn.ReceiverPorts.FordBoostCrvInpTq.Val /end MEASUREMENT
/begin MEASUREMENT CDD_FordBlaBoxIfCmn.FordBrkPlsRejctnEnad.Logl "MICROSAR RTE" UBYTE RTE_CM_BOOLEAN 0 0 0 255 ECU_ADDRESS 0 SYMBOL_LINK "Rte_CustDiag_FordBrkPlsRejctnEnad_Logl" 0 DISPLAY_IDENTIFIER CDD_FordBlaBoxIfCmn.ReceiverPorts.FordBrkPlsRejctnEnad.Logl /end MEASUREMENT
/begin MEASUREMENT CDD_FordBlaBoxIfCmn.FordCmpdHwPosn.Val "MICROSAR RTE" FLOAT32_IEEE NO_COMPU_METHOD 0 0 -3.402823466e+38 3.402823466e+38 ECU_ADDRESS 0 SYMBOL_LINK "Rte_FordHwAgArbn_FordCmpdHwPosn_Val" 0 DISPLAY_IDENTIFIER CDD_FordBlaBoxIfCmn.ReceiverPorts.FordCmpdHwPosn.Val /end MEASUREMENT
/begin MEASUREMENT CDD_FordBlaBoxIfCmn.FordCmpdHwPosnQlyFac.Val "MICROSAR RTE" UBYTE NO_COMPU_METHOD 0 0 0 255 ECU_ADDRESS 0 SYMBOL_LINK "Rte_FordHwAgArbn_FordCmpdHwPosnQlyFac8_Val" 0 DISPLAY_IDENTIFIER CDD_FordBlaBoxIfCmn.ReceiverPorts.FordCmpdHwPosnQlyFac.Val /end MEASUREMENT
/begin MEASUREMENT CDD_FordBlaBoxIfCmn.FordEvasSteerAssiEnaReq.Val "MICROSAR RTE" UBYTE NO_COMPU_METHOD 0 0 0 255 ECU_ADDRESS 0 SYMBOL_LINK "Rte_CDD_FordBlaBoxIfCmn_FordEvasSteerAssiEnaReq_Val" 0 DISPLAY_IDENTIFIER CDD_FordBlaBoxIfCmn.ReceiverPorts.FordEvasSteerAssiEnaReq.Val /end MEASUREMENT
/begin MEASUREMENT CDD_FordBlaBoxIfCmn.FordEvasSteerAssiEnad.Logl "MICROSAR RTE" UBYTE RTE_CM_BOOLEAN 0 0 0 255 ECU_ADDRESS 0 SYMBOL_LINK "Rte_CustDiag_FordEvasSteerAssiEnad_Logl" 0 DISPLAY_IDENTIFIER CDD_FordBlaBoxIfCmn.ReceiverPorts.FordEvasSteerAssiEnad.Logl /end MEASUREMENT
/begin MEASUREMENT CDD_FordBlaBoxIfCmn.FordHwVelVld.Logl "MICROSAR RTE" UBYTE RTE_CM_BOOLEAN 0 0 0 255 ECU_ADDRESS 0 SYMBOL_LINK "Rte_FordHwAgArbn_FordHwVelVld_Logl" 0 DISPLAY_IDENTIFIER CDD_FordBlaBoxIfCmn.ReceiverPorts.FordHwVelVld.Logl /end MEASUREMENT
/begin MEASUREMENT CDD_FordBlaBoxIfCmn.FordInpTqRaw.Val "MICROSAR RTE" SWORD NO_COMPU_METHOD 0 0 -32768 32767 ECU_ADDRESS 0 SYMBOL_LINK "Rte_FordHwTqCdng_FordInpTqRaw_Val" 0 DISPLAY_IDENTIFIER CDD_FordBlaBoxIfCmn.ReceiverPorts.FordInpTqRaw.Val /end MEASUREMENT
/begin MEASUREMENT CDD_FordBlaBoxIfCmn.FordInpTqRawVld.Logl "MICROSAR RTE" UBYTE RTE_CM_BOOLEAN 0 0 0 255 ECU_ADDRESS 0 SYMBOL_LINK "Rte_FordHwTqCdng_FordInpTqRawVld_Logl" 0 DISPLAY_IDENTIFIER CDD_FordBlaBoxIfCmn.ReceiverPorts.FordInpTqRawVld.Logl /end MEASUREMENT
/begin MEASUREMENT CDD_FordBlaBoxIfCmn.FordLaneCentrAssiEnad.Logl "MICROSAR RTE" UBYTE RTE_CM_BOOLEAN 0 0 0 255 ECU_ADDRESS 0 SYMBOL_LINK "Rte_CustDiag_FordLaneCentrAssiEnad_Logl" 0 DISPLAY_IDENTIFIER CDD_FordBlaBoxIfCmn.ReceiverPorts.FordLaneCentrAssiEnad.Logl /end MEASUREMENT
/begin MEASUREMENT CDD_FordBlaBoxIfCmn.FordLaneDprtrWarnEnad.Logl "MICROSAR RTE" UBYTE RTE_CM_BOOLEAN 0 0 0 255 ECU_ADDRESS 0 SYMBOL_LINK "Rte_CustDiag_FordLaneDprtrWarnEnad_Logl" 0 DISPLAY_IDENTIFIER CDD_FordBlaBoxIfCmn.ReceiverPorts.FordLaneDprtrWarnEnad.Logl /end MEASUREMENT
/begin MEASUREMENT CDD_FordBlaBoxIfCmn.FordLaneKeepAssiEnad.Logl "MICROSAR RTE" UBYTE RTE_CM_BOOLEAN 0 0 0 255 ECU_ADDRESS 0 SYMBOL_LINK "Rte_CustDiag_FordLaneKeepAssiEnad_Logl" 0 DISPLAY_IDENTIFIER CDD_FordBlaBoxIfCmn.ReceiverPorts.FordLaneKeepAssiEnad.Logl /end MEASUREMENT
/begin MEASUREMENT CDD_FordBlaBoxIfCmn.FordMaxAsscTq.Val "MICROSAR RTE" FLOAT32_IEEE NO_COMPU_METHOD 0 0 -3.402823466e+38 3.402823466e+38 ECU_ADDRESS 0 SYMBOL_LINK "Rte_FordHwTqCdng_FordMaxAsscTq_Val" 0 DISPLAY_IDENTIFIER CDD_FordBlaBoxIfCmn.ReceiverPorts.FordMaxAsscTq.Val /end MEASUREMENT
/begin MEASUREMENT CDD_FordBlaBoxIfCmn.FordMsgInp1Vld.Logl "MICROSAR RTE" UBYTE RTE_CM_BOOLEAN 0 0 0 255 ECU_ADDRESS 0 SYMBOL_LINK "Rte_CDD_FordBlaBoxIfCmn_FordMsgInp1Vld_Logl" 0 DISPLAY_IDENTIFIER CDD_FordBlaBoxIfCmn.ReceiverPorts.FordMsgInp1Vld.Logl /end MEASUREMENT
/begin MEASUREMENT CDD_FordBlaBoxIfCmn.FordMsgInp2Vld.Logl "MICROSAR RTE" UBYTE RTE_CM_BOOLEAN 0 0 0 255 ECU_ADDRESS 0 SYMBOL_LINK "Rte_CDD_FordBlaBoxIfCmn_FordMsgInp2Vld_Logl" 0 DISPLAY_IDENTIFIER CDD_FordBlaBoxIfCmn.ReceiverPorts.FordMsgInp2Vld.Logl /end MEASUREMENT
/begin MEASUREMENT CDD_FordBlaBoxIfCmn.FordMsgInp3Vld.Logl "MICROSAR RTE" UBYTE RTE_CM_BOOLEAN 0 0 0 255 ECU_ADDRESS 0 SYMBOL_LINK "Rte_CDD_FordBlaBoxIfCmn_FordMsgInp3Vld_Logl" 0 DISPLAY_IDENTIFIER CDD_FordBlaBoxIfCmn.ReceiverPorts.FordMsgInp3Vld.Logl /end MEASUREMENT
/begin MEASUREMENT CDD_FordBlaBoxIfCmn.FordMsgInp4Vld.Logl "MICROSAR RTE" UBYTE RTE_CM_BOOLEAN 0 0 0 255 ECU_ADDRESS 0 SYMBOL_LINK "Rte_CDD_FordBlaBoxIfCmn_FordMsgInp4Vld_Logl" 0 DISPLAY_IDENTIFIER CDD_FordBlaBoxIfCmn.ReceiverPorts.FordMsgInp4Vld.Logl /end MEASUREMENT
/begin MEASUREMENT CDD_FordBlaBoxIfCmn.FordPullDriftCmpEnad.Logl "MICROSAR RTE" UBYTE RTE_CM_BOOLEAN 0 0 0 255 ECU_ADDRESS 0 SYMBOL_LINK "Rte_CustDiag_FordPullDriftCmpEnad_Logl" 0 DISPLAY_IDENTIFIER CDD_FordBlaBoxIfCmn.ReceiverPorts.FordPullDriftCmpEnad.Logl /end MEASUREMENT
/begin MEASUREMENT CDD_FordBlaBoxIfCmn.FordRelHwPosn.Val "MICROSAR RTE" FLOAT32_IEEE NO_COMPU_METHOD 0 0 -3.402823466e+38 3.402823466e+38 ECU_ADDRESS 0 SYMBOL_LINK "Rte_FordHwAgArbn_FordRelHwPosn_Val" 0 DISPLAY_IDENTIFIER CDD_FordBlaBoxIfCmn.ReceiverPorts.FordRelHwPosn.Val /end MEASUREMENT
/begin MEASUREMENT CDD_FordBlaBoxIfCmn.FordRelHwPosnVld.Logl "MICROSAR RTE" UBYTE RTE_CM_BOOLEAN 0 0 0 255 ECU_ADDRESS 0 SYMBOL_LINK "Rte_FordHwAgArbn_FordRelHwPosnVld_Logl" 0 DISPLAY_IDENTIFIER CDD_FordBlaBoxIfCmn.ReceiverPorts.FordRelHwPosnVld.Logl /end MEASUREMENT
/begin MEASUREMENT CDD_FordBlaBoxIfCmn.FordReqdFinalMotTq.Val "MICROSAR RTE" SLONG NO_COMPU_METHOD 0 0 -2147483648 2147483647 ECU_ADDRESS 0 SYMBOL_LINK "Rte_FordHwTqCdng_FordReqdFinalMotTq_Val" 0 DISPLAY_IDENTIFIER CDD_FordBlaBoxIfCmn.ReceiverPorts.FordReqdFinalMotTq.Val /end MEASUREMENT
/begin MEASUREMENT CDD_FordBlaBoxIfCmn.FordResrchFctEnad.Logl "MICROSAR RTE" UBYTE RTE_CM_BOOLEAN 0 0 0 255 ECU_ADDRESS 0 SYMBOL_LINK "Rte_CustDiag_FordResrchFctEnad_Logl" 0 DISPLAY_IDENTIFIER CDD_FordBlaBoxIfCmn.ReceiverPorts.FordResrchFctEnad.Logl /end MEASUREMENT
/begin MEASUREMENT CDD_FordBlaBoxIfCmn.FordTqSteerCmpEnad.Logl "MICROSAR RTE" UBYTE RTE_CM_BOOLEAN 0 0 0 255 ECU_ADDRESS 0 SYMBOL_LINK "Rte_CustDiag_FordTqSteerCmpEnad_Logl" 0 DISPLAY_IDENTIFIER CDD_FordBlaBoxIfCmn.ReceiverPorts.FordTqSteerCmpEnad.Logl /end MEASUREMENT
/begin MEASUREMENT CDD_FordBlaBoxIfCmn.FordTrfcJamAssiEnad.Logl "MICROSAR RTE" UBYTE RTE_CM_BOOLEAN 0 0 0 255 ECU_ADDRESS 0 SYMBOL_LINK "Rte_CustDiag_FordTrfcJamAssiEnad_Logl" 0 DISPLAY_IDENTIFIER CDD_FordBlaBoxIfCmn.ReceiverPorts.FordTrfcJamAssiEnad.Logl /end MEASUREMENT
/begin MEASUREMENT CDD_FordBlaBoxIfCmn.FordTrlrAidHitchAgRate.Val "MICROSAR RTE" UWORD NO_COMPU_METHOD 0 0 0 65535 ECU_ADDRESS 0 SYMBOL_LINK "Rte_CDD_FordBlaBoxIfCmn_FordTrlrAidHitchAgRate_Val" 0 DISPLAY_IDENTIFIER CDD_FordBlaBoxIfCmn.ReceiverPorts.FordTrlrAidHitchAgRate.Val /end MEASUREMENT
/begin MEASUREMENT CDD_FordBlaBoxIfCmn.FordTrlrBackupAssi5WhlEnad.Logl "MICROSAR RTE" UBYTE RTE_CM_BOOLEAN 0 0 0 255 ECU_ADDRESS 0 SYMBOL_LINK "Rte_CDD_FordBlaBoxIfCmn_FordTrlrBackupAssi5WhlEnad_Logl" 0 DISPLAY_IDENTIFIER CDD_FordBlaBoxIfCmn.ReceiverPorts.FordTrlrBackupAssi5WhlEnad.Logl /end MEASUREMENT
/begin MEASUREMENT CDD_FordBlaBoxIfCmn.FordTrlrBackupAssiEnad.Logl "MICROSAR RTE" UBYTE RTE_CM_BOOLEAN 0 0 0 255 ECU_ADDRESS 0 SYMBOL_LINK "Rte_CDD_FordBlaBoxIfCmn_FordTrlrBackupAssiEnad_Logl" 0 DISPLAY_IDENTIFIER CDD_FordBlaBoxIfCmn.ReceiverPorts.FordTrlrBackupAssiEnad.Logl /end MEASUREMENT
/begin MEASUREMENT CDD_FordBlaBoxIfCmn.FordTrlrBackupAssiTrigEnad.Logl "MICROSAR RTE" UBYTE RTE_CM_BOOLEAN 0 0 0 255 ECU_ADDRESS 0 SYMBOL_LINK "Rte_CDD_FordBlaBoxIfCmn_FordTrlrBackupAssiTrigEnad_Logl" 0 DISPLAY_IDENTIFIER CDD_FordBlaBoxIfCmn.ReceiverPorts.FordTrlrBackupAssiTrigEnad.Logl /end MEASUREMENT
/begin MEASUREMENT CDD_FordBlaBoxIfCmn.FordVehAbsActv.Val "MICROSAR RTE" UBYTE NO_COMPU_METHOD 0 0 0 255 ECU_ADDRESS 0 SYMBOL_LINK "Rte_FordMsg213BusHiSpd_FordVehAbsActv_Val" 0 DISPLAY_IDENTIFIER CDD_FordBlaBoxIfCmn.ReceiverPorts.FordVehAbsActv.Val /end MEASUREMENT
/begin MEASUREMENT CDD_FordBlaBoxIfCmn.FordVehAbsEscStsVld.Logl "MICROSAR RTE" UBYTE RTE_CM_BOOLEAN 0 0 0 255 ECU_ADDRESS 0 SYMBOL_LINK "Rte_FordMsg213BusHiSpd_FordVehAbsEscStsVld_Logl" 0 DISPLAY_IDENTIFIER CDD_FordBlaBoxIfCmn.ReceiverPorts.FordVehAbsEscStsVld.Logl /end MEASUREMENT
/begin MEASUREMENT CDD_FordBlaBoxIfCmn.FordVehAccrPedlPosnStsQlyFacRaw.Val "MICROSAR RTE" UWORD NO_COMPU_METHOD 0 0 0 65535 ECU_ADDRESS 0 SYMBOL_LINK "Rte_CDD_FordBlaBoxIfCmn_FordVehAccrPedlPosnStsQlyFacRaw_Val" 0 DISPLAY_IDENTIFIER CDD_FordBlaBoxIfCmn.ReceiverPorts.FordVehAccrPedlPosnStsQlyFacRaw.Val /end MEASUREMENT
/begin MEASUREMENT CDD_FordBlaBoxIfCmn.FordVehAccrPedlPosnStsRaw.Val "MICROSAR RTE" UWORD NO_COMPU_METHOD 0 0 0 65535 ECU_ADDRESS 0 SYMBOL_LINK "Rte_CDD_FordBlaBoxIfCmn_FordVehAccrPedlPosnStsRaw_Val" 0 DISPLAY_IDENTIFIER CDD_FordBlaBoxIfCmn.ReceiverPorts.FordVehAccrPedlPosnStsRaw.Val /end MEASUREMENT
/begin MEASUREMENT CDD_FordBlaBoxIfCmn.FordVehAccrPedlPosnStsVld.Logl "MICROSAR RTE" UBYTE RTE_CM_BOOLEAN 0 0 0 255 ECU_ADDRESS 0 SYMBOL_LINK "Rte_CDD_FordBlaBoxIfCmn_FordVehAccrPedlPosnStsVld_Logl" 0 DISPLAY_IDENTIFIER CDD_FordBlaBoxIfCmn.ReceiverPorts.FordVehAccrPedlPosnStsVld.Logl /end MEASUREMENT
/begin MEASUREMENT CDD_FordBlaBoxIfCmn.FordVehActBrkTqRaw.Val "MICROSAR RTE" UWORD NO_COMPU_METHOD 0 0 0 65535 ECU_ADDRESS 0 SYMBOL_LINK "Rte_FordMsg07DBusHiSpd_FordVehActBrkTqRaw_Val" 0 DISPLAY_IDENTIFIER CDD_FordBlaBoxIfCmn.ReceiverPorts.FordVehActBrkTqRaw.Val /end MEASUREMENT
/begin MEASUREMENT CDD_FordBlaBoxIfCmn.FordVehBlaBoxInp1HiPart.Val "MICROSAR RTE" ULONG NO_COMPU_METHOD 0 0 0 4294967295 ECU_ADDRESS 0 SYMBOL_LINK "Rte_CDD_FordBlaBoxIfCmn_FordVehBlaBoxInp1HiPart_Val" 0 DISPLAY_IDENTIFIER CDD_FordBlaBoxIfCmn.ReceiverPorts.FordVehBlaBoxInp1HiPart.Val /end MEASUREMENT
/begin MEASUREMENT CDD_FordBlaBoxIfCmn.FordVehBlaBoxInp1LoPart.Val "MICROSAR RTE" ULONG NO_COMPU_METHOD 0 0 0 4294967295 ECU_ADDRESS 0 SYMBOL_LINK "Rte_CDD_FordBlaBoxIfCmn_FordVehBlaBoxInp1LoPart_Val" 0 DISPLAY_IDENTIFIER CDD_FordBlaBoxIfCmn.ReceiverPorts.FordVehBlaBoxInp1LoPart.Val /end MEASUREMENT
/begin MEASUREMENT CDD_FordBlaBoxIfCmn.FordVehBlaBoxInp2HiPart.Val "MICROSAR RTE" ULONG NO_COMPU_METHOD 0 0 0 4294967295 ECU_ADDRESS 0 SYMBOL_LINK "Rte_CDD_FordBlaBoxIfCmn_FordVehBlaBoxInp2HiPart_Val" 0 DISPLAY_IDENTIFIER CDD_FordBlaBoxIfCmn.ReceiverPorts.FordVehBlaBoxInp2HiPart.Val /end MEASUREMENT
/begin MEASUREMENT CDD_FordBlaBoxIfCmn.FordVehBlaBoxInp2LoPart.Val "MICROSAR RTE" ULONG NO_COMPU_METHOD 0 0 0 4294967295 ECU_ADDRESS 0 SYMBOL_LINK "Rte_CDD_FordBlaBoxIfCmn_FordVehBlaBoxInp2LoPart_Val" 0 DISPLAY_IDENTIFIER CDD_FordBlaBoxIfCmn.ReceiverPorts.FordVehBlaBoxInp2LoPart.Val /end MEASUREMENT
/begin MEASUREMENT CDD_FordBlaBoxIfCmn.FordVehBlaBoxInp3HiPart.Val "MICROSAR RTE" ULONG NO_COMPU_METHOD 0 0 0 4294967295 ECU_ADDRESS 0 SYMBOL_LINK "Rte_CDD_FordBlaBoxIfCmn_FordVehBlaBoxInp3HiPart_Val" 0 DISPLAY_IDENTIFIER CDD_FordBlaBoxIfCmn.ReceiverPorts.FordVehBlaBoxInp3HiPart.Val /end MEASUREMENT
/begin MEASUREMENT CDD_FordBlaBoxIfCmn.FordVehBlaBoxInp3LoPart.Val "MICROSAR RTE" ULONG NO_COMPU_METHOD 0 0 0 4294967295 ECU_ADDRESS 0 SYMBOL_LINK "Rte_CDD_FordBlaBoxIfCmn_FordVehBlaBoxInp3LoPart_Val" 0 DISPLAY_IDENTIFIER CDD_FordBlaBoxIfCmn.ReceiverPorts.FordVehBlaBoxInp3LoPart.Val /end MEASUREMENT
/begin MEASUREMENT CDD_FordBlaBoxIfCmn.FordVehBlaBoxInp4HiPart.Val "MICROSAR RTE" ULONG NO_COMPU_METHOD 0 0 0 4294967295 ECU_ADDRESS 0 SYMBOL_LINK "Rte_CDD_FordBlaBoxIfCmn_FordVehBlaBoxInp4HiPart_Val" 0 DISPLAY_IDENTIFIER CDD_FordBlaBoxIfCmn.ReceiverPorts.FordVehBlaBoxInp4HiPart.Val /end MEASUREMENT
/begin MEASUREMENT CDD_FordBlaBoxIfCmn.FordVehBlaBoxInp4LoPart.Val "MICROSAR RTE" ULONG NO_COMPU_METHOD 0 0 0 4294967295 ECU_ADDRESS 0 SYMBOL_LINK "Rte_CDD_FordBlaBoxIfCmn_FordVehBlaBoxInp4LoPart_Val" 0 DISPLAY_IDENTIFIER CDD_FordBlaBoxIfCmn.ReceiverPorts.FordVehBlaBoxInp4LoPart.Val /end MEASUREMENT
/begin MEASUREMENT CDD_FordBlaBoxIfCmn.FordVehBrkPedlAppld.Val "MICROSAR RTE" UBYTE NO_COMPU_METHOD 0 0 0 255 ECU_ADDRESS 0 SYMBOL_LINK "Rte_CDD_FordBlaBoxIfCmn_FordVehBrkPedlAppld_Val" 0 DISPLAY_IDENTIFIER CDD_FordBlaBoxIfCmn.ReceiverPorts.FordVehBrkPedlAppld.Val /end MEASUREMENT
/begin MEASUREMENT CDD_FordBlaBoxIfCmn.FordVehBrkPedlAppldQlyFac.Val "MICROSAR RTE" UBYTE NO_COMPU_METHOD 0 0 0 255 ECU_ADDRESS 0 SYMBOL_LINK "Rte_CDD_FordBlaBoxIfCmn_FordVehBrkPedlAppldQlyFac_Val" 0 DISPLAY_IDENTIFIER CDD_FordBlaBoxIfCmn.ReceiverPorts.FordVehBrkPedlAppldQlyFac.Val /end MEASUREMENT
/begin MEASUREMENT CDD_FordBlaBoxIfCmn.FordVehBrkPedlVld.Logl "MICROSAR RTE" UBYTE RTE_CM_BOOLEAN 0 0 0 255 ECU_ADDRESS 0 SYMBOL_LINK "Rte_CDD_FordBlaBoxIfCmn_FordVehBrkPedlVld_Logl" 0 DISPLAY_IDENTIFIER CDD_FordBlaBoxIfCmn.ReceiverPorts.FordVehBrkPedlVld.Logl /end MEASUREMENT
/begin MEASUREMENT CDD_FordBlaBoxIfCmn.FordVehBrkTqVld.Logl "MICROSAR RTE" UBYTE RTE_CM_BOOLEAN 0 0 0 255 ECU_ADDRESS 0 SYMBOL_LINK "Rte_FordMsg07DBusHiSpd_FordVehBrkTqVld_Logl" 0 DISPLAY_IDENTIFIER CDD_FordBlaBoxIfCmn.ReceiverPorts.FordVehBrkTqVld.Logl /end MEASUREMENT
/begin MEASUREMENT CDD_FordBlaBoxIfCmn.FordVehCllsnMtgtnByBrkgDenied.Val "MICROSAR RTE" UBYTE NO_COMPU_METHOD 0 0 0 255 ECU_ADDRESS 0 SYMBOL_LINK "Rte_FordMsg213BusHiSpd_FordVehCllsnMtgtnByBrkgDenied_Val" 0 DISPLAY_IDENTIFIER CDD_FordBlaBoxIfCmn.ReceiverPorts.FordVehCllsnMtgtnByBrkgDenied.Val /end MEASUREMENT
/begin MEASUREMENT CDD_FordBlaBoxIfCmn.FordVehCllsnMtgtnByBrkgDisad.Val "MICROSAR RTE" UBYTE NO_COMPU_METHOD 0 0 0 255 ECU_ADDRESS 0 SYMBOL_LINK "Rte_FordMsg213BusHiSpd_FordVehCllsnMtgtnByBrkgDisad_Val" 0 DISPLAY_IDENTIFIER CDD_FordBlaBoxIfCmn.ReceiverPorts.FordVehCllsnMtgtnByBrkgDisad.Val /end MEASUREMENT
/begin MEASUREMENT CDD_FordBlaBoxIfCmn.FordVehCllsnMtgtnByBrkgLatDstRaw.Val "MICROSAR RTE" UWORD NO_COMPU_METHOD 0 0 0 65535 ECU_ADDRESS 0 SYMBOL_LINK "Rte_FordMsg3D7BusHiSpd_FordVehCllsnMtgtnByBrkgLatDstRaw_Val" 0 DISPLAY_IDENTIFIER CDD_FordBlaBoxIfCmn.ReceiverPorts.FordVehCllsnMtgtnByBrkgLatDstRaw.Val /end MEASUREMENT
/begin MEASUREMENT CDD_FordBlaBoxIfCmn.FordVehCllsnMtgtnByBrkgLgtDstRaw.Val "MICROSAR RTE" UWORD NO_COMPU_METHOD 0 0 0 65535 ECU_ADDRESS 0 SYMBOL_LINK "Rte_FordMsg3D7BusHiSpd_FordVehCllsnMtgtnByBrkgLgtDstRaw_Val" 0 DISPLAY_IDENTIFIER CDD_FordBlaBoxIfCmn.ReceiverPorts.FordVehCllsnMtgtnByBrkgLgtDstRaw.Val /end MEASUREMENT
/begin MEASUREMENT CDD_FordBlaBoxIfCmn.FordVehCllsnMtgtnByBrkgObjDataConfLvlRaw.Val "MICROSAR RTE" UBYTE NO_COMPU_METHOD 0 0 0 255 ECU_ADDRESS 0 SYMBOL_LINK "Rte_FordMsg3D7BusHiSpd_FordVehCllsnMtgtnByBrkgObjDataConfLvlRaw_Val" 0 DISPLAY_IDENTIFIER CDD_FordBlaBoxIfCmn.ReceiverPorts.FordVehCllsnMtgtnByBrkgObjDataConfLvlRaw.Val /end MEASUREMENT
/begin MEASUREMENT CDD_FordBlaBoxIfCmn.FordVehCllsnMtgtnByBrkgObjTypClassnRaw.Val "MICROSAR RTE" UBYTE NO_COMPU_METHOD 0 0 0 255 ECU_ADDRESS 0 SYMBOL_LINK "Rte_FordMsg3D7BusHiSpd_FordVehCllsnMtgtnByBrkgObjTypClassnRaw_Val" 0 DISPLAY_IDENTIFIER CDD_FordBlaBoxIfCmn.ReceiverPorts.FordVehCllsnMtgtnByBrkgObjTypClassnRaw.Val /end MEASUREMENT
/begin MEASUREMENT CDD_FordBlaBoxIfCmn.FordVehCllsnMtgtnByBrkgRelLatVelRaw.Val "MICROSAR RTE" UWORD NO_COMPU_METHOD 0 0 0 65535 ECU_ADDRESS 0 SYMBOL_LINK "Rte_FordMsg3D7BusHiSpd_FordVehCllsnMtgtnByBrkgRelLatVelRaw_Val" 0 DISPLAY_IDENTIFIER CDD_FordBlaBoxIfCmn.ReceiverPorts.FordVehCllsnMtgtnByBrkgRelLatVelRaw.Val /end MEASUREMENT
/begin MEASUREMENT CDD_FordBlaBoxIfCmn.FordVehCllsnMtgtnByBrkgRelLgtVelRaw.Val "MICROSAR RTE" UWORD NO_COMPU_METHOD 0 0 0 65535 ECU_ADDRESS 0 SYMBOL_LINK "Rte_FordMsg3D7BusHiSpd_FordVehCllsnMtgtnByBrkgRelLgtVelRaw_Val" 0 DISPLAY_IDENTIFIER CDD_FordBlaBoxIfCmn.ReceiverPorts.FordVehCllsnMtgtnByBrkgRelLgtVelRaw.Val /end MEASUREMENT
/begin MEASUREMENT CDD_FordBlaBoxIfCmn.FordVehCllsnMtgtnByBrkgTiToCllsnRaw.Val "MICROSAR RTE" UBYTE NO_COMPU_METHOD 0 0 0 255 ECU_ADDRESS 0 SYMBOL_LINK "Rte_FordMsg3D7BusHiSpd_FordVehCllsnMtgtnByBrkgTiToCllsnRaw_Val" 0 DISPLAY_IDENTIFIER CDD_FordBlaBoxIfCmn.ReceiverPorts.FordVehCllsnMtgtnByBrkgTiToCllsnRaw.Val /end MEASUREMENT
/begin MEASUREMENT CDD_FordBlaBoxIfCmn.FordVehEngSpdRaw.Val "MICROSAR RTE" UWORD NO_COMPU_METHOD 0 0 0 65535 ECU_ADDRESS 0 SYMBOL_LINK "Rte_CDD_FordBlaBoxIfCmn_FordVehEngSpdRaw_Val" 0 DISPLAY_IDENTIFIER CDD_FordBlaBoxIfCmn.ReceiverPorts.FordVehEngSpdRaw.Val /end MEASUREMENT
/begin MEASUREMENT CDD_FordBlaBoxIfCmn.FordVehEngSpdVld.Logl "MICROSAR RTE" UBYTE RTE_CM_BOOLEAN 0 0 0 255 ECU_ADDRESS 0 SYMBOL_LINK "Rte_CDD_FordBlaBoxIfCmn_FordVehEngSpdVld_Logl" 0 DISPLAY_IDENTIFIER CDD_FordBlaBoxIfCmn.ReceiverPorts.FordVehEngSpdVld.Logl /end MEASUREMENT
/begin MEASUREMENT CDD_FordBlaBoxIfCmn.FordVehEscActv.Val "MICROSAR RTE" UBYTE NO_COMPU_METHOD 0 0 0 255 ECU_ADDRESS 0 SYMBOL_LINK "Rte_FordMsg213BusHiSpd_FordVehEscActv_Val" 0 DISPLAY_IDENTIFIER CDD_FordBlaBoxIfCmn.ReceiverPorts.FordVehEscActv.Val /end MEASUREMENT
/begin MEASUREMENT CDD_FordBlaBoxIfCmn.FordVehEvasSteerAssiImgProcrModlAVld.Logl "MICROSAR RTE" UBYTE RTE_CM_BOOLEAN 0 0 0 255 ECU_ADDRESS 0 SYMBOL_LINK "Rte_FordMsg3D7BusHiSpd_FordVehEvasSteerAssiImgProcrModlAVld_Logl" 0 DISPLAY_IDENTIFIER CDD_FordBlaBoxIfCmn.ReceiverPorts.FordVehEvasSteerAssiImgProcrModlAVld.Logl /end MEASUREMENT
/begin MEASUREMENT CDD_FordBlaBoxIfCmn.FordVehEvasSteerAssiReq.Val "MICROSAR RTE" UBYTE NO_COMPU_METHOD 0 0 0 255 ECU_ADDRESS 0 SYMBOL_LINK "Rte_FordMsg2FDBusHiSpd_FordVehEvasSteerAssiReq_Val" 0 DISPLAY_IDENTIFIER CDD_FordBlaBoxIfCmn.ReceiverPorts.FordVehEvasSteerAssiReq.Val /end MEASUREMENT
/begin MEASUREMENT CDD_FordBlaBoxIfCmn.FordVehEvasSteerAssiReqVld.Logl "MICROSAR RTE" UBYTE RTE_CM_BOOLEAN 0 0 0 255 ECU_ADDRESS 0 SYMBOL_LINK "Rte_FordMsg2FDBusHiSpd_FordVehEvasSteerAssiReqVld_Logl" 0 DISPLAY_IDENTIFIER CDD_FordBlaBoxIfCmn.ReceiverPorts.FordVehEvasSteerAssiReqVld.Logl /end MEASUREMENT
/begin MEASUREMENT CDD_FordBlaBoxIfCmn.FordVehFrntLeWhlCntrDirVld.Logl "MICROSAR RTE" UBYTE RTE_CM_BOOLEAN 0 0 0 255 ECU_ADDRESS 0 SYMBOL_LINK "Rte_FordMsg216BusHiSpd_FordVehFrntLeWhlCntrDirVld_Logl" 0 DISPLAY_IDENTIFIER CDD_FordBlaBoxIfCmn.ReceiverPorts.FordVehFrntLeWhlCntrDirVld.Logl /end MEASUREMENT
/begin MEASUREMENT CDD_FordBlaBoxIfCmn.FordVehFrntLeWhlDirRaw.Val "MICROSAR RTE" UBYTE NO_COMPU_METHOD 0 0 0 255 ECU_ADDRESS 0 SYMBOL_LINK "Rte_FordMsg216BusHiSpd_FordVehFrntLeWhlDirRaw_Val" 0 DISPLAY_IDENTIFIER CDD_FordBlaBoxIfCmn.ReceiverPorts.FordVehFrntLeWhlDirRaw.Val /end MEASUREMENT
/begin MEASUREMENT CDD_FordBlaBoxIfCmn.FordVehFrntLeWhlRollgCntr.Val "MICROSAR RTE" UBYTE NO_COMPU_METHOD 0 0 0 255 ECU_ADDRESS 0 SYMBOL_LINK "Rte_CDD_FordBlaBoxIfCmn_FordVehFrntLeWhlRollgCntr_Val" 0 DISPLAY_IDENTIFIER CDD_FordBlaBoxIfCmn.ReceiverPorts.FordVehFrntLeWhlRollgCntr.Val /end MEASUREMENT
/begin MEASUREMENT CDD_FordBlaBoxIfCmn.FordVehFrntLeWhlSpdRaw.Val "MICROSAR RTE" UWORD NO_COMPU_METHOD 0 0 0 65535 ECU_ADDRESS 0 SYMBOL_LINK "Rte_FordMsg217BusHiSpd_FordVehFrntLeWhlSpdRaw_Val" 0 DISPLAY_IDENTIFIER CDD_FordBlaBoxIfCmn.ReceiverPorts.FordVehFrntLeWhlSpdRaw.Val /end MEASUREMENT
/begin MEASUREMENT CDD_FordBlaBoxIfCmn.FordVehFrntLeWhlSpdVld.Logl "MICROSAR RTE" UBYTE RTE_CM_BOOLEAN 0 0 0 255 ECU_ADDRESS 0 SYMBOL_LINK "Rte_FordMsg217BusHiSpd_FordVehFrntLeWhlSpdVld_Logl" 0 DISPLAY_IDENTIFIER CDD_FordBlaBoxIfCmn.ReceiverPorts.FordVehFrntLeWhlSpdVld.Logl /end MEASUREMENT
/begin MEASUREMENT CDD_FordBlaBoxIfCmn.FordVehFrntRiWhlCntrDirVld.Logl "MICROSAR RTE" UBYTE RTE_CM_BOOLEAN 0 0 0 255 ECU_ADDRESS 0 SYMBOL_LINK "Rte_FordMsg216BusHiSpd_FordVehFrntRiWhlCntrDirVld_Logl" 0 DISPLAY_IDENTIFIER CDD_FordBlaBoxIfCmn.ReceiverPorts.FordVehFrntRiWhlCntrDirVld.Logl /end MEASUREMENT
/begin MEASUREMENT CDD_FordBlaBoxIfCmn.FordVehFrntRiWhlDirRaw.Val "MICROSAR RTE" UBYTE NO_COMPU_METHOD 0 0 0 255 ECU_ADDRESS 0 SYMBOL_LINK "Rte_FordMsg216BusHiSpd_FordVehFrntRiWhlDirRaw_Val" 0 DISPLAY_IDENTIFIER CDD_FordBlaBoxIfCmn.ReceiverPorts.FordVehFrntRiWhlDirRaw.Val /end MEASUREMENT
/begin MEASUREMENT CDD_FordBlaBoxIfCmn.FordVehFrntRiWhlRollgCntr.Val "MICROSAR RTE" UBYTE NO_COMPU_METHOD 0 0 0 255 ECU_ADDRESS 0 SYMBOL_LINK "Rte_CDD_FordBlaBoxIfCmn_FordVehFrntRiWhlRollgCntr_Val" 0 DISPLAY_IDENTIFIER CDD_FordBlaBoxIfCmn.ReceiverPorts.FordVehFrntRiWhlRollgCntr.Val /end MEASUREMENT
/begin MEASUREMENT CDD_FordBlaBoxIfCmn.FordVehFrntRiWhlSpdRaw.Val "MICROSAR RTE" UWORD NO_COMPU_METHOD 0 0 0 65535 ECU_ADDRESS 0 SYMBOL_LINK "Rte_FordMsg217BusHiSpd_FordVehFrntRiWhlSpdRaw_Val" 0 DISPLAY_IDENTIFIER CDD_FordBlaBoxIfCmn.ReceiverPorts.FordVehFrntRiWhlSpdRaw.Val /end MEASUREMENT
/begin MEASUREMENT CDD_FordBlaBoxIfCmn.FordVehFrntRiWhlSpdVld.Logl "MICROSAR RTE" UBYTE RTE_CM_BOOLEAN 0 0 0 255 ECU_ADDRESS 0 SYMBOL_LINK "Rte_FordMsg217BusHiSpd_FordVehFrntRiWhlSpdVld_Logl" 0 DISPLAY_IDENTIFIER CDD_FordBlaBoxIfCmn.ReceiverPorts.FordVehFrntRiWhlSpdVld.Logl /end MEASUREMENT
/begin MEASUREMENT CDD_FordBlaBoxIfCmn.FordVehGearLvrPosn.Val "MICROSAR RTE" UBYTE NO_COMPU_METHOD 0 0 0 255 ECU_ADDRESS 0 SYMBOL_LINK "Rte_CDD_FordBlaBoxIfCmn_FordVehGearLvrPosn_Val" 0 DISPLAY_IDENTIFIER CDD_FordBlaBoxIfCmn.ReceiverPorts.FordVehGearLvrPosn.Val /end MEASUREMENT
/begin MEASUREMENT CDD_FordBlaBoxIfCmn.FordVehGearLvrPosnVldInt.Logl "MICROSAR RTE" UBYTE RTE_CM_BOOLEAN 0 0 0 255 ECU_ADDRESS 0 SYMBOL_LINK "Rte_FordMsg230BusHiSpd_FordVehGearLvrPosnVldInt_Logl" 0 DISPLAY_IDENTIFIER CDD_FordBlaBoxIfCmn.ReceiverPorts.FordVehGearLvrPosnVldInt.Logl /end MEASUREMENT
/begin MEASUREMENT CDD_FordBlaBoxIfCmn.FordVehGearPosnRaw.Val "MICROSAR RTE" UBYTE NO_COMPU_METHOD 0 0 0 255 ECU_ADDRESS 0 SYMBOL_LINK "Rte_CDD_FordBlaBoxIfCmn_FordVehGearPosnRaw_Val" 0 DISPLAY_IDENTIFIER CDD_FordBlaBoxIfCmn.ReceiverPorts.FordVehGearPosnRaw.Val /end MEASUREMENT
/begin MEASUREMENT CDD_FordBlaBoxIfCmn.FordVehGearRvsStsRaw.Val "MICROSAR RTE" UBYTE NO_COMPU_METHOD 0 0 0 255 ECU_ADDRESS 0 SYMBOL_LINK "Rte_FordMsg202BusHiSpd_FordVehGearRvsStsRaw_Val" 0 DISPLAY_IDENTIFIER CDD_FordBlaBoxIfCmn.ReceiverPorts.FordVehGearRvsStsRaw.Val /end MEASUREMENT
/begin MEASUREMENT CDD_FordBlaBoxIfCmn.FordVehGearRvsStsVld.Logl "MICROSAR RTE" UBYTE RTE_CM_BOOLEAN 0 0 0 255 ECU_ADDRESS 0 SYMBOL_LINK "Rte_FordMsg202BusHiSpd_FordVehGearRvsStsVld_Logl" 0 DISPLAY_IDENTIFIER CDD_FordBlaBoxIfCmn.ReceiverPorts.FordVehGearRvsStsVld.Logl /end MEASUREMENT
/begin MEASUREMENT CDD_FordBlaBoxIfCmn.FordVehIgnSts.Val "MICROSAR RTE" UBYTE NO_COMPU_METHOD 0 0 0 255 ECU_ADDRESS 0 SYMBOL_LINK "Rte_CDD_FordBlaBoxIfCmn_FordVehIgnSts_Val" 0 DISPLAY_IDENTIFIER CDD_FordBlaBoxIfCmn.ReceiverPorts.FordVehIgnSts.Val /end MEASUREMENT
/begin MEASUREMENT CDD_FordBlaBoxIfCmn.FordVehIgnStsVld.Logl "MICROSAR RTE" UBYTE RTE_CM_BOOLEAN 0 0 0 255 ECU_ADDRESS 0 SYMBOL_LINK "Rte_FordMsg3B3BusHiSpd_FordVehIgnStsVld_Logl" 0 DISPLAY_IDENTIFIER CDD_FordBlaBoxIfCmn.ReceiverPorts.FordVehIgnStsVld.Logl /end MEASUREMENT
/begin MEASUREMENT CDD_FordBlaBoxIfCmn.FordVehLaneAssiImgProcgModlAVld.Logl "MICROSAR RTE" UBYTE RTE_CM_BOOLEAN 0 0 0 255 ECU_ADDRESS 0 SYMBOL_LINK "Rte_FordMsg3CABusHiSpd_FordVehLaneAssiImgProcgModlAVld_Logl" 0 DISPLAY_IDENTIFIER CDD_FordBlaBoxIfCmn.ReceiverPorts.FordVehLaneAssiImgProcgModlAVld.Logl /end MEASUREMENT
/begin MEASUREMENT CDD_FordBlaBoxIfCmn.FordVehLaneDetnWarnInten.Val "MICROSAR RTE" UBYTE NO_COMPU_METHOD 0 0 0 255 ECU_ADDRESS 0 SYMBOL_LINK "Rte_FordMsg3CABusHiSpd_FordVehLaneDetnWarnInten_Val" 0 DISPLAY_IDENTIFIER CDD_FordBlaBoxIfCmn.ReceiverPorts.FordVehLaneDetnWarnInten.Val /end MEASUREMENT
/begin MEASUREMENT CDD_FordBlaBoxIfCmn.FordVehLaneDetnWarnSts.Val "MICROSAR RTE" UBYTE NO_COMPU_METHOD 0 0 0 255 ECU_ADDRESS 0 SYMBOL_LINK "Rte_FordMsg3CABusHiSpd_FordVehLaneDetnWarnSts_Val" 0 DISPLAY_IDENTIFIER CDD_FordBlaBoxIfCmn.ReceiverPorts.FordVehLaneDetnWarnSts.Val /end MEASUREMENT
/begin MEASUREMENT CDD_FordBlaBoxIfCmn.FordVehLaneKeepSysCrvtRaw.Val "MICROSAR RTE" UWORD NO_COMPU_METHOD 0 0 0 65535 ECU_ADDRESS 0 SYMBOL_LINK "Rte_FordMsg3CABusHiSpd_FordVehLaneKeepSysCrvtRaw_Val" 0 DISPLAY_IDENTIFIER CDD_FordBlaBoxIfCmn.ReceiverPorts.FordVehLaneKeepSysCrvtRaw.Val /end MEASUREMENT
/begin MEASUREMENT CDD_FordBlaBoxIfCmn.FordVehLaneKeepSysRampTyp.Val "MICROSAR RTE" UBYTE NO_COMPU_METHOD 0 0 0 255 ECU_ADDRESS 0 SYMBOL_LINK "Rte_FordMsg3CABusHiSpd_FordVehLaneKeepSysRampTyp_Val" 0 DISPLAY_IDENTIFIER CDD_FordBlaBoxIfCmn.ReceiverPorts.FordVehLaneKeepSysRampTyp.Val /end MEASUREMENT
/begin MEASUREMENT CDD_FordBlaBoxIfCmn.FordVehLaneKeepSysReqdAgRaw.Val "MICROSAR RTE" UWORD NO_COMPU_METHOD 0 0 0 65535 ECU_ADDRESS 0 SYMBOL_LINK "Rte_FordMsg3CABusHiSpd_FordVehLaneKeepSysReqdAgRaw_Val" 0 DISPLAY_IDENTIFIER CDD_FordBlaBoxIfCmn.ReceiverPorts.FordVehLaneKeepSysReqdAgRaw.Val /end MEASUREMENT
/begin MEASUREMENT CDD_FordBlaBoxIfCmn.FordVehLaneKeepSysSts.Val "MICROSAR RTE" UBYTE NO_COMPU_METHOD 0 0 0 255 ECU_ADDRESS 0 SYMBOL_LINK "Rte_FordMsg3CABusHiSpd_FordVehLaneKeepSysSts_Val" 0 DISPLAY_IDENTIFIER CDD_FordBlaBoxIfCmn.ReceiverPorts.FordVehLaneKeepSysSts.Val /end MEASUREMENT
/begin MEASUREMENT CDD_FordBlaBoxIfCmn.FordVehLatACmpdRaw.Val "MICROSAR RTE" UWORD NO_COMPU_METHOD 0 0 0 65535 ECU_ADDRESS 0 SYMBOL_LINK "Rte_FordMsg077BusHiSpd_FordVehLatACmpdRaw_Val" 0 DISPLAY_IDENTIFIER CDD_FordBlaBoxIfCmn.ReceiverPorts.FordVehLatACmpdRaw.Val /end MEASUREMENT
/begin MEASUREMENT CDD_FordBlaBoxIfCmn.FordVehLatACmpdVld.Logl "MICROSAR RTE" UBYTE RTE_CM_BOOLEAN 0 0 0 255 ECU_ADDRESS 0 SYMBOL_LINK "Rte_FordMsg077BusHiSpd_FordVehLatACmpdVld_Logl" 0 DISPLAY_IDENTIFIER CDD_FordBlaBoxIfCmn.ReceiverPorts.FordVehLatACmpdVld.Logl /end MEASUREMENT
/begin MEASUREMENT CDD_FordBlaBoxIfCmn.FordVehLatCtrlCrvtRateRaw.Val "MICROSAR RTE" UWORD NO_COMPU_METHOD 0 0 0 65535 ECU_ADDRESS 0 SYMBOL_LINK "Rte_FordMsg3D3BusHiSpd_FordVehLatCtrlCrvtRateRaw_Val" 0 DISPLAY_IDENTIFIER CDD_FordBlaBoxIfCmn.ReceiverPorts.FordVehLatCtrlCrvtRateRaw.Val /end MEASUREMENT
/begin MEASUREMENT CDD_FordBlaBoxIfCmn.FordVehLatCtrlCrvtRaw.Val "MICROSAR RTE" UWORD NO_COMPU_METHOD 0 0 0 65535 ECU_ADDRESS 0 SYMBOL_LINK "Rte_FordMsg3D3BusHiSpd_FordVehLatCtrlCrvtRaw_Val" 0 DISPLAY_IDENTIFIER CDD_FordBlaBoxIfCmn.ReceiverPorts.FordVehLatCtrlCrvtRaw.Val /end MEASUREMENT
/begin MEASUREMENT CDD_FordBlaBoxIfCmn.FordVehLatCtrlHandsOffDetnTqStimlsReq.Val "MICROSAR RTE" UBYTE NO_COMPU_METHOD 0 0 0 255 ECU_ADDRESS 0 SYMBOL_LINK "Rte_FordMsg3D3BusHiSpd_FordVehLatCtrlHandsOffDetnTqStimlsReq_Val" 0 DISPLAY_IDENTIFIER CDD_FordBlaBoxIfCmn.ReceiverPorts.FordVehLatCtrlHandsOffDetnTqStimlsReq.Val /end MEASUREMENT
/begin MEASUREMENT CDD_FordBlaBoxIfCmn.FordVehLatCtrlImgProcrModlAVld.Logl "MICROSAR RTE" UBYTE RTE_CM_BOOLEAN 0 0 0 255 ECU_ADDRESS 0 SYMBOL_LINK "Rte_FordMsg3D3BusHiSpd_FordVehLatCtrlImgProcrModlAVld_Logl" 0 DISPLAY_IDENTIFIER CDD_FordBlaBoxIfCmn.ReceiverPorts.FordVehLatCtrlImgProcrModlAVld.Logl /end MEASUREMENT
/begin MEASUREMENT CDD_FordBlaBoxIfCmn.FordVehLatCtrlPahOffsRaw.Val "MICROSAR RTE" UWORD NO_COMPU_METHOD 0 0 0 65535 ECU_ADDRESS 0 SYMBOL_LINK "Rte_FordMsg3D3BusHiSpd_FordVehLatCtrlPahOffsRaw_Val" 0 DISPLAY_IDENTIFIER CDD_FordBlaBoxIfCmn.ReceiverPorts.FordVehLatCtrlPahOffsRaw.Val /end MEASUREMENT
/begin MEASUREMENT CDD_FordBlaBoxIfCmn.FordVehLatCtrlPahRaw.Val "MICROSAR RTE" UWORD NO_COMPU_METHOD 0 0 0 65535 ECU_ADDRESS 0 SYMBOL_LINK "Rte_FordMsg3D3BusHiSpd_FordVehLatCtrlPahRaw_Val" 0 DISPLAY_IDENTIFIER CDD_FordBlaBoxIfCmn.ReceiverPorts.FordVehLatCtrlPahRaw.Val /end MEASUREMENT
/begin MEASUREMENT CDD_FordBlaBoxIfCmn.FordVehLatCtrlPrcsn.Val "MICROSAR RTE" UBYTE NO_COMPU_METHOD 0 0 0 255 ECU_ADDRESS 0 SYMBOL_LINK "Rte_FordMsg3D3BusHiSpd_FordVehLatCtrlPrcsn_Val" 0 DISPLAY_IDENTIFIER CDD_FordBlaBoxIfCmn.ReceiverPorts.FordVehLatCtrlPrcsn.Val /end MEASUREMENT
/begin MEASUREMENT CDD_FordBlaBoxIfCmn.FordVehLatCtrlRampTyp.Val "MICROSAR RTE" UBYTE NO_COMPU_METHOD 0 0 0 255 ECU_ADDRESS 0 SYMBOL_LINK "Rte_FordMsg3D3BusHiSpd_FordVehLatCtrlRampTyp_Val" 0 DISPLAY_IDENTIFIER CDD_FordBlaBoxIfCmn.ReceiverPorts.FordVehLatCtrlRampTyp.Val /end MEASUREMENT
/begin MEASUREMENT CDD_FordBlaBoxIfCmn.FordVehLatCtrlReq.Val "MICROSAR RTE" UBYTE NO_COMPU_METHOD 0 0 0 255 ECU_ADDRESS 0 SYMBOL_LINK "Rte_FordMsg3D3BusHiSpd_FordVehLatCtrlReq_Val" 0 DISPLAY_IDENTIFIER CDD_FordBlaBoxIfCmn.ReceiverPorts.FordVehLatCtrlReq.Val /end MEASUREMENT
/begin MEASUREMENT CDD_FordBlaBoxIfCmn.FordVehLatCtrlRingMax.Val "MICROSAR RTE" UBYTE NO_COMPU_METHOD 0 0 0 255 ECU_ADDRESS 0 SYMBOL_LINK "Rte_FordMsg3D3BusHiSpd_FordVehLatCtrlRingMax_Val" 0 DISPLAY_IDENTIFIER CDD_FordBlaBoxIfCmn.ReceiverPorts.FordVehLatCtrlRingMax.Val /end MEASUREMENT
/begin MEASUREMENT CDD_FordBlaBoxIfCmn.FordVehLgtACmpdRaw.Val "MICROSAR RTE" UWORD NO_COMPU_METHOD 0 0 0 65535 ECU_ADDRESS 0 SYMBOL_LINK "Rte_FordMsg077BusHiSpd_FordVehLgtACmpdRaw_Val" 0 DISPLAY_IDENTIFIER CDD_FordBlaBoxIfCmn.ReceiverPorts.FordVehLgtACmpdRaw.Val /end MEASUREMENT
/begin MEASUREMENT CDD_FordBlaBoxIfCmn.FordVehLgtACmpdVld.Logl "MICROSAR RTE" UBYTE RTE_CM_BOOLEAN 0 0 0 255 ECU_ADDRESS 0 SYMBOL_LINK "Rte_FordMsg077BusHiSpd_FordVehLgtACmpdVld_Logl" 0 DISPLAY_IDENTIFIER CDD_FordBlaBoxIfCmn.ReceiverPorts.FordVehLgtACmpdVld.Logl /end MEASUREMENT
/begin MEASUREMENT CDD_FordBlaBoxIfCmn.FordVehLoSpdMtnCtrlBrkSprtStsRaw.Val "MICROSAR RTE" UBYTE NO_COMPU_METHOD 0 0 0 255 ECU_ADDRESS 0 SYMBOL_LINK "Rte_FordMsg415BusHiSpd_FordVehLoSpdMtnCtrlBrkSprtStsRaw_Val" 0 DISPLAY_IDENTIFIER CDD_FordBlaBoxIfCmn.ReceiverPorts.FordVehLoSpdMtnCtrlBrkSprtStsRaw.Val /end MEASUREMENT
/begin MEASUREMENT CDD_FordBlaBoxIfCmn.FordVehLoSpdMtnCtrlBrkSprtVld.Logl "MICROSAR RTE" UBYTE RTE_CM_BOOLEAN 0 0 0 255 ECU_ADDRESS 0 SYMBOL_LINK "Rte_FordMsg415BusHiSpd_FordVehLoSpdMtnCtrlBrkSprtVld_Logl" 0 DISPLAY_IDENTIFIER CDD_FordBlaBoxIfCmn.ReceiverPorts.FordVehLoSpdMtnCtrlBrkSprtVld.Logl /end MEASUREMENT
/begin MEASUREMENT CDD_FordBlaBoxIfCmn.FordVehParkAidModlStsVld.Logl "MICROSAR RTE" UBYTE RTE_CM_BOOLEAN 0 0 0 255 ECU_ADDRESS 0 SYMBOL_LINK "Rte_CDD_FordBlaBoxIfCmn_FordVehParkAidModlStsVld_Logl" 0 DISPLAY_IDENTIFIER CDD_FordBlaBoxIfCmn.ReceiverPorts.FordVehParkAidModlStsVld.Logl /end MEASUREMENT
/begin MEASUREMENT CDD_FordBlaBoxIfCmn.FordVehParkAidModlSysSt.Val "MICROSAR RTE" UBYTE NO_COMPU_METHOD 0 0 0 255 ECU_ADDRESS 0 SYMBOL_LINK "Rte_CDD_FordBlaBoxIfCmn_FordVehParkAidModlSysSt_Val" 0 DISPLAY_IDENTIFIER CDD_FordBlaBoxIfCmn.ReceiverPorts.FordVehParkAidModlSysSt.Val /end MEASUREMENT
/begin MEASUREMENT CDD_FordBlaBoxIfCmn.FordVehPrpnWhlTqRaw.Val "MICROSAR RTE" UWORD NO_COMPU_METHOD 0 0 0 65535 ECU_ADDRESS 0 SYMBOL_LINK "Rte_FordMsg167BusHiSpd_FordVehPrpnWhlTqRaw_Val" 0 DISPLAY_IDENTIFIER CDD_FordBlaBoxIfCmn.ReceiverPorts.FordVehPrpnWhlTqRaw.Val /end MEASUREMENT
/begin MEASUREMENT CDD_FordBlaBoxIfCmn.FordVehPrpnWhlTqVld.Logl "MICROSAR RTE" UBYTE RTE_CM_BOOLEAN 0 0 0 255 ECU_ADDRESS 0 SYMBOL_LINK "Rte_FordMsg167BusHiSpd_FordVehPrpnWhlTqVld_Logl" 0 DISPLAY_IDENTIFIER CDD_FordBlaBoxIfCmn.ReceiverPorts.FordVehPrpnWhlTqVld.Logl /end MEASUREMENT
/begin MEASUREMENT CDD_FordBlaBoxIfCmn.FordVehReLeWhlCntrDirVld.Logl "MICROSAR RTE" UBYTE RTE_CM_BOOLEAN 0 0 0 255 ECU_ADDRESS 0 SYMBOL_LINK "Rte_FordMsg216BusHiSpd_FordVehReLeWhlCntrDirVld_Logl" 0 DISPLAY_IDENTIFIER CDD_FordBlaBoxIfCmn.ReceiverPorts.FordVehReLeWhlCntrDirVld.Logl /end MEASUREMENT
/begin MEASUREMENT CDD_FordBlaBoxIfCmn.FordVehReLeWhlDirRaw.Val "MICROSAR RTE" UBYTE NO_COMPU_METHOD 0 0 0 255 ECU_ADDRESS 0 SYMBOL_LINK "Rte_FordMsg216BusHiSpd_FordVehReLeWhlDirRaw_Val" 0 DISPLAY_IDENTIFIER CDD_FordBlaBoxIfCmn.ReceiverPorts.FordVehReLeWhlDirRaw.Val /end MEASUREMENT
/begin MEASUREMENT CDD_FordBlaBoxIfCmn.FordVehReLeWhlRollgCntr.Val "MICROSAR RTE" UBYTE NO_COMPU_METHOD 0 0 0 255 ECU_ADDRESS 0 SYMBOL_LINK "Rte_CDD_FordBlaBoxIfCmn_FordVehReLeWhlRollgCntr_Val" 0 DISPLAY_IDENTIFIER CDD_FordBlaBoxIfCmn.ReceiverPorts.FordVehReLeWhlRollgCntr.Val /end MEASUREMENT
/begin MEASUREMENT CDD_FordBlaBoxIfCmn.FordVehReLeWhlSpdRaw.Val "MICROSAR RTE" UWORD NO_COMPU_METHOD 0 0 0 65535 ECU_ADDRESS 0 SYMBOL_LINK "Rte_FordMsg217BusHiSpd_FordVehReLeWhlSpdRaw_Val" 0 DISPLAY_IDENTIFIER CDD_FordBlaBoxIfCmn.ReceiverPorts.FordVehReLeWhlSpdRaw.Val /end MEASUREMENT
/begin MEASUREMENT CDD_FordBlaBoxIfCmn.FordVehReLeWhlSpdVld.Logl "MICROSAR RTE" UBYTE RTE_CM_BOOLEAN 0 0 0 255 ECU_ADDRESS 0 SYMBOL_LINK "Rte_FordMsg217BusHiSpd_FordVehReLeWhlSpdVld_Logl" 0 DISPLAY_IDENTIFIER CDD_FordBlaBoxIfCmn.ReceiverPorts.FordVehReLeWhlSpdVld.Logl /end MEASUREMENT
/begin MEASUREMENT CDD_FordBlaBoxIfCmn.FordVehReRiWhlCntrDirVld.Logl "MICROSAR RTE" UBYTE RTE_CM_BOOLEAN 0 0 0 255 ECU_ADDRESS 0 SYMBOL_LINK "Rte_FordMsg216BusHiSpd_FordVehReRiWhlCntrDirVld_Logl" 0 DISPLAY_IDENTIFIER CDD_FordBlaBoxIfCmn.ReceiverPorts.FordVehReRiWhlCntrDirVld.Logl /end MEASUREMENT
/begin MEASUREMENT CDD_FordBlaBoxIfCmn.FordVehReRiWhlDirRaw.Val "MICROSAR RTE" UBYTE NO_COMPU_METHOD 0 0 0 255 ECU_ADDRESS 0 SYMBOL_LINK "Rte_FordMsg216BusHiSpd_FordVehReRiWhlDirRaw_Val" 0 DISPLAY_IDENTIFIER CDD_FordBlaBoxIfCmn.ReceiverPorts.FordVehReRiWhlDirRaw.Val /end MEASUREMENT
/begin MEASUREMENT CDD_FordBlaBoxIfCmn.FordVehReRiWhlRollgCntr.Val "MICROSAR RTE" UBYTE NO_COMPU_METHOD 0 0 0 255 ECU_ADDRESS 0 SYMBOL_LINK "Rte_CDD_FordBlaBoxIfCmn_FordVehReRiWhlRollgCntr_Val" 0 DISPLAY_IDENTIFIER CDD_FordBlaBoxIfCmn.ReceiverPorts.FordVehReRiWhlRollgCntr.Val /end MEASUREMENT
/begin MEASUREMENT CDD_FordBlaBoxIfCmn.FordVehReRiWhlSpdRaw.Val "MICROSAR RTE" UWORD NO_COMPU_METHOD 0 0 0 65535 ECU_ADDRESS 0 SYMBOL_LINK "Rte_FordMsg217BusHiSpd_FordVehReRiWhlSpdRaw_Val" 0 DISPLAY_IDENTIFIER CDD_FordBlaBoxIfCmn.ReceiverPorts.FordVehReRiWhlSpdRaw.Val /end MEASUREMENT
/begin MEASUREMENT CDD_FordBlaBoxIfCmn.FordVehReRiWhlSpdVld.Logl "MICROSAR RTE" UBYTE RTE_CM_BOOLEAN 0 0 0 255 ECU_ADDRESS 0 SYMBOL_LINK "Rte_FordMsg217BusHiSpd_FordVehReRiWhlSpdVld_Logl" 0 DISPLAY_IDENTIFIER CDD_FordBlaBoxIfCmn.ReceiverPorts.FordVehReRiWhlSpdVld.Logl /end MEASUREMENT
/begin MEASUREMENT CDD_FordBlaBoxIfCmn.FordVehSelDrvModChassisVld.Logl "MICROSAR RTE" UBYTE RTE_CM_BOOLEAN 0 0 0 255 ECU_ADDRESS 0 SYMBOL_LINK "Rte_FordMsg41EBusHiSpd_FordVehSelDrvModChassisVld_Logl" 0 DISPLAY_IDENTIFIER CDD_FordBlaBoxIfCmn.ReceiverPorts.FordVehSelDrvModChassisVld.Logl /end MEASUREMENT
/begin MEASUREMENT CDD_FordBlaBoxIfCmn.FordVehSpd.Val "MICROSAR RTE" FLOAT32_IEEE NO_COMPU_METHOD 0 0 -3.402823466e+38 3.402823466e+38 ECU_ADDRESS 0 SYMBOL_LINK "Rte_FordVehSpdArbn_FordVehSpd_Val" 0 DISPLAY_IDENTIFIER CDD_FordBlaBoxIfCmn.ReceiverPorts.FordVehSpd.Val /end MEASUREMENT
/begin MEASUREMENT CDD_FordBlaBoxIfCmn.FordVehSpdBrkModlRaw.Val "MICROSAR RTE" UWORD NO_COMPU_METHOD 0 0 0 65535 ECU_ADDRESS 0 SYMBOL_LINK "Rte_FordMsg415BusHiSpd_FordVehSpdBrkModlRaw_Val" 0 DISPLAY_IDENTIFIER CDD_FordBlaBoxIfCmn.ReceiverPorts.FordVehSpdBrkModlRaw.Val /end MEASUREMENT
/begin MEASUREMENT CDD_FordBlaBoxIfCmn.FordVehSpdOverGndRaw.Val "MICROSAR RTE" UWORD NO_COMPU_METHOD 0 0 0 65535 ECU_ADDRESS 0 SYMBOL_LINK "Rte_FordMsg077BusHiSpd_FordVehSpdOverGndRaw_Val" 0 DISPLAY_IDENTIFIER CDD_FordBlaBoxIfCmn.ReceiverPorts.FordVehSpdOverGndRaw.Val /end MEASUREMENT
/begin MEASUREMENT CDD_FordBlaBoxIfCmn.FordVehSpdOverGndVld.Logl "MICROSAR RTE" UBYTE RTE_CM_BOOLEAN 0 0 0 255 ECU_ADDRESS 0 SYMBOL_LINK "Rte_FordMsg077BusHiSpd_FordVehSpdOverGndVld_Logl" 0 DISPLAY_IDENTIFIER CDD_FordBlaBoxIfCmn.ReceiverPorts.FordVehSpdOverGndVld.Logl /end MEASUREMENT
/begin MEASUREMENT CDD_FordBlaBoxIfCmn.FordVehSteerPinionAgOffsRaw.Val "MICROSAR RTE" UWORD NO_COMPU_METHOD 0 0 0 65535 ECU_ADDRESS 0 SYMBOL_LINK "Rte_FordMsg414BusHiSpd_FordVehSteerPinionAgOffsRaw_Val" 0 DISPLAY_IDENTIFIER CDD_FordBlaBoxIfCmn.ReceiverPorts.FordVehSteerPinionAgOffsRaw.Val /end MEASUREMENT
/begin MEASUREMENT CDD_FordBlaBoxIfCmn.FordVehSteerPinionAgOffsVld.Logl "MICROSAR RTE" UBYTE RTE_CM_BOOLEAN 0 0 0 255 ECU_ADDRESS 0 SYMBOL_LINK "Rte_FordMsg414BusHiSpd_FordVehSteerPinionAgOffsVld_Logl" 0 DISPLAY_IDENTIFIER CDD_FordBlaBoxIfCmn.ReceiverPorts.FordVehSteerPinionAgOffsVld.Logl /end MEASUREMENT
/begin MEASUREMENT CDD_FordBlaBoxIfCmn.FordVehSteerPinionOffsStsRaw.Val "MICROSAR RTE" UBYTE NO_COMPU_METHOD 0 0 0 255 ECU_ADDRESS 0 SYMBOL_LINK "Rte_FordMsg414BusHiSpd_FordVehSteerPinionOffsStsRaw_Val" 0 DISPLAY_IDENTIFIER CDD_FordBlaBoxIfCmn.ReceiverPorts.FordVehSteerPinionOffsStsRaw.Val /end MEASUREMENT
/begin MEASUREMENT CDD_FordBlaBoxIfCmn.FordVehTireCircum.Val "MICROSAR RTE" FLOAT32_IEEE NO_COMPU_METHOD 0 0 -3.402823466e+38 3.402823466e+38 ECU_ADDRESS 0 SYMBOL_LINK "Rte_FordMsg40ABusHiSpd_FordVehTireCircum_Val" 0 DISPLAY_IDENTIFIER CDD_FordBlaBoxIfCmn.ReceiverPorts.FordVehTireCircum.Val /end MEASUREMENT
/begin MEASUREMENT CDD_FordBlaBoxIfCmn.FordVehTrlrAgOffsDirRaw.Val "MICROSAR RTE" UBYTE NO_COMPU_METHOD 0 0 0 255 ECU_ADDRESS 0 SYMBOL_LINK "Rte_CDD_FordBlaBoxIfCmn_FordVehTrlrAgOffsDirRaw_Val" 0 DISPLAY_IDENTIFIER CDD_FordBlaBoxIfCmn.ReceiverPorts.FordVehTrlrAgOffsDirRaw.Val /end MEASUREMENT
/begin MEASUREMENT CDD_FordBlaBoxIfCmn.FordVehTrlrAidAcqSts.Val "MICROSAR RTE" UBYTE NO_COMPU_METHOD 0 0 0 255 ECU_ADDRESS 0 SYMBOL_LINK "Rte_FordMsg459BusHiSpd_FordVehTrlrAidAcqSts_Val" 0 DISPLAY_IDENTIFIER CDD_FordBlaBoxIfCmn.ReceiverPorts.FordVehTrlrAidAcqSts.Val /end MEASUREMENT
/begin MEASUREMENT CDD_FordBlaBoxIfCmn.FordVehTrlrAidAvlRaw.Val "MICROSAR RTE" UBYTE NO_COMPU_METHOD 0 0 0 255 ECU_ADDRESS 0 SYMBOL_LINK "Rte_FordMsg202BusHiSpd_FordVehTrlrAidAvlRaw_Val" 0 DISPLAY_IDENTIFIER CDD_FordBlaBoxIfCmn.ReceiverPorts.FordVehTrlrAidAvlRaw.Val /end MEASUREMENT
/begin MEASUREMENT CDD_FordBlaBoxIfCmn.FordVehTrlrAidCnclReq.Val "MICROSAR RTE" UBYTE NO_COMPU_METHOD 0 0 0 255 ECU_ADDRESS 0 SYMBOL_LINK "Rte_CDD_FordBlaBoxIfCmn_FordVehTrlrAidCnclReq_Val" 0 DISPLAY_IDENTIFIER CDD_FordBlaBoxIfCmn.ReceiverPorts.FordVehTrlrAidCnclReq.Val /end MEASUREMENT
/begin MEASUREMENT CDD_FordBlaBoxIfCmn.FordVehTrlrAidCnclReqVld.Logl "MICROSAR RTE" UBYTE RTE_CM_BOOLEAN 0 0 0 255 ECU_ADDRESS 0 SYMBOL_LINK "Rte_CDD_FordBlaBoxIfCmn_FordVehTrlrAidCnclReqVld_Logl" 0 DISPLAY_IDENTIFIER CDD_FordBlaBoxIfCmn.ReceiverPorts.FordVehTrlrAidCnclReqVld.Logl /end MEASUREMENT
/begin MEASUREMENT CDD_FordBlaBoxIfCmn.FordVehTrlrAidHitchAg.Val "MICROSAR RTE" UWORD NO_COMPU_METHOD 0 0 0 65535 ECU_ADDRESS 0 SYMBOL_LINK "Rte_FordMsg459BusHiSpd_FordVehTrlrAidHitchAg_Val" 0 DISPLAY_IDENTIFIER CDD_FordBlaBoxIfCmn.ReceiverPorts.FordVehTrlrAidHitchAg.Val /end MEASUREMENT
/begin MEASUREMENT CDD_FordBlaBoxIfCmn.FordVehTrlrAidIdnNrRaw.Val "MICROSAR RTE" UBYTE NO_COMPU_METHOD 0 0 0 255 ECU_ADDRESS 0 SYMBOL_LINK "Rte_CDD_FordBlaBoxIfCmn_FordVehTrlrAidIdnNrRaw_Val" 0 DISPLAY_IDENTIFIER CDD_FordBlaBoxIfCmn.ReceiverPorts.FordVehTrlrAidIdnNrRaw.Val /end MEASUREMENT
/begin MEASUREMENT CDD_FordBlaBoxIfCmn.FordVehTrlrAidIdnVal.Val "MICROSAR RTE" UBYTE NO_COMPU_METHOD 0 0 0 255 ECU_ADDRESS 0 SYMBOL_LINK "Rte_FordMsg459BusHiSpd_FordVehTrlrAidIdnVal_Val" 0 DISPLAY_IDENTIFIER CDD_FordBlaBoxIfCmn.ReceiverPorts.FordVehTrlrAidIdnVal.Val /end MEASUREMENT
/begin MEASUREMENT CDD_FordBlaBoxIfCmn.FordVehTrlrAidKnobBtn.Val "MICROSAR RTE" UBYTE NO_COMPU_METHOD 0 0 0 255 ECU_ADDRESS 0 SYMBOL_LINK "Rte_FordMsg47ABusHiSpd_FordVehTrlrAidKnobBtn_Val" 0 DISPLAY_IDENTIFIER CDD_FordBlaBoxIfCmn.ReceiverPorts.FordVehTrlrAidKnobBtn.Val /end MEASUREMENT
/begin MEASUREMENT CDD_FordBlaBoxIfCmn.FordVehTrlrAidKnobPosn.Val "MICROSAR RTE" UWORD NO_COMPU_METHOD 0 0 0 65535 ECU_ADDRESS 0 SYMBOL_LINK "Rte_FordMsg47ABusHiSpd_FordVehTrlrAidKnobPosn_Val" 0 DISPLAY_IDENTIFIER CDD_FordBlaBoxIfCmn.ReceiverPorts.FordVehTrlrAidKnobPosn.Val /end MEASUREMENT
/begin MEASUREMENT CDD_FordBlaBoxIfCmn.FordVehTrlrAidKnobPosnVld.Logl "MICROSAR RTE" UBYTE RTE_CM_BOOLEAN 0 0 0 255 ECU_ADDRESS 0 SYMBOL_LINK "Rte_CDD_FordBlaBoxIfCmn_FordVehTrlrAidKnobPosnVld_Logl" 0 DISPLAY_IDENTIFIER CDD_FordBlaBoxIfCmn.ReceiverPorts.FordVehTrlrAidKnobPosnVld.Logl /end MEASUREMENT
/begin MEASUREMENT CDD_FordBlaBoxIfCmn.FordVehTrlrAidKnobStsVld.Logl "MICROSAR RTE" UBYTE RTE_CM_BOOLEAN 0 0 0 255 ECU_ADDRESS 0 SYMBOL_LINK "Rte_CDD_FordBlaBoxIfCmn_FordVehTrlrAidKnobStsVld_Logl" 0 DISPLAY_IDENTIFIER CDD_FordBlaBoxIfCmn.ReceiverPorts.FordVehTrlrAidKnobStsVld.Logl /end MEASUREMENT
/begin MEASUREMENT CDD_FordBlaBoxIfCmn.FordVehTrlrAidModReq.Val "MICROSAR RTE" UBYTE NO_COMPU_METHOD 0 0 0 255 ECU_ADDRESS 0 SYMBOL_LINK "Rte_CDD_FordBlaBoxIfCmn_FordVehTrlrAidModReq_Val" 0 DISPLAY_IDENTIFIER CDD_FordBlaBoxIfCmn.ReceiverPorts.FordVehTrlrAidModReq.Val /end MEASUREMENT
/begin MEASUREMENT CDD_FordBlaBoxIfCmn.FordVehTrlrAidModReqVld.Logl "MICROSAR RTE" UBYTE RTE_CM_BOOLEAN 0 0 0 255 ECU_ADDRESS 0 SYMBOL_LINK "Rte_FordMsg215BusHiSpd_FordVehTrlrAidModReqVld_Logl" 0 DISPLAY_IDENTIFIER CDD_FordBlaBoxIfCmn.ReceiverPorts.FordVehTrlrAidModReqVld.Logl /end MEASUREMENT
/begin MEASUREMENT CDD_FordBlaBoxIfCmn.FordVehTrlrAidSetUpRaw.Val "MICROSAR RTE" UBYTE NO_COMPU_METHOD 0 0 0 255 ECU_ADDRESS 0 SYMBOL_LINK "Rte_CDD_FordBlaBoxIfCmn_FordVehTrlrAidSetUpRaw_Val" 0 DISPLAY_IDENTIFIER CDD_FordBlaBoxIfCmn.ReceiverPorts.FordVehTrlrAidSetUpRaw.Val /end MEASUREMENT
/begin MEASUREMENT CDD_FordBlaBoxIfCmn.FordVehTrlrAidTrakgSt.Val "MICROSAR RTE" UBYTE NO_COMPU_METHOD 0 0 0 255 ECU_ADDRESS 0 SYMBOL_LINK "Rte_FordMsg459BusHiSpd_FordVehTrlrAidTrakgSt_Val" 0 DISPLAY_IDENTIFIER CDD_FordBlaBoxIfCmn.ReceiverPorts.FordVehTrlrAidTrakgSt.Val /end MEASUREMENT
/begin MEASUREMENT CDD_FordBlaBoxIfCmn.FordVehTrlrAidTrakgStVld.Logl "MICROSAR RTE" UBYTE RTE_CM_BOOLEAN 0 0 0 255 ECU_ADDRESS 0 SYMBOL_LINK "Rte_FordMsg459BusHiSpd_FordVehTrlrAidTrakgStVld_Logl" 0 DISPLAY_IDENTIFIER CDD_FordBlaBoxIfCmn.ReceiverPorts.FordVehTrlrAidTrakgStVld.Logl /end MEASUREMENT
/begin MEASUREMENT CDD_FordBlaBoxIfCmn.FordVehTrlrAidTrlrRvsGuidcSts.Val "MICROSAR RTE" UBYTE NO_COMPU_METHOD 0 0 0 255 ECU_ADDRESS 0 SYMBOL_LINK "Rte_FordMsg459BusHiSpd_FordVehTrlrAidTrlrRvsGuidcSts_Val" 0 DISPLAY_IDENTIFIER CDD_FordBlaBoxIfCmn.ReceiverPorts.FordVehTrlrAidTrlrRvsGuidcSts.Val /end MEASUREMENT
/begin MEASUREMENT CDD_FordBlaBoxIfCmn.FordVehTrlrAxleToBmpRaw.Val "MICROSAR RTE" UWORD NO_COMPU_METHOD 0 0 0 65535 ECU_ADDRESS 0 SYMBOL_LINK "Rte_CDD_FordBlaBoxIfCmn_FordVehTrlrAxleToBmpRaw_Val" 0 DISPLAY_IDENTIFIER CDD_FordBlaBoxIfCmn.ReceiverPorts.FordVehTrlrAxleToBmpRaw.Val /end MEASUREMENT
/begin MEASUREMENT CDD_FordBlaBoxIfCmn.FordVehTrlrBackupAssiAvlVld.Logl "MICROSAR RTE" UBYTE RTE_CM_BOOLEAN 0 0 0 255 ECU_ADDRESS 0 SYMBOL_LINK "Rte_FordMsg202BusHiSpd_FordVehTrlrBackupAssiAvlVld_Logl" 0 DISPLAY_IDENTIFIER CDD_FordBlaBoxIfCmn.ReceiverPorts.FordVehTrlrBackupAssiAvlVld.Logl /end MEASUREMENT
/begin MEASUREMENT CDD_FordBlaBoxIfCmn.FordVehTrlrBackupAssiMeasVld.Logl "MICROSAR RTE" UBYTE RTE_CM_BOOLEAN 0 0 0 255 ECU_ADDRESS 0 SYMBOL_LINK "Rte_CDD_FordBlaBoxIfCmn_FordVehTrlrBackupAssiMeasVld_Logl" 0 DISPLAY_IDENTIFIER CDD_FordBlaBoxIfCmn.ReceiverPorts.FordVehTrlrBackupAssiMeasVld.Logl /end MEASUREMENT
/begin MEASUREMENT CDD_FordBlaBoxIfCmn.FordVehTrlrBallToAxle.Val "MICROSAR RTE" UBYTE NO_COMPU_METHOD 0 0 0 255 ECU_ADDRESS 0 SYMBOL_LINK "Rte_FordMsg459BusHiSpd_FordVehTrlrBallToAxle_Val" 0 DISPLAY_IDENTIFIER CDD_FordBlaBoxIfCmn.ReceiverPorts.FordVehTrlrBallToAxle.Val /end MEASUREMENT
/begin MEASUREMENT CDD_FordBlaBoxIfCmn.FordVehTrlrBrkCnctnStsRaw.Val "MICROSAR RTE" UBYTE NO_COMPU_METHOD 0 0 0 255 ECU_ADDRESS 0 SYMBOL_LINK "Rte_CDD_FordBlaBoxIfCmn_FordVehTrlrBrkCnctnStsRaw_Val" 0 DISPLAY_IDENTIFIER CDD_FordBlaBoxIfCmn.ReceiverPorts.FordVehTrlrBrkCnctnStsRaw.Val /end MEASUREMENT
/begin MEASUREMENT CDD_FordBlaBoxIfCmn.FordVehTrlrEnaReqRaw.Val "MICROSAR RTE" UBYTE NO_COMPU_METHOD 0 0 0 255 ECU_ADDRESS 0 SYMBOL_LINK "Rte_CDD_FordBlaBoxIfCmn_FordVehTrlrEnaReqRaw_Val" 0 DISPLAY_IDENTIFIER CDD_FordBlaBoxIfCmn.ReceiverPorts.FordVehTrlrEnaReqRaw.Val /end MEASUREMENT
/begin MEASUREMENT CDD_FordBlaBoxIfCmn.FordVehTrlrHitchAgRateRaw.Val "MICROSAR RTE" UWORD NO_COMPU_METHOD 0 0 0 65535 ECU_ADDRESS 0 SYMBOL_LINK "Rte_CDD_FordBlaBoxIfCmn_FordVehTrlrHitchAgRateRaw_Val" 0 DISPLAY_IDENTIFIER CDD_FordBlaBoxIfCmn.ReceiverPorts.FordVehTrlrHitchAgRateRaw.Val /end MEASUREMENT
/begin MEASUREMENT CDD_FordBlaBoxIfCmn.FordVehTrlrHitchAgVld.Logl "MICROSAR RTE" UBYTE RTE_CM_BOOLEAN 0 0 0 255 ECU_ADDRESS 0 SYMBOL_LINK "Rte_FordMsg459BusHiSpd_FordVehTrlrHitchAgVld_Logl" 0 DISPLAY_IDENTIFIER CDD_FordBlaBoxIfCmn.ReceiverPorts.FordVehTrlrHitchAgVld.Logl /end MEASUREMENT
/begin MEASUREMENT CDD_FordBlaBoxIfCmn.FordVehTrlrHitchRateVld.Logl "MICROSAR RTE" UBYTE RTE_CM_BOOLEAN 0 0 0 255 ECU_ADDRESS 0 SYMBOL_LINK "Rte_FordMsg459BusHiSpd_FordVehTrlrHitchRateVld_Logl" 0 DISPLAY_IDENTIFIER CDD_FordBlaBoxIfCmn.ReceiverPorts.FordVehTrlrHitchRateVld.Logl /end MEASUREMENT
/begin MEASUREMENT CDD_FordBlaBoxIfCmn.FordVehTrlrHitchYawAgRaw.Val "MICROSAR RTE" UWORD NO_COMPU_METHOD 0 0 0 65535 ECU_ADDRESS 0 SYMBOL_LINK "Rte_CDD_FordBlaBoxIfCmn_FordVehTrlrHitchYawAgRaw_Val" 0 DISPLAY_IDENTIFIER CDD_FordBlaBoxIfCmn.ReceiverPorts.FordVehTrlrHitchYawAgRaw.Val /end MEASUREMENT
/begin MEASUREMENT CDD_FordBlaBoxIfCmn.FordVehTrlrHitchYawSts.Val "MICROSAR RTE" UBYTE NO_COMPU_METHOD 0 0 0 255 ECU_ADDRESS 0 SYMBOL_LINK "Rte_CDD_FordBlaBoxIfCmn_FordVehTrlrHitchYawSts_Val" 0 DISPLAY_IDENTIFIER CDD_FordBlaBoxIfCmn.ReceiverPorts.FordVehTrlrHitchYawSts.Val /end MEASUREMENT
/begin MEASUREMENT CDD_FordBlaBoxIfCmn.FordVehTrlrIdnTypRaw.Val "MICROSAR RTE" UWORD NO_COMPU_METHOD 0 0 0 65535 ECU_ADDRESS 0 SYMBOL_LINK "Rte_CDD_FordBlaBoxIfCmn_FordVehTrlrIdnTypRaw_Val" 0 DISPLAY_IDENTIFIER CDD_FordBlaBoxIfCmn.ReceiverPorts.FordVehTrlrIdnTypRaw.Val /end MEASUREMENT
/begin MEASUREMENT CDD_FordBlaBoxIfCmn.FordVehTrlrLampCnctnStsRaw.Val "MICROSAR RTE" UBYTE NO_COMPU_METHOD 0 0 0 255 ECU_ADDRESS 0 SYMBOL_LINK "Rte_CDD_FordBlaBoxIfCmn_FordVehTrlrLampCnctnStsRaw_Val" 0 DISPLAY_IDENTIFIER CDD_FordBlaBoxIfCmn.ReceiverPorts.FordVehTrlrLampCnctnStsRaw.Val /end MEASUREMENT
/begin MEASUREMENT CDD_FordBlaBoxIfCmn.FordVehTrlrRvsCnclReqRaw.Val "MICROSAR RTE" UBYTE NO_COMPU_METHOD 0 0 0 255 ECU_ADDRESS 0 SYMBOL_LINK "Rte_CDD_FordBlaBoxIfCmn_FordVehTrlrRvsCnclReqRaw_Val" 0 DISPLAY_IDENTIFIER CDD_FordBlaBoxIfCmn.ReceiverPorts.FordVehTrlrRvsCnclReqRaw.Val /end MEASUREMENT
/begin MEASUREMENT CDD_FordBlaBoxIfCmn.FordVehTrlrRvsEnaRaw.Val "MICROSAR RTE" UBYTE NO_COMPU_METHOD 0 0 0 255 ECU_ADDRESS 0 SYMBOL_LINK "Rte_CDD_FordBlaBoxIfCmn_FordVehTrlrRvsEnaRaw_Val" 0 DISPLAY_IDENTIFIER CDD_FordBlaBoxIfCmn.ReceiverPorts.FordVehTrlrRvsEnaRaw.Val /end MEASUREMENT
/begin MEASUREMENT CDD_FordBlaBoxIfCmn.FordVehTrlrRvsMsgTxtReqRaw.Val "MICROSAR RTE" UBYTE NO_COMPU_METHOD 0 0 0 255 ECU_ADDRESS 0 SYMBOL_LINK "Rte_CDD_FordBlaBoxIfCmn_FordVehTrlrRvsMsgTxtReqRaw_Val" 0 DISPLAY_IDENTIFIER CDD_FordBlaBoxIfCmn.ReceiverPorts.FordVehTrlrRvsMsgTxtReqRaw.Val /end MEASUREMENT
/begin MEASUREMENT CDD_FordBlaBoxIfCmn.FordVehTrlrTarVld.Logl "MICROSAR RTE" UBYTE RTE_CM_BOOLEAN 0 0 0 255 ECU_ADDRESS 0 SYMBOL_LINK "Rte_FordMsg459BusHiSpd_FordVehTrlrTarVld_Logl" 0 DISPLAY_IDENTIFIER CDD_FordBlaBoxIfCmn.ReceiverPorts.FordVehTrlrTarVld.Logl /end MEASUREMENT
/begin MEASUREMENT CDD_FordBlaBoxIfCmn.FordVehTrlrYawRateQlyFac.Val "MICROSAR RTE" UBYTE NO_COMPU_METHOD 0 0 0 255 ECU_ADDRESS 0 SYMBOL_LINK "Rte_CDD_FordBlaBoxIfCmn_FordVehTrlrYawRateQlyFac_Val" 0 DISPLAY_IDENTIFIER CDD_FordBlaBoxIfCmn.ReceiverPorts.FordVehTrlrYawRateQlyFac.Val /end MEASUREMENT
/begin MEASUREMENT CDD_FordBlaBoxIfCmn.FordVehTrlrYawRateRaw.Val "MICROSAR RTE" UWORD NO_COMPU_METHOD 0 0 0 65535 ECU_ADDRESS 0 SYMBOL_LINK "Rte_CDD_FordBlaBoxIfCmn_FordVehTrlrYawRateRaw_Val" 0 DISPLAY_IDENTIFIER CDD_FordBlaBoxIfCmn.ReceiverPorts.FordVehTrlrYawRateRaw.Val /end MEASUREMENT
/begin MEASUREMENT CDD_FordBlaBoxIfCmn.FordVehTrsmDesGearRaw.Val "MICROSAR RTE" UBYTE NO_COMPU_METHOD 0 0 0 255 ECU_ADDRESS 0 SYMBOL_LINK "Rte_CDD_FordBlaBoxIfCmn_FordVehTrsmDesGearRaw_Val" 0 DISPLAY_IDENTIFIER CDD_FordBlaBoxIfCmn.ReceiverPorts.FordVehTrsmDesGearRaw.Val /end MEASUREMENT
/begin MEASUREMENT CDD_FordBlaBoxIfCmn.FordVehTurnSigSwtStsRaw.Val "MICROSAR RTE" UBYTE NO_COMPU_METHOD 0 0 0 255 ECU_ADDRESS 0 SYMBOL_LINK "Rte_FordMsg083BusHiSpd_FordVehTurnSigSwtStsRaw_Val" 0 DISPLAY_IDENTIFIER CDD_FordBlaBoxIfCmn.ReceiverPorts.FordVehTurnSigSwtStsRaw.Val /end MEASUREMENT
/begin MEASUREMENT CDD_FordBlaBoxIfCmn.FordVehTurnSigVld.Logl "MICROSAR RTE" UBYTE RTE_CM_BOOLEAN 0 0 0 255 ECU_ADDRESS 0 SYMBOL_LINK "Rte_FordMsg083BusHiSpd_FordVehTurnSigVld_Logl" 0 DISPLAY_IDENTIFIER CDD_FordBlaBoxIfCmn.ReceiverPorts.FordVehTurnSigVld.Logl /end MEASUREMENT
/begin MEASUREMENT CDD_FordBlaBoxIfCmn.FordVehVertACmpdRaw.Val "MICROSAR RTE" UWORD NO_COMPU_METHOD 0 0 0 65535 ECU_ADDRESS 0 SYMBOL_LINK "Rte_FordMsg07DBusHiSpd_FordVehVertACmpdRaw_Val" 0 DISPLAY_IDENTIFIER CDD_FordBlaBoxIfCmn.ReceiverPorts.FordVehVertACmpdRaw.Val /end MEASUREMENT
/begin GROUP BattVltgCorrln.dBattVltgCorrlnNtc0x03CQlfrSts "MICROSAR RTE" /begin SUB_GROUP /end SUB_GROUP /begin FUNCTION_LIST /end FUNCTION_LIST /begin REF_CHARACTERISTIC /end REF_CHARACTERISTIC /begin REF_MEASUREMENT BattVltgCorrln.dBattVltgCorrlnNtc0x03CQlfrSts /end REF_MEASUREMENT /end GROUP
/begin GROUP BattVltgCorrln.dBattVltgCorrlnNtc0x044QlfrSts "MICROSAR RTE" /begin SUB_GROUP /end SUB_GROUP /begin FUNCTION_LIST /end FUNCTION_LIST /begin REF_CHARACTERISTIC /end REF_CHARACTERISTIC /begin REF_MEASUREMENT BattVltgCorrln.dBattVltgCorrlnNtc0x044QlfrSts /end REF_MEASUREMENT /end GROUP
/begin GROUP BswM "MICROSAR RTE" /begin SUB_GROUP BswM.ModeRequirePorts /end SUB_GROUP /begin FUNCTION_LIST /end FUNCTION_LIST /begin REF_CHARACTERISTIC /end REF_CHARACTERISTIC /begin REF_MEASUREMENT /end REF_MEASUREMENT /end GROUP
/begin GROUP BswM.ModeRequirePorts "MICROSAR RTE"
 /begin SUB_GROUP BswM.Notification_SwcModeNotification_BswM_MDGP_BswMEcuResetMod.BswM_MDGP_BswMEcuResetMod /end SUB_GROUP
 /begin FUNCTION_LIST /end FUNCTION_LIST
 /begin REF_CHARACTERISTIC /end REF_CHARACTERISTIC
 /begin REF_MEASUREMENT /end REF_MEASUREMENT
/end GROUP
/begin GROUP BswM.Notification_SwcModeNotification_BswM_MDGP_BswMEcuResetMod.BswM_MDGP_BswMEcuResetMod "MICROSAR RTE" /begin SUB_GROUP /end SUB_GROUP /begin FUNCTION_LIST /end FUNCTION_LIST /begin REF_CHARACTERISTIC /end REF_CHARACTERISTIC
 /begin REF_MEASUREMENT BswM.Notification_SwcModeNotification_BswM_MDGP_BswMEcuResetMod.BswM_MDGP_BswMEcuResetMod /end REF_MEASUREMENT
/end GROUP
/begin GROUP CDD_Adcf0CfgAndUse "MICROSAR RTE" /begin SUB_GROUP CDD_Adcf0CfgAndUse.PerInstanceMemories /end SUB_GROUP /begin FUNCTION_LIST /end FUNCTION_LIST /begin REF_CHARACTERISTIC /end REF_CHARACTERISTIC /begin REF_MEASUREMENT /end REF_MEASUREMENT /end GROUP
/begin GROUP CDD_Adcf0CfgAndUse.Adcf0DiagcEndPtr "MICROSAR RTE" /begin SUB_GROUP /end SUB_GROUP /begin FUNCTION_LIST /end FUNCTION_LIST /begin REF_CHARACTERISTIC /end REF_CHARACTERISTIC /begin REF_MEASUREMENT CDD_Adcf0CfgAndUse.Adcf0DiagcEndPtr /end REF_MEASUREMENT /end GROUP
/begin GROUP CDD_Adcf0CfgAndUse.Adcf0DiagcStrtPtr "MICROSAR RTE" /begin SUB_GROUP /end SUB_GROUP /begin FUNCTION_LIST /end FUNCTION_LIST /begin REF_CHARACTERISTIC /end REF_CHARACTERISTIC /begin REF_MEASUREMENT CDD_Adcf0CfgAndUse.Adcf0DiagcStrtPtr /end REF_MEASUREMENT /end GROUP
/begin GROUP CDD_Adcf0CfgAndUse.PerInstanceMemories "MICROSAR RTE"
 /begin SUB_GROUP CDD_Adcf0CfgAndUse.Adcf0DiagcEndPtr CDD_Adcf0CfgAndUse.Adcf0DiagcStrtPtr /end SUB_GROUP
 /begin FUNCTION_LIST /end FUNCTION_LIST
 /begin REF_CHARACTERISTIC /end REF_CHARACTERISTIC
 /begin REF_MEASUREMENT /end REF_MEASUREMENT
/end GROUP
/begin GROUP CDD_CoreVltgMonr "MICROSAR RTE" /begin SUB_GROUP CDD_CoreVltgMonr.PerInstanceMemories /end SUB_GROUP /begin FUNCTION_LIST /end FUNCTION_LIST /begin REF_CHARACTERISTIC /end REF_CHARACTERISTIC /begin REF_MEASUREMENT /end REF_MEASUREMENT /end GROUP
/begin GROUP CDD_CoreVltgMonr.CoreVltgMonrStrtUpFltPrmByte "MICROSAR RTE" /begin SUB_GROUP /end SUB_GROUP /begin FUNCTION_LIST /end FUNCTION_LIST /begin REF_CHARACTERISTIC /end REF_CHARACTERISTIC /begin REF_MEASUREMENT CDD_CoreVltgMonr.CoreVltgMonrStrtUpFltPrmByte /end REF_MEASUREMENT /end GROUP
/begin GROUP CDD_CoreVltgMonr.PerInstanceMemories "MICROSAR RTE"
 /begin SUB_GROUP CDD_CoreVltgMonr.CoreVltgMonrStrtUpFltPrmByte CDD_CoreVltgMonr.dCoreVltgMonrStrtUpTestCmpl /end SUB_GROUP
 /begin FUNCTION_LIST /end FUNCTION_LIST
 /begin REF_CHARACTERISTIC /end REF_CHARACTERISTIC
 /begin REF_MEASUREMENT /end REF_MEASUREMENT
/end GROUP
/begin GROUP CDD_CoreVltgMonr.dCoreVltgMonrStrtUpTestCmpl "MICROSAR RTE" /begin SUB_GROUP /end SUB_GROUP /begin FUNCTION_LIST /end FUNCTION_LIST /begin REF_CHARACTERISTIC /end REF_CHARACTERISTIC /begin REF_MEASUREMENT CDD_CoreVltgMonr.dCoreVltgMonrStrtUpTestCmpl /end REF_MEASUREMENT /end GROUP
/begin GROUP CDD_CurrMeas "MICROSAR RTE"
 /begin SUB_GROUP CDD_CurrMeas.CalibrationParameters CDD_CurrMeas.CalibrationPorts CDD_CurrMeas.PerInstanceMemories CDD_CurrMeas.ReceiverPorts CDD_CurrMeas.SenderPorts /end SUB_GROUP
 /begin FUNCTION_LIST /end FUNCTION_LIST
 /begin REF_CHARACTERISTIC /end REF_CHARACTERISTIC
 /begin REF_MEASUREMENT /end REF_MEASUREMENT
/end GROUP
/begin GROUP CDD_CurrMeas.BrdgVltg.Val "MICROSAR RTE" /begin SUB_GROUP /end SUB_GROUP /begin FUNCTION_LIST /end FUNCTION_LIST /begin REF_CHARACTERISTIC /end REF_CHARACTERISTIC /begin REF_MEASUREMENT CDD_CurrMeas.BrdgVltg.Val /end REF_MEASUREMENT /end GROUP
/begin GROUP CDD_CurrMeas.BrdgVltgSumPrev "MICROSAR RTE" /begin SUB_GROUP /end SUB_GROUP /begin FUNCTION_LIST /end FUNCTION_LIST /begin REF_CHARACTERISTIC /end REF_CHARACTERISTIC /begin REF_MEASUREMENT CDD_CurrMeas.BrdgVltgSumPrev /end REF_MEASUREMENT /end GROUP
/begin GROUP CDD_CurrMeas.CalibrationParameters "MICROSAR RTE"
 /begin SUB_GROUP CDD_CurrMeas.CurrMeasEolGainCalSetABCDft CDD_CurrMeas.CurrMeasEolOffsCalSetABCDft /end SUB_GROUP
 /begin FUNCTION_LIST /end FUNCTION_LIST
 /begin REF_CHARACTERISTIC /end REF_CHARACTERISTIC
 /begin REF_MEASUREMENT /end REF_MEASUREMENT
/end GROUP
/begin GROUP CDD_CurrMeas.CalibrationPorts "MICROSAR RTE"
 /begin SUB_GROUP CDD_CurrMeas.CurrMeasEolFixdPwmPerd.Val CDD_CurrMeas.CurrMeasEolGainMax.Val CDD_CurrMeas.CurrMeasEolGainMin.Val CDD_CurrMeas.CurrMeasEolGainNom.Val CDD_CurrMeas.CurrMeasEolGainNrOfSample.Val CDD_CurrMeas.CurrMeasEolGainNumer.Val CDD_CurrMeas.CurrMeasEolMaxMotVel.Val CDD_CurrMeas.CurrMeasEolOffsHiBrdgVltgMin.Val CDD_CurrMeas.CurrMeasEolOffsHiCmuOffs.Val CDD_CurrMeas.CurrMeasEolOffsLoCmuOffs.Val CDD_CurrMeas.CurrMeasEolOffsMax.Val CDD_CurrMeas.CurrMeasEolOffsMin.Val CDD_CurrMeas.CurrMeasEolOffsNom.Val CDD_CurrMeas.CurrMeasEolOffsNrOfSample.Val CDD_CurrMeas.CurrMeasEolTranCntrThd.Val CDD_CurrMeas.CurrMeasMinRqrdPhaOnTi.Val CDD_CurrMeas.CurrMeasMotAgCompuDly.Val CDD_CurrMeas.CurrMeasMotCurrAdcVlyWrmIninMax.Val CDD_CurrMeas.CurrMeasMotCurrAdcVlyWrmIninMin.Val CDD_CurrMeas.CurrMeasNtc0x05DFailStep.Val CDD_CurrMeas.CurrMeasNtc0x05DPassStep.Val CDD_CurrMeas.SysGlbPrmMotPoleCnt.Val /end SUB_GROUP
 /begin FUNCTION_LIST /end FUNCTION_LIST
 /begin REF_CHARACTERISTIC /end REF_CHARACTERISTIC
 /begin REF_MEASUREMENT /end REF_MEASUREMENT
/end GROUP
/begin GROUP CDD_CurrMeas.CurrMeasEolFixdPwmPerd.Val "MICROSAR RTE" /begin SUB_GROUP /end SUB_GROUP /begin FUNCTION_LIST /end FUNCTION_LIST /begin REF_CHARACTERISTIC CDD_CurrMeas.CurrMeasEolFixdPwmPerd.Val /end REF_CHARACTERISTIC /begin REF_MEASUREMENT /end REF_MEASUREMENT /end GROUP
/begin GROUP CDD_CurrMeas.CurrMeasEolGainCalSetABC "MICROSAR RTE" /begin SUB_GROUP /end SUB_GROUP /begin FUNCTION_LIST /end FUNCTION_LIST /begin REF_CHARACTERISTIC /end REF_CHARACTERISTIC
 /begin REF_MEASUREMENT CDD_CurrMeas.CurrMeasEolGainCalSetABC.CurrMeasMotCurrEolGainA CDD_CurrMeas.CurrMeasEolGainCalSetABC.CurrMeasMotCurrEolGainB CDD_CurrMeas.CurrMeasEolGainCalSetABC.CurrMeasMotCurrEolGainC /end REF_MEASUREMENT
/end GROUP
/begin GROUP CDD_CurrMeas.CurrMeasEolGainCalSetABCDft "MICROSAR RTE" /begin SUB_GROUP /end SUB_GROUP /begin FUNCTION_LIST /end FUNCTION_LIST
 /begin REF_CHARACTERISTIC CDD_CurrMeas.CurrMeasEolGainCalSetABCDft.CurrMeasMotCurrEolGainA CDD_CurrMeas.CurrMeasEolGainCalSetABCDft.CurrMeasMotCurrEolGainB CDD_CurrMeas.CurrMeasEolGainCalSetABCDft.CurrMeasMotCurrEolGainC /end REF_CHARACTERISTIC
 /begin REF_MEASUREMENT /end REF_MEASUREMENT
/end GROUP
/begin GROUP CDD_CurrMeas.CurrMeasEolGainMax.Val "MICROSAR RTE" /begin SUB_GROUP /end SUB_GROUP /begin FUNCTION_LIST /end FUNCTION_LIST /begin REF_CHARACTERISTIC CDD_CurrMeas.CurrMeasEolGainMax.Val /end REF_CHARACTERISTIC /begin REF_MEASUREMENT /end REF_MEASUREMENT /end GROUP
/begin GROUP CDD_CurrMeas.CurrMeasEolGainMin.Val "MICROSAR RTE" /begin SUB_GROUP /end SUB_GROUP /begin FUNCTION_LIST /end FUNCTION_LIST /begin REF_CHARACTERISTIC CDD_CurrMeas.CurrMeasEolGainMin.Val /end REF_CHARACTERISTIC /begin REF_MEASUREMENT /end REF_MEASUREMENT /end GROUP
/begin GROUP CDD_CurrMeas.CurrMeasEolGainNom.Val "MICROSAR RTE" /begin SUB_GROUP /end SUB_GROUP /begin FUNCTION_LIST /end FUNCTION_LIST /begin REF_CHARACTERISTIC CDD_CurrMeas.CurrMeasEolGainNom.Val /end REF_CHARACTERISTIC /begin REF_MEASUREMENT /end REF_MEASUREMENT /end GROUP
/begin GROUP CDD_CurrMeas.CurrMeasEolGainNrOfSample.Val "MICROSAR RTE" /begin SUB_GROUP /end SUB_GROUP /begin FUNCTION_LIST /end FUNCTION_LIST /begin REF_CHARACTERISTIC CDD_CurrMeas.CurrMeasEolGainNrOfSample.Val /end REF_CHARACTERISTIC /begin REF_MEASUREMENT /end REF_MEASUREMENT /end GROUP
/begin GROUP CDD_CurrMeas.CurrMeasEolGainNumer.Val "MICROSAR RTE" /begin SUB_GROUP /end SUB_GROUP /begin FUNCTION_LIST /end FUNCTION_LIST /begin REF_CHARACTERISTIC CDD_CurrMeas.CurrMeasEolGainNumer.Val /end REF_CHARACTERISTIC /begin REF_MEASUREMENT /end REF_MEASUREMENT /end GROUP
/begin GROUP CDD_CurrMeas.CurrMeasEolMaxMotVel.Val "MICROSAR RTE" /begin SUB_GROUP /end SUB_GROUP /begin FUNCTION_LIST /end FUNCTION_LIST /begin REF_CHARACTERISTIC CDD_CurrMeas.CurrMeasEolMaxMotVel.Val /end REF_CHARACTERISTIC /begin REF_MEASUREMENT /end REF_MEASUREMENT /end GROUP
/begin GROUP CDD_CurrMeas.CurrMeasEolOffsCalSetABC "MICROSAR RTE" /begin SUB_GROUP /end SUB_GROUP /begin FUNCTION_LIST /end FUNCTION_LIST /begin REF_CHARACTERISTIC /end REF_CHARACTERISTIC
 /begin REF_MEASUREMENT CDD_CurrMeas.CurrMeasEolOffsCalSetABC.CurrMeasEolOffsHiBrdgVltg CDD_CurrMeas.CurrMeasEolOffsCalSetABC.CurrMeasMotCurrEolOffsDifA CDD_CurrMeas.CurrMeasEolOffsCalSetABC.CurrMeasMotCurrEolOffsDifB CDD_CurrMeas.CurrMeasEolOffsCalSetABC.CurrMeasMotCurrEolOffsDifC CDD_CurrMeas.CurrMeasEolOffsCalSetABC.CurrMeasMotCurrOffsLoAvrgA CDD_CurrMeas.CurrMeasEolOffsCalSetABC.CurrMeasMotCurrOffsLoAvrgB CDD_CurrMeas.CurrMeasEolOffsCalSetABC.CurrMeasMotCurrOffsLoAvrgC /end REF_MEASUREMENT
/end GROUP
/begin GROUP CDD_CurrMeas.CurrMeasEolOffsCalSetABCDft "MICROSAR RTE" /begin SUB_GROUP /end SUB_GROUP /begin FUNCTION_LIST /end FUNCTION_LIST
 /begin REF_CHARACTERISTIC CDD_CurrMeas.CurrMeasEolOffsCalSetABCDft.CurrMeasEolOffsHiBrdgVltg CDD_CurrMeas.CurrMeasEolOffsCalSetABCDft.CurrMeasMotCurrEolOffsDifA CDD_CurrMeas.CurrMeasEolOffsCalSetABCDft.CurrMeasMotCurrEolOffsDifB CDD_CurrMeas.CurrMeasEolOffsCalSetABCDft.CurrMeasMotCurrEolOffsDifC CDD_CurrMeas.CurrMeasEolOffsCalSetABCDft.CurrMeasMotCurrOffsLoAvrgA CDD_CurrMeas.CurrMeasEolOffsCalSetABCDft.CurrMeasMotCurrOffsLoAvrgB CDD_CurrMeas.CurrMeasEolOffsCalSetABCDft.CurrMeasMotCurrOffsLoAvrgC /end REF_CHARACTERISTIC
 /begin REF_MEASUREMENT /end REF_MEASUREMENT
/end GROUP
/begin GROUP CDD_CurrMeas.CurrMeasEolOffsHiBrdgVltgMin.Val "MICROSAR RTE" /begin SUB_GROUP /end SUB_GROUP /begin FUNCTION_LIST /end FUNCTION_LIST /begin REF_CHARACTERISTIC CDD_CurrMeas.CurrMeasEolOffsHiBrdgVltgMin.Val /end REF_CHARACTERISTIC /begin REF_MEASUREMENT /end REF_MEASUREMENT /end GROUP
/begin GROUP CDD_CurrMeas.CurrMeasEolOffsHiCmuOffs.Val "MICROSAR RTE" /begin SUB_GROUP /end SUB_GROUP /begin FUNCTION_LIST /end FUNCTION_LIST /begin REF_CHARACTERISTIC CDD_CurrMeas.CurrMeasEolOffsHiCmuOffs.Val /end REF_CHARACTERISTIC /begin REF_MEASUREMENT /end REF_MEASUREMENT /end GROUP
/begin GROUP CDD_CurrMeas.CurrMeasEolOffsLoCmuOffs.Val "MICROSAR RTE" /begin SUB_GROUP /end SUB_GROUP /begin FUNCTION_LIST /end FUNCTION_LIST /begin REF_CHARACTERISTIC CDD_CurrMeas.CurrMeasEolOffsLoCmuOffs.Val /end REF_CHARACTERISTIC /begin REF_MEASUREMENT /end REF_MEASUREMENT /end GROUP
/begin GROUP CDD_CurrMeas.CurrMeasEolOffsMax.Val "MICROSAR RTE" /begin SUB_GROUP /end SUB_GROUP /begin FUNCTION_LIST /end FUNCTION_LIST /begin REF_CHARACTERISTIC CDD_CurrMeas.CurrMeasEolOffsMax.Val /end REF_CHARACTERISTIC /begin REF_MEASUREMENT /end REF_MEASUREMENT /end GROUP
/begin GROUP CDD_CurrMeas.CurrMeasEolOffsMin.Val "MICROSAR RTE" /begin SUB_GROUP /end SUB_GROUP /begin FUNCTION_LIST /end FUNCTION_LIST /begin REF_CHARACTERISTIC CDD_CurrMeas.CurrMeasEolOffsMin.Val /end REF_CHARACTERISTIC /begin REF_MEASUREMENT /end REF_MEASUREMENT /end GROUP
/begin GROUP CDD_CurrMeas.CurrMeasEolOffsNom.Val "MICROSAR RTE" /begin SUB_GROUP /end SUB_GROUP /begin FUNCTION_LIST /end FUNCTION_LIST /begin REF_CHARACTERISTIC CDD_CurrMeas.CurrMeasEolOffsNom.Val /end REF_CHARACTERISTIC /begin REF_MEASUREMENT /end REF_MEASUREMENT /end GROUP
/begin GROUP CDD_CurrMeas.CurrMeasEolOffsNrOfSample.Val "MICROSAR RTE" /begin SUB_GROUP /end SUB_GROUP /begin FUNCTION_LIST /end FUNCTION_LIST /begin REF_CHARACTERISTIC CDD_CurrMeas.CurrMeasEolOffsNrOfSample.Val /end REF_CHARACTERISTIC /begin REF_MEASUREMENT /end REF_MEASUREMENT /end GROUP
/begin GROUP CDD_CurrMeas.CurrMeasEolTranCntrThd.Val "MICROSAR RTE" /begin SUB_GROUP /end SUB_GROUP /begin FUNCTION_LIST /end FUNCTION_LIST /begin REF_CHARACTERISTIC CDD_CurrMeas.CurrMeasEolTranCntrThd.Val /end REF_CHARACTERISTIC /begin REF_MEASUREMENT /end REF_MEASUREMENT /end GROUP
/begin GROUP CDD_CurrMeas.CurrMeasMinRqrdPhaOnTi.Val "MICROSAR RTE" /begin SUB_GROUP /end SUB_GROUP /begin FUNCTION_LIST /end FUNCTION_LIST /begin REF_CHARACTERISTIC CDD_CurrMeas.CurrMeasMinRqrdPhaOnTi.Val /end REF_CHARACTERISTIC /begin REF_MEASUREMENT /end REF_MEASUREMENT /end GROUP
/begin GROUP CDD_CurrMeas.CurrMeasMotAgCompuDly.Val "MICROSAR RTE" /begin SUB_GROUP /end SUB_GROUP /begin FUNCTION_LIST /end FUNCTION_LIST /begin REF_CHARACTERISTIC CDD_CurrMeas.CurrMeasMotAgCompuDly.Val /end REF_CHARACTERISTIC /begin REF_MEASUREMENT /end REF_MEASUREMENT /end GROUP
/begin GROUP CDD_CurrMeas.CurrMeasMotCurrAdcVlyWrmIninMax.Val "MICROSAR RTE" /begin SUB_GROUP /end SUB_GROUP /begin FUNCTION_LIST /end FUNCTION_LIST /begin REF_CHARACTERISTIC CDD_CurrMeas.CurrMeasMotCurrAdcVlyWrmIninMax.Val /end REF_CHARACTERISTIC /begin REF_MEASUREMENT /end REF_MEASUREMENT /end GROUP
/begin GROUP CDD_CurrMeas.CurrMeasMotCurrAdcVlyWrmIninMin.Val "MICROSAR RTE" /begin SUB_GROUP /end SUB_GROUP /begin FUNCTION_LIST /end FUNCTION_LIST /begin REF_CHARACTERISTIC CDD_CurrMeas.CurrMeasMotCurrAdcVlyWrmIninMin.Val /end REF_CHARACTERISTIC /begin REF_MEASUREMENT /end REF_MEASUREMENT /end GROUP
/begin GROUP CDD_CurrMeas.CurrMeasNtc0x05DFailStep.Val "MICROSAR RTE" /begin SUB_GROUP /end SUB_GROUP /begin FUNCTION_LIST /end FUNCTION_LIST /begin REF_CHARACTERISTIC CDD_CurrMeas.CurrMeasNtc0x05DFailStep.Val /end REF_CHARACTERISTIC /begin REF_MEASUREMENT /end REF_MEASUREMENT /end GROUP
/begin GROUP CDD_CurrMeas.CurrMeasNtc0x05DPassStep.Val "MICROSAR RTE" /begin SUB_GROUP /end SUB_GROUP /begin FUNCTION_LIST /end FUNCTION_LIST /begin REF_CHARACTERISTIC CDD_CurrMeas.CurrMeasNtc0x05DPassStep.Val /end REF_CHARACTERISTIC /begin REF_MEASUREMENT /end REF_MEASUREMENT /end GROUP
/begin GROUP CDD_CurrMeas.CurrMeasWrmIninTestCmpl.Logl "MICROSAR RTE" /begin SUB_GROUP /end SUB_GROUP /begin FUNCTION_LIST /end FUNCTION_LIST /begin REF_CHARACTERISTIC /end REF_CHARACTERISTIC /begin REF_MEASUREMENT CDD_CurrMeas.CurrMeasWrmIninTestCmpl.Logl /end REF_MEASUREMENT /end GROUP
/begin GROUP CDD_CurrMeas.DiagcStsIvtr1Inactv.Logl "MICROSAR RTE" /begin SUB_GROUP /end SUB_GROUP /begin FUNCTION_LIST /end FUNCTION_LIST /begin REF_CHARACTERISTIC /end REF_CHARACTERISTIC /begin REF_MEASUREMENT CDD_CurrMeas.DiagcStsIvtr1Inactv.Logl /end REF_MEASUREMENT /end GROUP
/begin GROUP CDD_CurrMeas.EolGainSts "MICROSAR RTE" /begin SUB_GROUP /end SUB_GROUP /begin FUNCTION_LIST /end FUNCTION_LIST /begin REF_CHARACTERISTIC /end REF_CHARACTERISTIC /begin REF_MEASUREMENT CDD_CurrMeas.EolGainSts /end REF_MEASUREMENT /end GROUP
/begin GROUP CDD_CurrMeas.EolGainTranCntrPrev "MICROSAR RTE" /begin SUB_GROUP /end SUB_GROUP /begin FUNCTION_LIST /end FUNCTION_LIST /begin REF_CHARACTERISTIC /end REF_CHARACTERISTIC /begin REF_MEASUREMENT CDD_CurrMeas.EolGainTranCntrPrev /end REF_MEASUREMENT /end GROUP
/begin GROUP CDD_CurrMeas.EolOffsHiBrdgVltg "MICROSAR RTE" /begin SUB_GROUP /end SUB_GROUP /begin FUNCTION_LIST /end FUNCTION_LIST /begin REF_CHARACTERISTIC /end REF_CHARACTERISTIC /begin REF_MEASUREMENT CDD_CurrMeas.EolOffsHiBrdgVltg /end REF_MEASUREMENT /end GROUP
/begin GROUP CDD_CurrMeas.EolOffsSts "MICROSAR RTE" /begin SUB_GROUP /end SUB_GROUP /begin FUNCTION_LIST /end FUNCTION_LIST /begin REF_CHARACTERISTIC /end REF_CHARACTERISTIC /begin REF_MEASUREMENT CDD_CurrMeas.EolOffsSts /end REF_MEASUREMENT /end GROUP
/begin GROUP CDD_CurrMeas.EolOffsTranCntrPrev "MICROSAR RTE" /begin SUB_GROUP /end SUB_GROUP /begin FUNCTION_LIST /end FUNCTION_LIST /begin REF_CHARACTERISTIC /end REF_CHARACTERISTIC /begin REF_MEASUREMENT CDD_CurrMeas.EolOffsTranCntrPrev /end REF_MEASUREMENT /end GROUP
/begin GROUP CDD_CurrMeas.GainEolAvrgCntrPrev "MICROSAR RTE" /begin SUB_GROUP /end SUB_GROUP /begin FUNCTION_LIST /end FUNCTION_LIST /begin REF_CHARACTERISTIC /end REF_CHARACTERISTIC /begin REF_MEASUREMENT CDD_CurrMeas.GainEolAvrgCntrPrev /end REF_MEASUREMENT /end GROUP
/begin GROUP CDD_CurrMeas.MotCtrlNtc5DErrCntPrev "MICROSAR RTE" /begin SUB_GROUP /end SUB_GROUP /begin FUNCTION_LIST /end FUNCTION_LIST /begin REF_CHARACTERISTIC /end REF_CHARACTERISTIC /begin REF_MEASUREMENT CDD_CurrMeas.MotCtrlNtc5DErrCntPrev /end REF_MEASUREMENT /end GROUP
/begin GROUP CDD_CurrMeas.MotCurrAdcVlyA.Val "MICROSAR RTE" /begin SUB_GROUP /end SUB_GROUP /begin FUNCTION_LIST /end FUNCTION_LIST /begin REF_CHARACTERISTIC /end REF_CHARACTERISTIC /begin REF_MEASUREMENT CDD_CurrMeas.MotCurrAdcVlyA.Val /end REF_MEASUREMENT /end GROUP
/begin GROUP CDD_CurrMeas.MotCurrAdcVlyB.Val "MICROSAR RTE" /begin SUB_GROUP /end SUB_GROUP /begin FUNCTION_LIST /end FUNCTION_LIST /begin REF_CHARACTERISTIC /end REF_CHARACTERISTIC /begin REF_MEASUREMENT CDD_CurrMeas.MotCurrAdcVlyB.Val /end REF_MEASUREMENT /end GROUP
/begin GROUP CDD_CurrMeas.MotCurrAdcVlyC.Val "MICROSAR RTE" /begin SUB_GROUP /end SUB_GROUP /begin FUNCTION_LIST /end FUNCTION_LIST /begin REF_CHARACTERISTIC /end REF_CHARACTERISTIC /begin REF_MEASUREMENT CDD_CurrMeas.MotCurrAdcVlyC.Val /end REF_MEASUREMENT /end GROUP
/begin GROUP CDD_CurrMeas.MotCurrEolCalSt.Val "MICROSAR RTE" /begin SUB_GROUP /end SUB_GROUP /begin FUNCTION_LIST /end FUNCTION_LIST /begin REF_CHARACTERISTIC /end REF_CHARACTERISTIC /begin REF_MEASUREMENT CDD_CurrMeas.MotCurrEolCalSt.Val /end REF_MEASUREMENT /end GROUP
/begin GROUP CDD_CurrMeas.MotCurrEolCalStPrev "MICROSAR RTE" /begin SUB_GROUP /end SUB_GROUP /begin FUNCTION_LIST /end FUNCTION_LIST /begin REF_CHARACTERISTIC /end REF_CHARACTERISTIC /begin REF_MEASUREMENT CDD_CurrMeas.MotCurrEolCalStPrev /end REF_MEASUREMENT /end GROUP
/begin GROUP CDD_CurrMeas.MotCurrEolGainA "MICROSAR RTE" /begin SUB_GROUP /end SUB_GROUP /begin FUNCTION_LIST /end FUNCTION_LIST /begin REF_CHARACTERISTIC /end REF_CHARACTERISTIC /begin REF_MEASUREMENT CDD_CurrMeas.MotCurrEolGainA /end REF_MEASUREMENT /end GROUP
/begin GROUP CDD_CurrMeas.MotCurrEolGainB "MICROSAR RTE" /begin SUB_GROUP /end SUB_GROUP /begin FUNCTION_LIST /end FUNCTION_LIST /begin REF_CHARACTERISTIC /end REF_CHARACTERISTIC /begin REF_MEASUREMENT CDD_CurrMeas.MotCurrEolGainB /end REF_MEASUREMENT /end GROUP
/begin GROUP CDD_CurrMeas.MotCurrEolGainC "MICROSAR RTE" /begin SUB_GROUP /end SUB_GROUP /begin FUNCTION_LIST /end FUNCTION_LIST /begin REF_CHARACTERISTIC /end REF_CHARACTERISTIC /begin REF_MEASUREMENT CDD_CurrMeas.MotCurrEolGainC /end REF_MEASUREMENT /end GROUP
/begin GROUP CDD_CurrMeas.MotCurrEolOffsProcFlg "MICROSAR RTE" /begin SUB_GROUP /end SUB_GROUP /begin FUNCTION_LIST /end FUNCTION_LIST /begin REF_CHARACTERISTIC /end REF_CHARACTERISTIC /begin REF_MEASUREMENT CDD_CurrMeas.MotCurrEolOffsProcFlg /end REF_MEASUREMENT /end GROUP
/begin GROUP CDD_CurrMeas.MotCurrOffsDeltaA "MICROSAR RTE" /begin SUB_GROUP /end SUB_GROUP /begin FUNCTION_LIST /end FUNCTION_LIST /begin REF_CHARACTERISTIC /end REF_CHARACTERISTIC /begin REF_MEASUREMENT CDD_CurrMeas.MotCurrOffsDeltaA /end REF_MEASUREMENT /end GROUP
/begin GROUP CDD_CurrMeas.MotCurrOffsDeltaB "MICROSAR RTE" /begin SUB_GROUP /end SUB_GROUP /begin FUNCTION_LIST /end FUNCTION_LIST /begin REF_CHARACTERISTIC /end REF_CHARACTERISTIC /begin REF_MEASUREMENT CDD_CurrMeas.MotCurrOffsDeltaB /end REF_MEASUREMENT /end GROUP
/begin GROUP CDD_CurrMeas.MotCurrOffsDeltaC "MICROSAR RTE" /begin SUB_GROUP /end SUB_GROUP /begin FUNCTION_LIST /end FUNCTION_LIST /begin REF_CHARACTERISTIC /end REF_CHARACTERISTIC /begin REF_MEASUREMENT CDD_CurrMeas.MotCurrOffsDeltaC /end REF_MEASUREMENT /end GROUP
/begin GROUP CDD_CurrMeas.MotCurrOffsHiAvrgA "MICROSAR RTE" /begin SUB_GROUP /end SUB_GROUP /begin FUNCTION_LIST /end FUNCTION_LIST /begin REF_CHARACTERISTIC /end REF_CHARACTERISTIC /begin REF_MEASUREMENT CDD_CurrMeas.MotCurrOffsHiAvrgA /end REF_MEASUREMENT /end GROUP
/begin GROUP CDD_CurrMeas.MotCurrOffsHiAvrgB "MICROSAR RTE" /begin SUB_GROUP /end SUB_GROUP /begin FUNCTION_LIST /end FUNCTION_LIST /begin REF_CHARACTERISTIC /end REF_CHARACTERISTIC /begin REF_MEASUREMENT CDD_CurrMeas.MotCurrOffsHiAvrgB /end REF_MEASUREMENT /end GROUP
/begin GROUP CDD_CurrMeas.MotCurrOffsHiAvrgC "MICROSAR RTE" /begin SUB_GROUP /end SUB_GROUP /begin FUNCTION_LIST /end FUNCTION_LIST /begin REF_CHARACTERISTIC /end REF_CHARACTERISTIC /begin REF_MEASUREMENT CDD_CurrMeas.MotCurrOffsHiAvrgC /end REF_MEASUREMENT /end GROUP
/begin GROUP CDD_CurrMeas.MotCurrOffsLoAvrgA "MICROSAR RTE" /begin SUB_GROUP /end SUB_GROUP /begin FUNCTION_LIST /end FUNCTION_LIST /begin REF_CHARACTERISTIC /end REF_CHARACTERISTIC /begin REF_MEASUREMENT CDD_CurrMeas.MotCurrOffsLoAvrgA /end REF_MEASUREMENT /end GROUP
/begin GROUP CDD_CurrMeas.MotCurrOffsLoAvrgB "MICROSAR RTE" /begin SUB_GROUP /end SUB_GROUP /begin FUNCTION_LIST /end FUNCTION_LIST /begin REF_CHARACTERISTIC /end REF_CHARACTERISTIC /begin REF_MEASUREMENT CDD_CurrMeas.MotCurrOffsLoAvrgB /end REF_MEASUREMENT /end GROUP
/begin GROUP CDD_CurrMeas.MotCurrOffsLoAvrgC "MICROSAR RTE" /begin SUB_GROUP /end SUB_GROUP /begin FUNCTION_LIST /end FUNCTION_LIST /begin REF_CHARACTERISTIC /end REF_CHARACTERISTIC /begin REF_MEASUREMENT CDD_CurrMeas.MotCurrOffsLoAvrgC /end REF_MEASUREMENT /end GROUP
/begin GROUP CDD_CurrMeas.MotCurrOffsZeroAvrgA "MICROSAR RTE" /begin SUB_GROUP /end SUB_GROUP /begin FUNCTION_LIST /end FUNCTION_LIST /begin REF_CHARACTERISTIC /end REF_CHARACTERISTIC /begin REF_MEASUREMENT CDD_CurrMeas.MotCurrOffsZeroAvrgA /end REF_MEASUREMENT /end GROUP
/begin GROUP CDD_CurrMeas.MotCurrOffsZeroAvrgB "MICROSAR RTE" /begin SUB_GROUP /end SUB_GROUP /begin FUNCTION_LIST /end FUNCTION_LIST /begin REF_CHARACTERISTIC /end REF_CHARACTERISTIC /begin REF_MEASUREMENT CDD_CurrMeas.MotCurrOffsZeroAvrgB /end REF_MEASUREMENT /end GROUP
/begin GROUP CDD_CurrMeas.MotCurrOffsZeroAvrgC "MICROSAR RTE" /begin SUB_GROUP /end SUB_GROUP /begin FUNCTION_LIST /end FUNCTION_LIST /begin REF_CHARACTERISTIC /end REF_CHARACTERISTIC /begin REF_MEASUREMENT CDD_CurrMeas.MotCurrOffsZeroAvrgC /end REF_MEASUREMENT /end GROUP
/begin GROUP CDD_CurrMeas.MotCurrQlfr1.Val "MICROSAR RTE" /begin SUB_GROUP /end SUB_GROUP /begin FUNCTION_LIST /end FUNCTION_LIST /begin REF_CHARACTERISTIC /end REF_CHARACTERISTIC /begin REF_MEASUREMENT CDD_CurrMeas.MotCurrQlfr1.Val /end REF_MEASUREMENT /end GROUP
/begin GROUP CDD_CurrMeas.MotCurrRollgCnt1Prev "MICROSAR RTE" /begin SUB_GROUP /end SUB_GROUP /begin FUNCTION_LIST /end FUNCTION_LIST /begin REF_CHARACTERISTIC /end REF_CHARACTERISTIC /begin REF_MEASUREMENT CDD_CurrMeas.MotCurrRollgCnt1Prev /end REF_MEASUREMENT /end GROUP
/begin GROUP CDD_CurrMeas.MotCurrSumAPrev "MICROSAR RTE" /begin SUB_GROUP /end SUB_GROUP /begin FUNCTION_LIST /end FUNCTION_LIST /begin REF_CHARACTERISTIC /end REF_CHARACTERISTIC /begin REF_MEASUREMENT CDD_CurrMeas.MotCurrSumAPrev /end REF_MEASUREMENT /end GROUP
/begin GROUP CDD_CurrMeas.MotCurrSumBPrev "MICROSAR RTE" /begin SUB_GROUP /end SUB_GROUP /begin FUNCTION_LIST /end FUNCTION_LIST /begin REF_CHARACTERISTIC /end REF_CHARACTERISTIC /begin REF_MEASUREMENT CDD_CurrMeas.MotCurrSumBPrev /end REF_MEASUREMENT /end GROUP
/begin GROUP CDD_CurrMeas.MotCurrSumCPrev "MICROSAR RTE" /begin SUB_GROUP /end SUB_GROUP /begin FUNCTION_LIST /end FUNCTION_LIST /begin REF_CHARACTERISTIC /end REF_CHARACTERISTIC /begin REF_MEASUREMENT CDD_CurrMeas.MotCurrSumCPrev /end REF_MEASUREMENT /end GROUP
/begin GROUP CDD_CurrMeas.MotVelMrf.Val "MICROSAR RTE" /begin SUB_GROUP /end SUB_GROUP /begin FUNCTION_LIST /end FUNCTION_LIST /begin REF_CHARACTERISTIC /end REF_CHARACTERISTIC /begin REF_MEASUREMENT CDD_CurrMeas.MotVelMrf.Val /end REF_MEASUREMENT /end GROUP
/begin GROUP CDD_CurrMeas.Ntc5DErrCnt.Val "MICROSAR RTE" /begin SUB_GROUP /end SUB_GROUP /begin FUNCTION_LIST /end FUNCTION_LIST /begin REF_CHARACTERISTIC /end REF_CHARACTERISTIC /begin REF_MEASUREMENT CDD_CurrMeas.Ntc5DErrCnt.Val /end REF_MEASUREMENT /end GROUP
/begin GROUP CDD_CurrMeas.Ntc5DErrCnt2MilliSecPrev "MICROSAR RTE" /begin SUB_GROUP /end SUB_GROUP /begin FUNCTION_LIST /end FUNCTION_LIST /begin REF_CHARACTERISTIC /end REF_CHARACTERISTIC /begin REF_MEASUREMENT CDD_CurrMeas.Ntc5DErrCnt2MilliSecPrev /end REF_MEASUREMENT /end GROUP
/begin GROUP CDD_CurrMeas.OffsEolAvrgCntrPrev "MICROSAR RTE" /begin SUB_GROUP /end SUB_GROUP /begin FUNCTION_LIST /end FUNCTION_LIST /begin REF_CHARACTERISTIC /end REF_CHARACTERISTIC /begin REF_MEASUREMENT CDD_CurrMeas.OffsEolAvrgCntrPrev /end REF_MEASUREMENT /end GROUP
/begin GROUP CDD_CurrMeas.PerInstanceMemories "MICROSAR RTE"
 /begin SUB_GROUP CDD_CurrMeas.BrdgVltgSumPrev CDD_CurrMeas.CurrMeasEolGainCalSetABC CDD_CurrMeas.CurrMeasEolOffsCalSetABC CDD_CurrMeas.EolGainSts CDD_CurrMeas.EolGainTranCntrPrev CDD_CurrMeas.EolOffsHiBrdgVltg CDD_CurrMeas.EolOffsSts CDD_CurrMeas.EolOffsTranCntrPrev CDD_CurrMeas.GainEolAvrgCntrPrev CDD_CurrMeas.MotCtrlNtc5DErrCntPrev CDD_CurrMeas.MotCurrEolCalStPrev CDD_CurrMeas.MotCurrEolGainA CDD_CurrMeas.MotCurrEolGainB CDD_CurrMeas.MotCurrEolGainC CDD_CurrMeas.MotCurrEolOffsProcFlg CDD_CurrMeas.MotCurrOffsDeltaA CDD_CurrMeas.MotCurrOffsDeltaB CDD_CurrMeas.MotCurrOffsDeltaC CDD_CurrMeas.MotCurrOffsHiAvrgA CDD_CurrMeas.MotCurrOffsHiAvrgB CDD_CurrMeas.MotCurrOffsHiAvrgC CDD_CurrMeas.MotCurrOffsLoAvrgA CDD_CurrMeas.MotCurrOffsLoAvrgB CDD_CurrMeas.MotCurrOffsLoAvrgC CDD_CurrMeas.MotCurrOffsZeroAvrgA CDD_CurrMeas.MotCurrOffsZeroAvrgB CDD_CurrMeas.MotCurrOffsZeroAvrgC CDD_CurrMeas.MotCurrRollgCnt1Prev CDD_CurrMeas.MotCurrSumAPrev CDD_CurrMeas.MotCurrSumBPrev CDD_CurrMeas.MotCurrSumCPrev CDD_CurrMeas.Ntc5DErrCnt2MilliSecPrev CDD_CurrMeas.OffsEolAvrgCntrPrev CDD_CurrMeas.PhaOnTiErrCntPrev CDD_CurrMeas.TmpMotCurrAdcVlySum1Prev CDD_CurrMeas.WrmIninTestCmplPrev /end SUB_GROUP
 /begin FUNCTION_LIST /end FUNCTION_LIST
 /begin REF_CHARACTERISTIC /end REF_CHARACTERISTIC
 /begin REF_MEASUREMENT /end REF_MEASUREMENT
/end GROUP
/begin GROUP CDD_CurrMeas.PhaOnTiErrCntPrev "MICROSAR RTE" /begin SUB_GROUP /end SUB_GROUP /begin FUNCTION_LIST /end FUNCTION_LIST /begin REF_CHARACTERISTIC /end REF_CHARACTERISTIC /begin REF_MEASUREMENT CDD_CurrMeas.PhaOnTiErrCntPrev /end REF_MEASUREMENT /end GROUP
/begin GROUP CDD_CurrMeas.ReceiverPorts "MICROSAR RTE"
 /begin SUB_GROUP CDD_CurrMeas.BrdgVltg.Val CDD_CurrMeas.DiagcStsIvtr1Inactv.Logl CDD_CurrMeas.MotCurrAdcVlyA.Val CDD_CurrMeas.MotCurrAdcVlyB.Val CDD_CurrMeas.MotCurrAdcVlyC.Val CDD_CurrMeas.MotVelMrf.Val CDD_CurrMeas.Ntc5DErrCnt.Val CDD_CurrMeas.StrtUpSt.Val CDD_CurrMeas.SysSt.Val CDD_CurrMeas.VehSpd.Val CDD_CurrMeas.VehSpdVld.Logl /end SUB_GROUP
 /begin FUNCTION_LIST /end FUNCTION_LIST
 /begin REF_CHARACTERISTIC /end REF_CHARACTERISTIC
 /begin REF_MEASUREMENT /end REF_MEASUREMENT
/end GROUP
/begin GROUP CDD_CurrMeas.SenderPorts "MICROSAR RTE"
 /begin SUB_GROUP CDD_CurrMeas.CurrMeasWrmIninTestCmpl.Logl CDD_CurrMeas.MotCurrEolCalSt.Val CDD_CurrMeas.MotCurrQlfr1.Val /end SUB_GROUP
 /begin FUNCTION_LIST /end FUNCTION_LIST
 /begin REF_CHARACTERISTIC /end REF_CHARACTERISTIC
 /begin REF_MEASUREMENT /end REF_MEASUREMENT
/end GROUP
/begin GROUP CDD_CurrMeas.StrtUpSt.Val "MICROSAR RTE" /begin SUB_GROUP /end SUB_GROUP /begin FUNCTION_LIST /end FUNCTION_LIST /begin REF_CHARACTERISTIC /end REF_CHARACTERISTIC /begin REF_MEASUREMENT CDD_CurrMeas.StrtUpSt.Val /end REF_MEASUREMENT /end GROUP
/begin GROUP CDD_CurrMeas.SysGlbPrmMotPoleCnt.Val "MICROSAR RTE" /begin SUB_GROUP /end SUB_GROUP /begin FUNCTION_LIST /end FUNCTION_LIST /begin REF_CHARACTERISTIC CDD_CurrMeas.SysGlbPrmMotPoleCnt.Val /end REF_CHARACTERISTIC /begin REF_MEASUREMENT /end REF_MEASUREMENT /end GROUP
/begin GROUP CDD_CurrMeas.SysSt.Val "MICROSAR RTE" /begin SUB_GROUP /end SUB_GROUP /begin FUNCTION_LIST /end FUNCTION_LIST /begin REF_CHARACTERISTIC /end REF_CHARACTERISTIC /begin REF_MEASUREMENT CDD_CurrMeas.SysSt.Val /end REF_MEASUREMENT /end GROUP
/begin GROUP CDD_CurrMeas.TmpMotCurrAdcVlySum1Prev "MICROSAR RTE" /begin SUB_GROUP /end SUB_GROUP /begin FUNCTION_LIST /end FUNCTION_LIST /begin REF_CHARACTERISTIC /end REF_CHARACTERISTIC /begin REF_MEASUREMENT CDD_CurrMeas.TmpMotCurrAdcVlySum1Prev /end REF_MEASUREMENT /end GROUP
/begin GROUP CDD_CurrMeas.VehSpd.Val "MICROSAR RTE" /begin SUB_GROUP /end SUB_GROUP /begin FUNCTION_LIST /end FUNCTION_LIST /begin REF_CHARACTERISTIC /end REF_CHARACTERISTIC /begin REF_MEASUREMENT CDD_CurrMeas.VehSpd.Val /end REF_MEASUREMENT /end GROUP
/begin GROUP CDD_CurrMeas.VehSpdVld.Logl "MICROSAR RTE" /begin SUB_GROUP /end SUB_GROUP /begin FUNCTION_LIST /end FUNCTION_LIST /begin REF_CHARACTERISTIC /end REF_CHARACTERISTIC /begin REF_MEASUREMENT CDD_CurrMeas.VehSpdVld.Logl /end REF_MEASUREMENT /end GROUP
/begin GROUP CDD_CurrMeas.WrmIninTestCmplPrev "MICROSAR RTE" /begin SUB_GROUP /end SUB_GROUP /begin FUNCTION_LIST /end FUNCTION_LIST /begin REF_CHARACTERISTIC /end REF_CHARACTERISTIC /begin REF_MEASUREMENT CDD_CurrMeas.WrmIninTestCmplPrev /end REF_MEASUREMENT /end GROUP
/begin GROUP CDD_CurrMeasArbn "MICROSAR RTE"
 /begin SUB_GROUP CDD_CurrMeasArbn.CalibrationPorts CDD_CurrMeasArbn.PerInstanceMemories /end SUB_GROUP
 /begin FUNCTION_LIST /end FUNCTION_LIST
 /begin REF_CHARACTERISTIC /end REF_CHARACTERISTIC
 /begin REF_MEASUREMENT /end REF_MEASUREMENT
/end GROUP
/begin GROUP CDD_CurrMeasArbn.CalibrationPorts "MICROSAR RTE" /begin SUB_GROUP CDD_CurrMeasArbn.CurrMeasArbnMaxStallCntr.Val /end SUB_GROUP /begin FUNCTION_LIST /end FUNCTION_LIST /begin REF_CHARACTERISTIC /end REF_CHARACTERISTIC /begin REF_MEASUREMENT /end REF_MEASUREMENT /end GROUP
/begin GROUP CDD_CurrMeasArbn.CurrMeasArbnMaxStallCntr.Val "MICROSAR RTE" /begin SUB_GROUP /end SUB_GROUP /begin FUNCTION_LIST /end FUNCTION_LIST /begin REF_CHARACTERISTIC CDD_CurrMeasArbn.CurrMeasArbnMaxStallCntr.Val /end REF_CHARACTERISTIC /begin REF_MEASUREMENT /end REF_MEASUREMENT /end GROUP
/begin GROUP CDD_CurrMeasArbn.CurrMeasArbnSens0RollgCntPrev "MICROSAR RTE" /begin SUB_GROUP /end SUB_GROUP /begin FUNCTION_LIST /end FUNCTION_LIST /begin REF_CHARACTERISTIC /end REF_CHARACTERISTIC /begin REF_MEASUREMENT CDD_CurrMeasArbn.CurrMeasArbnSens0RollgCntPrev /end REF_MEASUREMENT /end GROUP
/begin GROUP CDD_CurrMeasArbn.CurrMeasArbnSens0StallCntPrev "MICROSAR RTE" /begin SUB_GROUP /end SUB_GROUP /begin FUNCTION_LIST /end FUNCTION_LIST /begin REF_CHARACTERISTIC /end REF_CHARACTERISTIC /begin REF_MEASUREMENT CDD_CurrMeasArbn.CurrMeasArbnSens0StallCntPrev /end REF_MEASUREMENT /end GROUP
/begin GROUP CDD_CurrMeasArbn.CurrMeasArbnSens1RollgCntPrev "MICROSAR RTE" /begin SUB_GROUP /end SUB_GROUP /begin FUNCTION_LIST /end FUNCTION_LIST /begin REF_CHARACTERISTIC /end REF_CHARACTERISTIC /begin REF_MEASUREMENT CDD_CurrMeasArbn.CurrMeasArbnSens1RollgCntPrev /end REF_MEASUREMENT /end GROUP
/begin GROUP CDD_CurrMeasArbn.CurrMeasArbnSens1StallCntPrev "MICROSAR RTE" /begin SUB_GROUP /end SUB_GROUP /begin FUNCTION_LIST /end FUNCTION_LIST /begin REF_CHARACTERISTIC /end REF_CHARACTERISTIC /begin REF_MEASUREMENT CDD_CurrMeasArbn.CurrMeasArbnSens1StallCntPrev /end REF_MEASUREMENT /end GROUP
/begin GROUP CDD_CurrMeasArbn.PerInstanceMemories "MICROSAR RTE"
 /begin SUB_GROUP CDD_CurrMeasArbn.CurrMeasArbnSens0RollgCntPrev CDD_CurrMeasArbn.CurrMeasArbnSens0StallCntPrev CDD_CurrMeasArbn.CurrMeasArbnSens1RollgCntPrev CDD_CurrMeasArbn.CurrMeasArbnSens1StallCntPrev /end SUB_GROUP
 /begin FUNCTION_LIST /end FUNCTION_LIST
 /begin REF_CHARACTERISTIC /end REF_CHARACTERISTIC
 /begin REF_MEASUREMENT /end REF_MEASUREMENT
/end GROUP
/begin GROUP CDD_DmaCfgAndUse "MICROSAR RTE" /begin SUB_GROUP CDD_DmaCfgAndUse.PerInstanceMemories /end SUB_GROUP /begin FUNCTION_LIST /end FUNCTION_LIST /begin REF_CHARACTERISTIC /end REF_CHARACTERISTIC /begin REF_MEASUREMENT /end REF_MEASUREMENT /end GROUP
/begin GROUP CDD_DmaCfgAndUse.DmaCfgAndUse2MilliSecAdcMaxDmaTrfTi "MICROSAR RTE" /begin SUB_GROUP /end SUB_GROUP /begin FUNCTION_LIST /end FUNCTION_LIST /begin REF_CHARACTERISTIC /end REF_CHARACTERISTIC /begin REF_MEASUREMENT CDD_DmaCfgAndUse.DmaCfgAndUse2MilliSecAdcMaxDmaTrfTi /end REF_MEASUREMENT /end GROUP
/begin GROUP CDD_DmaCfgAndUse.DmaCfgAndUse2MilliSecAdcStrtTi "MICROSAR RTE" /begin SUB_GROUP /end SUB_GROUP /begin FUNCTION_LIST /end FUNCTION_LIST /begin REF_CHARACTERISTIC /end REF_CHARACTERISTIC /begin REF_MEASUREMENT CDD_DmaCfgAndUse.DmaCfgAndUse2MilliSecAdcStrtTi /end REF_MEASUREMENT /end GROUP
/begin GROUP CDD_DmaCfgAndUse.PerInstanceMemories "MICROSAR RTE"
 /begin SUB_GROUP CDD_DmaCfgAndUse.DmaCfgAndUse2MilliSecAdcMaxDmaTrfTi CDD_DmaCfgAndUse.DmaCfgAndUse2MilliSecAdcStrtTi CDD_DmaCfgAndUse.d2MilliSecAdcActDmaTrfTi /end SUB_GROUP
 /begin FUNCTION_LIST /end FUNCTION_LIST
 /begin REF_CHARACTERISTIC /end REF_CHARACTERISTIC
 /begin REF_MEASUREMENT /end REF_MEASUREMENT
/end GROUP
/begin GROUP CDD_DmaCfgAndUse.d2MilliSecAdcActDmaTrfTi "MICROSAR RTE" /begin SUB_GROUP /end SUB_GROUP /begin FUNCTION_LIST /end FUNCTION_LIST /begin REF_CHARACTERISTIC /end REF_CHARACTERISTIC /begin REF_MEASUREMENT CDD_DmaCfgAndUse.d2MilliSecAdcActDmaTrfTi /end REF_MEASUREMENT /end GROUP
/begin GROUP CDD_EcmOutpAndDiagc "MICROSAR RTE" /begin SUB_GROUP CDD_EcmOutpAndDiagc.PerInstanceMemories /end SUB_GROUP /begin FUNCTION_LIST /end FUNCTION_LIST /begin REF_CHARACTERISTIC /end REF_CHARACTERISTIC /begin REF_MEASUREMENT /end REF_MEASUREMENT /end GROUP
/begin GROUP CDD_EcmOutpAndDiagc.PerInstanceMemories "MICROSAR RTE"
 /begin SUB_GROUP CDD_EcmOutpAndDiagc.dEcmVrfyErrOutpCtrlCmpl CDD_EcmOutpAndDiagc.dEcmVrfyIntrptGennCmpl /end SUB_GROUP
 /begin FUNCTION_LIST /end FUNCTION_LIST
 /begin REF_CHARACTERISTIC /end REF_CHARACTERISTIC
 /begin REF_MEASUREMENT /end REF_MEASUREMENT
/end GROUP
/begin GROUP CDD_EcmOutpAndDiagc.dEcmVrfyErrOutpCtrlCmpl "MICROSAR RTE" /begin SUB_GROUP /end SUB_GROUP /begin FUNCTION_LIST /end FUNCTION_LIST /begin REF_CHARACTERISTIC /end REF_CHARACTERISTIC /begin REF_MEASUREMENT CDD_EcmOutpAndDiagc.dEcmVrfyErrOutpCtrlCmpl /end REF_MEASUREMENT /end GROUP
/begin GROUP CDD_EcmOutpAndDiagc.dEcmVrfyIntrptGennCmpl "MICROSAR RTE" /begin SUB_GROUP /end SUB_GROUP /begin FUNCTION_LIST /end FUNCTION_LIST /begin REF_CHARACTERISTIC /end REF_CHARACTERISTIC /begin REF_MEASUREMENT CDD_EcmOutpAndDiagc.dEcmVrfyIntrptGennCmpl /end REF_MEASUREMENT /end GROUP
/begin GROUP CDD_ExcpnHndlg "MICROSAR RTE" /begin SUB_GROUP CDD_ExcpnHndlg.PerInstanceMemories /end SUB_GROUP /begin FUNCTION_LIST /end FUNCTION_LIST /begin REF_CHARACTERISTIC /end REF_CHARACTERISTIC /begin REF_MEASUREMENT /end REF_MEASUREMENT /end GROUP
/begin GROUP CDD_ExcpnHndlg.McuDiagcData "MICROSAR RTE" /begin SUB_GROUP /end SUB_GROUP /begin FUNCTION_LIST /end FUNCTION_LIST /begin REF_CHARACTERISTIC /end REF_CHARACTERISTIC /begin REF_MEASUREMENT CDD_ExcpnHndlg.McuDiagcData /end REF_MEASUREMENT /end GROUP
/begin GROUP CDD_ExcpnHndlg.PerInstanceMemories "MICROSAR RTE" /begin SUB_GROUP CDD_ExcpnHndlg.McuDiagcData /end SUB_GROUP /begin FUNCTION_LIST /end FUNCTION_LIST /begin REF_CHARACTERISTIC /end REF_CHARACTERISTIC /begin REF_MEASUREMENT /end REF_MEASUREMENT /end GROUP
/begin GROUP CDD_FlsMem "MICROSAR RTE" /begin SUB_GROUP CDD_FlsMem.PerInstanceMemories CDD_FlsMem.SenderPorts /end SUB_GROUP /begin FUNCTION_LIST /end FUNCTION_LIST /begin REF_CHARACTERISTIC /end REF_CHARACTERISTIC /begin REF_MEASUREMENT /end REF_MEASUREMENT /end GROUP
/begin GROUP CDD_FlsMem.CodFlsCrcChkCmpl.Logl "MICROSAR RTE" /begin SUB_GROUP /end SUB_GROUP /begin FUNCTION_LIST /end FUNCTION_LIST /begin REF_CHARACTERISTIC /end REF_CHARACTERISTIC /begin REF_MEASUREMENT CDD_FlsMem.CodFlsCrcChkCmpl.Logl /end REF_MEASUREMENT /end GROUP
/begin GROUP CDD_FlsMem.CodFlsCrcChkStrtTi "MICROSAR RTE" /begin SUB_GROUP /end SUB_GROUP /begin FUNCTION_LIST /end FUNCTION_LIST /begin REF_CHARACTERISTIC /end REF_CHARACTERISTIC /begin REF_MEASUREMENT CDD_FlsMem.CodFlsCrcChkStrtTi /end REF_MEASUREMENT /end GROUP
/begin GROUP CDD_FlsMem.CodFlsDummyRead1 "MICROSAR RTE" /begin SUB_GROUP /end SUB_GROUP /begin FUNCTION_LIST /end FUNCTION_LIST /begin REF_CHARACTERISTIC /end REF_CHARACTERISTIC /begin REF_MEASUREMENT CDD_FlsMem.CodFlsDummyRead1 /end REF_MEASUREMENT /end GROUP
/begin GROUP CDD_FlsMem.CodFlsDummyRead2 "MICROSAR RTE" /begin SUB_GROUP /end SUB_GROUP /begin FUNCTION_LIST /end FUNCTION_LIST /begin REF_CHARACTERISTIC /end REF_CHARACTERISTIC /begin REF_MEASUREMENT CDD_FlsMem.CodFlsDummyRead2 /end REF_MEASUREMENT /end GROUP
/begin GROUP CDD_FlsMem.CodFlsDummyRead3 "MICROSAR RTE" /begin SUB_GROUP /end SUB_GROUP /begin FUNCTION_LIST /end FUNCTION_LIST /begin REF_CHARACTERISTIC /end REF_CHARACTERISTIC /begin REF_MEASUREMENT CDD_FlsMem.CodFlsDummyRead3 /end REF_MEASUREMENT /end GROUP
/begin GROUP CDD_FlsMem.CodFlsDummyRead4 "MICROSAR RTE" /begin SUB_GROUP /end SUB_GROUP /begin FUNCTION_LIST /end FUNCTION_LIST /begin REF_CHARACTERISTIC /end REF_CHARACTERISTIC /begin REF_MEASUREMENT CDD_FlsMem.CodFlsDummyRead4 /end REF_MEASUREMENT /end GROUP
/begin GROUP CDD_FlsMem.CodFlsSngBitErr "MICROSAR RTE" /begin SUB_GROUP /end SUB_GROUP /begin FUNCTION_LIST /end FUNCTION_LIST /begin REF_CHARACTERISTIC /end REF_CHARACTERISTIC /begin REF_MEASUREMENT CDD_FlsMem.CodFlsSngBitErr /end REF_MEASUREMENT /end GROUP
/begin GROUP CDD_FlsMem.CrcChkCmpl "MICROSAR RTE" /begin SUB_GROUP /end SUB_GROUP /begin FUNCTION_LIST /end FUNCTION_LIST /begin REF_CHARACTERISTIC /end REF_CHARACTERISTIC /begin REF_MEASUREMENT CDD_FlsMem.CrcChkCmpl /end REF_MEASUREMENT /end GROUP
/begin GROUP CDD_FlsMem.CrcHwIdxKey "MICROSAR RTE" /begin SUB_GROUP /end SUB_GROUP /begin FUNCTION_LIST /end FUNCTION_LIST /begin REF_CHARACTERISTIC /end REF_CHARACTERISTIC /begin REF_MEASUREMENT CDD_FlsMem.CrcHwIdxKey /end REF_MEASUREMENT /end GROUP
/begin GROUP CDD_FlsMem.PerInstanceMemories "MICROSAR RTE"
 /begin SUB_GROUP CDD_FlsMem.CodFlsCrcChkStrtTi CDD_FlsMem.CodFlsDummyRead1 CDD_FlsMem.CodFlsDummyRead2 CDD_FlsMem.CodFlsDummyRead3 CDD_FlsMem.CodFlsDummyRead4 CDD_FlsMem.CodFlsSngBitErr CDD_FlsMem.CrcChkCmpl CDD_FlsMem.CrcHwIdxKey CDD_FlsMem.PwrOnRstCrcChkCmpl CDD_FlsMem.dFlsMemVrfyCrcInitCmpl /end SUB_GROUP
 /begin FUNCTION_LIST /end FUNCTION_LIST
 /begin REF_CHARACTERISTIC /end REF_CHARACTERISTIC
 /begin REF_MEASUREMENT /end REF_MEASUREMENT
/end GROUP
/begin GROUP CDD_FlsMem.PwrOnRstCrcChkCmpl "MICROSAR RTE" /begin SUB_GROUP /end SUB_GROUP /begin FUNCTION_LIST /end FUNCTION_LIST /begin REF_CHARACTERISTIC /end REF_CHARACTERISTIC /begin REF_MEASUREMENT CDD_FlsMem.PwrOnRstCrcChkCmpl /end REF_MEASUREMENT /end GROUP
/begin GROUP CDD_FlsMem.SenderPorts "MICROSAR RTE" /begin SUB_GROUP CDD_FlsMem.CodFlsCrcChkCmpl.Logl CDD_FlsMem.SwApplCrc.Val /end SUB_GROUP /begin FUNCTION_LIST /end FUNCTION_LIST /begin REF_CHARACTERISTIC /end REF_CHARACTERISTIC /begin REF_MEASUREMENT /end REF_MEASUREMENT /end GROUP
/begin GROUP CDD_FlsMem.SwApplCrc.Val "MICROSAR RTE" /begin SUB_GROUP /end SUB_GROUP /begin FUNCTION_LIST /end FUNCTION_LIST /begin REF_CHARACTERISTIC /end REF_CHARACTERISTIC /begin REF_MEASUREMENT CDD_FlsMem.SwApplCrc.Val /end REF_MEASUREMENT /end GROUP
/begin GROUP CDD_FlsMem.dFlsMemVrfyCrcInitCmpl "MICROSAR RTE" /begin SUB_GROUP /end SUB_GROUP /begin FUNCTION_LIST /end FUNCTION_LIST /begin REF_CHARACTERISTIC /end REF_CHARACTERISTIC /begin REF_MEASUREMENT CDD_FlsMem.dFlsMemVrfyCrcInitCmpl /end REF_MEASUREMENT /end GROUP
/begin GROUP CDD_FordBlaBoxIfCmn "MICROSAR RTE"
 /begin SUB_GROUP CDD_FordBlaBoxIfCmn.CalibrationPorts CDD_FordBlaBoxIfCmn.ReceiverPorts /end SUB_GROUP
 /begin FUNCTION_LIST /end FUNCTION_LIST
 /begin REF_CHARACTERISTIC /end REF_CHARACTERISTIC
 /begin REF_MEASUREMENT /end REF_MEASUREMENT
/end GROUP
/begin GROUP CDD_FordBlaBoxIfCmn.ActvParkAssiTqFild.Val "MICROSAR RTE" /begin SUB_GROUP /end SUB_GROUP /begin FUNCTION_LIST /end FUNCTION_LIST /begin REF_CHARACTERISTIC /end REF_CHARACTERISTIC /begin REF_MEASUREMENT CDD_FordBlaBoxIfCmn.ActvParkAssiTqFild.Val /end REF_MEASUREMENT /end GROUP
/begin GROUP CDD_FordBlaBoxIfCmn.CalibrationPorts "MICROSAR RTE"
 /begin SUB_GROUP CDD_FordBlaBoxIfCmn.FordBlaBoxIfCmnVehSteerRat.Val CDD_FordBlaBoxIfCmn.FordBlaBoxIfCmnVehWhlBas.Val /end SUB_GROUP
 /begin FUNCTION_LIST /end FUNCTION_LIST
 /begin REF_CHARACTERISTIC /end REF_CHARACTERISTIC
 /begin REF_MEASUREMENT /end REF_MEASUREMENT
/end GROUP
/begin GROUP CDD_FordBlaBoxIfCmn.EcuId.Val "MICROSAR RTE" /begin SUB_GROUP /end SUB_GROUP /begin FUNCTION_LIST /end FUNCTION_LIST /begin REF_CHARACTERISTIC /end REF_CHARACTERISTIC /begin REF_MEASUREMENT CDD_FordBlaBoxIfCmn.EcuId.Val /end REF_MEASUREMENT /end GROUP
/begin GROUP CDD_FordBlaBoxIfCmn.EngTqClass.Val "MICROSAR RTE" /begin SUB_GROUP /end SUB_GROUP /begin FUNCTION_LIST /end FUNCTION_LIST /begin REF_CHARACTERISTIC /end REF_CHARACTERISTIC /begin REF_MEASUREMENT CDD_FordBlaBoxIfCmn.EngTqClass.Val /end REF_MEASUREMENT /end GROUP
/begin GROUP CDD_FordBlaBoxIfCmn.FildVehSpdVld.Logl "MICROSAR RTE" /begin SUB_GROUP /end SUB_GROUP /begin FUNCTION_LIST /end FUNCTION_LIST /begin REF_CHARACTERISTIC /end REF_CHARACTERISTIC /begin REF_MEASUREMENT CDD_FordBlaBoxIfCmn.FildVehSpdVld.Logl /end REF_MEASUREMENT /end GROUP
/begin GROUP CDD_FordBlaBoxIfCmn.FordActvNiblCtrlEnad.Logl "MICROSAR RTE" /begin SUB_GROUP /end SUB_GROUP /begin FUNCTION_LIST /end FUNCTION_LIST /begin REF_CHARACTERISTIC /end REF_CHARACTERISTIC /begin REF_MEASUREMENT CDD_FordBlaBoxIfCmn.FordActvNiblCtrlEnad.Logl /end REF_MEASUREMENT /end GROUP
/begin GROUP CDD_FordBlaBoxIfCmn.FordAppldFinalMotTq.Val "MICROSAR RTE" /begin SUB_GROUP /end SUB_GROUP /begin FUNCTION_LIST /end FUNCTION_LIST /begin REF_CHARACTERISTIC /end REF_CHARACTERISTIC /begin REF_MEASUREMENT CDD_FordBlaBoxIfCmn.FordAppldFinalMotTq.Val /end REF_MEASUREMENT /end GROUP
/begin GROUP CDD_FordBlaBoxIfCmn.FordAppldFinalMotTqVld.Logl "MICROSAR RTE" /begin SUB_GROUP /end SUB_GROUP /begin FUNCTION_LIST /end FUNCTION_LIST /begin REF_CHARACTERISTIC /end REF_CHARACTERISTIC /begin REF_MEASUREMENT CDD_FordBlaBoxIfCmn.FordAppldFinalMotTqVld.Logl /end REF_MEASUREMENT /end GROUP
/begin GROUP CDD_FordBlaBoxIfCmn.FordBlaBoxIfCmnVehSteerRat.Val "MICROSAR RTE" /begin SUB_GROUP /end SUB_GROUP /begin FUNCTION_LIST /end FUNCTION_LIST /begin REF_CHARACTERISTIC CDD_FordBlaBoxIfCmn.FordBlaBoxIfCmnVehSteerRat.Val /end REF_CHARACTERISTIC /begin REF_MEASUREMENT /end REF_MEASUREMENT /end GROUP
/begin GROUP CDD_FordBlaBoxIfCmn.FordBlaBoxIfCmnVehWhlBas.Val "MICROSAR RTE" /begin SUB_GROUP /end SUB_GROUP /begin FUNCTION_LIST /end FUNCTION_LIST /begin REF_CHARACTERISTIC CDD_FordBlaBoxIfCmn.FordBlaBoxIfCmnVehWhlBas.Val /end REF_CHARACTERISTIC /begin REF_MEASUREMENT /end REF_MEASUREMENT /end GROUP
/begin GROUP CDD_FordBlaBoxIfCmn.FordBoostCrvAssiTq.Val "MICROSAR RTE" /begin SUB_GROUP /end SUB_GROUP /begin FUNCTION_LIST /end FUNCTION_LIST /begin REF_CHARACTERISTIC /end REF_CHARACTERISTIC /begin REF_MEASUREMENT CDD_FordBlaBoxIfCmn.FordBoostCrvAssiTq.Val /end REF_MEASUREMENT /end GROUP
/begin GROUP CDD_FordBlaBoxIfCmn.FordBoostCrvInpTq.Val "MICROSAR RTE" /begin SUB_GROUP /end SUB_GROUP /begin FUNCTION_LIST /end FUNCTION_LIST /begin REF_CHARACTERISTIC /end REF_CHARACTERISTIC /begin REF_MEASUREMENT CDD_FordBlaBoxIfCmn.FordBoostCrvInpTq.Val /end REF_MEASUREMENT /end GROUP
/begin GROUP CDD_FordBlaBoxIfCmn.FordBrkPlsRejctnEnad.Logl "MICROSAR RTE" /begin SUB_GROUP /end SUB_GROUP /begin FUNCTION_LIST /end FUNCTION_LIST /begin REF_CHARACTERISTIC /end REF_CHARACTERISTIC /begin REF_MEASUREMENT CDD_FordBlaBoxIfCmn.FordBrkPlsRejctnEnad.Logl /end REF_MEASUREMENT /end GROUP
/begin GROUP CDD_FordBlaBoxIfCmn.FordCmpdHwPosn.Val "MICROSAR RTE" /begin SUB_GROUP /end SUB_GROUP /begin FUNCTION_LIST /end FUNCTION_LIST /begin REF_CHARACTERISTIC /end REF_CHARACTERISTIC /begin REF_MEASUREMENT CDD_FordBlaBoxIfCmn.FordCmpdHwPosn.Val /end REF_MEASUREMENT /end GROUP
/begin GROUP CDD_FordBlaBoxIfCmn.FordCmpdHwPosnQlyFac.Val "MICROSAR RTE" /begin SUB_GROUP /end SUB_GROUP /begin FUNCTION_LIST /end FUNCTION_LIST /begin REF_CHARACTERISTIC /end REF_CHARACTERISTIC /begin REF_MEASUREMENT CDD_FordBlaBoxIfCmn.FordCmpdHwPosnQlyFac.Val /end REF_MEASUREMENT /end GROUP
/begin GROUP CDD_FordBlaBoxIfCmn.FordEvasSteerAssiEnaReq.Val "MICROSAR RTE" /begin SUB_GROUP /end SUB_GROUP /begin FUNCTION_LIST /end FUNCTION_LIST /begin REF_CHARACTERISTIC /end REF_CHARACTERISTIC /begin REF_MEASUREMENT CDD_FordBlaBoxIfCmn.FordEvasSteerAssiEnaReq.Val /end REF_MEASUREMENT /end GROUP
/begin GROUP CDD_FordBlaBoxIfCmn.FordEvasSteerAssiEnad.Logl "MICROSAR RTE" /begin SUB_GROUP /end SUB_GROUP /begin FUNCTION_LIST /end FUNCTION_LIST /begin REF_CHARACTERISTIC /end REF_CHARACTERISTIC /begin REF_MEASUREMENT CDD_FordBlaBoxIfCmn.FordEvasSteerAssiEnad.Logl /end REF_MEASUREMENT /end GROUP
/begin GROUP CDD_FordBlaBoxIfCmn.FordHwVelVld.Logl "MICROSAR RTE" /begin SUB_GROUP /end SUB_GROUP /begin FUNCTION_LIST /end FUNCTION_LIST /begin REF_CHARACTERISTIC /end REF_CHARACTERISTIC /begin REF_MEASUREMENT CDD_FordBlaBoxIfCmn.FordHwVelVld.Logl /end REF_MEASUREMENT /end GROUP
/begin GROUP CDD_FordBlaBoxIfCmn.FordInpTqRaw.Val "MICROSAR RTE" /begin SUB_GROUP /end SUB_GROUP /begin FUNCTION_LIST /end FUNCTION_LIST /begin REF_CHARACTERISTIC /end REF_CHARACTERISTIC /begin REF_MEASUREMENT CDD_FordBlaBoxIfCmn.FordInpTqRaw.Val /end REF_MEASUREMENT /end GROUP
/begin GROUP CDD_FordBlaBoxIfCmn.FordInpTqRawVld.Logl "MICROSAR RTE" /begin SUB_GROUP /end SUB_GROUP /begin FUNCTION_LIST /end FUNCTION_LIST /begin REF_CHARACTERISTIC /end REF_CHARACTERISTIC /begin REF_MEASUREMENT CDD_FordBlaBoxIfCmn.FordInpTqRawVld.Logl /end REF_MEASUREMENT /end GROUP
/begin GROUP CDD_FordBlaBoxIfCmn.FordLaneCentrAssiEnad.Logl "MICROSAR RTE" /begin SUB_GROUP /end SUB_GROUP /begin FUNCTION_LIST /end FUNCTION_LIST /begin REF_CHARACTERISTIC /end REF_CHARACTERISTIC /begin REF_MEASUREMENT CDD_FordBlaBoxIfCmn.FordLaneCentrAssiEnad.Logl /end REF_MEASUREMENT /end GROUP
/begin GROUP CDD_FordBlaBoxIfCmn.FordLaneDprtrWarnEnad.Logl "MICROSAR RTE" /begin SUB_GROUP /end SUB_GROUP /begin FUNCTION_LIST /end FUNCTION_LIST /begin REF_CHARACTERISTIC /end REF_CHARACTERISTIC /begin REF_MEASUREMENT CDD_FordBlaBoxIfCmn.FordLaneDprtrWarnEnad.Logl /end REF_MEASUREMENT /end GROUP
/begin GROUP CDD_FordBlaBoxIfCmn.FordLaneKeepAssiEnad.Logl "MICROSAR RTE" /begin SUB_GROUP /end SUB_GROUP /begin FUNCTION_LIST /end FUNCTION_LIST /begin REF_CHARACTERISTIC /end REF_CHARACTERISTIC /begin REF_MEASUREMENT CDD_FordBlaBoxIfCmn.FordLaneKeepAssiEnad.Logl /end REF_MEASUREMENT /end GROUP
/begin GROUP CDD_FordBlaBoxIfCmn.FordMaxAsscTq.Val "MICROSAR RTE" /begin SUB_GROUP /end SUB_GROUP /begin FUNCTION_LIST /end FUNCTION_LIST /begin REF_CHARACTERISTIC /end REF_CHARACTERISTIC /begin REF_MEASUREMENT CDD_FordBlaBoxIfCmn.FordMaxAsscTq.Val /end REF_MEASUREMENT /end GROUP
/begin GROUP CDD_FordBlaBoxIfCmn.FordMsgInp1Vld.Logl "MICROSAR RTE" /begin SUB_GROUP /end SUB_GROUP /begin FUNCTION_LIST /end FUNCTION_LIST /begin REF_CHARACTERISTIC /end REF_CHARACTERISTIC /begin REF_MEASUREMENT CDD_FordBlaBoxIfCmn.FordMsgInp1Vld.Logl /end REF_MEASUREMENT /end GROUP
/begin GROUP CDD_FordBlaBoxIfCmn.FordMsgInp2Vld.Logl "MICROSAR RTE" /begin SUB_GROUP /end SUB_GROUP /begin FUNCTION_LIST /end FUNCTION_LIST /begin REF_CHARACTERISTIC /end REF_CHARACTERISTIC /begin REF_MEASUREMENT CDD_FordBlaBoxIfCmn.FordMsgInp2Vld.Logl /end REF_MEASUREMENT /end GROUP
/begin GROUP CDD_FordBlaBoxIfCmn.FordMsgInp3Vld.Logl "MICROSAR RTE" /begin SUB_GROUP /end SUB_GROUP /begin FUNCTION_LIST /end FUNCTION_LIST /begin REF_CHARACTERISTIC /end REF_CHARACTERISTIC /begin REF_MEASUREMENT CDD_FordBlaBoxIfCmn.FordMsgInp3Vld.Logl /end REF_MEASUREMENT /end GROUP
/begin GROUP CDD_FordBlaBoxIfCmn.FordMsgInp4Vld.Logl "MICROSAR RTE" /begin SUB_GROUP /end SUB_GROUP /begin FUNCTION_LIST /end FUNCTION_LIST /begin REF_CHARACTERISTIC /end REF_CHARACTERISTIC /begin REF_MEASUREMENT CDD_FordBlaBoxIfCmn.FordMsgInp4Vld.Logl /end REF_MEASUREMENT /end GROUP
/begin GROUP CDD_FordBlaBoxIfCmn.FordPullDriftCmpEnad.Logl "MICROSAR RTE" /begin SUB_GROUP /end SUB_GROUP /begin FUNCTION_LIST /end FUNCTION_LIST /begin REF_CHARACTERISTIC /end REF_CHARACTERISTIC /begin REF_MEASUREMENT CDD_FordBlaBoxIfCmn.FordPullDriftCmpEnad.Logl /end REF_MEASUREMENT /end GROUP
/begin GROUP CDD_FordBlaBoxIfCmn.FordRelHwPosn.Val "MICROSAR RTE" /begin SUB_GROUP /end SUB_GROUP /begin FUNCTION_LIST /end FUNCTION_LIST /begin REF_CHARACTERISTIC /end REF_CHARACTERISTIC /begin REF_MEASUREMENT CDD_FordBlaBoxIfCmn.FordRelHwPosn.Val /end REF_MEASUREMENT /end GROUP
/begin GROUP CDD_FordBlaBoxIfCmn.FordRelHwPosnVld.Logl "MICROSAR RTE" /begin SUB_GROUP /end SUB_GROUP /begin FUNCTION_LIST /end FUNCTION_LIST /begin REF_CHARACTERISTIC /end REF_CHARACTERISTIC /begin REF_MEASUREMENT CDD_FordBlaBoxIfCmn.FordRelHwPosnVld.Logl /end REF_MEASUREMENT /end GROUP
/begin GROUP CDD_FordBlaBoxIfCmn.FordReqdFinalMotTq.Val "MICROSAR RTE" /begin SUB_GROUP /end SUB_GROUP /begin FUNCTION_LIST /end FUNCTION_LIST /begin REF_CHARACTERISTIC /end REF_CHARACTERISTIC /begin REF_MEASUREMENT CDD_FordBlaBoxIfCmn.FordReqdFinalMotTq.Val /end REF_MEASUREMENT /end GROUP
/begin GROUP CDD_FordBlaBoxIfCmn.FordResrchFctEnad.Logl "MICROSAR RTE" /begin SUB_GROUP /end SUB_GROUP /begin FUNCTION_LIST /end FUNCTION_LIST /begin REF_CHARACTERISTIC /end REF_CHARACTERISTIC /begin REF_MEASUREMENT CDD_FordBlaBoxIfCmn.FordResrchFctEnad.Logl /end REF_MEASUREMENT /end GROUP
/begin GROUP CDD_FordBlaBoxIfCmn.FordTqSteerCmpEnad.Logl "MICROSAR RTE" /begin SUB_GROUP /end SUB_GROUP /begin FUNCTION_LIST /end FUNCTION_LIST /begin REF_CHARACTERISTIC /end REF_CHARACTERISTIC /begin REF_MEASUREMENT CDD_FordBlaBoxIfCmn.FordTqSteerCmpEnad.Logl /end REF_MEASUREMENT /end GROUP
/begin GROUP CDD_FordBlaBoxIfCmn.FordTrfcJamAssiEnad.Logl "MICROSAR RTE" /begin SUB_GROUP /end SUB_GROUP /begin FUNCTION_LIST /end FUNCTION_LIST /begin REF_CHARACTERISTIC /end REF_CHARACTERISTIC /begin REF_MEASUREMENT CDD_FordBlaBoxIfCmn.FordTrfcJamAssiEnad.Logl /end REF_MEASUREMENT /end GROUP
/begin GROUP CDD_FordBlaBoxIfCmn.FordTrlrAidHitchAgRate.Val "MICROSAR RTE" /begin SUB_GROUP /end SUB_GROUP /begin FUNCTION_LIST /end FUNCTION_LIST /begin REF_CHARACTERISTIC /end REF_CHARACTERISTIC /begin REF_MEASUREMENT CDD_FordBlaBoxIfCmn.FordTrlrAidHitchAgRate.Val /end REF_MEASUREMENT /end GROUP
/begin GROUP CDD_FordBlaBoxIfCmn.FordTrlrBackupAssi5WhlEnad.Logl "MICROSAR RTE" /begin SUB_GROUP /end SUB_GROUP /begin FUNCTION_LIST /end FUNCTION_LIST /begin REF_CHARACTERISTIC /end REF_CHARACTERISTIC /begin REF_MEASUREMENT CDD_FordBlaBoxIfCmn.FordTrlrBackupAssi5WhlEnad.Logl /end REF_MEASUREMENT /end GROUP
/begin GROUP CDD_FordBlaBoxIfCmn.FordTrlrBackupAssiEnad.Logl "MICROSAR RTE" /begin SUB_GROUP /end SUB_GROUP /begin FUNCTION_LIST /end FUNCTION_LIST /begin REF_CHARACTERISTIC /end REF_CHARACTERISTIC /begin REF_MEASUREMENT CDD_FordBlaBoxIfCmn.FordTrlrBackupAssiEnad.Logl /end REF_MEASUREMENT /end GROUP
/begin GROUP CDD_FordBlaBoxIfCmn.FordTrlrBackupAssiTrigEnad.Logl "MICROSAR RTE" /begin SUB_GROUP /end SUB_GROUP /begin FUNCTION_LIST /end FUNCTION_LIST /begin REF_CHARACTERISTIC /end REF_CHARACTERISTIC /begin REF_MEASUREMENT CDD_FordBlaBoxIfCmn.FordTrlrBackupAssiTrigEnad.Logl /end REF_MEASUREMENT /end GROUP
/begin GROUP CDD_FordBlaBoxIfCmn.FordVehAbsActv.Val "MICROSAR RTE" /begin SUB_GROUP /end SUB_GROUP /begin FUNCTION_LIST /end FUNCTION_LIST /begin REF_CHARACTERISTIC /end REF_CHARACTERISTIC /begin REF_MEASUREMENT CDD_FordBlaBoxIfCmn.FordVehAbsActv.Val /end REF_MEASUREMENT /end GROUP
/begin GROUP CDD_FordBlaBoxIfCmn.FordVehAbsEscStsVld.Logl "MICROSAR RTE" /begin SUB_GROUP /end SUB_GROUP /begin FUNCTION_LIST /end FUNCTION_LIST /begin REF_CHARACTERISTIC /end REF_CHARACTERISTIC /begin REF_MEASUREMENT CDD_FordBlaBoxIfCmn.FordVehAbsEscStsVld.Logl /end REF_MEASUREMENT /end GROUP
/begin GROUP CDD_FordBlaBoxIfCmn.FordVehAccrPedlPosnStsQlyFacRaw.Val "MICROSAR RTE" /begin SUB_GROUP /end SUB_GROUP /begin FUNCTION_LIST /end FUNCTION_LIST /begin REF_CHARACTERISTIC /end REF_CHARACTERISTIC /begin REF_MEASUREMENT CDD_FordBlaBoxIfCmn.FordVehAccrPedlPosnStsQlyFacRaw.Val /end REF_MEASUREMENT /end GROUP
/begin GROUP CDD_FordBlaBoxIfCmn.FordVehAccrPedlPosnStsRaw.Val "MICROSAR RTE" /begin SUB_GROUP /end SUB_GROUP /begin FUNCTION_LIST /end FUNCTION_LIST /begin REF_CHARACTERISTIC /end REF_CHARACTERISTIC /begin REF_MEASUREMENT CDD_FordBlaBoxIfCmn.FordVehAccrPedlPosnStsRaw.Val /end REF_MEASUREMENT /end GROUP
/begin GROUP CDD_FordBlaBoxIfCmn.FordVehAccrPedlPosnStsVld.Logl "MICROSAR RTE" /begin SUB_GROUP /end SUB_GROUP /begin FUNCTION_LIST /end FUNCTION_LIST /begin REF_CHARACTERISTIC /end REF_CHARACTERISTIC /begin REF_MEASUREMENT CDD_FordBlaBoxIfCmn.FordVehAccrPedlPosnStsVld.Logl /end REF_MEASUREMENT /end GROUP
/begin GROUP CDD_FordBlaBoxIfCmn.FordVehActBrkTqRaw.Val "MICROSAR RTE" /begin SUB_GROUP /end SUB_GROUP /begin FUNCTION_LIST /end FUNCTION_LIST /begin REF_CHARACTERISTIC /end REF_CHARACTERISTIC /begin REF_MEASUREMENT CDD_FordBlaBoxIfCmn.FordVehActBrkTqRaw.Val /end REF_MEASUREMENT /end GROUP
/begin GROUP CDD_FordBlaBoxIfCmn.FordVehBlaBoxInp1HiPart.Val "MICROSAR RTE" /begin SUB_GROUP /end SUB_GROUP /begin FUNCTION_LIST /end FUNCTION_LIST /begin REF_CHARACTERISTIC /end REF_CHARACTERISTIC /begin REF_MEASUREMENT CDD_FordBlaBoxIfCmn.FordVehBlaBoxInp1HiPart.Val /end REF_MEASUREMENT /end GROUP
/begin GROUP CDD_FordBlaBoxIfCmn.FordVehBlaBoxInp1LoPart.Val "MICROSAR RTE" /begin SUB_GROUP /end SUB_GROUP /begin FUNCTION_LIST /end FUNCTION_LIST /begin REF_CHARACTERISTIC /end REF_CHARACTERISTIC /begin REF_MEASUREMENT CDD_FordBlaBoxIfCmn.FordVehBlaBoxInp1LoPart.Val /end REF_MEASUREMENT /end GROUP
/begin GROUP CDD_FordBlaBoxIfCmn.FordVehBlaBoxInp2HiPart.Val "MICROSAR RTE" /begin SUB_GROUP /end SUB_GROUP /begin FUNCTION_LIST /end FUNCTION_LIST /begin REF_CHARACTERISTIC /end REF_CHARACTERISTIC /begin REF_MEASUREMENT CDD_FordBlaBoxIfCmn.FordVehBlaBoxInp2HiPart.Val /end REF_MEASUREMENT /end GROUP
/begin GROUP CDD_FordBlaBoxIfCmn.FordVehBlaBoxInp2LoPart.Val "MICROSAR RTE" /begin SUB_GROUP /end SUB_GROUP /begin FUNCTION_LIST /end FUNCTION_LIST /begin REF_CHARACTERISTIC /end REF_CHARACTERISTIC /begin REF_MEASUREMENT CDD_FordBlaBoxIfCmn.FordVehBlaBoxInp2LoPart.Val /end REF_MEASUREMENT /end GROUP
/begin GROUP CDD_FordBlaBoxIfCmn.FordVehBlaBoxInp3HiPart.Val "MICROSAR RTE" /begin SUB_GROUP /end SUB_GROUP /begin FUNCTION_LIST /end FUNCTION_LIST /begin REF_CHARACTERISTIC /end REF_CHARACTERISTIC /begin REF_MEASUREMENT CDD_FordBlaBoxIfCmn.FordVehBlaBoxInp3HiPart.Val /end REF_MEASUREMENT /end GROUP
/begin GROUP CDD_FordBlaBoxIfCmn.FordVehBlaBoxInp3LoPart.Val "MICROSAR RTE" /begin SUB_GROUP /end SUB_GROUP /begin FUNCTION_LIST /end FUNCTION_LIST /begin REF_CHARACTERISTIC /end REF_CHARACTERISTIC /begin REF_MEASUREMENT CDD_FordBlaBoxIfCmn.FordVehBlaBoxInp3LoPart.Val /end REF_MEASUREMENT /end GROUP
/begin GROUP CDD_FordBlaBoxIfCmn.FordVehBlaBoxInp4HiPart.Val "MICROSAR RTE" /begin SUB_GROUP /end SUB_GROUP /begin FUNCTION_LIST /end FUNCTION_LIST /begin REF_CHARACTERISTIC /end REF_CHARACTERISTIC /begin REF_MEASUREMENT CDD_FordBlaBoxIfCmn.FordVehBlaBoxInp4HiPart.Val /end REF_MEASUREMENT /end GROUP
/begin GROUP CDD_FordBlaBoxIfCmn.FordVehBlaBoxInp4LoPart.Val "MICROSAR RTE" /begin SUB_GROUP /end SUB_GROUP /begin FUNCTION_LIST /end FUNCTION_LIST /begin REF_CHARACTERISTIC /end REF_CHARACTERISTIC /begin REF_MEASUREMENT CDD_FordBlaBoxIfCmn.FordVehBlaBoxInp4LoPart.Val /end REF_MEASUREMENT /end GROUP
/begin GROUP CDD_FordBlaBoxIfCmn.FordVehBrkPedlAppld.Val "MICROSAR RTE" /begin SUB_GROUP /end SUB_GROUP /begin FUNCTION_LIST /end FUNCTION_LIST /begin REF_CHARACTERISTIC /end REF_CHARACTERISTIC /begin REF_MEASUREMENT CDD_FordBlaBoxIfCmn.FordVehBrkPedlAppld.Val /end REF_MEASUREMENT /end GROUP
/begin GROUP CDD_FordBlaBoxIfCmn.FordVehBrkPedlAppldQlyFac.Val "MICROSAR RTE" /begin SUB_GROUP /end SUB_GROUP /begin FUNCTION_LIST /end FUNCTION_LIST /begin REF_CHARACTERISTIC /end REF_CHARACTERISTIC /begin REF_MEASUREMENT CDD_FordBlaBoxIfCmn.FordVehBrkPedlAppldQlyFac.Val /end REF_MEASUREMENT /end GROUP
/begin GROUP CDD_FordBlaBoxIfCmn.FordVehBrkPedlVld.Logl "MICROSAR RTE" /begin SUB_GROUP /end SUB_GROUP /begin FUNCTION_LIST /end FUNCTION_LIST /begin REF_CHARACTERISTIC /end REF_CHARACTERISTIC /begin REF_MEASUREMENT CDD_FordBlaBoxIfCmn.FordVehBrkPedlVld.Logl /end REF_MEASUREMENT /end GROUP
/begin GROUP CDD_FordBlaBoxIfCmn.FordVehBrkTqVld.Logl "MICROSAR RTE" /begin SUB_GROUP /end SUB_GROUP /begin FUNCTION_LIST /end FUNCTION_LIST /begin REF_CHARACTERISTIC /end REF_CHARACTERISTIC /begin REF_MEASUREMENT CDD_FordBlaBoxIfCmn.FordVehBrkTqVld.Logl /end REF_MEASUREMENT /end GROUP
/begin GROUP CDD_FordBlaBoxIfCmn.FordVehCllsnMtgtnByBrkgDenied.Val "MICROSAR RTE" /begin SUB_GROUP /end SUB_GROUP /begin FUNCTION_LIST /end FUNCTION_LIST /begin REF_CHARACTERISTIC /end REF_CHARACTERISTIC /begin REF_MEASUREMENT CDD_FordBlaBoxIfCmn.FordVehCllsnMtgtnByBrkgDenied.Val /end REF_MEASUREMENT /end GROUP
/begin GROUP CDD_FordBlaBoxIfCmn.FordVehCllsnMtgtnByBrkgDisad.Val "MICROSAR RTE" /begin SUB_GROUP /end SUB_GROUP /begin FUNCTION_LIST /end FUNCTION_LIST /begin REF_CHARACTERISTIC /end REF_CHARACTERISTIC /begin REF_MEASUREMENT CDD_FordBlaBoxIfCmn.FordVehCllsnMtgtnByBrkgDisad.Val /end REF_MEASUREMENT /end GROUP
/begin GROUP CDD_FordBlaBoxIfCmn.FordVehCllsnMtgtnByBrkgLatDstRaw.Val "MICROSAR RTE" /begin SUB_GROUP /end SUB_GROUP /begin FUNCTION_LIST /end FUNCTION_LIST /begin REF_CHARACTERISTIC /end REF_CHARACTERISTIC /begin REF_MEASUREMENT CDD_FordBlaBoxIfCmn.FordVehCllsnMtgtnByBrkgLatDstRaw.Val /end REF_MEASUREMENT /end GROUP
/begin GROUP CDD_FordBlaBoxIfCmn.FordVehCllsnMtgtnByBrkgLgtDstRaw.Val "MICROSAR RTE" /begin SUB_GROUP /end SUB_GROUP /begin FUNCTION_LIST /end FUNCTION_LIST /begin REF_CHARACTERISTIC /end REF_CHARACTERISTIC /begin REF_MEASUREMENT CDD_FordBlaBoxIfCmn.FordVehCllsnMtgtnByBrkgLgtDstRaw.Val /end REF_MEASUREMENT /end GROUP
/begin GROUP CDD_FordBlaBoxIfCmn.FordVehCllsnMtgtnByBrkgObjDataConfLvlRaw.Val "MICROSAR RTE" /begin SUB_GROUP /end SUB_GROUP /begin FUNCTION_LIST /end FUNCTION_LIST /begin REF_CHARACTERISTIC /end REF_CHARACTERISTIC
 /begin REF_MEASUREMENT CDD_FordBlaBoxIfCmn.FordVehCllsnMtgtnByBrkgObjDataConfLvlRaw.Val /end REF_MEASUREMENT
/end GROUP
/begin GROUP CDD_FordBlaBoxIfCmn.FordVehCllsnMtgtnByBrkgObjTypClassnRaw.Val "MICROSAR RTE" /begin SUB_GROUP /end SUB_GROUP /begin FUNCTION_LIST /end FUNCTION_LIST /begin REF_CHARACTERISTIC /end REF_CHARACTERISTIC
 /begin REF_MEASUREMENT CDD_FordBlaBoxIfCmn.FordVehCllsnMtgtnByBrkgObjTypClassnRaw.Val /end REF_MEASUREMENT
/end GROUP
/begin GROUP CDD_FordBlaBoxIfCmn.FordVehCllsnMtgtnByBrkgRelLatVelRaw.Val "MICROSAR RTE" /begin SUB_GROUP /end SUB_GROUP /begin FUNCTION_LIST /end FUNCTION_LIST /begin REF_CHARACTERISTIC /end REF_CHARACTERISTIC
 /begin REF_MEASUREMENT CDD_FordBlaBoxIfCmn.FordVehCllsnMtgtnByBrkgRelLatVelRaw.Val /end REF_MEASUREMENT
/end GROUP
/begin GROUP CDD_FordBlaBoxIfCmn.FordVehCllsnMtgtnByBrkgRelLgtVelRaw.Val "MICROSAR RTE" /begin SUB_GROUP /end SUB_GROUP /begin FUNCTION_LIST /end FUNCTION_LIST /begin REF_CHARACTERISTIC /end REF_CHARACTERISTIC
 /begin REF_MEASUREMENT CDD_FordBlaBoxIfCmn.FordVehCllsnMtgtnByBrkgRelLgtVelRaw.Val /end REF_MEASUREMENT
/end GROUP
/begin GROUP CDD_FordBlaBoxIfCmn.FordVehCllsnMtgtnByBrkgTiToCllsnRaw.Val "MICROSAR RTE" /begin SUB_GROUP /end SUB_GROUP /begin FUNCTION_LIST /end FUNCTION_LIST /begin REF_CHARACTERISTIC /end REF_CHARACTERISTIC
 /begin REF_MEASUREMENT CDD_FordBlaBoxIfCmn.FordVehCllsnMtgtnByBrkgTiToCllsnRaw.Val /end REF_MEASUREMENT
/end GROUP
/begin GROUP CDD_FordBlaBoxIfCmn.FordVehEngSpdRaw.Val "MICROSAR RTE" /begin SUB_GROUP /end SUB_GROUP /begin FUNCTION_LIST /end FUNCTION_LIST /begin REF_CHARACTERISTIC /end REF_CHARACTERISTIC /begin REF_MEASUREMENT CDD_FordBlaBoxIfCmn.FordVehEngSpdRaw.Val /end REF_MEASUREMENT /end GROUP
/begin GROUP CDD_FordBlaBoxIfCmn.FordVehEngSpdVld.Logl "MICROSAR RTE" /begin SUB_GROUP /end SUB_GROUP /begin FUNCTION_LIST /end FUNCTION_LIST /begin REF_CHARACTERISTIC /end REF_CHARACTERISTIC /begin REF_MEASUREMENT CDD_FordBlaBoxIfCmn.FordVehEngSpdVld.Logl /end REF_MEASUREMENT /end GROUP
/begin GROUP CDD_FordBlaBoxIfCmn.FordVehEscActv.Val "MICROSAR RTE" /begin SUB_GROUP /end SUB_GROUP /begin FUNCTION_LIST /end FUNCTION_LIST /begin REF_CHARACTERISTIC /end REF_CHARACTERISTIC /begin REF_MEASUREMENT CDD_FordBlaBoxIfCmn.FordVehEscActv.Val /end REF_MEASUREMENT /end GROUP
/begin GROUP CDD_FordBlaBoxIfCmn.FordVehEvasSteerAssiImgProcrModlAVld.Logl "MICROSAR RTE" /begin SUB_GROUP /end SUB_GROUP /begin FUNCTION_LIST /end FUNCTION_LIST /begin REF_CHARACTERISTIC /end REF_CHARACTERISTIC
 /begin REF_MEASUREMENT CDD_FordBlaBoxIfCmn.FordVehEvasSteerAssiImgProcrModlAVld.Logl /end REF_MEASUREMENT
/end GROUP
/begin GROUP CDD_FordBlaBoxIfCmn.FordVehEvasSteerAssiReq.Val "MICROSAR RTE" /begin SUB_GROUP /end SUB_GROUP /begin FUNCTION_LIST /end FUNCTION_LIST /begin REF_CHARACTERISTIC /end REF_CHARACTERISTIC /begin REF_MEASUREMENT CDD_FordBlaBoxIfCmn.FordVehEvasSteerAssiReq.Val /end REF_MEASUREMENT /end GROUP
/begin GROUP CDD_FordBlaBoxIfCmn.FordVehEvasSteerAssiReqVld.Logl "MICROSAR RTE" /begin SUB_GROUP /end SUB_GROUP /begin FUNCTION_LIST /end FUNCTION_LIST /begin REF_CHARACTERISTIC /end REF_CHARACTERISTIC /begin REF_MEASUREMENT CDD_FordBlaBoxIfCmn.FordVehEvasSteerAssiReqVld.Logl /end REF_MEASUREMENT /end GROUP
/begin GROUP CDD_FordBlaBoxIfCmn.FordVehFrntLeWhlCntrDirVld.Logl "MICROSAR RTE" /begin SUB_GROUP /end SUB_GROUP /begin FUNCTION_LIST /end FUNCTION_LIST /begin REF_CHARACTERISTIC /end REF_CHARACTERISTIC /begin REF_MEASUREMENT CDD_FordBlaBoxIfCmn.FordVehFrntLeWhlCntrDirVld.Logl /end REF_MEASUREMENT /end GROUP
/begin GROUP CDD_FordBlaBoxIfCmn.FordVehFrntLeWhlDirRaw.Val "MICROSAR RTE" /begin SUB_GROUP /end SUB_GROUP /begin FUNCTION_LIST /end FUNCTION_LIST /begin REF_CHARACTERISTIC /end REF_CHARACTERISTIC /begin REF_MEASUREMENT CDD_FordBlaBoxIfCmn.FordVehFrntLeWhlDirRaw.Val /end REF_MEASUREMENT /end GROUP
/begin GROUP CDD_FordBlaBoxIfCmn.FordVehFrntLeWhlRollgCntr.Val "MICROSAR RTE" /begin SUB_GROUP /end SUB_GROUP /begin FUNCTION_LIST /end FUNCTION_LIST /begin REF_CHARACTERISTIC /end REF_CHARACTERISTIC /begin REF_MEASUREMENT CDD_FordBlaBoxIfCmn.FordVehFrntLeWhlRollgCntr.Val /end REF_MEASUREMENT /end GROUP
/begin GROUP CDD_FordBlaBoxIfCmn.FordVehFrntLeWhlSpdRaw.Val "MICROSAR RTE" /begin SUB_GROUP /end SUB_GROUP /begin FUNCTION_LIST /end FUNCTION_LIST /begin REF_CHARACTERISTIC /end REF_CHARACTERISTIC /begin REF_MEASUREMENT CDD_FordBlaBoxIfCmn.FordVehFrntLeWhlSpdRaw.Val /end REF_MEASUREMENT /end GROUP
/begin GROUP CDD_FordBlaBoxIfCmn.FordVehFrntLeWhlSpdVld.Logl "MICROSAR RTE" /begin SUB_GROUP /end SUB_GROUP /begin FUNCTION_LIST /end FUNCTION_LIST /begin REF_CHARACTERISTIC /end REF_CHARACTERISTIC /begin REF_MEASUREMENT CDD_FordBlaBoxIfCmn.FordVehFrntLeWhlSpdVld.Logl /end REF_MEASUREMENT /end GROUP
/begin GROUP CDD_FordBlaBoxIfCmn.FordVehFrntRiWhlCntrDirVld.Logl "MICROSAR RTE" /begin SUB_GROUP /end SUB_GROUP /begin FUNCTION_LIST /end FUNCTION_LIST /begin REF_CHARACTERISTIC /end REF_CHARACTERISTIC /begin REF_MEASUREMENT CDD_FordBlaBoxIfCmn.FordVehFrntRiWhlCntrDirVld.Logl /end REF_MEASUREMENT /end GROUP
/begin GROUP CDD_FordBlaBoxIfCmn.FordVehFrntRiWhlDirRaw.Val "MICROSAR RTE" /begin SUB_GROUP /end SUB_GROUP /begin FUNCTION_LIST /end FUNCTION_LIST /begin REF_CHARACTERISTIC /end REF_CHARACTERISTIC /begin REF_MEASUREMENT CDD_FordBlaBoxIfCmn.FordVehFrntRiWhlDirRaw.Val /end REF_MEASUREMENT /end GROUP
/begin GROUP CDD_FordBlaBoxIfCmn.FordVehFrntRiWhlRollgCntr.Val "MICROSAR RTE" /begin SUB_GROUP /end SUB_GROUP /begin FUNCTION_LIST /end FUNCTION_LIST /begin REF_CHARACTERISTIC /end REF_CHARACTERISTIC /begin REF_MEASUREMENT CDD_FordBlaBoxIfCmn.FordVehFrntRiWhlRollgCntr.Val /end REF_MEASUREMENT /end GROUP
/begin GROUP CDD_FordBlaBoxIfCmn.FordVehFrntRiWhlSpdRaw.Val "MICROSAR RTE" /begin SUB_GROUP /end SUB_GROUP /begin FUNCTION_LIST /end FUNCTION_LIST /begin REF_CHARACTERISTIC /end REF_CHARACTERISTIC /begin REF_MEASUREMENT CDD_FordBlaBoxIfCmn.FordVehFrntRiWhlSpdRaw.Val /end REF_MEASUREMENT /end GROUP
/begin GROUP CDD_FordBlaBoxIfCmn.FordVehFrntRiWhlSpdVld.Logl "MICROSAR RTE" /begin SUB_GROUP /end SUB_GROUP /begin FUNCTION_LIST /end FUNCTION_LIST /begin REF_CHARACTERISTIC /end REF_CHARACTERISTIC /begin REF_MEASUREMENT CDD_FordBlaBoxIfCmn.FordVehFrntRiWhlSpdVld.Logl /end REF_MEASUREMENT /end GROUP
/begin GROUP CDD_FordBlaBoxIfCmn.FordVehGearLvrPosn.Val "MICROSAR RTE" /begin SUB_GROUP /end SUB_GROUP /begin FUNCTION_LIST /end FUNCTION_LIST /begin REF_CHARACTERISTIC /end REF_CHARACTERISTIC /begin REF_MEASUREMENT CDD_FordBlaBoxIfCmn.FordVehGearLvrPosn.Val /end REF_MEASUREMENT /end GROUP
/begin GROUP CDD_FordBlaBoxIfCmn.FordVehGearLvrPosnVldInt.Logl "MICROSAR RTE" /begin SUB_GROUP /end SUB_GROUP /begin FUNCTION_LIST /end FUNCTION_LIST /begin REF_CHARACTERISTIC /end REF_CHARACTERISTIC /begin REF_MEASUREMENT CDD_FordBlaBoxIfCmn.FordVehGearLvrPosnVldInt.Logl /end REF_MEASUREMENT /end GROUP
/begin GROUP CDD_FordBlaBoxIfCmn.FordVehGearPosnRaw.Val "MICROSAR RTE" /begin SUB_GROUP /end SUB_GROUP /begin FUNCTION_LIST /end FUNCTION_LIST /begin REF_CHARACTERISTIC /end REF_CHARACTERISTIC /begin REF_MEASUREMENT CDD_FordBlaBoxIfCmn.FordVehGearPosnRaw.Val /end REF_MEASUREMENT /end GROUP
/begin GROUP CDD_FordBlaBoxIfCmn.FordVehGearRvsStsRaw.Val "MICROSAR RTE" /begin SUB_GROUP /end SUB_GROUP /begin FUNCTION_LIST /end FUNCTION_LIST /begin REF_CHARACTERISTIC /end REF_CHARACTERISTIC /begin REF_MEASUREMENT CDD_FordBlaBoxIfCmn.FordVehGearRvsStsRaw.Val /end REF_MEASUREMENT /end GROUP
/begin GROUP CDD_FordBlaBoxIfCmn.FordVehGearRvsStsVld.Logl "MICROSAR RTE" /begin SUB_GROUP /end SUB_GROUP /begin FUNCTION_LIST /end FUNCTION_LIST /begin REF_CHARACTERISTIC /end REF_CHARACTERISTIC /begin REF_MEASUREMENT CDD_FordBlaBoxIfCmn.FordVehGearRvsStsVld.Logl /end REF_MEASUREMENT /end GROUP
/begin GROUP CDD_FordBlaBoxIfCmn.FordVehIgnSts.Val "MICROSAR RTE" /begin SUB_GROUP /end SUB_GROUP /begin FUNCTION_LIST /end FUNCTION_LIST /begin REF_CHARACTERISTIC /end REF_CHARACTERISTIC /begin REF_MEASUREMENT CDD_FordBlaBoxIfCmn.FordVehIgnSts.Val /end REF_MEASUREMENT /end GROUP
/begin GROUP CDD_FordBlaBoxIfCmn.FordVehIgnStsVld.Logl "MICROSAR RTE" /begin SUB_GROUP /end SUB_GROUP /begin FUNCTION_LIST /end FUNCTION_LIST /begin REF_CHARACTERISTIC /end REF_CHARACTERISTIC /begin REF_MEASUREMENT CDD_FordBlaBoxIfCmn.FordVehIgnStsVld.Logl /end REF_MEASUREMENT /end GROUP
/begin GROUP CDD_FordBlaBoxIfCmn.FordVehLaneAssiImgProcgModlAVld.Logl "MICROSAR RTE" /begin SUB_GROUP /end SUB_GROUP /begin FUNCTION_LIST /end FUNCTION_LIST /begin REF_CHARACTERISTIC /end REF_CHARACTERISTIC /begin REF_MEASUREMENT CDD_FordBlaBoxIfCmn.FordVehLaneAssiImgProcgModlAVld.Logl /end REF_MEASUREMENT /end GROUP
/begin GROUP CDD_FordBlaBoxIfCmn.FordVehLaneDetnWarnInten.Val "MICROSAR RTE" /begin SUB_GROUP /end SUB_GROUP /begin FUNCTION_LIST /end FUNCTION_LIST /begin REF_CHARACTERISTIC /end REF_CHARACTERISTIC /begin REF_MEASUREMENT CDD_FordBlaBoxIfCmn.FordVehLaneDetnWarnInten.Val /end REF_MEASUREMENT /end GROUP
/begin GROUP CDD_FordBlaBoxIfCmn.FordVehLaneDetnWarnSts.Val "MICROSAR RTE" /begin SUB_GROUP /end SUB_GROUP /begin FUNCTION_LIST /end FUNCTION_LIST /begin REF_CHARACTERISTIC /end REF_CHARACTERISTIC /begin REF_MEASUREMENT CDD_FordBlaBoxIfCmn.FordVehLaneDetnWarnSts.Val /end REF_MEASUREMENT /end GROUP
/begin GROUP CDD_FordBlaBoxIfCmn.FordVehLaneKeepSysCrvtRaw.Val "MICROSAR RTE" /begin SUB_GROUP /end SUB_GROUP /begin FUNCTION_LIST /end FUNCTION_LIST /begin REF_CHARACTERISTIC /end REF_CHARACTERISTIC /begin REF_MEASUREMENT CDD_FordBlaBoxIfCmn.FordVehLaneKeepSysCrvtRaw.Val /end REF_MEASUREMENT /end GROUP
/begin GROUP CDD_FordBlaBoxIfCmn.FordVehLaneKeepSysRampTyp.Val "MICROSAR RTE" /begin SUB_GROUP /end SUB_GROUP /begin FUNCTION_LIST /end FUNCTION_LIST /begin REF_CHARACTERISTIC /end REF_CHARACTERISTIC /begin REF_MEASUREMENT CDD_FordBlaBoxIfCmn.FordVehLaneKeepSysRampTyp.Val /end REF_MEASUREMENT /end GROUP
/begin GROUP CDD_FordBlaBoxIfCmn.FordVehLaneKeepSysReqdAgRaw.Val "MICROSAR RTE" /begin SUB_GROUP /end SUB_GROUP /begin FUNCTION_LIST /end FUNCTION_LIST /begin REF_CHARACTERISTIC /end REF_CHARACTERISTIC /begin REF_MEASUREMENT CDD_FordBlaBoxIfCmn.FordVehLaneKeepSysReqdAgRaw.Val /end REF_MEASUREMENT /end GROUP
/begin GROUP CDD_FordBlaBoxIfCmn.FordVehLaneKeepSysSts.Val "MICROSAR RTE" /begin SUB_GROUP /end SUB_GROUP /begin FUNCTION_LIST /end FUNCTION_LIST /begin REF_CHARACTERISTIC /end REF_CHARACTERISTIC /begin REF_MEASUREMENT CDD_FordBlaBoxIfCmn.FordVehLaneKeepSysSts.Val /end REF_MEASUREMENT /end GROUP
/begin GROUP CDD_FordBlaBoxIfCmn.FordVehLatACmpdRaw.Val "MICROSAR RTE" /begin SUB_GROUP /end SUB_GROUP /begin FUNCTION_LIST /end FUNCTION_LIST /begin REF_CHARACTERISTIC /end REF_CHARACTERISTIC /begin REF_MEASUREMENT CDD_FordBlaBoxIfCmn.FordVehLatACmpdRaw.Val /end REF_MEASUREMENT /end GROUP
/begin GROUP CDD_FordBlaBoxIfCmn.FordVehLatACmpdVld.Logl "MICROSAR RTE" /begin SUB_GROUP /end SUB_GROUP /begin FUNCTION_LIST /end FUNCTION_LIST /begin REF_CHARACTERISTIC /end REF_CHARACTERISTIC /begin REF_MEASUREMENT CDD_FordBlaBoxIfCmn.FordVehLatACmpdVld.Logl /end REF_MEASUREMENT /end GROUP
/begin GROUP CDD_FordBlaBoxIfCmn.FordVehLatCtrlCrvtRateRaw.Val "MICROSAR RTE" /begin SUB_GROUP /end SUB_GROUP /begin FUNCTION_LIST /end FUNCTION_LIST /begin REF_CHARACTERISTIC /end REF_CHARACTERISTIC /begin REF_MEASUREMENT CDD_FordBlaBoxIfCmn.FordVehLatCtrlCrvtRateRaw.Val /end REF_MEASUREMENT /end GROUP
/begin GROUP CDD_FordBlaBoxIfCmn.FordVehLatCtrlCrvtRaw.Val "MICROSAR RTE" /begin SUB_GROUP /end SUB_GROUP /begin FUNCTION_LIST /end FUNCTION_LIST /begin REF_CHARACTERISTIC /end REF_CHARACTERISTIC /begin REF_MEASUREMENT CDD_FordBlaBoxIfCmn.FordVehLatCtrlCrvtRaw.Val /end REF_MEASUREMENT /end GROUP
/begin GROUP CDD_FordBlaBoxIfCmn.FordVehLatCtrlHandsOffDetnTqStimlsReq.Val "MICROSAR RTE" /begin SUB_GROUP /end SUB_GROUP /begin FUNCTION_LIST /end FUNCTION_LIST /begin REF_CHARACTERISTIC /end REF_CHARACTERISTIC
 /begin REF_MEASUREMENT CDD_FordBlaBoxIfCmn.FordVehLatCtrlHandsOffDetnTqStimlsReq.Val /end REF_MEASUREMENT
/end GROUP
/begin GROUP CDD_FordBlaBoxIfCmn.FordVehLatCtrlImgProcrModlAVld.Logl "MICROSAR RTE" /begin SUB_GROUP /end SUB_GROUP /begin FUNCTION_LIST /end FUNCTION_LIST /begin REF_CHARACTERISTIC /end REF_CHARACTERISTIC /begin REF_MEASUREMENT CDD_FordBlaBoxIfCmn.FordVehLatCtrlImgProcrModlAVld.Logl /end REF_MEASUREMENT /end GROUP
/begin GROUP CDD_FordBlaBoxIfCmn.FordVehLatCtrlPahOffsRaw.Val "MICROSAR RTE" /begin SUB_GROUP /end SUB_GROUP /begin FUNCTION_LIST /end FUNCTION_LIST /begin REF_CHARACTERISTIC /end REF_CHARACTERISTIC /begin REF_MEASUREMENT CDD_FordBlaBoxIfCmn.FordVehLatCtrlPahOffsRaw.Val /end REF_MEASUREMENT /end GROUP
/begin GROUP CDD_FordBlaBoxIfCmn.FordVehLatCtrlPahRaw.Val "MICROSAR RTE" /begin SUB_GROUP /end SUB_GROUP /begin FUNCTION_LIST /end FUNCTION_LIST /begin REF_CHARACTERISTIC /end REF_CHARACTERISTIC /begin REF_MEASUREMENT CDD_FordBlaBoxIfCmn.FordVehLatCtrlPahRaw.Val /end REF_MEASUREMENT /end GROUP
/begin GROUP CDD_FordBlaBoxIfCmn.FordVehLatCtrlPrcsn.Val "MICROSAR RTE" /begin SUB_GROUP /end SUB_GROUP /begin FUNCTION_LIST /end FUNCTION_LIST /begin REF_CHARACTERISTIC /end REF_CHARACTERISTIC /begin REF_MEASUREMENT CDD_FordBlaBoxIfCmn.FordVehLatCtrlPrcsn.Val /end REF_MEASUREMENT /end GROUP
/begin GROUP CDD_FordBlaBoxIfCmn.FordVehLatCtrlRampTyp.Val "MICROSAR RTE" /begin SUB_GROUP /end SUB_GROUP /begin FUNCTION_LIST /end FUNCTION_LIST /begin REF_CHARACTERISTIC /end REF_CHARACTERISTIC /begin REF_MEASUREMENT CDD_FordBlaBoxIfCmn.FordVehLatCtrlRampTyp.Val /end REF_MEASUREMENT /end GROUP
/begin GROUP CDD_FordBlaBoxIfCmn.FordVehLatCtrlReq.Val "MICROSAR RTE" /begin SUB_GROUP /end SUB_GROUP /begin FUNCTION_LIST /end FUNCTION_LIST /begin REF_CHARACTERISTIC /end REF_CHARACTERISTIC /begin REF_MEASUREMENT CDD_FordBlaBoxIfCmn.FordVehLatCtrlReq.Val /end REF_MEASUREMENT /end GROUP
/begin GROUP CDD_FordBlaBoxIfCmn.FordVehLatCtrlRingMax.Val "MICROSAR RTE" /begin SUB_GROUP /end SUB_GROUP /begin FUNCTION_LIST /end FUNCTION_LIST /begin REF_CHARACTERISTIC /end REF_CHARACTERISTIC /begin REF_MEASUREMENT CDD_FordBlaBoxIfCmn.FordVehLatCtrlRingMax.Val /end REF_MEASUREMENT /end GROUP
/begin GROUP CDD_FordBlaBoxIfCmn.FordVehLgtACmpdRaw.Val "MICROSAR RTE" /begin SUB_GROUP /end SUB_GROUP /begin FUNCTION_LIST /end FUNCTION_LIST /begin REF_CHARACTERISTIC /end REF_CHARACTERISTIC /begin REF_MEASUREMENT CDD_FordBlaBoxIfCmn.FordVehLgtACmpdRaw.Val /end REF_MEASUREMENT /end GROUP
/begin GROUP CDD_FordBlaBoxIfCmn.FordVehLgtACmpdVld.Logl "MICROSAR RTE" /begin SUB_GROUP /end SUB_GROUP /begin FUNCTION_LIST /end FUNCTION_LIST /begin REF_CHARACTERISTIC /end REF_CHARACTERISTIC /begin REF_MEASUREMENT CDD_FordBlaBoxIfCmn.FordVehLgtACmpdVld.Logl /end REF_MEASUREMENT /end GROUP
/begin GROUP CDD_FordBlaBoxIfCmn.FordVehLoSpdMtnCtrlBrkSprtStsRaw.Val "MICROSAR RTE" /begin SUB_GROUP /end SUB_GROUP /begin FUNCTION_LIST /end FUNCTION_LIST /begin REF_CHARACTERISTIC /end REF_CHARACTERISTIC /begin REF_MEASUREMENT CDD_FordBlaBoxIfCmn.FordVehLoSpdMtnCtrlBrkSprtStsRaw.Val /end REF_MEASUREMENT /end GROUP
/begin GROUP CDD_FordBlaBoxIfCmn.FordVehLoSpdMtnCtrlBrkSprtVld.Logl "MICROSAR RTE" /begin SUB_GROUP /end SUB_GROUP /begin FUNCTION_LIST /end FUNCTION_LIST /begin REF_CHARACTERISTIC /end REF_CHARACTERISTIC /begin REF_MEASUREMENT CDD_FordBlaBoxIfCmn.FordVehLoSpdMtnCtrlBrkSprtVld.Logl /end REF_MEASUREMENT /end GROUP
/begin GROUP CDD_FordBlaBoxIfCmn.FordVehParkAidModlStsVld.Logl "MICROSAR RTE" /begin SUB_GROUP /end SUB_GROUP /begin FUNCTION_LIST /end FUNCTION_LIST /begin REF_CHARACTERISTIC /end REF_CHARACTERISTIC /begin REF_MEASUREMENT CDD_FordBlaBoxIfCmn.FordVehParkAidModlStsVld.Logl /end REF_MEASUREMENT /end GROUP
/begin GROUP CDD_FordBlaBoxIfCmn.FordVehParkAidModlSysSt.Val "MICROSAR RTE" /begin SUB_GROUP /end SUB_GROUP /begin FUNCTION_LIST /end FUNCTION_LIST /begin REF_CHARACTERISTIC /end REF_CHARACTERISTIC /begin REF_MEASUREMENT CDD_FordBlaBoxIfCmn.FordVehParkAidModlSysSt.Val /end REF_MEASUREMENT /end GROUP
/begin GROUP CDD_FordBlaBoxIfCmn.FordVehPrpnWhlTqRaw.Val "MICROSAR RTE" /begin SUB_GROUP /end SUB_GROUP /begin FUNCTION_LIST /end FUNCTION_LIST /begin REF_CHARACTERISTIC /end REF_CHARACTERISTIC /begin REF_MEASUREMENT CDD_FordBlaBoxIfCmn.FordVehPrpnWhlTqRaw.Val /end REF_MEASUREMENT /end GROUP
/begin GROUP CDD_FordBlaBoxIfCmn.FordVehPrpnWhlTqVld.Logl "MICROSAR RTE" /begin SUB_GROUP /end SUB_GROUP /begin FUNCTION_LIST /end FUNCTION_LIST /begin REF_CHARACTERISTIC /end REF_CHARACTERISTIC /begin REF_MEASUREMENT CDD_FordBlaBoxIfCmn.FordVehPrpnWhlTqVld.Logl /end REF_MEASUREMENT /end GROUP
/begin GROUP CDD_FordBlaBoxIfCmn.FordVehReLeWhlCntrDirVld.Logl "MICROSAR RTE" /begin SUB_GROUP /end SUB_GROUP /begin FUNCTION_LIST /end FUNCTION_LIST /begin REF_CHARACTERISTIC /end REF_CHARACTERISTIC /begin REF_MEASUREMENT CDD_FordBlaBoxIfCmn.FordVehReLeWhlCntrDirVld.Logl /end REF_MEASUREMENT /end GROUP
/begin GROUP CDD_FordBlaBoxIfCmn.FordVehReLeWhlDirRaw.Val "MICROSAR RTE" /begin SUB_GROUP /end SUB_GROUP /begin FUNCTION_LIST /end FUNCTION_LIST /begin REF_CHARACTERISTIC /end REF_CHARACTERISTIC /begin REF_MEASUREMENT CDD_FordBlaBoxIfCmn.FordVehReLeWhlDirRaw.Val /end REF_MEASUREMENT /end GROUP
/begin GROUP CDD_FordBlaBoxIfCmn.FordVehReLeWhlRollgCntr.Val "MICROSAR RTE" /begin SUB_GROUP /end SUB_GROUP /begin FUNCTION_LIST /end FUNCTION_LIST /begin REF_CHARACTERISTIC /end REF_CHARACTERISTIC /begin REF_MEASUREMENT CDD_FordBlaBoxIfCmn.FordVehReLeWhlRollgCntr.Val /end REF_MEASUREMENT /end GROUP
/begin GROUP CDD_FordBlaBoxIfCmn.FordVehReLeWhlSpdRaw.Val "MICROSAR RTE" /begin SUB_GROUP /end SUB_GROUP /begin FUNCTION_LIST /end FUNCTION_LIST /begin REF_CHARACTERISTIC /end REF_CHARACTERISTIC /begin REF_MEASUREMENT CDD_FordBlaBoxIfCmn.FordVehReLeWhlSpdRaw.Val /end REF_MEASUREMENT /end GROUP
/begin GROUP CDD_FordBlaBoxIfCmn.FordVehReLeWhlSpdVld.Logl "MICROSAR RTE" /begin SUB_GROUP /end SUB_GROUP /begin FUNCTION_LIST /end FUNCTION_LIST /begin REF_CHARACTERISTIC /end REF_CHARACTERISTIC /begin REF_MEASUREMENT CDD_FordBlaBoxIfCmn.FordVehReLeWhlSpdVld.Logl /end REF_MEASUREMENT /end GROUP
/begin GROUP CDD_FordBlaBoxIfCmn.FordVehReRiWhlCntrDirVld.Logl "MICROSAR RTE" /begin SUB_GROUP /end SUB_GROUP /begin FUNCTION_LIST /end FUNCTION_LIST /begin REF_CHARACTERISTIC /end REF_CHARACTERISTIC /begin REF_MEASUREMENT CDD_FordBlaBoxIfCmn.FordVehReRiWhlCntrDirVld.Logl /end REF_MEASUREMENT /end GROUP
/begin GROUP CDD_FordBlaBoxIfCmn.FordVehReRiWhlDirRaw.Val "MICROSAR RTE" /begin SUB_GROUP /end SUB_GROUP /begin FUNCTION_LIST /end FUNCTION_LIST /begin REF_CHARACTERISTIC /end REF_CHARACTERISTIC /begin REF_MEASUREMENT CDD_FordBlaBoxIfCmn.FordVehReRiWhlDirRaw.Val /end REF_MEASUREMENT /end GROUP
/begin GROUP CDD_FordBlaBoxIfCmn.FordVehReRiWhlRollgCntr.Val "MICROSAR RTE" /begin SUB_GROUP /end SUB_GROUP /begin FUNCTION_LIST /end FUNCTION_LIST /begin REF_CHARACTERISTIC /end REF_CHARACTERISTIC /begin REF_MEASUREMENT CDD_FordBlaBoxIfCmn.FordVehReRiWhlRollgCntr.Val /end REF_MEASUREMENT /end GROUP
/begin GROUP CDD_FordBlaBoxIfCmn.FordVehReRiWhlSpdRaw.Val "MICROSAR RTE" /begin SUB_GROUP /end SUB_GROUP /begin FUNCTION_LIST /end FUNCTION_LIST /begin REF_CHARACTERISTIC /end REF_CHARACTERISTIC /begin REF_MEASUREMENT CDD_FordBlaBoxIfCmn.FordVehReRiWhlSpdRaw.Val /end REF_MEASUREMENT /end GROUP
/begin GROUP CDD_FordBlaBoxIfCmn.FordVehReRiWhlSpdVld.Logl "MICROSAR RTE" /begin SUB_GROUP /end SUB_GROUP /begin FUNCTION_LIST /end FUNCTION_LIST /begin REF_CHARACTERISTIC /end REF_CHARACTERISTIC /begin REF_MEASUREMENT CDD_FordBlaBoxIfCmn.FordVehReRiWhlSpdVld.Logl /end REF_MEASUREMENT /end GROUP
/begin GROUP CDD_FordBlaBoxIfCmn.FordVehSelDrvModChassisVld.Logl "MICROSAR RTE" /begin SUB_GROUP /end SUB_GROUP /begin FUNCTION_LIST /end FUNCTION_LIST /begin REF_CHARACTERISTIC /end REF_CHARACTERISTIC /begin REF_MEASUREMENT CDD_FordBlaBoxIfCmn.FordVehSelDrvModChassisVld.Logl /end REF_MEASUREMENT /end GROUP
/begin GROUP CDD_FordBlaBoxIfCmn.FordVehSpd.Val "MICROSAR RTE" /begin SUB_GROUP /end SUB_GROUP /begin FUNCTION_LIST /end FUNCTION_LIST /begin REF_CHARACTERISTIC /end REF_CHARACTERISTIC /begin REF_MEASUREMENT CDD_FordBlaBoxIfCmn.FordVehSpd.Val /end REF_MEASUREMENT /end GROUP
/begin GROUP CDD_FordBlaBoxIfCmn.FordVehSpdBrkModlRaw.Val "MICROSAR RTE" /begin SUB_GROUP /end SUB_GROUP /begin FUNCTION_LIST /end FUNCTION_LIST /begin REF_CHARACTERISTIC /end REF_CHARACTERISTIC /begin REF_MEASUREMENT CDD_FordBlaBoxIfCmn.FordVehSpdBrkModlRaw.Val /end REF_MEASUREMENT /end GROUP
/begin GROUP CDD_FordBlaBoxIfCmn.FordVehSpdOverGndRaw.Val "MICROSAR RTE" /begin SUB_GROUP /end SUB_GROUP /begin FUNCTION_LIST /end FUNCTION_LIST /begin REF_CHARACTERISTIC /end REF_CHARACTERISTIC /begin REF_MEASUREMENT CDD_FordBlaBoxIfCmn.FordVehSpdOverGndRaw.Val /end REF_MEASUREMENT /end GROUP
/begin GROUP CDD_FordBlaBoxIfCmn.FordVehSpdOverGndVld.Logl "MICROSAR RTE" /begin SUB_GROUP /end SUB_GROUP /begin FUNCTION_LIST /end FUNCTION_LIST /begin REF_CHARACTERISTIC /end REF_CHARACTERISTIC /begin REF_MEASUREMENT CDD_FordBlaBoxIfCmn.FordVehSpdOverGndVld.Logl /end REF_MEASUREMENT /end GROUP
/begin GROUP CDD_FordBlaBoxIfCmn.FordVehSteerPinionAgOffsRaw.Val "MICROSAR RTE" /begin SUB_GROUP /end SUB_GROUP /begin FUNCTION_LIST /end FUNCTION_LIST /begin REF_CHARACTERISTIC /end REF_CHARACTERISTIC /begin REF_MEASUREMENT CDD_FordBlaBoxIfCmn.FordVehSteerPinionAgOffsRaw.Val /end REF_MEASUREMENT /end GROUP
/begin GROUP CDD_FordBlaBoxIfCmn.FordVehSteerPinionAgOffsVld.Logl "MICROSAR RTE" /begin SUB_GROUP /end SUB_GROUP /begin FUNCTION_LIST /end FUNCTION_LIST /begin REF_CHARACTERISTIC /end REF_CHARACTERISTIC /begin REF_MEASUREMENT CDD_FordBlaBoxIfCmn.FordVehSteerPinionAgOffsVld.Logl /end REF_MEASUREMENT /end GROUP
/begin GROUP CDD_FordBlaBoxIfCmn.FordVehSteerPinionOffsStsRaw.Val "MICROSAR RTE" /begin SUB_GROUP /end SUB_GROUP /begin FUNCTION_LIST /end FUNCTION_LIST /begin REF_CHARACTERISTIC /end REF_CHARACTERISTIC /begin REF_MEASUREMENT CDD_FordBlaBoxIfCmn.FordVehSteerPinionOffsStsRaw.Val /end REF_MEASUREMENT /end GROUP
/begin GROUP CDD_FordBlaBoxIfCmn.FordVehTireCircum.Val "MICROSAR RTE" /begin SUB_GROUP /end SUB_GROUP /begin FUNCTION_LIST /end FUNCTION_LIST /begin REF_CHARACTERISTIC /end REF_CHARACTERISTIC /begin REF_MEASUREMENT CDD_FordBlaBoxIfCmn.FordVehTireCircum.Val /end REF_MEASUREMENT /end GROUP
/begin GROUP CDD_FordBlaBoxIfCmn.FordVehTrlrAgOffsDirRaw.Val "MICROSAR RTE" /begin SUB_GROUP /end SUB_GROUP /begin FUNCTION_LIST /end FUNCTION_LIST /begin REF_CHARACTERISTIC /end REF_CHARACTERISTIC /begin REF_MEASUREMENT CDD_FordBlaBoxIfCmn.FordVehTrlrAgOffsDirRaw.Val /end REF_MEASUREMENT /end GROUP
/begin GROUP CDD_FordBlaBoxIfCmn.FordVehTrlrAidAcqSts.Val "MICROSAR RTE" /begin SUB_GROUP /end SUB_GROUP /begin FUNCTION_LIST /end FUNCTION_LIST /begin REF_CHARACTERISTIC /end REF_CHARACTERISTIC /begin REF_MEASUREMENT CDD_FordBlaBoxIfCmn.FordVehTrlrAidAcqSts.Val /end REF_MEASUREMENT /end GROUP
/begin GROUP CDD_FordBlaBoxIfCmn.FordVehTrlrAidAvlRaw.Val "MICROSAR RTE" /begin SUB_GROUP /end SUB_GROUP /begin FUNCTION_LIST /end FUNCTION_LIST /begin REF_CHARACTERISTIC /end REF_CHARACTERISTIC /begin REF_MEASUREMENT CDD_FordBlaBoxIfCmn.FordVehTrlrAidAvlRaw.Val /end REF_MEASUREMENT /end GROUP
/begin GROUP CDD_FordBlaBoxIfCmn.FordVehTrlrAidCnclReq.Val "MICROSAR RTE" /begin SUB_GROUP /end SUB_GROUP /begin FUNCTION_LIST /end FUNCTION_LIST /begin REF_CHARACTERISTIC /end REF_CHARACTERISTIC /begin REF_MEASUREMENT CDD_FordBlaBoxIfCmn.FordVehTrlrAidCnclReq.Val /end REF_MEASUREMENT /end GROUP
/begin GROUP CDD_FordBlaBoxIfCmn.FordVehTrlrAidCnclReqVld.Logl "MICROSAR RTE" /begin SUB_GROUP /end SUB_GROUP /begin FUNCTION_LIST /end FUNCTION_LIST /begin REF_CHARACTERISTIC /end REF_CHARACTERISTIC /begin REF_MEASUREMENT CDD_FordBlaBoxIfCmn.FordVehTrlrAidCnclReqVld.Logl /end REF_MEASUREMENT /end GROUP
/begin GROUP CDD_FordBlaBoxIfCmn.FordVehTrlrAidHitchAg.Val "MICROSAR RTE" /begin SUB_GROUP /end SUB_GROUP /begin FUNCTION_LIST /end FUNCTION_LIST /begin REF_CHARACTERISTIC /end REF_CHARACTERISTIC /begin REF_MEASUREMENT CDD_FordBlaBoxIfCmn.FordVehTrlrAidHitchAg.Val /end REF_MEASUREMENT /end GROUP
/begin GROUP CDD_FordBlaBoxIfCmn.FordVehTrlrAidIdnNrRaw.Val "MICROSAR RTE" /begin SUB_GROUP /end SUB_GROUP /begin FUNCTION_LIST /end FUNCTION_LIST /begin REF_CHARACTERISTIC /end REF_CHARACTERISTIC /begin REF_MEASUREMENT CDD_FordBlaBoxIfCmn.FordVehTrlrAidIdnNrRaw.Val /end REF_MEASUREMENT /end GROUP
/begin GROUP CDD_FordBlaBoxIfCmn.FordVehTrlrAidIdnVal.Val "MICROSAR RTE" /begin SUB_GROUP /end SUB_GROUP /begin FUNCTION_LIST /end FUNCTION_LIST /begin REF_CHARACTERISTIC /end REF_CHARACTERISTIC /begin REF_MEASUREMENT CDD_FordBlaBoxIfCmn.FordVehTrlrAidIdnVal.Val /end REF_MEASUREMENT /end GROUP
/begin GROUP CDD_FordBlaBoxIfCmn.FordVehTrlrAidKnobBtn.Val "MICROSAR RTE" /begin SUB_GROUP /end SUB_GROUP /begin FUNCTION_LIST /end FUNCTION_LIST /begin REF_CHARACTERISTIC /end REF_CHARACTERISTIC /begin REF_MEASUREMENT CDD_FordBlaBoxIfCmn.FordVehTrlrAidKnobBtn.Val /end REF_MEASUREMENT /end GROUP
/begin GROUP CDD_FordBlaBoxIfCmn.FordVehTrlrAidKnobPosn.Val "MICROSAR RTE" /begin SUB_GROUP /end SUB_GROUP /begin FUNCTION_LIST /end FUNCTION_LIST /begin REF_CHARACTERISTIC /end REF_CHARACTERISTIC /begin REF_MEASUREMENT CDD_FordBlaBoxIfCmn.FordVehTrlrAidKnobPosn.Val /end REF_MEASUREMENT /end GROUP
/begin GROUP CDD_FordBlaBoxIfCmn.FordVehTrlrAidKnobPosnVld.Logl "MICROSAR RTE" /begin SUB_GROUP /end SUB_GROUP /begin FUNCTION_LIST /end FUNCTION_LIST /begin REF_CHARACTERISTIC /end REF_CHARACTERISTIC /begin REF_MEASUREMENT CDD_FordBlaBoxIfCmn.FordVehTrlrAidKnobPosnVld.Logl /end REF_MEASUREMENT /end GROUP
/begin GROUP CDD_FordBlaBoxIfCmn.FordVehTrlrAidKnobStsVld.Logl "MICROSAR RTE" /begin SUB_GROUP /end SUB_GROUP /begin FUNCTION_LIST /end FUNCTION_LIST /begin REF_CHARACTERISTIC /end REF_CHARACTERISTIC /begin REF_MEASUREMENT CDD_FordBlaBoxIfCmn.FordVehTrlrAidKnobStsVld.Logl /end REF_MEASUREMENT /end GROUP
/begin GROUP CDD_FordBlaBoxIfCmn.FordVehTrlrAidModReq.Val "MICROSAR RTE" /begin SUB_GROUP /end SUB_GROUP /begin FUNCTION_LIST /end FUNCTION_LIST /begin REF_CHARACTERISTIC /end REF_CHARACTERISTIC /begin REF_MEASUREMENT CDD_FordBlaBoxIfCmn.FordVehTrlrAidModReq.Val /end REF_MEASUREMENT /end GROUP
/begin GROUP CDD_FordBlaBoxIfCmn.FordVehTrlrAidModReqVld.Logl "MICROSAR RTE" /begin SUB_GROUP /end SUB_GROUP /begin FUNCTION_LIST /end FUNCTION_LIST /begin REF_CHARACTERISTIC /end REF_CHARACTERISTIC /begin REF_MEASUREMENT CDD_FordBlaBoxIfCmn.FordVehTrlrAidModReqVld.Logl /end REF_MEASUREMENT /end GROUP
/begin GROUP CDD_FordBlaBoxIfCmn.FordVehTrlrAidSetUpRaw.Val "MICROSAR RTE" /begin SUB_GROUP /end SUB_GROUP /begin FUNCTION_LIST /end FUNCTION_LIST /begin REF_CHARACTERISTIC /end REF_CHARACTERISTIC /begin REF_MEASUREMENT CDD_FordBlaBoxIfCmn.FordVehTrlrAidSetUpRaw.Val /end REF_MEASUREMENT /end GROUP
/begin GROUP CDD_FordBlaBoxIfCmn.FordVehTrlrAidTrakgSt.Val "MICROSAR RTE" /begin SUB_GROUP /end SUB_GROUP /begin FUNCTION_LIST /end FUNCTION_LIST /begin REF_CHARACTERISTIC /end REF_CHARACTERISTIC /begin REF_MEASUREMENT CDD_FordBlaBoxIfCmn.FordVehTrlrAidTrakgSt.Val /end REF_MEASUREMENT /end GROUP
/begin GROUP CDD_FordBlaBoxIfCmn.FordVehTrlrAidTrakgStVld.Logl "MICROSAR RTE" /begin SUB_GROUP /end SUB_GROUP /begin FUNCTION_LIST /end FUNCTION_LIST /begin REF_CHARACTERISTIC /end REF_CHARACTERISTIC /begin REF_MEASUREMENT CDD_FordBlaBoxIfCmn.FordVehTrlrAidTrakgStVld.Logl /end REF_MEASUREMENT /end GROUP
/begin GROUP CDD_FordBlaBoxIfCmn.FordVehTrlrAidTrlrRvsGuidcSts.Val "MICROSAR RTE" /begin SUB_GROUP /end SUB_GROUP /begin FUNCTION_LIST /end FUNCTION_LIST /begin REF_CHARACTERISTIC /end REF_CHARACTERISTIC /begin REF_MEASUREMENT CDD_FordBlaBoxIfCmn.FordVehTrlrAidTrlrRvsGuidcSts.Val /end REF_MEASUREMENT /end GROUP
/begin GROUP CDD_FordBlaBoxIfCmn.FordVehTrlrAxleToBmpRaw.Val "MICROSAR RTE" /begin SUB_GROUP /end SUB_GROUP /begin FUNCTION_LIST /end FUNCTION_LIST /begin REF_CHARACTERISTIC /end REF_CHARACTERISTIC /begin REF_MEASUREMENT CDD_FordBlaBoxIfCmn.FordVehTrlrAxleToBmpRaw.Val /end REF_MEASUREMENT /end GROUP
/begin GROUP CDD_FordBlaBoxIfCmn.FordVehTrlrBackupAssiAvlVld.Logl "MICROSAR RTE" /begin SUB_GROUP /end SUB_GROUP /begin FUNCTION_LIST /end FUNCTION_LIST /begin REF_CHARACTERISTIC /end REF_CHARACTERISTIC /begin REF_MEASUREMENT CDD_FordBlaBoxIfCmn.FordVehTrlrBackupAssiAvlVld.Logl /end REF_MEASUREMENT /end GROUP
/begin GROUP CDD_FordBlaBoxIfCmn.FordVehTrlrBackupAssiMeasVld.Logl "MICROSAR RTE" /begin SUB_GROUP /end SUB_GROUP /begin FUNCTION_LIST /end FUNCTION_LIST /begin REF_CHARACTERISTIC /end REF_CHARACTERISTIC /begin REF_MEASUREMENT CDD_FordBlaBoxIfCmn.FordVehTrlrBackupAssiMeasVld.Logl /end REF_MEASUREMENT /end GROUP
/begin GROUP CDD_FordBlaBoxIfCmn.FordVehTrlrBallToAxle.Val "MICROSAR RTE" /begin SUB_GROUP /end SUB_GROUP /begin FUNCTION_LIST /end FUNCTION_LIST /begin REF_CHARACTERISTIC /end REF_CHARACTERISTIC /begin REF_MEASUREMENT CDD_FordBlaBoxIfCmn.FordVehTrlrBallToAxle.Val /end REF_MEASUREMENT /end GROUP
/begin GROUP CDD_FordBlaBoxIfCmn.FordVehTrlrBrkCnctnStsRaw.Val "MICROSAR RTE" /begin SUB_GROUP /end SUB_GROUP /begin FUNCTION_LIST /end FUNCTION_LIST /begin REF_CHARACTERISTIC /end REF_CHARACTERISTIC /begin REF_MEASUREMENT CDD_FordBlaBoxIfCmn.FordVehTrlrBrkCnctnStsRaw.Val /end REF_MEASUREMENT /end GROUP
/begin GROUP CDD_FordBlaBoxIfCmn.FordVehTrlrEnaReqRaw.Val "MICROSAR RTE" /begin SUB_GROUP /end SUB_GROUP /begin FUNCTION_LIST /end FUNCTION_LIST /begin REF_CHARACTERISTIC /end REF_CHARACTERISTIC /begin REF_MEASUREMENT CDD_FordBlaBoxIfCmn.FordVehTrlrEnaReqRaw.Val /end REF_MEASUREMENT /end GROUP
/begin GROUP CDD_FordBlaBoxIfCmn.FordVehTrlrHitchAgRateRaw.Val "MICROSAR RTE" /begin SUB_GROUP /end SUB_GROUP /begin FUNCTION_LIST /end FUNCTION_LIST /begin REF_CHARACTERISTIC /end REF_CHARACTERISTIC /begin REF_MEASUREMENT CDD_FordBlaBoxIfCmn.FordVehTrlrHitchAgRateRaw.Val /end REF_MEASUREMENT /end GROUP
/begin GROUP CDD_FordBlaBoxIfCmn.FordVehTrlrHitchAgVld.Logl "MICROSAR RTE" /begin SUB_GROUP /end SUB_GROUP /begin FUNCTION_LIST /end FUNCTION_LIST /begin REF_CHARACTERISTIC /end REF_CHARACTERISTIC /begin REF_MEASUREMENT CDD_FordBlaBoxIfCmn.FordVehTrlrHitchAgVld.Logl /end REF_MEASUREMENT /end GROUP
/begin GROUP CDD_FordBlaBoxIfCmn.FordVehTrlrHitchRateVld.Logl "MICROSAR RTE" /begin SUB_GROUP /end SUB_GROUP /begin FUNCTION_LIST /end FUNCTION_LIST /begin REF_CHARACTERISTIC /end REF_CHARACTERISTIC /begin REF_MEASUREMENT CDD_FordBlaBoxIfCmn.FordVehTrlrHitchRateVld.Logl /end REF_MEASUREMENT /end GROUP
/begin GROUP CDD_FordBlaBoxIfCmn.FordVehTrlrHitchYawAgRaw.Val "MICROSAR RTE" /begin SUB_GROUP /end SUB_GROUP /begin FUNCTION_LIST /end FUNCTION_LIST /begin REF_CHARACTERISTIC /end REF_CHARACTERISTIC /begin REF_MEASUREMENT CDD_FordBlaBoxIfCmn.FordVehTrlrHitchYawAgRaw.Val /end REF_MEASUREMENT /end GROUP
/begin GROUP CDD_FordBlaBoxIfCmn.FordVehTrlrHitchYawSts.Val "MICROSAR RTE" /begin SUB_GROUP /end SUB_GROUP /begin FUNCTION_LIST /end FUNCTION_LIST /begin REF_CHARACTERISTIC /end REF_CHARACTERISTIC /begin REF_MEASUREMENT CDD_FordBlaBoxIfCmn.FordVehTrlrHitchYawSts.Val /end REF_MEASUREMENT /end GROUP
/begin GROUP CDD_FordBlaBoxIfCmn.FordVehTrlrIdnTypRaw.Val "MICROSAR RTE" /begin SUB_GROUP /end SUB_GROUP /begin FUNCTION_LIST /end FUNCTION_LIST /begin REF_CHARACTERISTIC /end REF_CHARACTERISTIC /begin REF_MEASUREMENT CDD_FordBlaBoxIfCmn.FordVehTrlrIdnTypRaw.Val /end REF_MEASUREMENT /end GROUP
/begin GROUP CDD_FordBlaBoxIfCmn.FordVehTrlrLampCnctnStsRaw.Val "MICROSAR RTE" /begin SUB_GROUP /end SUB_GROUP /begin FUNCTION_LIST /end FUNCTION_LIST /begin REF_CHARACTERISTIC /end REF_CHARACTERISTIC /begin REF_MEASUREMENT CDD_FordBlaBoxIfCmn.FordVehTrlrLampCnctnStsRaw.Val /end REF_MEASUREMENT /end GROUP
/begin GROUP CDD_FordBlaBoxIfCmn.FordVehTrlrRvsCnclReqRaw.Val "MICROSAR RTE" /begin SUB_GROUP /end SUB_GROUP /begin FUNCTION_LIST /end FUNCTION_LIST /begin REF_CHARACTERISTIC /end REF_CHARACTERISTIC /begin REF_MEASUREMENT CDD_FordBlaBoxIfCmn.FordVehTrlrRvsCnclReqRaw.Val /end REF_MEASUREMENT /end GROUP
/begin GROUP CDD_FordBlaBoxIfCmn.FordVehTrlrRvsEnaRaw.Val "MICROSAR RTE" /begin SUB_GROUP /end SUB_GROUP /begin FUNCTION_LIST /end FUNCTION_LIST /begin REF_CHARACTERISTIC /end REF_CHARACTERISTIC /begin REF_MEASUREMENT CDD_FordBlaBoxIfCmn.FordVehTrlrRvsEnaRaw.Val /end REF_MEASUREMENT /end GROUP
/begin GROUP CDD_FordBlaBoxIfCmn.FordVehTrlrRvsMsgTxtReqRaw.Val "MICROSAR RTE" /begin SUB_GROUP /end SUB_GROUP /begin FUNCTION_LIST /end FUNCTION_LIST /begin REF_CHARACTERISTIC /end REF_CHARACTERISTIC /begin REF_MEASUREMENT CDD_FordBlaBoxIfCmn.FordVehTrlrRvsMsgTxtReqRaw.Val /end REF_MEASUREMENT /end GROUP
/begin GROUP CDD_FordBlaBoxIfCmn.FordVehTrlrTarVld.Logl "MICROSAR RTE" /begin SUB_GROUP /end SUB_GROUP /begin FUNCTION_LIST /end FUNCTION_LIST /begin REF_CHARACTERISTIC /end REF_CHARACTERISTIC /begin REF_MEASUREMENT CDD_FordBlaBoxIfCmn.FordVehTrlrTarVld.Logl /end REF_MEASUREMENT /end GROUP
/begin GROUP CDD_FordBlaBoxIfCmn.FordVehTrlrYawRateQlyFac.Val "MICROSAR RTE" /begin SUB_GROUP /end SUB_GROUP /begin FUNCTION_LIST /end FUNCTION_LIST /begin REF_CHARACTERISTIC /end REF_CHARACTERISTIC /begin REF_MEASUREMENT CDD_FordBlaBoxIfCmn.FordVehTrlrYawRateQlyFac.Val /end REF_MEASUREMENT /end GROUP
/begin GROUP CDD_FordBlaBoxIfCmn.FordVehTrlrYawRateRaw.Val "MICROSAR RTE" /begin SUB_GROUP /end SUB_GROUP /begin FUNCTION_LIST /end FUNCTION_LIST /begin REF_CHARACTERISTIC /end REF_CHARACTERISTIC /begin REF_MEASUREMENT CDD_FordBlaBoxIfCmn.FordVehTrlrYawRateRaw.Val /end REF_MEASUREMENT /end GROUP
/begin GROUP CDD_FordBlaBoxIfCmn.FordVehTrsmDesGearRaw.Val "MICROSAR RTE" /begin SUB_GROUP /end SUB_GROUP /begin FUNCTION_LIST /end FUNCTION_LIST /begin REF_CHARACTERISTIC /end REF_CHARACTERISTIC /begin REF_MEASUREMENT CDD_FordBlaBoxIfCmn.FordVehTrsmDesGearRaw.Val /end REF_MEASUREMENT /end GROUP
/begin GROUP CDD_FordBlaBoxIfCmn.FordVehTurnSigSwtStsRaw.Val "MICROSAR RTE" /begin SUB_GROUP /end SUB_GROUP /begin FUNCTION_LIST /end FUNCTION_LIST /begin REF_CHARACTERISTIC /end REF_CHARACTERISTIC /begin REF_MEASUREMENT CDD_FordBlaBoxIfCmn.FordVehTurnSigSwtStsRaw.Val /end REF_MEASUREMENT /end GROUP
/begin GROUP CDD_FordBlaBoxIfCmn.FordVehTurnSigVld.Logl "MICROSAR RTE" /begin SUB_GROUP /end SUB_GROUP /begin FUNCTION_LIST /end FUNCTION_LIST /begin REF_CHARACTERISTIC /end REF_CHARACTERISTIC /begin REF_MEASUREMENT CDD_FordBlaBoxIfCmn.FordVehTurnSigVld.Logl /end REF_MEASUREMENT /end GROUP
/begin GROUP CDD_FordBlaBoxIfCmn.FordVehVertACmpdRaw.Val "MICROSAR RTE" /begin SUB_GROUP /end SUB_GROUP /begin FUNCTION_LIST /end FUNCTION_LIST /begin REF_CHARACTERISTIC /end REF_CHARACTERISTIC /begin REF_MEASUREMENT CDD_FordBlaBoxIfCmn.FordVehVertACmpdRaw.Val /end REF_MEASUREMENT /end GROUP
/**********************************************************************************************************************
* RECORD_LAYOUT
*********************************************************************************************************************/
/begin RECORD_LAYOUT RTE_RL_UBYTE FNC_VALUES 1 UBYTE ROW_DIR DIRECT /end RECORD_LAYOUT
/begin RECORD_LAYOUT RTE_RL_UWORD FNC_VALUES 1 UWORD ROW_DIR DIRECT /end RECORD_LAYOUT
/begin RECORD_LAYOUT RTE_RL_ULONG FNC_VALUES 1 ULONG ROW_DIR DIRECT /end RECORD_LAYOUT
/begin RECORD_LAYOUT RTE_RL_FLOAT32_IEEE FNC_VALUES 1 FLOAT32_IEEE ROW_DIR DIRECT /end RECORD_LAYOUT
/**********************************************************************************************************************
* COMPU_METHOD / COMPU_VTAB_RANGE
*********************************************************************************************************************/
/begin COMPU_METHOD RTE_CM_BOOLEAN "" TAB_VERB "%3.1" "" COMPU_TAB_REF RTE_CM_BOOLEAN /end COMPU_METHOD
/begin COMPU_VTAB_RANGE RTE_CM_BOOLEAN "" 2 0 0 "false" 1 255 "true" /end COMPU_VTAB_RANGE
/begin COMPU_METHOD RTE_CM_ENUM_SysSt1 "" TAB_VERB "%.1" "" COMPU_TAB_REF RTE_CM_ENUM_SysSt1 /end COMPU_METHOD
/begin COMPU_VTAB_RANGE RTE_CM_ENUM_SysSt1 "" 4 0 0 "SYSST_DI" 1 1 "SYSST_OFF" 2 2 "SYSST_ENA" 3 3 "SYSST_WRMININ" /end COMPU_VTAB_RANGE
/begin COMPU_METHOD RTE_CM_ENUM_SigQlfr1 "" TAB_VERB "%.1" "" COMPU_TAB_REF RTE_CM_ENUM_SigQlfr1 /end COMPU_METHOD
/begin COMPU_VTAB_RANGE RTE_CM_ENUM_SigQlfr1 "" 3 0 0 "SIGQLFR_NORES" 1 1 "SIGQLFR_PASSD" 2 2 "SIGQLFR_FAILD" /end COMPU_VTAB_RANGE
/begin COMPU_METHOD RTE_CM_ENUM_BswMEcuResetMod "" TAB_VERB "%.1" "" COMPU_TAB_REF RTE_CM_ENUM_BswMEcuResetMod /end COMPU_METHOD
/begin COMPU_VTAB_RANGE RTE_CM_ENUM_BswMEcuResetMod "" 4 0 0 "RTE_MODE_BswMEcuResetMod_EcuResetDisabled" 1 1 "RTE_MODE_BswMEcuResetMod_EcuResetEnabled" 2 2 "RTE_MODE_BswMEcuResetMod_EcuResetStarted" 3 3 "RTE_TRANSITION_BswMEcuResetMod" /end COMPU_VTAB_RANGE
/begin COMPU_METHOD RTE_CM_ENUM_MotCurrEolCalSt2 "" TAB_VERB "%.1" "" COMPU_TAB_REF RTE_CM_ENUM_MotCurrEolCalSt2 /end COMPU_METHOD
/begin COMPU_VTAB_RANGE RTE_CM_ENUM_MotCurrEolCalSt2 "" 9 0 0 "MCECS_OFFSCMDSTRT" 1 1 "MCECS_OFFSCMDHI" 2 2 "MCECS_OFFSCMDLO" 3 3 "MCECS_OFFSCMDZERO" 4 4 "MCECS_OFFSCMDEND" 5 5 "MCECS_GAINCMDAD" 6 6 "MCECS_GAINCMDBE" 7 7 "MCECS_GAINCMDCF" 8 8 "MCECS_CMDSAFEST" /end COMPU_VTAB_RANGE
