/*
COPYRIGHT
This software is copyright protected and proprietary to Vector Informatik GmbH.
Vector Informatik GmbH grants to you only those rights as set out in the license conditions.
License:  Unlimited license CBD1601056 for Nexteer Automotive Corporation
*/
/begin CHARACTERISTIC CDD_MotCurrRegVltgLimr.MotCurrRegVltgLimrMotVltgDaxIntglLoLim.Val "MICROSAR RTE" VALUE 0x0 RTE_RL_FLOAT32_IEEE 0 NO_COMPU_METHOD -3.402823466e+38 3.402823466e+38 SYMBOL_LINK "Rte_CalprmRom_CalRegn01Cmn_DEFAULT_RTE_CALPRM_GROUP.MotCurrRegVltgLimrMotVltgDaxIntglLoLim_Val" 0 DISPLAY_IDENTIFIER CDD_MotCurrRegVltgLimr.CalibrationPorts.MotCurrRegVltgLimrMotVltgDaxIntglLoLim.Val /end CHARACTERISTIC
/begin CHARACTERISTIC CDD_MotCurrRegVltgLimr.MotCurrRegVltgLimrMotVltgQaxFfFilEna.Logl "MICROSAR RTE" VALUE 0x0 RTE_RL_BOOLEAN 0 RTE_CM_BOOLEAN 0 255 SYMBOL_LINK "Rte_CalprmRom_CalRegn01Cmn_DEFAULT_RTE_CALPRM_GROUP.MotCurrRegVltgLimrMotVltgQaxFfFilEna_Logl" 0 DISPLAY_IDENTIFIER CDD_MotCurrRegVltgLimr.CalibrationPorts.MotCurrRegVltgLimrMotVltgQaxFfFilEna.Logl /end CHARACTERISTIC
/begin CHARACTERISTIC CDD_MotCurrRegVltgLimr.MotCurrRegVltgLimrMotVltgQaxFfLpFilFrq.Val "MICROSAR RTE" VALUE 0x0 RTE_RL_FLOAT32_IEEE 0 NO_COMPU_METHOD -3.402823466e+38 3.402823466e+38 SYMBOL_LINK "Rte_CalprmRom_CalRegn01Cmn_DEFAULT_RTE_CALPRM_GROUP.MotCurrRegVltgLimrMotVltgQaxFfLpFilFrq_Val" 0 DISPLAY_IDENTIFIER CDD_MotCurrRegVltgLimr.CalibrationPorts.MotCurrRegVltgLimrMotVltgQaxFfLpFilFrq.Val /end CHARACTERISTIC
/begin CHARACTERISTIC CDD_MotCurrRegVltgLimr.MotCurrRegVltgLimrMotVltgQaxIntglHiLim.Val "MICROSAR RTE" VALUE 0x0 RTE_RL_FLOAT32_IEEE 0 NO_COMPU_METHOD -3.402823466e+38 3.402823466e+38 SYMBOL_LINK "Rte_CalprmRom_CalRegn01Cmn_DEFAULT_RTE_CALPRM_GROUP.MotCurrRegVltgLimrMotVltgQaxIntglHiLim_Val" 0 DISPLAY_IDENTIFIER CDD_MotCurrRegVltgLimr.CalibrationPorts.MotCurrRegVltgLimrMotVltgQaxIntglHiLim.Val /end CHARACTERISTIC
/begin CHARACTERISTIC CDD_MotCurrRegVltgLimr.MotCurrRegVltgLimrMotVltgQaxIntglLoLim.Val "MICROSAR RTE" VALUE 0x0 RTE_RL_FLOAT32_IEEE 0 NO_COMPU_METHOD -3.402823466e+38 3.402823466e+38 SYMBOL_LINK "Rte_CalprmRom_CalRegn01Cmn_DEFAULT_RTE_CALPRM_GROUP.MotCurrRegVltgLimrMotVltgQaxIntglLoLim_Val" 0 DISPLAY_IDENTIFIER CDD_MotCurrRegVltgLimr.CalibrationPorts.MotCurrRegVltgLimrMotVltgQaxIntglLoLim.Val /end CHARACTERISTIC
/begin CHARACTERISTIC CDD_MotCurrRegVltgLimr.MotCurrRegVltgLimrQaxAntiWdupCoeff.Val "MICROSAR RTE" VALUE 0x0 RTE_RL_FLOAT32_IEEE 0 NO_COMPU_METHOD -25 25 SYMBOL_LINK "Rte_CalprmRom_CalRegn01Cmn_DEFAULT_RTE_CALPRM_GROUP.MotCurrRegVltgLimrQaxAntiWdupCoeff_Val" 0 DISPLAY_IDENTIFIER CDD_MotCurrRegVltgLimr.CalibrationPorts.MotCurrRegVltgLimrQaxAntiWdupCoeff.Val /end CHARACTERISTIC
/begin CHARACTERISTIC CDD_MotCurrRegVltgLimr.MotCurrRegVltgLimrQaxAntiWdupScagDi.Logl "MICROSAR RTE" VALUE 0x0 RTE_RL_BOOLEAN 0 RTE_CM_BOOLEAN 0 255 SYMBOL_LINK "Rte_CalprmRom_CalRegn01Cmn_DEFAULT_RTE_CALPRM_GROUP.MotCurrRegVltgLimrQaxAntiWdupScagDi_Logl" 0 DISPLAY_IDENTIFIER CDD_MotCurrRegVltgLimr.CalibrationPorts.MotCurrRegVltgLimrQaxAntiWdupScagDi.Logl /end CHARACTERISTIC
/begin CHARACTERISTIC CDD_MotCurrRegVltgLimr.MotRefMdlFbCtrlDi.Logl "MICROSAR RTE" VALUE 0x0 RTE_RL_BOOLEAN 0 RTE_CM_BOOLEAN 0 255 SYMBOL_LINK "Rte_CalprmRom_CalRegn01Cmn_DEFAULT_RTE_CALPRM_GROUP.MotRefMdlFbCtrlDi_Logl" 0 DISPLAY_IDENTIFIER CDD_MotCurrRegVltgLimr.CalibrationPorts.MotRefMdlFbCtrlDi.Logl /end CHARACTERISTIC
/begin CHARACTERISTIC CDD_MotCurrRegVltgLimr.MotRefMdlIvtrDeadTiBrdgVltgSca.Val "MICROSAR RTE" VALUE 0x0 RTE_RL_FLOAT32_IEEE 0 NO_COMPU_METHOD 0.98 1 SYMBOL_LINK "Rte_CalprmRom_CalRegn01Cmn_DEFAULT_RTE_CALPRM_GROUP.MotRefMdlIvtrDeadTiBrdgVltgSca_Val" 0 DISPLAY_IDENTIFIER CDD_MotCurrRegVltgLimr.CalibrationPorts.MotRefMdlIvtrDeadTiBrdgVltgSca.Val /end CHARACTERISTIC
/begin CHARACTERISTIC CDD_MotRplCoggCmd.MotRplCoggCmdHrmncOrder1Elec.Val "MICROSAR RTE" VALUE 0x0 RTE_RL_UBYTE 0 NO_COMPU_METHOD 0 255 SYMBOL_LINK "Rte_CalprmRom_CalRegn02Cmn_DEFAULT_RTE_CALPRM_GROUP.MotRplCoggCmdHrmncOrder1Elec_Val" 0 DISPLAY_IDENTIFIER CDD_MotRplCoggCmd.CalibrationPorts.MotRplCoggCmdHrmncOrder1Elec.Val /end CHARACTERISTIC
/begin CHARACTERISTIC CDD_MotRplCoggCmd.MotRplCoggCmdHrmncOrder2Elec.Val "MICROSAR RTE" VALUE 0x0 RTE_RL_UBYTE 0 NO_COMPU_METHOD 0 255 SYMBOL_LINK "Rte_CalprmRom_CalRegn02Cmn_DEFAULT_RTE_CALPRM_GROUP.MotRplCoggCmdHrmncOrder2Elec_Val" 0 DISPLAY_IDENTIFIER CDD_MotRplCoggCmd.CalibrationPorts.MotRplCoggCmdHrmncOrder2Elec.Val /end CHARACTERISTIC
/begin CHARACTERISTIC CDD_MotRplCoggCmd.MotRplCoggCmdHrmncOrder3Elec.Val "MICROSAR RTE" VALUE 0x0 RTE_RL_UBYTE 0 NO_COMPU_METHOD 0 255 SYMBOL_LINK "Rte_CalprmRom_CalRegn02Cmn_DEFAULT_RTE_CALPRM_GROUP.MotRplCoggCmdHrmncOrder3Elec_Val" 0 DISPLAY_IDENTIFIER CDD_MotRplCoggCmd.CalibrationPorts.MotRplCoggCmdHrmncOrder3Elec.Val /end CHARACTERISTIC
/begin CHARACTERISTIC CDD_SinVltgGenn.MotAgSwCalVehSpdThd.Val "MICROSAR RTE" VALUE 0x0 RTE_RL_FLOAT32_IEEE 0 NO_COMPU_METHOD -3.402823466e+38 3.402823466e+38 SYMBOL_LINK "Rte_CalprmRom_CalRegn01Cmn_DEFAULT_RTE_CALPRM_GROUP.MotAgSwCalVehSpdThd_Val" 0 DISPLAY_IDENTIFIER CDD_SinVltgGenn.CalibrationPorts.MotAgSwCalVehSpdThd.Val /end CHARACTERISTIC
/begin CHARACTERISTIC CDD_SinVltgGenn.SinVltgGennDthrEna.Logl "MICROSAR RTE" VALUE 0x0 RTE_RL_BOOLEAN 0 RTE_CM_BOOLEAN 0 255 SYMBOL_LINK "Rte_CalprmRom_CalRegn01Cmn_DEFAULT_RTE_CALPRM_GROUP.SinVltgGennDthrEna_Logl" 0 DISPLAY_IDENTIFIER CDD_SinVltgGenn.CalibrationPorts.SinVltgGennDthrEna.Logl /end CHARACTERISTIC
/begin CHARACTERISTIC CDD_SinVltgGenn.SinVltgGennDthrLpFilCoeff.Val "MICROSAR RTE" VALUE 0x0 RTE_RL_FLOAT32_IEEE 0 NO_COMPU_METHOD -3.402823466e+38 3.402823466e+38 SYMBOL_LINK "Rte_CalprmRom_CalRegn01Cmn_DEFAULT_RTE_CALPRM_GROUP.SinVltgGennDthrLpFilCoeff_Val" 0 DISPLAY_IDENTIFIER CDD_SinVltgGenn.CalibrationPorts.SinVltgGennDthrLpFilCoeff.Val /end CHARACTERISTIC
/begin CHARACTERISTIC CalRegn01Cmn.AssiSumLimCmdSumFilActv.Logl "MICROSAR RTE" VALUE 0x0 RTE_RL_BOOLEAN 0 RTE_CM_BOOLEAN 0 255 SYMBOL_LINK "Rte_CalprmRom_CalRegn01Cmn_DEFAULT_RTE_CALPRM_GROUP.AssiSumLimCmdSumFilActv_Logl" 0 DISPLAY_IDENTIFIER CalRegn01Cmn.CalibrationPorts.AssiSumLimCmdSumFilActv.Logl /end CHARACTERISTIC
/begin CHARACTERISTIC CalRegn01Cmn.AssiSumLimNtc0x0C4FailStep.Val "MICROSAR RTE" VALUE 0x0 RTE_RL_UWORD 0 NO_COMPU_METHOD 0 65535 SYMBOL_LINK "Rte_CalprmRom_CalRegn01Cmn_DEFAULT_RTE_CALPRM_GROUP.AssiSumLimNtc0x0C4FailStep_Val" 0 DISPLAY_IDENTIFIER CalRegn01Cmn.CalibrationPorts.AssiSumLimNtc0x0C4FailStep.Val /end CHARACTERISTIC
/begin CHARACTERISTIC CalRegn01Cmn.AssiSumLimNtc0x0C4PassStep.Val "MICROSAR RTE" VALUE 0x0 RTE_RL_UWORD 0 NO_COMPU_METHOD 0 65535 SYMBOL_LINK "Rte_CalprmRom_CalRegn01Cmn_DEFAULT_RTE_CALPRM_GROUP.AssiSumLimNtc0x0C4PassStep_Val" 0 DISPLAY_IDENTIFIER CalRegn01Cmn.CalibrationPorts.AssiSumLimNtc0x0C4PassStep.Val /end CHARACTERISTIC
/begin CHARACTERISTIC CalRegn01Cmn.AssiSumLimPullCmpLim.Val "MICROSAR RTE" VALUE 0x0 RTE_RL_FLOAT32_IEEE 0 NO_COMPU_METHOD -3.402823466e+38 3.402823466e+38 SYMBOL_LINK "Rte_CalprmRom_CalRegn01Cmn_DEFAULT_RTE_CALPRM_GROUP.AssiSumLimPullCmpLim_Val" 0 DISPLAY_IDENTIFIER CalRegn01Cmn.CalibrationPorts.AssiSumLimPullCmpLim.Val /end CHARACTERISTIC
/begin CHARACTERISTIC CalRegn01Cmn.BattVltgCorrlnAllwdVltgDif.Val "MICROSAR RTE" VALUE 0x0 RTE_RL_FLOAT32_IEEE 0 NO_COMPU_METHOD -3.402823466e+38 3.402823466e+38 SYMBOL_LINK "Rte_CalprmRom_CalRegn01Cmn_DEFAULT_RTE_CALPRM_GROUP.BattVltgCorrlnAllwdVltgDif_Val" 0 DISPLAY_IDENTIFIER CalRegn01Cmn.CalibrationPorts.BattVltgCorrlnAllwdVltgDif.Val /end CHARACTERISTIC
/begin CHARACTERISTIC CalRegn01Cmn.BattVltgCorrlnBattLoVltg.Val "MICROSAR RTE" VALUE 0x0 RTE_RL_FLOAT32_IEEE 0 NO_COMPU_METHOD -3.402823466e+38 3.402823466e+38 SYMBOL_LINK "Rte_CalprmRom_CalRegn01Cmn_DEFAULT_RTE_CALPRM_GROUP.BattVltgCorrlnBattLoVltg_Val" 0 DISPLAY_IDENTIFIER CalRegn01Cmn.CalibrationPorts.BattVltgCorrlnBattLoVltg.Val /end CHARACTERISTIC
/begin CHARACTERISTIC CalRegn01Cmn.BattVltgCorrlnBattOverVltg.Val "MICROSAR RTE" VALUE 0x0 RTE_RL_FLOAT32_IEEE 0 NO_COMPU_METHOD -3.402823466e+38 3.402823466e+38 SYMBOL_LINK "Rte_CalprmRom_CalRegn01Cmn_DEFAULT_RTE_CALPRM_GROUP.BattVltgCorrlnBattOverVltg_Val" 0 DISPLAY_IDENTIFIER CalRegn01Cmn.CalibrationPorts.BattVltgCorrlnBattOverVltg.Val /end CHARACTERISTIC
/begin CHARACTERISTIC CalRegn01Cmn.BattVltgCorrlnBattUnderVltg.Val "MICROSAR RTE" VALUE 0x0 RTE_RL_FLOAT32_IEEE 0 NO_COMPU_METHOD -3.402823466e+38 3.402823466e+38 SYMBOL_LINK "Rte_CalprmRom_CalRegn01Cmn_DEFAULT_RTE_CALPRM_GROUP.BattVltgCorrlnBattUnderVltg_Val" 0 DISPLAY_IDENTIFIER CalRegn01Cmn.CalibrationPorts.BattVltgCorrlnBattUnderVltg.Val /end CHARACTERISTIC
/begin CHARACTERISTIC CalRegn01Cmn.BattVltgCorrlnNtc0x03C0x044FailStep.Val "MICROSAR RTE" VALUE 0x0 RTE_RL_UWORD 0 NO_COMPU_METHOD 0 65535 SYMBOL_LINK "Rte_CalprmRom_CalRegn01Cmn_DEFAULT_RTE_CALPRM_GROUP.BattVltgCorrlnNtc0x03C0x044FailStep_Val" 0 DISPLAY_IDENTIFIER CalRegn01Cmn.CalibrationPorts.BattVltgCorrlnNtc0x03C0x044FailStep.Val /end CHARACTERISTIC
/begin CHARACTERISTIC CalRegn01Cmn.BattVltgCorrlnNtc0x03C0x044PassStep.Val "MICROSAR RTE" VALUE 0x0 RTE_RL_UWORD 0 NO_COMPU_METHOD 0 65535 SYMBOL_LINK "Rte_CalprmRom_CalRegn01Cmn_DEFAULT_RTE_CALPRM_GROUP.BattVltgCorrlnNtc0x03C0x044PassStep_Val" 0 DISPLAY_IDENTIFIER CalRegn01Cmn.CalibrationPorts.BattVltgCorrlnNtc0x03C0x044PassStep.Val /end CHARACTERISTIC
/begin CHARACTERISTIC CalRegn01Cmn.BattVltgCorrlnNtc0x0B0FailStep.Val "MICROSAR RTE" VALUE 0x0 RTE_RL_UWORD 0 NO_COMPU_METHOD 0 65535 SYMBOL_LINK "Rte_CalprmRom_CalRegn01Cmn_DEFAULT_RTE_CALPRM_GROUP.BattVltgCorrlnNtc0x0B0FailStep_Val" 0 DISPLAY_IDENTIFIER CalRegn01Cmn.CalibrationPorts.BattVltgCorrlnNtc0x0B0FailStep.Val /end CHARACTERISTIC
/begin CHARACTERISTIC CalRegn01Cmn.BattVltgCorrlnNtc0x0B0PassStep.Val "MICROSAR RTE" VALUE 0x0 RTE_RL_UWORD 0 NO_COMPU_METHOD 0 65535 SYMBOL_LINK "Rte_CalprmRom_CalRegn01Cmn_DEFAULT_RTE_CALPRM_GROUP.BattVltgCorrlnNtc0x0B0PassStep_Val" 0 DISPLAY_IDENTIFIER CalRegn01Cmn.CalibrationPorts.BattVltgCorrlnNtc0x0B0PassStep.Val /end CHARACTERISTIC
/begin CHARACTERISTIC CalRegn01Cmn.BattVltgCorrlnNtc0x0B1FailStep.Val "MICROSAR RTE" VALUE 0x0 RTE_RL_UWORD 0 NO_COMPU_METHOD 0 65535 SYMBOL_LINK "Rte_CalprmRom_CalRegn01Cmn_DEFAULT_RTE_CALPRM_GROUP.BattVltgCorrlnNtc0x0B1FailStep_Val" 0 DISPLAY_IDENTIFIER CalRegn01Cmn.CalibrationPorts.BattVltgCorrlnNtc0x0B1FailStep.Val /end CHARACTERISTIC
/begin CHARACTERISTIC CalRegn01Cmn.BattVltgCorrlnNtc0x0B1PassStep.Val "MICROSAR RTE" VALUE 0x0 RTE_RL_UWORD 0 NO_COMPU_METHOD 0 65535 SYMBOL_LINK "Rte_CalprmRom_CalRegn01Cmn_DEFAULT_RTE_CALPRM_GROUP.BattVltgCorrlnNtc0x0B1PassStep_Val" 0 DISPLAY_IDENTIFIER CalRegn01Cmn.CalibrationPorts.BattVltgCorrlnNtc0x0B1PassStep.Val /end CHARACTERISTIC
/begin CHARACTERISTIC CalRegn01Cmn.BattVltgCorrlnNtc0x0B5FailStep.Val "MICROSAR RTE" VALUE 0x0 RTE_RL_UWORD 0 NO_COMPU_METHOD 0 65535 SYMBOL_LINK "Rte_CalprmRom_CalRegn01Cmn_DEFAULT_RTE_CALPRM_GROUP.BattVltgCorrlnNtc0x0B5FailStep_Val" 0 DISPLAY_IDENTIFIER CalRegn01Cmn.CalibrationPorts.BattVltgCorrlnNtc0x0B5FailStep.Val /end CHARACTERISTIC
/begin CHARACTERISTIC CalRegn01Cmn.BattVltgCorrlnNtc0x0B5PassStep.Val "MICROSAR RTE" VALUE 0x0 RTE_RL_UWORD 0 NO_COMPU_METHOD 0 65535 SYMBOL_LINK "Rte_CalprmRom_CalRegn01Cmn_DEFAULT_RTE_CALPRM_GROUP.BattVltgCorrlnNtc0x0B5PassStep_Val" 0 DISPLAY_IDENTIFIER CalRegn01Cmn.CalibrationPorts.BattVltgCorrlnNtc0x0B5PassStep.Val /end CHARACTERISTIC
/begin CHARACTERISTIC CalRegn01Cmn.BattVltgCorrlnRcvrlBattLoVltg.Val "MICROSAR RTE" VALUE 0x0 RTE_RL_FLOAT32_IEEE 0 NO_COMPU_METHOD -3.402823466e+38 3.402823466e+38 SYMBOL_LINK "Rte_CalprmRom_CalRegn01Cmn_DEFAULT_RTE_CALPRM_GROUP.BattVltgCorrlnRcvrlBattLoVltg_Val" 0 DISPLAY_IDENTIFIER CalRegn01Cmn.CalibrationPorts.BattVltgCorrlnRcvrlBattLoVltg.Val /end CHARACTERISTIC
/begin CHARACTERISTIC CalRegn01Cmn.BattVltgCorrlnRcvrlBattOverVltg.Val "MICROSAR RTE" VALUE 0x0 RTE_RL_FLOAT32_IEEE 0 NO_COMPU_METHOD -3.402823466e+38 3.402823466e+38 SYMBOL_LINK "Rte_CalprmRom_CalRegn01Cmn_DEFAULT_RTE_CALPRM_GROUP.BattVltgCorrlnRcvrlBattOverVltg_Val" 0 DISPLAY_IDENTIFIER CalRegn01Cmn.CalibrationPorts.BattVltgCorrlnRcvrlBattOverVltg.Val /end CHARACTERISTIC
/begin CHARACTERISTIC CalRegn01Cmn.BattVltgCorrlnRcvrlBattUnderVltg.Val "MICROSAR RTE" VALUE 0x0 RTE_RL_FLOAT32_IEEE 0 NO_COMPU_METHOD -3.402823466e+38 3.402823466e+38 SYMBOL_LINK "Rte_CalprmRom_CalRegn01Cmn_DEFAULT_RTE_CALPRM_GROUP.BattVltgCorrlnRcvrlBattUnderVltg_Val" 0 DISPLAY_IDENTIFIER CalRegn01Cmn.CalibrationPorts.BattVltgCorrlnRcvrlBattUnderVltg.Val /end CHARACTERISTIC
/begin CHARACTERISTIC CalRegn01Cmn.BattVltgCorrlnSwdMax.Val "MICROSAR RTE" VALUE 0x0 RTE_RL_FLOAT32_IEEE 0 NO_COMPU_METHOD -3.402823466e+38 3.402823466e+38 SYMBOL_LINK "Rte_CalprmRom_CalRegn01Cmn_DEFAULT_RTE_CALPRM_GROUP.BattVltgCorrlnSwdMax_Val" 0 DISPLAY_IDENTIFIER CalRegn01Cmn.CalibrationPorts.BattVltgCorrlnSwdMax.Val /end CHARACTERISTIC
/begin CHARACTERISTIC CalRegn01Cmn.BattVltgCorrlnSysMinVltg.Val "MICROSAR RTE" VALUE 0x0 RTE_RL_FLOAT32_IEEE 0 NO_COMPU_METHOD -3.402823466e+38 3.402823466e+38 SYMBOL_LINK "Rte_CalprmRom_CalRegn01Cmn_DEFAULT_RTE_CALPRM_GROUP.BattVltgCorrlnSysMinVltg_Val" 0 DISPLAY_IDENTIFIER CalRegn01Cmn.CalibrationPorts.BattVltgCorrlnSysMinVltg.Val /end CHARACTERISTIC
/begin CHARACTERISTIC CalRegn01Cmn.BattVltgSwdMax.Val "MICROSAR RTE" VALUE 0x0 RTE_RL_FLOAT32_IEEE 0 NO_COMPU_METHOD -3.402823466e+38 3.402823466e+38 SYMBOL_LINK "Rte_CalprmRom_CalRegn01Cmn_DEFAULT_RTE_CALPRM_GROUP.BattVltgSwdMax_Val" 0 DISPLAY_IDENTIFIER CalRegn01Cmn.CalibrationPorts.BattVltgSwdMax.Val /end CHARACTERISTIC
/begin CHARACTERISTIC CalRegn01Cmn.CmnMfgSrvSecuAcsAtmptTiOut.Val "MICROSAR RTE" VALUE 0x0 RTE_RL_UWORD 0 NO_COMPU_METHOD 0 65535 SYMBOL_LINK "Rte_CalprmRom_CalRegn01Cmn_DEFAULT_RTE_CALPRM_GROUP.CmnMfgSrvSecuAcsAtmptTiOut_Val" 0 DISPLAY_IDENTIFIER CalRegn01Cmn.CalibrationPorts.CmnMfgSrvSecuAcsAtmptTiOut.Val /end CHARACTERISTIC
/begin CHARACTERISTIC CalRegn01Cmn.CmnMfgSrvSecuAcsMaxNrAtmpt.Val "MICROSAR RTE" VALUE 0x0 RTE_RL_UBYTE 0 NO_COMPU_METHOD 0 255 SYMBOL_LINK "Rte_CalprmRom_CalRegn01Cmn_DEFAULT_RTE_CALPRM_GROUP.CmnMfgSrvSecuAcsMaxNrAtmpt_Val" 0 DISPLAY_IDENTIFIER CalRegn01Cmn.CalibrationPorts.CmnMfgSrvSecuAcsMaxNrAtmpt.Val /end CHARACTERISTIC
/begin CHARACTERISTIC CalRegn01Cmn.CurrMeasArbnMaxStallCntr.Val "MICROSAR RTE" VALUE 0x0 RTE_RL_UBYTE 0 NO_COMPU_METHOD 0 255 SYMBOL_LINK "Rte_CalprmRom_CalRegn01Cmn_DEFAULT_RTE_CALPRM_GROUP.CurrMeasArbnMaxStallCntr_Val" 0 DISPLAY_IDENTIFIER CalRegn01Cmn.CalibrationPorts.CurrMeasArbnMaxStallCntr.Val /end CHARACTERISTIC
/begin CHARACTERISTIC CalRegn01Cmn.CurrMeasCorrlnMaxErrCurr.Val "MICROSAR RTE" VALUE 0x0 RTE_RL_FLOAT32_IEEE 0 NO_COMPU_METHOD -3.402823466e+38 3.402823466e+38 SYMBOL_LINK "Rte_CalprmRom_CalRegn01Cmn_DEFAULT_RTE_CALPRM_GROUP.CurrMeasCorrlnMaxErrCurr_Val" 0 DISPLAY_IDENTIFIER CalRegn01Cmn.CalibrationPorts.CurrMeasCorrlnMaxErrCurr.Val /end CHARACTERISTIC
/begin CHARACTERISTIC CalRegn01Cmn.CurrMeasCorrlnMaxStallCntr.Val "MICROSAR RTE" VALUE 0x0 RTE_RL_UBYTE 0 NO_COMPU_METHOD 0 255 SYMBOL_LINK "Rte_CalprmRom_CalRegn01Cmn_DEFAULT_RTE_CALPRM_GROUP.CurrMeasCorrlnMaxStallCntr_Val" 0 DISPLAY_IDENTIFIER CalRegn01Cmn.CalibrationPorts.CurrMeasCorrlnMaxStallCntr.Val /end CHARACTERISTIC
/begin CHARACTERISTIC CalRegn01Cmn.CurrMeasCorrlnNtc0x04DFailStep.Val "MICROSAR RTE" VALUE 0x0 RTE_RL_UWORD 0 NO_COMPU_METHOD 0 65535 SYMBOL_LINK "Rte_CalprmRom_CalRegn01Cmn_DEFAULT_RTE_CALPRM_GROUP.CurrMeasCorrlnNtc0x04DFailStep_Val" 0 DISPLAY_IDENTIFIER CalRegn01Cmn.CalibrationPorts.CurrMeasCorrlnNtc0x04DFailStep.Val /end CHARACTERISTIC
/begin CHARACTERISTIC CalRegn01Cmn.CurrMeasCorrlnNtc0x04DPassStep.Val "MICROSAR RTE" VALUE 0x0 RTE_RL_UWORD 0 NO_COMPU_METHOD 0 65535 SYMBOL_LINK "Rte_CalprmRom_CalRegn01Cmn_DEFAULT_RTE_CALPRM_GROUP.CurrMeasCorrlnNtc0x04DPassStep_Val" 0 DISPLAY_IDENTIFIER CalRegn01Cmn.CalibrationPorts.CurrMeasCorrlnNtc0x04DPassStep.Val /end CHARACTERISTIC
/begin CHARACTERISTIC CalRegn01Cmn.CurrMeasEolFixdPwmPerd.Val "MICROSAR RTE" VALUE 0x0 RTE_RL_ULONG 0 NO_COMPU_METHOD 0 4294967295 SYMBOL_LINK "Rte_CalprmRom_CalRegn01Cmn_DEFAULT_RTE_CALPRM_GROUP.CurrMeasEolFixdPwmPerd_Val" 0 DISPLAY_IDENTIFIER CalRegn01Cmn.CalibrationPorts.CurrMeasEolFixdPwmPerd.Val /end CHARACTERISTIC
/begin CHARACTERISTIC CalRegn01Cmn.CurrMeasEolGainMax.Val "MICROSAR RTE" VALUE 0x0 RTE_RL_FLOAT32_IEEE 0 NO_COMPU_METHOD -3.402823466e+38 3.402823466e+38 SYMBOL_LINK "Rte_CalprmRom_CalRegn01Cmn_DEFAULT_RTE_CALPRM_GROUP.CurrMeasEolGainMax_Val" 0 DISPLAY_IDENTIFIER CalRegn01Cmn.CalibrationPorts.CurrMeasEolGainMax.Val /end CHARACTERISTIC
/begin CHARACTERISTIC CalRegn01Cmn.CurrMeasEolGainMin.Val "MICROSAR RTE" VALUE 0x0 RTE_RL_FLOAT32_IEEE 0 NO_COMPU_METHOD -3.402823466e+38 3.402823466e+38 SYMBOL_LINK "Rte_CalprmRom_CalRegn01Cmn_DEFAULT_RTE_CALPRM_GROUP.CurrMeasEolGainMin_Val" 0 DISPLAY_IDENTIFIER CalRegn01Cmn.CalibrationPorts.CurrMeasEolGainMin.Val /end CHARACTERISTIC
/begin CHARACTERISTIC CalRegn01Cmn.CurrMeasEolGainNom.Val "MICROSAR RTE" VALUE 0x0 RTE_RL_FLOAT32_IEEE 0 NO_COMPU_METHOD -3.402823466e+38 3.402823466e+38 SYMBOL_LINK "Rte_CalprmRom_CalRegn01Cmn_DEFAULT_RTE_CALPRM_GROUP.CurrMeasEolGainNom_Val" 0 DISPLAY_IDENTIFIER CalRegn01Cmn.CalibrationPorts.CurrMeasEolGainNom.Val /end CHARACTERISTIC
/begin CHARACTERISTIC CalRegn01Cmn.CurrMeasEolGainNrOfSample.Val "MICROSAR RTE" VALUE 0x0 RTE_RL_UWORD 0 NO_COMPU_METHOD 0 65535 SYMBOL_LINK "Rte_CalprmRom_CalRegn01Cmn_DEFAULT_RTE_CALPRM_GROUP.CurrMeasEolGainNrOfSample_Val" 0 DISPLAY_IDENTIFIER CalRegn01Cmn.CalibrationPorts.CurrMeasEolGainNrOfSample.Val /end CHARACTERISTIC
/begin CHARACTERISTIC CalRegn01Cmn.CurrMeasEolGainNumer.Val "MICROSAR RTE" VALUE 0x0 RTE_RL_FLOAT32_IEEE 0 NO_COMPU_METHOD -3.402823466e+38 3.402823466e+38 SYMBOL_LINK "Rte_CalprmRom_CalRegn01Cmn_DEFAULT_RTE_CALPRM_GROUP.CurrMeasEolGainNumer_Val" 0 DISPLAY_IDENTIFIER CalRegn01Cmn.CalibrationPorts.CurrMeasEolGainNumer.Val /end CHARACTERISTIC
/begin CHARACTERISTIC CalRegn01Cmn.CurrMeasEolMaxMotVel.Val "MICROSAR RTE" VALUE 0x0 RTE_RL_FLOAT32_IEEE 0 NO_COMPU_METHOD -3.402823466e+38 3.402823466e+38 SYMBOL_LINK "Rte_CalprmRom_CalRegn01Cmn_DEFAULT_RTE_CALPRM_GROUP.CurrMeasEolMaxMotVel_Val" 0 DISPLAY_IDENTIFIER CalRegn01Cmn.CalibrationPorts.CurrMeasEolMaxMotVel.Val /end CHARACTERISTIC
/begin CHARACTERISTIC CalRegn01Cmn.CurrMeasEolOffsHiBrdgVltgMin.Val "MICROSAR RTE" VALUE 0x0 RTE_RL_FLOAT32_IEEE 0 NO_COMPU_METHOD -3.402823466e+38 3.402823466e+38 SYMBOL_LINK "Rte_CalprmRom_CalRegn01Cmn_DEFAULT_RTE_CALPRM_GROUP.CurrMeasEolOffsHiBrdgVltgMin_Val" 0 DISPLAY_IDENTIFIER CalRegn01Cmn.CalibrationPorts.CurrMeasEolOffsHiBrdgVltgMin.Val /end CHARACTERISTIC
/begin CHARACTERISTIC CalRegn01Cmn.CurrMeasEolOffsHiCmuOffs.Val "MICROSAR RTE" VALUE 0x0 RTE_RL_ULONG 0 NO_COMPU_METHOD 0 4294967295 SYMBOL_LINK "Rte_CalprmRom_CalRegn01Cmn_DEFAULT_RTE_CALPRM_GROUP.CurrMeasEolOffsHiCmuOffs_Val" 0 DISPLAY_IDENTIFIER CalRegn01Cmn.CalibrationPorts.CurrMeasEolOffsHiCmuOffs.Val /end CHARACTERISTIC
/begin CHARACTERISTIC CalRegn01Cmn.CurrMeasEolOffsLoCmuOffs.Val "MICROSAR RTE" VALUE 0x0 RTE_RL_ULONG 0 NO_COMPU_METHOD 0 4294967295 SYMBOL_LINK "Rte_CalprmRom_CalRegn01Cmn_DEFAULT_RTE_CALPRM_GROUP.CurrMeasEolOffsLoCmuOffs_Val" 0 DISPLAY_IDENTIFIER CalRegn01Cmn.CalibrationPorts.CurrMeasEolOffsLoCmuOffs.Val /end CHARACTERISTIC
/begin CHARACTERISTIC CalRegn01Cmn.CurrMeasEolOffsMax.Val "MICROSAR RTE" VALUE 0x0 RTE_RL_FLOAT32_IEEE 0 NO_COMPU_METHOD -3.402823466e+38 3.402823466e+38 SYMBOL_LINK "Rte_CalprmRom_CalRegn01Cmn_DEFAULT_RTE_CALPRM_GROUP.CurrMeasEolOffsMax_Val" 0 DISPLAY_IDENTIFIER CalRegn01Cmn.CalibrationPorts.CurrMeasEolOffsMax.Val /end CHARACTERISTIC
/begin CHARACTERISTIC CalRegn01Cmn.CurrMeasEolOffsMin.Val "MICROSAR RTE" VALUE 0x0 RTE_RL_FLOAT32_IEEE 0 NO_COMPU_METHOD -3.402823466e+38 3.402823466e+38 SYMBOL_LINK "Rte_CalprmRom_CalRegn01Cmn_DEFAULT_RTE_CALPRM_GROUP.CurrMeasEolOffsMin_Val" 0 DISPLAY_IDENTIFIER CalRegn01Cmn.CalibrationPorts.CurrMeasEolOffsMin.Val /end CHARACTERISTIC
/begin CHARACTERISTIC CalRegn01Cmn.CurrMeasEolOffsNom.Val "MICROSAR RTE" VALUE 0x0 RTE_RL_FLOAT32_IEEE 0 NO_COMPU_METHOD -3.402823466e+38 3.402823466e+38 SYMBOL_LINK "Rte_CalprmRom_CalRegn01Cmn_DEFAULT_RTE_CALPRM_GROUP.CurrMeasEolOffsNom_Val" 0 DISPLAY_IDENTIFIER CalRegn01Cmn.CalibrationPorts.CurrMeasEolOffsNom.Val /end CHARACTERISTIC
/begin CHARACTERISTIC CalRegn01Cmn.CurrMeasEolOffsNrOfSample.Val "MICROSAR RTE" VALUE 0x0 RTE_RL_UWORD 0 NO_COMPU_METHOD 0 65535 SYMBOL_LINK "Rte_CalprmRom_CalRegn01Cmn_DEFAULT_RTE_CALPRM_GROUP.CurrMeasEolOffsNrOfSample_Val" 0 DISPLAY_IDENTIFIER CalRegn01Cmn.CalibrationPorts.CurrMeasEolOffsNrOfSample.Val /end CHARACTERISTIC
/begin CHARACTERISTIC CalRegn01Cmn.CurrMeasEolTranCntrThd.Val "MICROSAR RTE" VALUE 0x0 RTE_RL_UBYTE 0 NO_COMPU_METHOD 0 255 SYMBOL_LINK "Rte_CalprmRom_CalRegn01Cmn_DEFAULT_RTE_CALPRM_GROUP.CurrMeasEolTranCntrThd_Val" 0 DISPLAY_IDENTIFIER CalRegn01Cmn.CalibrationPorts.CurrMeasEolTranCntrThd.Val /end CHARACTERISTIC
/begin CHARACTERISTIC CalRegn01Cmn.CurrMeasMinRqrdPhaOnTi.Val "MICROSAR RTE" VALUE 0x0 RTE_RL_ULONG 0 NO_COMPU_METHOD 0 4294967295 SYMBOL_LINK "Rte_CalprmRom_CalRegn01Cmn_DEFAULT_RTE_CALPRM_GROUP.CurrMeasMinRqrdPhaOnTi_Val" 0 DISPLAY_IDENTIFIER CalRegn01Cmn.CalibrationPorts.CurrMeasMinRqrdPhaOnTi.Val /end CHARACTERISTIC
/begin CHARACTERISTIC CalRegn01Cmn.CurrMeasMotAgCompuDly.Val "MICROSAR RTE" VALUE 0x0 RTE_RL_ULONG 0 NO_COMPU_METHOD 0 4294967295 SYMBOL_LINK "Rte_CalprmRom_CalRegn01Cmn_DEFAULT_RTE_CALPRM_GROUP.CurrMeasMotAgCompuDly_Val" 0 DISPLAY_IDENTIFIER CalRegn01Cmn.CalibrationPorts.CurrMeasMotAgCompuDly.Val /end CHARACTERISTIC
/begin CHARACTERISTIC CalRegn01Cmn.CurrMeasMotCurrAdcVlyWrmIninMax.Val "MICROSAR RTE" VALUE 0x0 RTE_RL_FLOAT32_IEEE 0 NO_COMPU_METHOD -3.402823466e+38 3.402823466e+38 SYMBOL_LINK "Rte_CalprmRom_CalRegn01Cmn_DEFAULT_RTE_CALPRM_GROUP.CurrMeasMotCurrAdcVlyWrmIninMax_Val" 0 DISPLAY_IDENTIFIER CalRegn01Cmn.CalibrationPorts.CurrMeasMotCurrAdcVlyWrmIninMax.Val /end CHARACTERISTIC
/begin CHARACTERISTIC CalRegn01Cmn.CurrMeasMotCurrAdcVlyWrmIninMin.Val "MICROSAR RTE" VALUE 0x0 RTE_RL_FLOAT32_IEEE 0 NO_COMPU_METHOD -3.402823466e+38 3.402823466e+38 SYMBOL_LINK "Rte_CalprmRom_CalRegn01Cmn_DEFAULT_RTE_CALPRM_GROUP.CurrMeasMotCurrAdcVlyWrmIninMin_Val" 0 DISPLAY_IDENTIFIER CalRegn01Cmn.CalibrationPorts.CurrMeasMotCurrAdcVlyWrmIninMin.Val /end CHARACTERISTIC
/begin CHARACTERISTIC CalRegn01Cmn.CurrMeasNtc0x05DFailStep.Val "MICROSAR RTE" VALUE 0x0 RTE_RL_UWORD 0 NO_COMPU_METHOD 0 65535 SYMBOL_LINK "Rte_CalprmRom_CalRegn01Cmn_DEFAULT_RTE_CALPRM_GROUP.CurrMeasNtc0x05DFailStep_Val" 0 DISPLAY_IDENTIFIER CalRegn01Cmn.CalibrationPorts.CurrMeasNtc0x05DFailStep.Val /end CHARACTERISTIC
/begin CHARACTERISTIC CalRegn01Cmn.CurrMeasNtc0x05DPassStep.Val "MICROSAR RTE" VALUE 0x0 RTE_RL_UWORD 0 NO_COMPU_METHOD 0 65535 SYMBOL_LINK "Rte_CalprmRom_CalRegn01Cmn_DEFAULT_RTE_CALPRM_GROUP.CurrMeasNtc0x05DPassStep_Val" 0 DISPLAY_IDENTIFIER CalRegn01Cmn.CalibrationPorts.CurrMeasNtc0x05DPassStep.Val /end CHARACTERISTIC
/begin CHARACTERISTIC CalRegn01Cmn.DiagcMgrFltResp.Ary1D "MICROSAR RTE" VAL_BLK 0x0 RTE_RL_UWORD 0 NO_COMPU_METHOD 0 65535 MATRIX_DIM 512 1 1 SYMBOL_LINK "Rte_CalprmRom_CalRegn01Cmn_DEFAULT_RTE_CALPRM_GROUP.DiagcMgrFltResp_Ary1D" 0 DISPLAY_IDENTIFIER CalRegn01Cmn.CalibrationPorts.DiagcMgrFltResp.Ary1D /end CHARACTERISTIC
/begin CHARACTERISTIC CalRegn01Cmn.DrvrTqEstimnMtrxA.Ary2D "MICROSAR RTE" VAL_BLK 0x0 RTE_RL_FLOAT32_IEEE 0 NO_COMPU_METHOD -3.402823466e+38 3.402823466e+38 MATRIX_DIM 5 5 1 SYMBOL_LINK "Rte_CalprmRom_CalRegn01Cmn_DEFAULT_RTE_CALPRM_GROUP.DrvrTqEstimnMtrxA_Ary2D" 0 DISPLAY_IDENTIFIER CalRegn01Cmn.CalibrationPorts.DrvrTqEstimnMtrxA.Ary2D /end CHARACTERISTIC
/begin CHARACTERISTIC CalRegn01Cmn.DrvrTqEstimnMtrxB.Ary2D "MICROSAR RTE" VAL_BLK 0x0 RTE_RL_FLOAT32_IEEE 0 NO_COMPU_METHOD -3.402823466e+38 3.402823466e+38 MATRIX_DIM 4 5 1 SYMBOL_LINK "Rte_CalprmRom_CalRegn01Cmn_DEFAULT_RTE_CALPRM_GROUP.DrvrTqEstimnMtrxB_Ary2D" 0 DISPLAY_IDENTIFIER CalRegn01Cmn.CalibrationPorts.DrvrTqEstimnMtrxB.Ary2D /end CHARACTERISTIC
/begin CHARACTERISTIC CalRegn01Cmn.DrvrTqEstimnMtrxC.Ary1D "MICROSAR RTE" VAL_BLK 0x0 RTE_RL_FLOAT32_IEEE 0 NO_COMPU_METHOD -3.402823466e+38 3.402823466e+38 MATRIX_DIM 5 1 1 SYMBOL_LINK "Rte_CalprmRom_CalRegn01Cmn_DEFAULT_RTE_CALPRM_GROUP.DrvrTqEstimnMtrxC_Ary1D" 0 DISPLAY_IDENTIFIER CalRegn01Cmn.CalibrationPorts.DrvrTqEstimnMtrxC.Ary1D /end CHARACTERISTIC
/begin CHARACTERISTIC CalRegn01Cmn.DrvrTqEstimnMtrxD.Ary1D "MICROSAR RTE" VAL_BLK 0x0 RTE_RL_FLOAT32_IEEE 0 NO_COMPU_METHOD -3.402823466e+38 3.402823466e+38 MATRIX_DIM 4 1 1 SYMBOL_LINK "Rte_CalprmRom_CalRegn01Cmn_DEFAULT_RTE_CALPRM_GROUP.DrvrTqEstimnMtrxD_Ary1D" 0 DISPLAY_IDENTIFIER CalRegn01Cmn.CalibrationPorts.DrvrTqEstimnMtrxD.Ary1D /end CHARACTERISTIC
/begin CHARACTERISTIC CalRegn01Cmn.DutyCycThermProtnAbsltCtrlTFetMtgtnTblX.Ary1D "MICROSAR RTE" VAL_BLK 0x0 RTE_RL_SWORD 0 NO_COMPU_METHOD -32768 32767 MATRIX_DIM 4 1 1 SYMBOL_LINK "Rte_CalprmRom_CalRegn01Cmn_DEFAULT_RTE_CALPRM_GROUP.DutyCycThermProtnAbsltCtrlTFetMtgtnTblX_Ary1D" 0 DISPLAY_IDENTIFIER CalRegn01Cmn.CalibrationPorts.DutyCycThermProtnAbsltCtrlTFetMtgtnTblX.Ary1D /end CHARACTERISTIC
/begin CHARACTERISTIC CalRegn01Cmn.DutyCycThermProtnAbsltCtrlTTblX.Ary1D "MICROSAR RTE" VAL_BLK 0x0 RTE_RL_SWORD 0 NO_COMPU_METHOD -32768 32767 MATRIX_DIM 4 1 1 SYMBOL_LINK "Rte_CalprmRom_CalRegn01Cmn_DEFAULT_RTE_CALPRM_GROUP.DutyCycThermProtnAbsltCtrlTTblX_Ary1D" 0 DISPLAY_IDENTIFIER CalRegn01Cmn.CalibrationPorts.DutyCycThermProtnAbsltCtrlTTblX.Ary1D /end CHARACTERISTIC
/begin CHARACTERISTIC CalRegn01Cmn.DutyCycThermProtnAbsltCtrlTTqFetMtgtnTblY.Ary1D "MICROSAR RTE" VAL_BLK 0x0 RTE_RL_UWORD 0 NO_COMPU_METHOD 0 65535 MATRIX_DIM 4 1 1 SYMBOL_LINK "Rte_CalprmRom_CalRegn01Cmn_DEFAULT_RTE_CALPRM_GROUP.DutyCycThermProtnAbsltCtrlTTqFetMtgtnTblY_Ary1D" 0 DISPLAY_IDENTIFIER CalRegn01Cmn.CalibrationPorts.DutyCycThermProtnAbsltCtrlTTqFetMtgtnTblY.Ary1D /end CHARACTERISTIC
/begin CHARACTERISTIC CalRegn01Cmn.DutyCycThermProtnAbsltCtrlTTqTblY.Ary1D "MICROSAR RTE" VAL_BLK 0x0 RTE_RL_UWORD 0 NO_COMPU_METHOD 0 65535 MATRIX_DIM 4 1 1 SYMBOL_LINK "Rte_CalprmRom_CalRegn01Cmn_DEFAULT_RTE_CALPRM_GROUP.DutyCycThermProtnAbsltCtrlTTqTblY_Ary1D" 0 DISPLAY_IDENTIFIER CalRegn01Cmn.CalibrationPorts.DutyCycThermProtnAbsltCtrlTTqTblY.Ary1D /end CHARACTERISTIC
/begin CHARACTERISTIC CalRegn01Cmn.DutyCycThermProtnAbsltCuTFetMtgtnTblX.Ary1D "MICROSAR RTE" VAL_BLK 0x0 RTE_RL_SWORD 0 NO_COMPU_METHOD -32768 32767 MATRIX_DIM 4 1 1 SYMBOL_LINK "Rte_CalprmRom_CalRegn01Cmn_DEFAULT_RTE_CALPRM_GROUP.DutyCycThermProtnAbsltCuTFetMtgtnTblX_Ary1D" 0 DISPLAY_IDENTIFIER CalRegn01Cmn.CalibrationPorts.DutyCycThermProtnAbsltCuTFetMtgtnTblX.Ary1D /end CHARACTERISTIC
/begin CHARACTERISTIC CalRegn01Cmn.DutyCycThermProtnAbsltCuTTblX.Ary1D "MICROSAR RTE" VAL_BLK 0x0 RTE_RL_SWORD 0 NO_COMPU_METHOD -32768 32767 MATRIX_DIM 4 1 1 SYMBOL_LINK "Rte_CalprmRom_CalRegn01Cmn_DEFAULT_RTE_CALPRM_GROUP.DutyCycThermProtnAbsltCuTTblX_Ary1D" 0 DISPLAY_IDENTIFIER CalRegn01Cmn.CalibrationPorts.DutyCycThermProtnAbsltCuTTblX.Ary1D /end CHARACTERISTIC
/begin CHARACTERISTIC CalRegn01Cmn.DutyCycThermProtnAbsltCuTTqFetMtgtnTblY.Ary1D "MICROSAR RTE" VAL_BLK 0x0 RTE_RL_UWORD 0 NO_COMPU_METHOD 0 65535 MATRIX_DIM 4 1 1 SYMBOL_LINK "Rte_CalprmRom_CalRegn01Cmn_DEFAULT_RTE_CALPRM_GROUP.DutyCycThermProtnAbsltCuTTqFetMtgtnTblY_Ary1D" 0 DISPLAY_IDENTIFIER CalRegn01Cmn.CalibrationPorts.DutyCycThermProtnAbsltCuTTqFetMtgtnTblY.Ary1D /end CHARACTERISTIC
/begin CHARACTERISTIC CalRegn01Cmn.DutyCycThermProtnAbsltCuTTqTblY.Ary1D "MICROSAR RTE" VAL_BLK 0x0 RTE_RL_UWORD 0 NO_COMPU_METHOD 0 65535 MATRIX_DIM 4 1 1 SYMBOL_LINK "Rte_CalprmRom_CalRegn01Cmn_DEFAULT_RTE_CALPRM_GROUP.DutyCycThermProtnAbsltCuTTqTblY_Ary1D" 0 DISPLAY_IDENTIFIER CalRegn01Cmn.CalibrationPorts.DutyCycThermProtnAbsltCuTTqTblY.Ary1D /end CHARACTERISTIC
/begin CHARACTERISTIC CalRegn01Cmn.DutyCycThermProtnAbsltMotVelBreakPt.Val "MICROSAR RTE" VALUE 0x0 RTE_RL_FLOAT32_IEEE 0 NO_COMPU_METHOD -3.402823466e+38 3.402823466e+38 SYMBOL_LINK "Rte_CalprmRom_CalRegn01Cmn_DEFAULT_RTE_CALPRM_GROUP.DutyCycThermProtnAbsltMotVelBreakPt_Val" 0 DISPLAY_IDENTIFIER CalRegn01Cmn.CalibrationPorts.DutyCycThermProtnAbsltMotVelBreakPt.Val /end CHARACTERISTIC
/begin CHARACTERISTIC CalRegn01Cmn.DutyCycThermProtnAbsltTTqSlewHiLim.Val "MICROSAR RTE" VALUE 0x0 RTE_RL_FLOAT32_IEEE 0 NO_COMPU_METHOD -3.402823466e+38 3.402823466e+38 SYMBOL_LINK "Rte_CalprmRom_CalRegn01Cmn_DEFAULT_RTE_CALPRM_GROUP.DutyCycThermProtnAbsltTTqSlewHiLim_Val" 0 DISPLAY_IDENTIFIER CalRegn01Cmn.CalibrationPorts.DutyCycThermProtnAbsltTTqSlewHiLim.Val /end CHARACTERISTIC
/begin CHARACTERISTIC CalRegn01Cmn.DutyCycThermProtnAbsltTTqSlewLoLim.Val "MICROSAR RTE" VALUE 0x0 RTE_RL_FLOAT32_IEEE 0 NO_COMPU_METHOD -3.402823466e+38 3.402823466e+38 SYMBOL_LINK "Rte_CalprmRom_CalRegn01Cmn_DEFAULT_RTE_CALPRM_GROUP.DutyCycThermProtnAbsltTTqSlewLoLim_Val" 0 DISPLAY_IDENTIFIER CalRegn01Cmn.CalibrationPorts.DutyCycThermProtnAbsltTTqSlewLoLim.Val /end CHARACTERISTIC
/begin CHARACTERISTIC CalRegn01Cmn.DutyCycThermProtnCtrlT.Val "MICROSAR RTE" VALUE 0x0 RTE_RL_FLOAT32_IEEE 0 NO_COMPU_METHOD -3.402823466e+38 3.402823466e+38 SYMBOL_LINK "Rte_CalprmRom_CalRegn01Cmn_DEFAULT_RTE_CALPRM_GROUP.DutyCycThermProtnCtrlT_Val" 0 DISPLAY_IDENTIFIER CalRegn01Cmn.CalibrationPorts.DutyCycThermProtnCtrlT.Val /end CHARACTERISTIC
/begin CHARACTERISTIC CalRegn01Cmn.DutyCycThermProtnCtrlTSeln.Logl "MICROSAR RTE" VALUE 0x0 RTE_RL_BOOLEAN 0 RTE_CM_BOOLEAN 0 255 SYMBOL_LINK "Rte_CalprmRom_CalRegn01Cmn_DEFAULT_RTE_CALPRM_GROUP.DutyCycThermProtnCtrlTSeln_Logl" 0 DISPLAY_IDENTIFIER CalRegn01Cmn.CalibrationPorts.DutyCycThermProtnCtrlTSeln.Logl /end CHARACTERISTIC
/begin CHARACTERISTIC CalRegn01Cmn.DutyCycThermProtnDutyCycFildThd.Val "MICROSAR RTE" VALUE 0x0 RTE_RL_UWORD 0 NO_COMPU_METHOD 0 65535 SYMBOL_LINK "Rte_CalprmRom_CalRegn01Cmn_DEFAULT_RTE_CALPRM_GROUP.DutyCycThermProtnDutyCycFildThd_Val" 0 DISPLAY_IDENTIFIER CalRegn01Cmn.CalibrationPorts.DutyCycThermProtnDutyCycFildThd.Val /end CHARACTERISTIC
/begin CHARACTERISTIC CalRegn01Cmn.DutyCycThermProtnIgnOffCtrlEna.Logl "MICROSAR RTE" VALUE 0x0 RTE_RL_BOOLEAN 0 RTE_CM_BOOLEAN 0 255 SYMBOL_LINK "Rte_CalprmRom_CalRegn01Cmn_DEFAULT_RTE_CALPRM_GROUP.DutyCycThermProtnIgnOffCtrlEna_Logl" 0 DISPLAY_IDENTIFIER CalRegn01Cmn.CalibrationPorts.DutyCycThermProtnIgnOffCtrlEna.Logl /end CHARACTERISTIC
/begin CHARACTERISTIC CalRegn01Cmn.DutyCycThermProtnIgnOffMsgWaitTi.Val "MICROSAR RTE" VALUE 0x0 RTE_RL_FLOAT32_IEEE 0 NO_COMPU_METHOD -3.402823466e+38 3.402823466e+38 SYMBOL_LINK "Rte_CalprmRom_CalRegn01Cmn_DEFAULT_RTE_CALPRM_GROUP.DutyCycThermProtnIgnOffMsgWaitTi_Val" 0 DISPLAY_IDENTIFIER CalRegn01Cmn.CalibrationPorts.DutyCycThermProtnIgnOffMsgWaitTi.Val /end CHARACTERISTIC
/begin MEASUREMENT CDD_MotCurrRegVltgLimr.MotVltgBrdgLpFil.FilGain "MICROSAR RTE" FLOAT32_IEEE NO_COMPU_METHOD 0 0 -3.402823466e+38 3.402823466e+38 ECU_ADDRESS 0 SYMBOL_LINK "Rte_CDD_MotCurrRegVltgLimr_MotVltgBrdgLpFil.FilGain" 0 DISPLAY_IDENTIFIER CDD_MotCurrRegVltgLimr.PerInstanceMemories.MotVltgBrdgLpFil.FilGain /end MEASUREMENT
/begin MEASUREMENT CDD_MotCurrRegVltgLimr.MotVltgBrdgLpFil.FilSt "MICROSAR RTE" FLOAT32_IEEE NO_COMPU_METHOD 0 0 -3.402823466e+38 3.402823466e+38 ECU_ADDRESS 0 SYMBOL_LINK "Rte_CDD_MotCurrRegVltgLimr_MotVltgBrdgLpFil.FilSt" 0 DISPLAY_IDENTIFIER CDD_MotCurrRegVltgLimr.PerInstanceMemories.MotVltgBrdgLpFil.FilSt /end MEASUREMENT
/begin MEASUREMENT CDD_MotCurrRegVltgLimr.MotVltgIntglCmdDaxPrev "MICROSAR RTE" FLOAT32_IEEE NO_COMPU_METHOD 0 0 -1000 1000 ECU_ADDRESS 0 SYMBOL_LINK "Rte_CDD_MotCurrRegVltgLimr_MotVltgIntglCmdDaxPrev" 0 DISPLAY_IDENTIFIER CDD_MotCurrRegVltgLimr.PerInstanceMemories.MotVltgIntglCmdDaxPrev /end MEASUREMENT
/begin MEASUREMENT CDD_MotCurrRegVltgLimr.MotVltgIntglCmdQaxPrev "MICROSAR RTE" FLOAT32_IEEE NO_COMPU_METHOD 0 0 -1000 1000 ECU_ADDRESS 0 SYMBOL_LINK "Rte_CDD_MotCurrRegVltgLimr_MotVltgIntglCmdQaxPrev" 0 DISPLAY_IDENTIFIER CDD_MotCurrRegVltgLimr.PerInstanceMemories.MotVltgIntglCmdQaxPrev /end MEASUREMENT
/begin MEASUREMENT CDD_MotCurrRegVltgLimr.MotVltgQaxFfLpFil.FilGain "MICROSAR RTE" FLOAT32_IEEE NO_COMPU_METHOD 0 0 -3.402823466e+38 3.402823466e+38 ECU_ADDRESS 0 SYMBOL_LINK "Rte_CDD_MotCurrRegVltgLimr_MotVltgQaxFfLpFil.FilGain" 0 DISPLAY_IDENTIFIER CDD_MotCurrRegVltgLimr.PerInstanceMemories.MotVltgQaxFfLpFil.FilGain /end MEASUREMENT
/begin MEASUREMENT CDD_MotCurrRegVltgLimr.MotVltgQaxFfLpFil.FilSt "MICROSAR RTE" FLOAT32_IEEE NO_COMPU_METHOD 0 0 -3.402823466e+38 3.402823466e+38 ECU_ADDRESS 0 SYMBOL_LINK "Rte_CDD_MotCurrRegVltgLimr_MotVltgQaxFfLpFil.FilSt" 0 DISPLAY_IDENTIFIER CDD_MotCurrRegVltgLimr.PerInstanceMemories.MotVltgQaxFfLpFil.FilSt /end MEASUREMENT
/begin MEASUREMENT CDD_MotCurrRegVltgLimr.dMotCurrRegVltgLimrAntiWdupCmdScaDax "MICROSAR RTE" FLOAT32_IEEE NO_COMPU_METHOD 0 0 0.0 1.0 ECU_ADDRESS 0 SYMBOL_LINK "Rte_CDD_MotCurrRegVltgLimr_dMotCurrRegVltgLimrAntiWdupCmdScaDax" 0 DISPLAY_IDENTIFIER CDD_MotCurrRegVltgLimr.PerInstanceMemories.dMotCurrRegVltgLimrAntiWdupCmdScaDax /end MEASUREMENT
/begin MEASUREMENT CDD_MotCurrRegVltgLimr.dMotCurrRegVltgLimrAntiWdupCmdScaQax "MICROSAR RTE" FLOAT32_IEEE NO_COMPU_METHOD 0 0 0.0 1.0 ECU_ADDRESS 0 SYMBOL_LINK "Rte_CDD_MotCurrRegVltgLimr_dMotCurrRegVltgLimrAntiWdupCmdScaQax" 0 DISPLAY_IDENTIFIER CDD_MotCurrRegVltgLimr.PerInstanceMemories.dMotCurrRegVltgLimrAntiWdupCmdScaQax /end MEASUREMENT
/begin MEASUREMENT CDD_MotCurrRegVltgLimr.dMotCurrRegVltgLimrMotCurrCmdErrDax "MICROSAR RTE" FLOAT32_IEEE NO_COMPU_METHOD 0 0 -450 450 ECU_ADDRESS 0 SYMBOL_LINK "Rte_CDD_MotCurrRegVltgLimr_dMotCurrRegVltgLimrMotCurrCmdErrDax" 0 DISPLAY_IDENTIFIER CDD_MotCurrRegVltgLimr.PerInstanceMemories.dMotCurrRegVltgLimrMotCurrCmdErrDax /end MEASUREMENT
/begin MEASUREMENT CDD_MotCurrRegVltgLimr.dMotCurrRegVltgLimrMotCurrCmdErrQax "MICROSAR RTE" FLOAT32_IEEE NO_COMPU_METHOD 0 0 -450 450 ECU_ADDRESS 0 SYMBOL_LINK "Rte_CDD_MotCurrRegVltgLimr_dMotCurrRegVltgLimrMotCurrCmdErrQax" 0 DISPLAY_IDENTIFIER CDD_MotCurrRegVltgLimr.PerInstanceMemories.dMotCurrRegVltgLimrMotCurrCmdErrQax /end MEASUREMENT
/begin MEASUREMENT CDD_MotCurrRegVltgLimr.dMotCurrRegVltgLimrMotCurrCmdScaDax "MICROSAR RTE" FLOAT32_IEEE NO_COMPU_METHOD 0 0 -200 200 ECU_ADDRESS 0 SYMBOL_LINK "Rte_CDD_MotCurrRegVltgLimr_dMotCurrRegVltgLimrMotCurrCmdScaDax" 0 DISPLAY_IDENTIFIER CDD_MotCurrRegVltgLimr.PerInstanceMemories.dMotCurrRegVltgLimrMotCurrCmdScaDax /end MEASUREMENT
/begin MEASUREMENT CDD_MotCurrRegVltgLimr.dMotCurrRegVltgLimrMotCurrCmdScaQax "MICROSAR RTE" FLOAT32_IEEE NO_COMPU_METHOD 0 0 -200 200 ECU_ADDRESS 0 SYMBOL_LINK "Rte_CDD_MotCurrRegVltgLimr_dMotCurrRegVltgLimrMotCurrCmdScaQax" 0 DISPLAY_IDENTIFIER CDD_MotCurrRegVltgLimr.PerInstanceMemories.dMotCurrRegVltgLimrMotCurrCmdScaQax /end MEASUREMENT
/begin MEASUREMENT CDD_MotCurrRegVltgLimr.dMotCurrRegVltgLimrMotVltgBrdgFild "MICROSAR RTE" FLOAT32_IEEE NO_COMPU_METHOD 0 0 -3.402823466e+38 3.402823466e+38 ECU_ADDRESS 0 SYMBOL_LINK "Rte_CDD_MotCurrRegVltgLimr_dMotCurrRegVltgLimrMotVltgBrdgFild" 0 DISPLAY_IDENTIFIER CDD_MotCurrRegVltgLimr.PerInstanceMemories.dMotCurrRegVltgLimrMotVltgBrdgFild /end MEASUREMENT
/begin MEASUREMENT CDD_MotCurrRegVltgLimr.dMotCurrRegVltgLimrMotVltgCmdFinal "MICROSAR RTE" FLOAT32_IEEE NO_COMPU_METHOD 0 0 -26.5 26.5 ECU_ADDRESS 0 SYMBOL_LINK "Rte_CDD_MotCurrRegVltgLimr_dMotCurrRegVltgLimrMotVltgCmdFinal" 0 DISPLAY_IDENTIFIER CDD_MotCurrRegVltgLimr.PerInstanceMemories.dMotCurrRegVltgLimrMotVltgCmdFinal /end MEASUREMENT
/begin MEASUREMENT CDD_MotCurrRegVltgLimr.dMotCurrRegVltgLimrMotVltgCmdPreLim "MICROSAR RTE" FLOAT32_IEEE NO_COMPU_METHOD 0 0 -26.5 26.5 ECU_ADDRESS 0 SYMBOL_LINK "Rte_CDD_MotCurrRegVltgLimr_dMotCurrRegVltgLimrMotVltgCmdPreLim" 0 DISPLAY_IDENTIFIER CDD_MotCurrRegVltgLimr.PerInstanceMemories.dMotCurrRegVltgLimrMotVltgCmdPreLim /end MEASUREMENT
/begin MEASUREMENT CDD_MotCurrRegVltgLimr.dMotCurrRegVltgLimrMotVltgDampgDax "MICROSAR RTE" FLOAT32_IEEE NO_COMPU_METHOD 0 0 -26.5 26.5 ECU_ADDRESS 0 SYMBOL_LINK "Rte_CDD_MotCurrRegVltgLimr_dMotCurrRegVltgLimrMotVltgDampgDax" 0 DISPLAY_IDENTIFIER CDD_MotCurrRegVltgLimr.PerInstanceMemories.dMotCurrRegVltgLimrMotVltgDampgDax /end MEASUREMENT
/begin MEASUREMENT CDD_MotCurrRegVltgLimr.dMotCurrRegVltgLimrMotVltgDampgQax "MICROSAR RTE" FLOAT32_IEEE NO_COMPU_METHOD 0 0 -26.5 26.5 ECU_ADDRESS 0 SYMBOL_LINK "Rte_CDD_MotCurrRegVltgLimr_dMotCurrRegVltgLimrMotVltgDampgQax" 0 DISPLAY_IDENTIFIER CDD_MotCurrRegVltgLimr.PerInstanceMemories.dMotCurrRegVltgLimrMotVltgDampgQax /end MEASUREMENT
/begin MEASUREMENT CDD_MotCurrRegVltgLimr.dMotCurrRegVltgLimrMotVltgDaxFb "MICROSAR RTE" FLOAT32_IEEE NO_COMPU_METHOD 0 0 -3.402823466e+38 3.402823466e+38 ECU_ADDRESS 0 SYMBOL_LINK "Rte_CDD_MotCurrRegVltgLimr_dMotCurrRegVltgLimrMotVltgDaxFb" 0 DISPLAY_IDENTIFIER CDD_MotCurrRegVltgLimr.PerInstanceMemories.dMotCurrRegVltgLimrMotVltgDaxFb /end MEASUREMENT
/begin MEASUREMENT CDD_MotCurrRegVltgLimr.dMotCurrRegVltgLimrMotVltgDaxIntglPreLim "MICROSAR RTE" FLOAT32_IEEE NO_COMPU_METHOD 0 0 -3.402823466e+38 3.402823466e+38 ECU_ADDRESS 0 SYMBOL_LINK "Rte_CDD_MotCurrRegVltgLimr_dMotCurrRegVltgLimrMotVltgDaxIntglPreLim" 0 DISPLAY_IDENTIFIER CDD_MotCurrRegVltgLimr.PerInstanceMemories.dMotCurrRegVltgLimrMotVltgDaxIntglPreLim /end MEASUREMENT
/begin MEASUREMENT CDD_MotCurrRegVltgLimr.dMotCurrRegVltgLimrMotVltgDecoupldFbDax "MICROSAR RTE" FLOAT32_IEEE NO_COMPU_METHOD 0 0 -26.5 26.5 ECU_ADDRESS 0 SYMBOL_LINK "Rte_CDD_MotCurrRegVltgLimr_dMotCurrRegVltgLimrMotVltgDecoupldFbDax" 0 DISPLAY_IDENTIFIER CDD_MotCurrRegVltgLimr.PerInstanceMemories.dMotCurrRegVltgLimrMotVltgDecoupldFbDax /end MEASUREMENT
/begin MEASUREMENT CDD_MotCurrRegVltgLimr.dMotCurrRegVltgLimrMotVltgDecoupldFbQax "MICROSAR RTE" FLOAT32_IEEE NO_COMPU_METHOD 0 0 -26.5 26.5 ECU_ADDRESS 0 SYMBOL_LINK "Rte_CDD_MotCurrRegVltgLimr_dMotCurrRegVltgLimrMotVltgDecoupldFbQax" 0 DISPLAY_IDENTIFIER CDD_MotCurrRegVltgLimr.PerInstanceMemories.dMotCurrRegVltgLimrMotVltgDecoupldFbQax /end MEASUREMENT
/begin MEASUREMENT CDD_MotCurrRegVltgLimr.dMotCurrRegVltgLimrMotVltgDircFbDax "MICROSAR RTE" FLOAT32_IEEE NO_COMPU_METHOD 0 0 -26.5 26.5 ECU_ADDRESS 0 SYMBOL_LINK "Rte_CDD_MotCurrRegVltgLimr_dMotCurrRegVltgLimrMotVltgDircFbDax" 0 DISPLAY_IDENTIFIER CDD_MotCurrRegVltgLimr.PerInstanceMemories.dMotCurrRegVltgLimrMotVltgDircFbDax /end MEASUREMENT
/begin MEASUREMENT CDD_MotCurrRegVltgLimr.dMotCurrRegVltgLimrMotVltgDircFbQax "MICROSAR RTE" FLOAT32_IEEE NO_COMPU_METHOD 0 0 -26.5 26.5 ECU_ADDRESS 0 SYMBOL_LINK "Rte_CDD_MotCurrRegVltgLimr_dMotCurrRegVltgLimrMotVltgDircFbQax" 0 DISPLAY_IDENTIFIER CDD_MotCurrRegVltgLimr.PerInstanceMemories.dMotCurrRegVltgLimrMotVltgDircFbQax /end MEASUREMENT
/begin MEASUREMENT CDD_MotCurrRegVltgLimr.dMotCurrRegVltgLimrMotVltgPreLimDax "MICROSAR RTE" FLOAT32_IEEE NO_COMPU_METHOD 0 0 -26.5 26.5 ECU_ADDRESS 0 SYMBOL_LINK "Rte_CDD_MotCurrRegVltgLimr_dMotCurrRegVltgLimrMotVltgPreLimDax" 0 DISPLAY_IDENTIFIER CDD_MotCurrRegVltgLimr.PerInstanceMemories.dMotCurrRegVltgLimrMotVltgPreLimDax /end MEASUREMENT
/begin MEASUREMENT CDD_MotCurrRegVltgLimr.dMotCurrRegVltgLimrMotVltgPreLimQax "MICROSAR RTE" FLOAT32_IEEE NO_COMPU_METHOD 0 0 -26.5 26.5 ECU_ADDRESS 0 SYMBOL_LINK "Rte_CDD_MotCurrRegVltgLimr_dMotCurrRegVltgLimrMotVltgPreLimQax" 0 DISPLAY_IDENTIFIER CDD_MotCurrRegVltgLimr.PerInstanceMemories.dMotCurrRegVltgLimrMotVltgPreLimQax /end MEASUREMENT
/begin MEASUREMENT CDD_MotCurrRegVltgLimr.dMotCurrRegVltgLimrMotVltgPropCmdDax "MICROSAR RTE" FLOAT32_IEEE NO_COMPU_METHOD 0 0 -26.5 26.5 ECU_ADDRESS 0 SYMBOL_LINK "Rte_CDD_MotCurrRegVltgLimr_dMotCurrRegVltgLimrMotVltgPropCmdDax" 0 DISPLAY_IDENTIFIER CDD_MotCurrRegVltgLimr.PerInstanceMemories.dMotCurrRegVltgLimrMotVltgPropCmdDax /end MEASUREMENT
/begin MEASUREMENT CDD_MotCurrRegVltgLimr.dMotCurrRegVltgLimrMotVltgPropCmdQax "MICROSAR RTE" FLOAT32_IEEE NO_COMPU_METHOD 0 0 -26.5 26.5 ECU_ADDRESS 0 SYMBOL_LINK "Rte_CDD_MotCurrRegVltgLimr_dMotCurrRegVltgLimrMotVltgPropCmdQax" 0 DISPLAY_IDENTIFIER CDD_MotCurrRegVltgLimr.PerInstanceMemories.dMotCurrRegVltgLimrMotVltgPropCmdQax /end MEASUREMENT
/begin MEASUREMENT CDD_MotCurrRegVltgLimr.dMotCurrRegVltgLimrMotVltgQaxFb "MICROSAR RTE" FLOAT32_IEEE NO_COMPU_METHOD 0 0 -3.402823466e+38 3.402823466e+38 ECU_ADDRESS 0 SYMBOL_LINK "Rte_CDD_MotCurrRegVltgLimr_dMotCurrRegVltgLimrMotVltgQaxFb" 0 DISPLAY_IDENTIFIER CDD_MotCurrRegVltgLimr.PerInstanceMemories.dMotCurrRegVltgLimrMotVltgQaxFb /end MEASUREMENT
/begin MEASUREMENT CDD_MotCurrRegVltgLimr.dMotCurrRegVltgLimrMotVltgQaxFfFild "MICROSAR RTE" FLOAT32_IEEE NO_COMPU_METHOD 0 0 -3.402823466e+38 3.402823466e+38 ECU_ADDRESS 0 SYMBOL_LINK "Rte_CDD_MotCurrRegVltgLimr_dMotCurrRegVltgLimrMotVltgQaxFfFild" 0 DISPLAY_IDENTIFIER CDD_MotCurrRegVltgLimr.PerInstanceMemories.dMotCurrRegVltgLimrMotVltgQaxFfFild /end MEASUREMENT
/begin MEASUREMENT CDD_MotCurrRegVltgLimr.dMotCurrRegVltgLimrMotVltgQaxIntglPreLim "MICROSAR RTE" FLOAT32_IEEE NO_COMPU_METHOD 0 0 -3.402823466e+38 3.402823466e+38 ECU_ADDRESS 0 SYMBOL_LINK "Rte_CDD_MotCurrRegVltgLimr_dMotCurrRegVltgLimrMotVltgQaxIntglPreLim" 0 DISPLAY_IDENTIFIER CDD_MotCurrRegVltgLimr.PerInstanceMemories.dMotCurrRegVltgLimrMotVltgQaxIntglPreLim /end MEASUREMENT
/begin MEASUREMENT CDD_MotCurrRegVltgLimr.dMotCurrRegVltgLimrMotVltgSatnIvsRat "MICROSAR RTE" FLOAT32_IEEE NO_COMPU_METHOD 0 0 0.0 1.0 ECU_ADDRESS 0 SYMBOL_LINK "Rte_CDD_MotCurrRegVltgLimr_dMotCurrRegVltgLimrMotVltgSatnIvsRat" 0 DISPLAY_IDENTIFIER CDD_MotCurrRegVltgLimr.PerInstanceMemories.dMotCurrRegVltgLimrMotVltgSatnIvsRat /end MEASUREMENT
/begin MEASUREMENT CDD_MotCurrRegVltgLimr.dMotCurrRegVltgLimrMotVltgSatnRat "MICROSAR RTE" FLOAT32_IEEE NO_COMPU_METHOD 0 0 0.0 1.0 ECU_ADDRESS 0 SYMBOL_LINK "Rte_CDD_MotCurrRegVltgLimr_dMotCurrRegVltgLimrMotVltgSatnRat" 0 DISPLAY_IDENTIFIER CDD_MotCurrRegVltgLimr.PerInstanceMemories.dMotCurrRegVltgLimrMotVltgSatnRat /end MEASUREMENT
/begin MEASUREMENT CDD_MotCurrRegVltgLimr.dMotCurrRegVltgLimrPhaAdvPreDly "MICROSAR RTE" FLOAT32_IEEE NO_COMPU_METHOD 0 0 0 6.2832 ECU_ADDRESS 0 SYMBOL_LINK "Rte_CDD_MotCurrRegVltgLimr_dMotCurrRegVltgLimrPhaAdvPreDly" 0 DISPLAY_IDENTIFIER CDD_MotCurrRegVltgLimr.PerInstanceMemories.dMotCurrRegVltgLimrPhaAdvPreDly /end MEASUREMENT
/begin MEASUREMENT CDD_MotRplCoggCmd.MotCoggCmdY "MICROSAR RTE" SWORD NO_COMPU_METHOD 0 0 -32768 32767 MATRIX_DIM 512 1 1 ECU_ADDRESS 0 SYMBOL_LINK "Rte_CDD_MotRplCoggCmd_MotCoggCmdY" 0 DISPLAY_IDENTIFIER CDD_MotRplCoggCmd.PerInstanceMemories.MotCoggCmdY /end MEASUREMENT
/begin MEASUREMENT CDD_MotRplCoggCmd.dMotRplCoggCmdCoggIdx "MICROSAR RTE" UWORD NO_COMPU_METHOD 0 0 0 65535 ECU_ADDRESS 0 SYMBOL_LINK "Rte_CDD_MotRplCoggCmd_dMotRplCoggCmdCoggIdx" 0 DISPLAY_IDENTIFIER CDD_MotRplCoggCmd.PerInstanceMemories.dMotRplCoggCmdCoggIdx /end MEASUREMENT
/begin MEASUREMENT CDD_MotRplCoggCmd.dMotRplCoggCmdMotCoggCmd "MICROSAR RTE" FLOAT32_IEEE NO_COMPU_METHOD 0 0 -3.402823466e+38 3.402823466e+38 ECU_ADDRESS 0 SYMBOL_LINK "Rte_CDD_MotRplCoggCmd_dMotRplCoggCmdMotCoggCmd" 0 DISPLAY_IDENTIFIER CDD_MotRplCoggCmd.PerInstanceMemories.dMotRplCoggCmdMotCoggCmd /end MEASUREMENT
/begin MEASUREMENT CDD_MotRplCoggCmd.dMotRplCoggCmdMotCurrQaxCoggCmdPreLim "MICROSAR RTE" FLOAT32_IEEE NO_COMPU_METHOD 0 0 -3.402823466e+38 3.402823466e+38 ECU_ADDRESS 0 SYMBOL_LINK "Rte_CDD_MotRplCoggCmd_dMotRplCoggCmdMotCurrQaxCoggCmdPreLim" 0 DISPLAY_IDENTIFIER CDD_MotRplCoggCmd.PerInstanceMemories.dMotRplCoggCmdMotCurrQaxCoggCmdPreLim /end MEASUREMENT
/begin MEASUREMENT CDD_MotRplCoggCmd.dMotRplCoggCmdMotRplCmdPreLim "MICROSAR RTE" FLOAT32_IEEE NO_COMPU_METHOD 0 0 -3.402823466e+38 3.402823466e+38 ECU_ADDRESS 0 SYMBOL_LINK "Rte_CDD_MotRplCoggCmd_dMotRplCoggCmdMotRplCmdPreLim" 0 DISPLAY_IDENTIFIER CDD_MotRplCoggCmd.PerInstanceMemories.dMotRplCoggCmdMotRplCmdPreLim /end MEASUREMENT
/begin MEASUREMENT CDD_MotVel.AssiMechPolarity.Val "MICROSAR RTE" SBYTE NO_COMPU_METHOD 0 0 -128 127 ECU_ADDRESS 0 SYMBOL_LINK "Rte_PolarityCfg_AssiMechPolarity_Val" 0 DISPLAY_IDENTIFIER CDD_MotVel.ReceiverPorts.AssiMechPolarity.Val /end MEASUREMENT
/begin MEASUREMENT CDD_MotVel.MotAgBuf.Ary1D "MICROSAR RTE" UWORD NO_COMPU_METHOD 0 0 0 65535 MATRIX_DIM 8 1 1 ECU_ADDRESS 0 SYMBOL_LINK "Rte_CDD_MotCtrlMgr_MotAgBuf_Ary1D" 0 DISPLAY_IDENTIFIER CDD_MotVel.ReceiverPorts.MotAgBuf.Ary1D /end MEASUREMENT
/begin MEASUREMENT CDD_MotVel.MotAgBufIdx.Val "MICROSAR RTE" UBYTE NO_COMPU_METHOD 0 0 0 255 ECU_ADDRESS 0 SYMBOL_LINK "Rte_CDD_MotCtrlMgr_MotAgBufIdx_Val" 0 DISPLAY_IDENTIFIER CDD_MotVel.ReceiverPorts.MotAgBufIdx.Val /end MEASUREMENT
/begin MEASUREMENT CDD_MotVel.MotAgBufIdxPrev "MICROSAR RTE" UBYTE NO_COMPU_METHOD 0 0 0 255 ECU_ADDRESS 0 SYMBOL_LINK "Rte_CDD_MotVel_MotAgBufIdxPrev" 0 DISPLAY_IDENTIFIER CDD_MotVel.PerInstanceMemories.MotAgBufIdxPrev /end MEASUREMENT
/begin MEASUREMENT CDD_MotVel.MotAgBufIdxPrim "MICROSAR RTE" UBYTE NO_COMPU_METHOD 0 0 0 255 ECU_ADDRESS 0 SYMBOL_LINK "Rte_CDD_MotVel_MotAgBufIdxPrim" 0 DISPLAY_IDENTIFIER CDD_MotVel.PerInstanceMemories.MotAgBufIdxPrim /end MEASUREMENT
/begin MEASUREMENT CDD_MotVel.MotAgBufPrev "MICROSAR RTE" UWORD NO_COMPU_METHOD 0 0 0 65535 MATRIX_DIM 8 1 1 ECU_ADDRESS 0 SYMBOL_LINK "Rte_CDD_MotVel_MotAgBufPrev" 0 DISPLAY_IDENTIFIER CDD_MotVel.PerInstanceMemories.MotAgBufPrev /end MEASUREMENT
/begin MEASUREMENT CDD_MotVel.MotAgMeclIdptSig.Val "MICROSAR RTE" UBYTE NO_COMPU_METHOD 0 0 0 255 ECU_ADDRESS 0 SYMBOL_LINK "Rte_MotAgCorrln_MotAgMeclIdptSig_Val" 0 DISPLAY_IDENTIFIER CDD_MotVel.ReceiverPorts.MotAgMeclIdptSig.Val /end MEASUREMENT
/begin MEASUREMENT CDD_MotVel.MotAgTiBuf.Ary1D "MICROSAR RTE" ULONG NO_COMPU_METHOD 0 0 0 4294967295 MATRIX_DIM 8 1 1 ECU_ADDRESS 0 SYMBOL_LINK "Rte_CDD_MotCtrlMgr_MotAgTiBuf_Ary1D" 0 DISPLAY_IDENTIFIER CDD_MotVel.ReceiverPorts.MotAgTiBuf.Ary1D /end MEASUREMENT
/begin MEASUREMENT CDD_MotVel.MotAgTiBufPrev "MICROSAR RTE" ULONG NO_COMPU_METHOD 0 0 0 4294967295 MATRIX_DIM 8 1 1 ECU_ADDRESS 0 SYMBOL_LINK "Rte_CDD_MotVel_MotAgTiBufPrev" 0 DISPLAY_IDENTIFIER CDD_MotVel.PerInstanceMemories.MotAgTiBufPrev /end MEASUREMENT
/begin MEASUREMENT CDD_MotVel.MotVelCrf.Val "MICROSAR RTE" FLOAT32_IEEE NO_COMPU_METHOD 0 0 -3.402823466e+38 3.402823466e+38 ECU_ADDRESS 0 SYMBOL_LINK "Rte_CDD_MotVel_MotVelCrf_Val" 0 DISPLAY_IDENTIFIER CDD_MotVel.SenderPorts.MotVelCrf.Val /end MEASUREMENT
/begin MEASUREMENT CDD_MotVel.MotVelIninCntr "MICROSAR RTE" UBYTE NO_COMPU_METHOD 0 0 0 255 ECU_ADDRESS 0 SYMBOL_LINK "Rte_CDD_MotVel_MotVelIninCntr" 0 DISPLAY_IDENTIFIER CDD_MotVel.PerInstanceMemories.MotVelIninCntr /end MEASUREMENT
/begin MEASUREMENT CDD_MotVel.MotVelMrf.Val "MICROSAR RTE" FLOAT32_IEEE NO_COMPU_METHOD 0 0 -3.402823466e+38 3.402823466e+38 ECU_ADDRESS 0 SYMBOL_LINK "Rte_CDD_MotVel_MotVelMrf_Val" 0 DISPLAY_IDENTIFIER CDD_MotVel.SenderPorts.MotVelMrf.Val /end MEASUREMENT
/begin MEASUREMENT CDD_MotVel.MotVelVld.Logl "MICROSAR RTE" UBYTE RTE_CM_BOOLEAN 0 0 0 255 ECU_ADDRESS 0 SYMBOL_LINK "Rte_CDD_MotVel_MotVelVld_Logl" 0 DISPLAY_IDENTIFIER CDD_MotVel.SenderPorts.MotVelVld.Logl /end MEASUREMENT
/begin MEASUREMENT CDD_MotVel.dMotVelAvrgTi "MICROSAR RTE" FLOAT32_IEEE NO_COMPU_METHOD 0 0 -3.402823466e+38 3.402823466e+38 ECU_ADDRESS 0 SYMBOL_LINK "Rte_CDD_MotVel_dMotVelAvrgTi" 0 DISPLAY_IDENTIFIER CDD_MotVel.PerInstanceMemories.dMotVelAvrgTi /end MEASUREMENT
/begin MEASUREMENT CDD_MotVel.dMotVelMotAgRef "MICROSAR RTE" UWORD NO_COMPU_METHOD 0 0 0 65535 ECU_ADDRESS 0 SYMBOL_LINK "Rte_CDD_MotVel_dMotVelMotAgRef" 0 DISPLAY_IDENTIFIER CDD_MotVel.PerInstanceMemories.dMotVelMotAgRef /end MEASUREMENT
/begin MEASUREMENT CDD_MotVel.dMotVelTiStampRef "MICROSAR RTE" FLOAT32_IEEE NO_COMPU_METHOD 0 0 -3.402823466e+38 3.402823466e+38 ECU_ADDRESS 0 SYMBOL_LINK "Rte_CDD_MotVel_dMotVelTiStampRef" 0 DISPLAY_IDENTIFIER CDD_MotVel.PerInstanceMemories.dMotVelTiStampRef /end MEASUREMENT
/begin MEASUREMENT CDD_NvMProxy.BlkFltTbl[0].Prm "MICROSAR RTE" UBYTE NO_COMPU_METHOD 0 0 0 255 ECU_ADDRESS 0 SYMBOL_LINK "Rte_CDD_NvMProxy_BlkFltTbl[0].Prm" 0 DISPLAY_IDENTIFIER CDD_NvMProxy.PerInstanceMemories.BlkFltTbl[0].Prm /end MEASUREMENT
/begin MEASUREMENT CDD_NvMProxy.BlkFltTbl[0].Sts "MICROSAR RTE" UBYTE RTE_CM_ENUM_NtcSts1 0 0 0 255 ECU_ADDRESS 0 SYMBOL_LINK "Rte_CDD_NvMProxy_BlkFltTbl[0].Sts" 0 DISPLAY_IDENTIFIER CDD_NvMProxy.PerInstanceMemories.BlkFltTbl[0].Sts /end MEASUREMENT
/begin MEASUREMENT CDD_NvMProxy.BlkFltTbl[1].Prm "MICROSAR RTE" UBYTE NO_COMPU_METHOD 0 0 0 255 ECU_ADDRESS 0 SYMBOL_LINK "Rte_CDD_NvMProxy_BlkFltTbl[1].Prm" 0 DISPLAY_IDENTIFIER CDD_NvMProxy.PerInstanceMemories.BlkFltTbl[1].Prm /end MEASUREMENT
/begin MEASUREMENT CDD_NvMProxy.BlkFltTbl[1].Sts "MICROSAR RTE" UBYTE RTE_CM_ENUM_NtcSts1 0 0 0 255 ECU_ADDRESS 0 SYMBOL_LINK "Rte_CDD_NvMProxy_BlkFltTbl[1].Sts" 0 DISPLAY_IDENTIFIER CDD_NvMProxy.PerInstanceMemories.BlkFltTbl[1].Sts /end MEASUREMENT
/begin MEASUREMENT CDD_NvMProxy.BlkFltTbl[2].Prm "MICROSAR RTE" UBYTE NO_COMPU_METHOD 0 0 0 255 ECU_ADDRESS 0 SYMBOL_LINK "Rte_CDD_NvMProxy_BlkFltTbl[2].Prm" 0 DISPLAY_IDENTIFIER CDD_NvMProxy.PerInstanceMemories.BlkFltTbl[2].Prm /end MEASUREMENT
/begin MEASUREMENT CDD_NvMProxy.BlkFltTbl[2].Sts "MICROSAR RTE" UBYTE RTE_CM_ENUM_NtcSts1 0 0 0 255 ECU_ADDRESS 0 SYMBOL_LINK "Rte_CDD_NvMProxy_BlkFltTbl[2].Sts" 0 DISPLAY_IDENTIFIER CDD_NvMProxy.PerInstanceMemories.BlkFltTbl[2].Sts /end MEASUREMENT
/begin MEASUREMENT CDD_NvMProxy.BlkFltTbl[3].Prm "MICROSAR RTE" UBYTE NO_COMPU_METHOD 0 0 0 255 ECU_ADDRESS 0 SYMBOL_LINK "Rte_CDD_NvMProxy_BlkFltTbl[3].Prm" 0 DISPLAY_IDENTIFIER CDD_NvMProxy.PerInstanceMemories.BlkFltTbl[3].Prm /end MEASUREMENT
/begin MEASUREMENT CDD_NvMProxy.BlkFltTbl[3].Sts "MICROSAR RTE" UBYTE RTE_CM_ENUM_NtcSts1 0 0 0 255 ECU_ADDRESS 0 SYMBOL_LINK "Rte_CDD_NvMProxy_BlkFltTbl[3].Sts" 0 DISPLAY_IDENTIFIER CDD_NvMProxy.PerInstanceMemories.BlkFltTbl[3].Sts /end MEASUREMENT
/begin MEASUREMENT CDD_NvMProxy.BlkFltTbl[4].Prm "MICROSAR RTE" UBYTE NO_COMPU_METHOD 0 0 0 255 ECU_ADDRESS 0 SYMBOL_LINK "Rte_CDD_NvMProxy_BlkFltTbl[4].Prm" 0 DISPLAY_IDENTIFIER CDD_NvMProxy.PerInstanceMemories.BlkFltTbl[4].Prm /end MEASUREMENT
/begin MEASUREMENT CDD_NvMProxy.BlkFltTbl[4].Sts "MICROSAR RTE" UBYTE RTE_CM_ENUM_NtcSts1 0 0 0 255 ECU_ADDRESS 0 SYMBOL_LINK "Rte_CDD_NvMProxy_BlkFltTbl[4].Sts" 0 DISPLAY_IDENTIFIER CDD_NvMProxy.PerInstanceMemories.BlkFltTbl[4].Sts /end MEASUREMENT
/begin MEASUREMENT CDD_NvMProxy.NvmStsCollctd "MICROSAR RTE" UBYTE RTE_CM_BOOLEAN 0 0 0 255 ECU_ADDRESS 0 SYMBOL_LINK "Rte_CDD_NvMProxy_NvmStsCollctd" 0 DISPLAY_IDENTIFIER CDD_NvMProxy.PerInstanceMemories.NvmStsCollctd /end MEASUREMENT
/begin MEASUREMENT CDD_NvMProxy.ShtdwnClsChk "MICROSAR RTE" ULONG NO_COMPU_METHOD 0 0 0 4294967295 ECU_ADDRESS 0 SYMBOL_LINK "Rte_CDD_NvMProxy_ShtdwnClsChk" 0 DISPLAY_IDENTIFIER CDD_NvMProxy.PerInstanceMemories.ShtdwnClsChk /end MEASUREMENT
/begin MEASUREMENT CDD_NxtrTi.PrevTi "MICROSAR RTE" ULONG NO_COMPU_METHOD 0 0 0 4294967295 ECU_ADDRESS 0 SYMBOL_LINK "Rte_CDD_NxtrTi_PrevTi" 0 DISPLAY_IDENTIFIER CDD_NxtrTi.PerInstanceMemories.PrevTi /end MEASUREMENT
/begin MEASUREMENT CDD_RamMem.GlbRamEccSngBitCntr "MICROSAR RTE" UBYTE NO_COMPU_METHOD 0 0 0 255 ECU_ADDRESS 0 SYMBOL_LINK "Rte_CDD_RamMem_GlbRamEccSngBitCntr" 0 DISPLAY_IDENTIFIER CDD_RamMem.PerInstanceMemories.GlbRamEccSngBitCntr /end MEASUREMENT
/begin MEASUREMENT CDD_RamMem.GlbRamEccSngBitCntrOutp.Val "MICROSAR RTE" UBYTE NO_COMPU_METHOD 0 0 0 255 ECU_ADDRESS 0 SYMBOL_LINK "Rte_CDD_RamMem_GlbRamEccSngBitCntrOutp_Val" 0 DISPLAY_IDENTIFIER CDD_RamMem.SenderPorts.GlbRamEccSngBitCntrOutp.Val /end MEASUREMENT
/begin MEASUREMENT CDD_RamMem.GlbRamEccSngBitSoftFailr "MICROSAR RTE" UBYTE RTE_CM_BOOLEAN 0 0 0 255 ECU_ADDRESS 0 SYMBOL_LINK "Rte_CDD_RamMem_GlbRamEccSngBitSoftFailr" 0 DISPLAY_IDENTIFIER CDD_RamMem.PerInstanceMemories.GlbRamEccSngBitSoftFailr /end MEASUREMENT
/begin MEASUREMENT CDD_RamMem.GlbRamFailrAdr "MICROSAR RTE" ULONG NO_COMPU_METHOD 0 0 0 4294967295 ECU_ADDRESS 0 SYMBOL_LINK "Rte_CDD_RamMem_GlbRamFailrAdr" 0 DISPLAY_IDENTIFIER CDD_RamMem.PerInstanceMemories.GlbRamFailrAdr /end MEASUREMENT
/begin MEASUREMENT CDD_RamMem.GlbRamWordLineRead "MICROSAR RTE" ULONG NO_COMPU_METHOD 0 0 0 4294967295 ECU_ADDRESS 0 SYMBOL_LINK "Rte_CDD_RamMem_GlbRamWordLineRead" 0 DISPLAY_IDENTIFIER CDD_RamMem.PerInstanceMemories.GlbRamWordLineRead /end MEASUREMENT
/begin MEASUREMENT CDD_RamMem.LclRamEccSngBitCntr "MICROSAR RTE" UBYTE NO_COMPU_METHOD 0 0 0 255 ECU_ADDRESS 0 SYMBOL_LINK "Rte_CDD_RamMem_LclRamEccSngBitCntr" 0 DISPLAY_IDENTIFIER CDD_RamMem.PerInstanceMemories.LclRamEccSngBitCntr /end MEASUREMENT
/begin MEASUREMENT CDD_RamMem.LclRamEccSngBitCntrOutp.Val "MICROSAR RTE" UBYTE NO_COMPU_METHOD 0 0 0 255 ECU_ADDRESS 0 SYMBOL_LINK "Rte_CDD_RamMem_LclRamEccSngBitCntrOutp_Val" 0 DISPLAY_IDENTIFIER CDD_RamMem.SenderPorts.LclRamEccSngBitCntrOutp.Val /end MEASUREMENT
/begin MEASUREMENT CDD_RamMem.LclRamEccSngBitSoftFailr "MICROSAR RTE" UBYTE RTE_CM_BOOLEAN 0 0 0 255 ECU_ADDRESS 0 SYMBOL_LINK "Rte_CDD_RamMem_LclRamEccSngBitSoftFailr" 0 DISPLAY_IDENTIFIER CDD_RamMem.PerInstanceMemories.LclRamEccSngBitSoftFailr /end MEASUREMENT
/begin MEASUREMENT CDD_RamMem.LclRamFailrAdr "MICROSAR RTE" ULONG NO_COMPU_METHOD 0 0 0 4294967295 ECU_ADDRESS 0 SYMBOL_LINK "Rte_CDD_RamMem_LclRamFailrAdr" 0 DISPLAY_IDENTIFIER CDD_RamMem.PerInstanceMemories.LclRamFailrAdr /end MEASUREMENT
/begin MEASUREMENT CDD_RamMem.LclRamWordLineRead "MICROSAR RTE" ULONG NO_COMPU_METHOD 0 0 0 4294967295 ECU_ADDRESS 0 SYMBOL_LINK "Rte_CDD_RamMem_LclRamWordLineRead" 0 DISPLAY_IDENTIFIER CDD_RamMem.PerInstanceMemories.LclRamWordLineRead /end MEASUREMENT
/begin MEASUREMENT CDD_RamMem.dRamMemCanRamDblBitEccErrAdr "MICROSAR RTE" ULONG NO_COMPU_METHOD 0 0 0 4294967295 ECU_ADDRESS 0 SYMBOL_LINK "Rte_CDD_RamMem_dRamMemCanRamDblBitEccErrAdr" 0 DISPLAY_IDENTIFIER CDD_RamMem.PerInstanceMemories.dRamMemCanRamDblBitEccErrAdr /end MEASUREMENT
/begin MEASUREMENT CDD_RamMem.dRamMemCanRamSngBitEccErrAdr "MICROSAR RTE" ULONG NO_COMPU_METHOD 0 0 0 4294967295 ECU_ADDRESS 0 SYMBOL_LINK "Rte_CDD_RamMem_dRamMemCanRamSngBitEccErrAdr" 0 DISPLAY_IDENTIFIER CDD_RamMem.PerInstanceMemories.dRamMemCanRamSngBitEccErrAdr /end MEASUREMENT
/begin MEASUREMENT CDD_RamMem.dRamMemDtsRamEccErrAdr "MICROSAR RTE" ULONG NO_COMPU_METHOD 0 0 0 4294967295 ECU_ADDRESS 0 SYMBOL_LINK "Rte_CDD_RamMem_dRamMemDtsRamEccErrAdr" 0 DISPLAY_IDENTIFIER CDD_RamMem.PerInstanceMemories.dRamMemDtsRamEccErrAdr /end MEASUREMENT
/begin MEASUREMENT CDD_RamMem.dRamMemFrRamDblBitEccErrAdr "MICROSAR RTE" ULONG NO_COMPU_METHOD 0 0 0 4294967295 ECU_ADDRESS 0 SYMBOL_LINK "Rte_CDD_RamMem_dRamMemFrRamDblBitEccErrAdr" 0 DISPLAY_IDENTIFIER CDD_RamMem.PerInstanceMemories.dRamMemFrRamDblBitEccErrAdr /end MEASUREMENT
/begin MEASUREMENT CDD_RamMem.dRamMemFrRamSngBitEccErrAdr "MICROSAR RTE" ULONG NO_COMPU_METHOD 0 0 0 4294967295 ECU_ADDRESS 0 SYMBOL_LINK "Rte_CDD_RamMem_dRamMemFrRamSngBitEccErrAdr" 0 DISPLAY_IDENTIFIER CDD_RamMem.PerInstanceMemories.dRamMemFrRamSngBitEccErrAdr /end MEASUREMENT
/begin MEASUREMENT CDD_RamMem.dRamMemFrRamTmpBufADblBitEccErrAdr "MICROSAR RTE" ULONG NO_COMPU_METHOD 0 0 0 4294967295 ECU_ADDRESS 0 SYMBOL_LINK "Rte_CDD_RamMem_dRamMemFrRamTmpBufADblBitEccErrAdr" 0 DISPLAY_IDENTIFIER CDD_RamMem.PerInstanceMemories.dRamMemFrRamTmpBufADblBitEccErrAdr /end MEASUREMENT
/begin MEASUREMENT CDD_RamMem.dRamMemFrRamTmpBufBDblBitEccErrAdr "MICROSAR RTE" ULONG NO_COMPU_METHOD 0 0 0 4294967295 ECU_ADDRESS 0 SYMBOL_LINK "Rte_CDD_RamMem_dRamMemFrRamTmpBufBDblBitEccErrAdr" 0 DISPLAY_IDENTIFIER CDD_RamMem.PerInstanceMemories.dRamMemFrRamTmpBufBDblBitEccErrAdr /end MEASUREMENT
/begin MEASUREMENT CDD_RamMem.dRamMemGtmRamSngBitEccErrAdr "MICROSAR RTE" ULONG NO_COMPU_METHOD 0 0 0 4294967295 ECU_ADDRESS 0 SYMBOL_LINK "Rte_CDD_RamMem_dRamMemGtmRamSngBitEccErrAdr" 0 DISPLAY_IDENTIFIER CDD_RamMem.PerInstanceMemories.dRamMemGtmRamSngBitEccErrAdr /end MEASUREMENT
/begin MEASUREMENT CDD_RamMem.dRamMemMCan0RamDblBitEccErrAdr "MICROSAR RTE" ULONG NO_COMPU_METHOD 0 0 0 4294967295 ECU_ADDRESS 0 SYMBOL_LINK "Rte_CDD_RamMem_dRamMemMCan0RamDblBitEccErrAdr" 0 DISPLAY_IDENTIFIER CDD_RamMem.PerInstanceMemories.dRamMemMCan0RamDblBitEccErrAdr /end MEASUREMENT
/begin MEASUREMENT CDD_RamMem.dRamMemMCan1RamDblBitEccErrAdr "MICROSAR RTE" ULONG NO_COMPU_METHOD 0 0 0 4294967295 ECU_ADDRESS 0 SYMBOL_LINK "Rte_CDD_RamMem_dRamMemMCan1RamDblBitEccErrAdr" 0 DISPLAY_IDENTIFIER CDD_RamMem.PerInstanceMemories.dRamMemMCan1RamDblBitEccErrAdr /end MEASUREMENT
/begin MEASUREMENT CDD_RamMem.dRamMemSpi0RamEccErrAdr "MICROSAR RTE" ULONG NO_COMPU_METHOD 0 0 0 4294967295 ECU_ADDRESS 0 SYMBOL_LINK "Rte_CDD_RamMem_dRamMemSpi0RamEccErrAdr" 0 DISPLAY_IDENTIFIER CDD_RamMem.PerInstanceMemories.dRamMemSpi0RamEccErrAdr /end MEASUREMENT
/begin MEASUREMENT CDD_RamMem.dRamMemSpi1RamEccErrAdr "MICROSAR RTE" ULONG NO_COMPU_METHOD 0 0 0 4294967295 ECU_ADDRESS 0 SYMBOL_LINK "Rte_CDD_RamMem_dRamMemSpi1RamEccErrAdr" 0 DISPLAY_IDENTIFIER CDD_RamMem.PerInstanceMemories.dRamMemSpi1RamEccErrAdr /end MEASUREMENT
/begin MEASUREMENT CDD_RamMem.dRamMemSpi2RamEccErrAdr "MICROSAR RTE" ULONG NO_COMPU_METHOD 0 0 0 4294967295 ECU_ADDRESS 0 SYMBOL_LINK "Rte_CDD_RamMem_dRamMemSpi2RamEccErrAdr" 0 DISPLAY_IDENTIFIER CDD_RamMem.PerInstanceMemories.dRamMemSpi2RamEccErrAdr /end MEASUREMENT
/begin MEASUREMENT CDD_RamMem.dRamMemSpi3RamEccErrAdr "MICROSAR RTE" ULONG NO_COMPU_METHOD 0 0 0 4294967295 ECU_ADDRESS 0 SYMBOL_LINK "Rte_CDD_RamMem_dRamMemSpi3RamEccErrAdr" 0 DISPLAY_IDENTIFIER CDD_RamMem.PerInstanceMemories.dRamMemSpi3RamEccErrAdr /end MEASUREMENT
/begin MEASUREMENT CDD_RamMem.dRamMemSpiRamEccErrAdr "MICROSAR RTE" ULONG NO_COMPU_METHOD 0 0 0 4294967295 ECU_ADDRESS 0 SYMBOL_LINK "Rte_CDD_RamMem_dRamMemSpiRamEccErrAdr" 0 DISPLAY_IDENTIFIER CDD_RamMem.PerInstanceMemories.dRamMemSpiRamEccErrAdr /end MEASUREMENT
/begin MEASUREMENT CDD_SinVltgGenn.Fil1OutpPrev "MICROSAR RTE" FLOAT32_IEEE NO_COMPU_METHOD 0 0 -3.402823466e+38 3.402823466e+38 ECU_ADDRESS 0 SYMBOL_LINK "Rte_CDD_SinVltgGenn_Fil1OutpPrev" 0 DISPLAY_IDENTIFIER CDD_SinVltgGenn.PerInstanceMemories.Fil1OutpPrev /end MEASUREMENT
/begin MEASUREMENT CDD_SinVltgGenn.Fil2OutpPrev "MICROSAR RTE" FLOAT32_IEEE NO_COMPU_METHOD 0 0 -3.402823466e+38 3.402823466e+38 ECU_ADDRESS 0 SYMBOL_LINK "Rte_CDD_SinVltgGenn_Fil2OutpPrev" 0 DISPLAY_IDENTIFIER CDD_SinVltgGenn.PerInstanceMemories.Fil2OutpPrev /end MEASUREMENT
/begin MEASUREMENT CDD_SinVltgGenn.MotElecMeclPolarity.Val "MICROSAR RTE" SBYTE NO_COMPU_METHOD 0 0 -128 127 ECU_ADDRESS 0 SYMBOL_LINK "Rte_PolarityCfg_MotElecMeclPolarity_Val" 0 DISPLAY_IDENTIFIER CDD_SinVltgGenn.ReceiverPorts.MotElecMeclPolarity.Val /end MEASUREMENT
/begin MEASUREMENT CDD_SinVltgGenn.PhaDptOffsA "MICROSAR RTE" FLOAT32_IEEE NO_COMPU_METHOD 0 0 -3.402823466e+38 3.402823466e+38 ECU_ADDRESS 0 SYMBOL_LINK "Rte_CDD_SinVltgGenn_PhaDptOffsA" 0 DISPLAY_IDENTIFIER CDD_SinVltgGenn.PerInstanceMemories.PhaDptOffsA /end MEASUREMENT
/begin MEASUREMENT CDD_SinVltgGenn.PhaDptOffsB "MICROSAR RTE" FLOAT32_IEEE NO_COMPU_METHOD 0 0 -3.402823466e+38 3.402823466e+38 ECU_ADDRESS 0 SYMBOL_LINK "Rte_CDD_SinVltgGenn_PhaDptOffsB" 0 DISPLAY_IDENTIFIER CDD_SinVltgGenn.PerInstanceMemories.PhaDptOffsB /end MEASUREMENT
/begin MEASUREMENT CDD_SinVltgGenn.PhaDptOffsC "MICROSAR RTE" FLOAT32_IEEE NO_COMPU_METHOD 0 0 -3.402823466e+38 3.402823466e+38 ECU_ADDRESS 0 SYMBOL_LINK "Rte_CDD_SinVltgGenn_PhaDptOffsC" 0 DISPLAY_IDENTIFIER CDD_SinVltgGenn.PerInstanceMemories.PhaDptOffsC /end MEASUREMENT
/begin MEASUREMENT CDD_SinVltgGenn.PhaOnTiSumAPrev "MICROSAR RTE" ULONG NO_COMPU_METHOD 0 0 0 4294967295 ECU_ADDRESS 0 SYMBOL_LINK "Rte_CDD_SinVltgGenn_PhaOnTiSumAPrev" 0 DISPLAY_IDENTIFIER CDD_SinVltgGenn.PerInstanceMemories.PhaOnTiSumAPrev /end MEASUREMENT
/begin MEASUREMENT CDD_SinVltgGenn.PhaOnTiSumBPrev "MICROSAR RTE" ULONG NO_COMPU_METHOD 0 0 0 4294967295 ECU_ADDRESS 0 SYMBOL_LINK "Rte_CDD_SinVltgGenn_PhaOnTiSumBPrev" 0 DISPLAY_IDENTIFIER CDD_SinVltgGenn.PerInstanceMemories.PhaOnTiSumBPrev /end MEASUREMENT
/begin MEASUREMENT CDD_SinVltgGenn.PhaOnTiSumCPrev "MICROSAR RTE" ULONG NO_COMPU_METHOD 0 0 0 4294967295 ECU_ADDRESS 0 SYMBOL_LINK "Rte_CDD_SinVltgGenn_PhaOnTiSumCPrev" 0 DISPLAY_IDENTIFIER CDD_SinVltgGenn.PerInstanceMemories.PhaOnTiSumCPrev /end MEASUREMENT
/begin MEASUREMENT CDD_SinVltgGenn.PwmPerdRng "MICROSAR RTE" ULONG NO_COMPU_METHOD 0 0 0 4294967295 ECU_ADDRESS 0 SYMBOL_LINK "Rte_CDD_SinVltgGenn_PwmPerdRng" 0 DISPLAY_IDENTIFIER CDD_SinVltgGenn.PerInstanceMemories.PwmPerdRng /end MEASUREMENT
/begin MEASUREMENT CDD_SinVltgGenn.RndNrPrev "MICROSAR RTE" FLOAT32_IEEE NO_COMPU_METHOD 0 0 -3.402823466e+38 3.402823466e+38 ECU_ADDRESS 0 SYMBOL_LINK "Rte_CDD_SinVltgGenn_RndNrPrev" 0 DISPLAY_IDENTIFIER CDD_SinVltgGenn.PerInstanceMemories.RndNrPrev /end MEASUREMENT
/begin MEASUREMENT CDD_SyncCrc.CrcHwSts[0].CrcHwSts "MICROSAR RTE" UBYTE RTE_CM_ENUM_CrcHwSts1 0 0 0 255 ECU_ADDRESS 0 SYMBOL_LINK "Rte_CDD_SyncCrc_CrcHwSts[0].CrcHwSts" 0 DISPLAY_IDENTIFIER CDD_SyncCrc.PerInstanceMemories.CrcHwSts[0].CrcHwSts /end MEASUREMENT
/begin MEASUREMENT CDD_SyncCrc.CrcHwSts[0].TaskId "MICROSAR RTE" ULONG NO_COMPU_METHOD 0 0 0 4294967295 ECU_ADDRESS 0 SYMBOL_LINK "Rte_CDD_SyncCrc_CrcHwSts[0].TaskId" 0 DISPLAY_IDENTIFIER CDD_SyncCrc.PerInstanceMemories.CrcHwSts[0].TaskId /end MEASUREMENT
/begin MEASUREMENT CDD_SyncCrc.CrcHwSts[1].CrcHwSts "MICROSAR RTE" UBYTE RTE_CM_ENUM_CrcHwSts1 0 0 0 255 ECU_ADDRESS 0 SYMBOL_LINK "Rte_CDD_SyncCrc_CrcHwSts[1].CrcHwSts" 0 DISPLAY_IDENTIFIER CDD_SyncCrc.PerInstanceMemories.CrcHwSts[1].CrcHwSts /end MEASUREMENT
/begin MEASUREMENT CDD_SyncCrc.CrcHwSts[1].TaskId "MICROSAR RTE" ULONG NO_COMPU_METHOD 0 0 0 4294967295 ECU_ADDRESS 0 SYMBOL_LINK "Rte_CDD_SyncCrc_CrcHwSts[1].TaskId" 0 DISPLAY_IDENTIFIER CDD_SyncCrc.PerInstanceMemories.CrcHwSts[1].TaskId /end MEASUREMENT
/begin MEASUREMENT CDD_SyncCrc.CrcHwSts[2].CrcHwSts "MICROSAR RTE" UBYTE RTE_CM_ENUM_CrcHwSts1 0 0 0 255 ECU_ADDRESS 0 SYMBOL_LINK "Rte_CDD_SyncCrc_CrcHwSts[2].CrcHwSts" 0 DISPLAY_IDENTIFIER CDD_SyncCrc.PerInstanceMemories.CrcHwSts[2].CrcHwSts /end MEASUREMENT
/begin MEASUREMENT CDD_SyncCrc.CrcHwSts[2].TaskId "MICROSAR RTE" ULONG NO_COMPU_METHOD 0 0 0 4294967295 ECU_ADDRESS 0 SYMBOL_LINK "Rte_CDD_SyncCrc_CrcHwSts[2].TaskId" 0 DISPLAY_IDENTIFIER CDD_SyncCrc.PerInstanceMemories.CrcHwSts[2].TaskId /end MEASUREMENT
/begin MEASUREMENT CDD_SyncCrc.CrcHwSts[3].CrcHwSts "MICROSAR RTE" UBYTE RTE_CM_ENUM_CrcHwSts1 0 0 0 255 ECU_ADDRESS 0 SYMBOL_LINK "Rte_CDD_SyncCrc_CrcHwSts[3].CrcHwSts" 0 DISPLAY_IDENTIFIER CDD_SyncCrc.PerInstanceMemories.CrcHwSts[3].CrcHwSts /end MEASUREMENT
/begin MEASUREMENT CDD_SyncCrc.CrcHwSts[3].TaskId "MICROSAR RTE" ULONG NO_COMPU_METHOD 0 0 0 4294967295 ECU_ADDRESS 0 SYMBOL_LINK "Rte_CDD_SyncCrc_CrcHwSts[3].TaskId" 0 DISPLAY_IDENTIFIER CDD_SyncCrc.PerInstanceMemories.CrcHwSts[3].TaskId /end MEASUREMENT
/begin MEASUREMENT CDD_SyncCrc.CrcHwSts[4].CrcHwSts "MICROSAR RTE" UBYTE RTE_CM_ENUM_CrcHwSts1 0 0 0 255 ECU_ADDRESS 0 SYMBOL_LINK "Rte_CDD_SyncCrc_CrcHwSts[4].CrcHwSts" 0 DISPLAY_IDENTIFIER CDD_SyncCrc.PerInstanceMemories.CrcHwSts[4].CrcHwSts /end MEASUREMENT
/begin MEASUREMENT CDD_SyncCrc.CrcHwSts[4].TaskId "MICROSAR RTE" ULONG NO_COMPU_METHOD 0 0 0 4294967295 ECU_ADDRESS 0 SYMBOL_LINK "Rte_CDD_SyncCrc_CrcHwSts[4].TaskId" 0 DISPLAY_IDENTIFIER CDD_SyncCrc.PerInstanceMemories.CrcHwSts[4].TaskId /end MEASUREMENT
/begin MEASUREMENT CDD_SyncCrc.CrcHwSts[5].CrcHwSts "MICROSAR RTE" UBYTE RTE_CM_ENUM_CrcHwSts1 0 0 0 255 ECU_ADDRESS 0 SYMBOL_LINK "Rte_CDD_SyncCrc_CrcHwSts[5].CrcHwSts" 0 DISPLAY_IDENTIFIER CDD_SyncCrc.PerInstanceMemories.CrcHwSts[5].CrcHwSts /end MEASUREMENT
/begin MEASUREMENT CDD_SyncCrc.CrcHwSts[5].TaskId "MICROSAR RTE" ULONG NO_COMPU_METHOD 0 0 0 4294967295 ECU_ADDRESS 0 SYMBOL_LINK "Rte_CDD_SyncCrc_CrcHwSts[5].TaskId" 0 DISPLAY_IDENTIFIER CDD_SyncCrc.PerInstanceMemories.CrcHwSts[5].TaskId /end MEASUREMENT
/begin MEASUREMENT CDD_SyncCrc.CrcHwSts[6].CrcHwSts "MICROSAR RTE" UBYTE RTE_CM_ENUM_CrcHwSts1 0 0 0 255 ECU_ADDRESS 0 SYMBOL_LINK "Rte_CDD_SyncCrc_CrcHwSts[6].CrcHwSts" 0 DISPLAY_IDENTIFIER CDD_SyncCrc.PerInstanceMemories.CrcHwSts[6].CrcHwSts /end MEASUREMENT
/begin MEASUREMENT CDD_SyncCrc.CrcHwSts[6].TaskId "MICROSAR RTE" ULONG NO_COMPU_METHOD 0 0 0 4294967295 ECU_ADDRESS 0 SYMBOL_LINK "Rte_CDD_SyncCrc_CrcHwSts[6].TaskId" 0 DISPLAY_IDENTIFIER CDD_SyncCrc.PerInstanceMemories.CrcHwSts[6].TaskId /end MEASUREMENT
/begin MEASUREMENT CDD_SyncCrc.CrcHwSts[7].CrcHwSts "MICROSAR RTE" UBYTE RTE_CM_ENUM_CrcHwSts1 0 0 0 255 ECU_ADDRESS 0 SYMBOL_LINK "Rte_CDD_SyncCrc_CrcHwSts[7].CrcHwSts" 0 DISPLAY_IDENTIFIER CDD_SyncCrc.PerInstanceMemories.CrcHwSts[7].CrcHwSts /end MEASUREMENT
/begin MEASUREMENT CDD_SyncCrc.CrcHwSts[7].TaskId "MICROSAR RTE" ULONG NO_COMPU_METHOD 0 0 0 4294967295 ECU_ADDRESS 0 SYMBOL_LINK "Rte_CDD_SyncCrc_CrcHwSts[7].TaskId" 0 DISPLAY_IDENTIFIER CDD_SyncCrc.PerInstanceMemories.CrcHwSts[7].TaskId /end MEASUREMENT
/begin MEASUREMENT CDD_Uart0CfgAndUse.PrevDmaTrfCnt "MICROSAR RTE" UWORD NO_COMPU_METHOD 0 0 0 65535 ECU_ADDRESS 0 SYMBOL_LINK "Rte_CDD_Uart0CfgAndUse_PrevDmaTrfCnt" 0 DISPLAY_IDENTIFIER CDD_Uart0CfgAndUse.PerInstanceMemories.PrevDmaTrfCnt /end MEASUREMENT
/begin MEASUREMENT CDD_Uart0CfgAndUse.Uart0100MilliSecBufCnt "MICROSAR RTE" UBYTE NO_COMPU_METHOD 0 0 0 255 MATRIX_DIM 2048 1 1 ECU_ADDRESS 0 SYMBOL_LINK "Rte_CDD_Uart0CfgAndUse_Uart0100MilliSecBufCnt" 0 DISPLAY_IDENTIFIER CDD_Uart0CfgAndUse.PerInstanceMemories.Uart0100MilliSecBufCnt /end MEASUREMENT
/begin MEASUREMENT CDD_Uart0CfgAndUse.Uart0100MilliSecReadCmpl "MICROSAR RTE" UBYTE NO_COMPU_METHOD 0 0 0 255 ECU_ADDRESS 0 SYMBOL_LINK "Rte_CDD_Uart0CfgAndUse_Uart0100MilliSecReadCmpl" 0 DISPLAY_IDENTIFIER CDD_Uart0CfgAndUse.PerInstanceMemories.Uart0100MilliSecReadCmpl /end MEASUREMENT
/begin MEASUREMENT CDD_Uart0CfgAndUse.Uart010MilliSecBufCnt "MICROSAR RTE" UBYTE NO_COMPU_METHOD 0 0 0 255 MATRIX_DIM 2048 1 1 ECU_ADDRESS 0 SYMBOL_LINK "Rte_CDD_Uart0CfgAndUse_Uart010MilliSecBufCnt" 0 DISPLAY_IDENTIFIER CDD_Uart0CfgAndUse.PerInstanceMemories.Uart010MilliSecBufCnt /end MEASUREMENT
/begin MEASUREMENT CDD_Uart0CfgAndUse.Uart010MilliSecReadCmpl "MICROSAR RTE" UBYTE NO_COMPU_METHOD 0 0 0 255 ECU_ADDRESS 0 SYMBOL_LINK "Rte_CDD_Uart0CfgAndUse_Uart010MilliSecReadCmpl" 0 DISPLAY_IDENTIFIER CDD_Uart0CfgAndUse.PerInstanceMemories.Uart010MilliSecReadCmpl /end MEASUREMENT
/begin MEASUREMENT CDD_Uart0CfgAndUse.Uart02MilliSecBufCnt "MICROSAR RTE" UBYTE NO_COMPU_METHOD 0 0 0 255 MATRIX_DIM 2048 1 1 ECU_ADDRESS 0 SYMBOL_LINK "Rte_CDD_Uart0CfgAndUse_Uart02MilliSecBufCnt" 0 DISPLAY_IDENTIFIER CDD_Uart0CfgAndUse.PerInstanceMemories.Uart02MilliSecBufCnt /end MEASUREMENT
/begin MEASUREMENT CDD_Uart0CfgAndUse.Uart0DiagcFrmErrCntr "MICROSAR RTE" ULONG NO_COMPU_METHOD 0 0 0 4294967295 ECU_ADDRESS 0 SYMBOL_LINK "Rte_CDD_Uart0CfgAndUse_Uart0DiagcFrmErrCntr" 0 DISPLAY_IDENTIFIER CDD_Uart0CfgAndUse.PerInstanceMemories.Uart0DiagcFrmErrCntr /end MEASUREMENT
/begin MEASUREMENT CDD_Uart0CfgAndUse.Uart0DiagcOvrrunErrCntr "MICROSAR RTE" ULONG NO_COMPU_METHOD 0 0 0 4294967295 ECU_ADDRESS 0 SYMBOL_LINK "Rte_CDD_Uart0CfgAndUse_Uart0DiagcOvrrunErrCntr" 0 DISPLAY_IDENTIFIER CDD_Uart0CfgAndUse.PerInstanceMemories.Uart0DiagcOvrrunErrCntr /end MEASUREMENT
/begin MEASUREMENT CDD_Uart0CfgAndUse.Uart0DiagcParErrCntr "MICROSAR RTE" ULONG NO_COMPU_METHOD 0 0 0 4294967295 ECU_ADDRESS 0 SYMBOL_LINK "Rte_CDD_Uart0CfgAndUse_Uart0DiagcParErrCntr" 0 DISPLAY_IDENTIFIER CDD_Uart0CfgAndUse.PerInstanceMemories.Uart0DiagcParErrCntr /end MEASUREMENT
/begin MEASUREMENT CDD_Uart0CfgAndUse.Uart0DiagcRxMaxDataErrCntr "MICROSAR RTE" ULONG NO_COMPU_METHOD 0 0 0 4294967295 ECU_ADDRESS 0 SYMBOL_LINK "Rte_CDD_Uart0CfgAndUse_Uart0DiagcRxMaxDataErrCntr" 0 DISPLAY_IDENTIFIER CDD_Uart0CfgAndUse.PerInstanceMemories.Uart0DiagcRxMaxDataErrCntr /end MEASUREMENT
/begin MEASUREMENT CDD_Uart0CfgAndUse.Uart0NrOfPnd100MilliSecFrmCnt "MICROSAR RTE" UBYTE NO_COMPU_METHOD 0 0 0 255 ECU_ADDRESS 0 SYMBOL_LINK "Rte_CDD_Uart0CfgAndUse_Uart0NrOfPnd100MilliSecFrmCnt" 0 DISPLAY_IDENTIFIER CDD_Uart0CfgAndUse.PerInstanceMemories.Uart0NrOfPnd100MilliSecFrmCnt /end MEASUREMENT
/begin MEASUREMENT CDD_Uart0CfgAndUse.Uart0NrOfPnd10MilliSecFrmCnt "MICROSAR RTE" UBYTE NO_COMPU_METHOD 0 0 0 255 ECU_ADDRESS 0 SYMBOL_LINK "Rte_CDD_Uart0CfgAndUse_Uart0NrOfPnd10MilliSecFrmCnt" 0 DISPLAY_IDENTIFIER CDD_Uart0CfgAndUse.PerInstanceMemories.Uart0NrOfPnd10MilliSecFrmCnt /end MEASUREMENT
/begin MEASUREMENT CDD_Uart0CfgAndUse.Uart0RxPrevLoopDataUnread "MICROSAR RTE" UBYTE NO_COMPU_METHOD 0 0 0 255 ECU_ADDRESS 0 SYMBOL_LINK "Rte_CDD_Uart0CfgAndUse_Uart0RxPrevLoopDataUnread" 0 DISPLAY_IDENTIFIER CDD_Uart0CfgAndUse.PerInstanceMemories.Uart0RxPrevLoopDataUnread /end MEASUREMENT
/begin MEASUREMENT CDD_Uart1CfgAndUse.PrevDmaTrfCnt "MICROSAR RTE" UWORD NO_COMPU_METHOD 0 0 0 65535 ECU_ADDRESS 0 SYMBOL_LINK "Rte_CDD_Uart1CfgAndUse_PrevDmaTrfCnt" 0 DISPLAY_IDENTIFIER CDD_Uart1CfgAndUse.PerInstanceMemories.PrevDmaTrfCnt /end MEASUREMENT
/begin MEASUREMENT CDD_Uart1CfgAndUse.Uart1100MilliSecBufCnt "MICROSAR RTE" UBYTE NO_COMPU_METHOD 0 0 0 255 MATRIX_DIM 2048 1 1 ECU_ADDRESS 0 SYMBOL_LINK "Rte_CDD_Uart1CfgAndUse_Uart1100MilliSecBufCnt" 0 DISPLAY_IDENTIFIER CDD_Uart1CfgAndUse.PerInstanceMemories.Uart1100MilliSecBufCnt /end MEASUREMENT
/begin MEASUREMENT CDD_Uart1CfgAndUse.Uart1100MilliSecReadCmpl "MICROSAR RTE" UBYTE NO_COMPU_METHOD 0 0 0 255 ECU_ADDRESS 0 SYMBOL_LINK "Rte_CDD_Uart1CfgAndUse_Uart1100MilliSecReadCmpl" 0 DISPLAY_IDENTIFIER CDD_Uart1CfgAndUse.PerInstanceMemories.Uart1100MilliSecReadCmpl /end MEASUREMENT
/begin MEASUREMENT CDD_Uart1CfgAndUse.Uart110MilliSecBufCnt "MICROSAR RTE" UBYTE NO_COMPU_METHOD 0 0 0 255 MATRIX_DIM 2048 1 1 ECU_ADDRESS 0 SYMBOL_LINK "Rte_CDD_Uart1CfgAndUse_Uart110MilliSecBufCnt" 0 DISPLAY_IDENTIFIER CDD_Uart1CfgAndUse.PerInstanceMemories.Uart110MilliSecBufCnt /end MEASUREMENT
/begin MEASUREMENT CDD_Uart1CfgAndUse.Uart110MilliSecReadCmpl "MICROSAR RTE" UBYTE NO_COMPU_METHOD 0 0 0 255 ECU_ADDRESS 0 SYMBOL_LINK "Rte_CDD_Uart1CfgAndUse_Uart110MilliSecReadCmpl" 0 DISPLAY_IDENTIFIER CDD_Uart1CfgAndUse.PerInstanceMemories.Uart110MilliSecReadCmpl /end MEASUREMENT
/begin MEASUREMENT CDD_Uart1CfgAndUse.Uart12MilliSecBufCnt "MICROSAR RTE" UBYTE NO_COMPU_METHOD 0 0 0 255 MATRIX_DIM 2048 1 1 ECU_ADDRESS 0 SYMBOL_LINK "Rte_CDD_Uart1CfgAndUse_Uart12MilliSecBufCnt" 0 DISPLAY_IDENTIFIER CDD_Uart1CfgAndUse.PerInstanceMemories.Uart12MilliSecBufCnt /end MEASUREMENT
/begin MEASUREMENT CDD_Uart1CfgAndUse.Uart1DiagcFrmErrCntr "MICROSAR RTE" ULONG NO_COMPU_METHOD 0 0 0 4294967295 ECU_ADDRESS 0 SYMBOL_LINK "Rte_CDD_Uart1CfgAndUse_Uart1DiagcFrmErrCntr" 0 DISPLAY_IDENTIFIER CDD_Uart1CfgAndUse.PerInstanceMemories.Uart1DiagcFrmErrCntr /end MEASUREMENT
/begin MEASUREMENT CDD_Uart1CfgAndUse.Uart1DiagcOvrrunErrCntr "MICROSAR RTE" ULONG NO_COMPU_METHOD 0 0 0 4294967295 ECU_ADDRESS 0 SYMBOL_LINK "Rte_CDD_Uart1CfgAndUse_Uart1DiagcOvrrunErrCntr" 0 DISPLAY_IDENTIFIER CDD_Uart1CfgAndUse.PerInstanceMemories.Uart1DiagcOvrrunErrCntr /end MEASUREMENT
/begin MEASUREMENT CDD_Uart1CfgAndUse.Uart1DiagcParErrCntr "MICROSAR RTE" ULONG NO_COMPU_METHOD 0 0 0 4294967295 ECU_ADDRESS 0 SYMBOL_LINK "Rte_CDD_Uart1CfgAndUse_Uart1DiagcParErrCntr" 0 DISPLAY_IDENTIFIER CDD_Uart1CfgAndUse.PerInstanceMemories.Uart1DiagcParErrCntr /end MEASUREMENT
/begin MEASUREMENT CDD_Uart1CfgAndUse.Uart1DiagcRxMaxDataErrCntr "MICROSAR RTE" ULONG NO_COMPU_METHOD 0 0 0 4294967295 ECU_ADDRESS 0 SYMBOL_LINK "Rte_CDD_Uart1CfgAndUse_Uart1DiagcRxMaxDataErrCntr" 0 DISPLAY_IDENTIFIER CDD_Uart1CfgAndUse.PerInstanceMemories.Uart1DiagcRxMaxDataErrCntr /end MEASUREMENT
/begin MEASUREMENT CDD_Uart1CfgAndUse.Uart1NrOfPnd100MilliSecFrmCnt "MICROSAR RTE" UBYTE NO_COMPU_METHOD 0 0 0 255 ECU_ADDRESS 0 SYMBOL_LINK "Rte_CDD_Uart1CfgAndUse_Uart1NrOfPnd100MilliSecFrmCnt" 0 DISPLAY_IDENTIFIER CDD_Uart1CfgAndUse.PerInstanceMemories.Uart1NrOfPnd100MilliSecFrmCnt /end MEASUREMENT
/begin MEASUREMENT CDD_Uart1CfgAndUse.Uart1NrOfPnd10MilliSecFrmCnt "MICROSAR RTE" UBYTE NO_COMPU_METHOD 0 0 0 255 ECU_ADDRESS 0 SYMBOL_LINK "Rte_CDD_Uart1CfgAndUse_Uart1NrOfPnd10MilliSecFrmCnt" 0 DISPLAY_IDENTIFIER CDD_Uart1CfgAndUse.PerInstanceMemories.Uart1NrOfPnd10MilliSecFrmCnt /end MEASUREMENT
/begin MEASUREMENT CDD_Uart1CfgAndUse.Uart1RxPrevLoopDataUnread "MICROSAR RTE" UBYTE NO_COMPU_METHOD 0 0 0 255 ECU_ADDRESS 0 SYMBOL_LINK "Rte_CDD_Uart1CfgAndUse_Uart1RxPrevLoopDataUnread" 0 DISPLAY_IDENTIFIER CDD_Uart1CfgAndUse.PerInstanceMemories.Uart1RxPrevLoopDataUnread /end MEASUREMENT
/begin MEASUREMENT CDD_VrfyCritReg.MCalReadVrfyCritRegFltInfo "MICROSAR RTE" ULONG NO_COMPU_METHOD 0 0 0 4294967295 ECU_ADDRESS 0 SYMBOL_LINK "Rte_CDD_VrfyCritReg_MCalReadVrfyCritRegFltInfo" 0 DISPLAY_IDENTIFIER CDD_VrfyCritReg.PerInstanceMemories.MCalReadVrfyCritRegFltInfo /end MEASUREMENT
/begin MEASUREMENT CDD_VrfyCritReg.MCalReadVrfyCritRegFltNvmInfo "MICROSAR RTE" ULONG NO_COMPU_METHOD 0 0 0 4294967295 ECU_ADDRESS 0 SYMBOL_LINK "Rte_CDD_VrfyCritReg_MCalReadVrfyCritRegFltNvmInfo" 0 DISPLAY_IDENTIFIER CDD_VrfyCritReg.PerInstanceMemories.MCalReadVrfyCritRegFltNvmInfo /end MEASUREMENT
/begin MEASUREMENT CDD_VrfyCritReg.dVrfyCritRegCritRegActVal "MICROSAR RTE" ULONG NO_COMPU_METHOD 0 0 0 4294967295 ECU_ADDRESS 0 SYMBOL_LINK "Rte_CDD_VrfyCritReg_dVrfyCritRegCritRegActVal" 0 DISPLAY_IDENTIFIER CDD_VrfyCritReg.PerInstanceMemories.dVrfyCritRegCritRegActVal /end MEASUREMENT
/begin MEASUREMENT CDD_VrfyCritReg.dVrfyCritRegCritRegAdr "MICROSAR RTE" ULONG NO_COMPU_METHOD 0 0 0 4294967295 ECU_ADDRESS 0 SYMBOL_LINK "Rte_CDD_VrfyCritReg_dVrfyCritRegCritRegAdr" 0 DISPLAY_IDENTIFIER CDD_VrfyCritReg.PerInstanceMemories.dVrfyCritRegCritRegAdr /end MEASUREMENT
/begin MEASUREMENT CDD_VrfyCritReg.dVrfyCritRegCritRegDesVal "MICROSAR RTE" ULONG NO_COMPU_METHOD 0 0 0 4294967295 ECU_ADDRESS 0 SYMBOL_LINK "Rte_CDD_VrfyCritReg_dVrfyCritRegCritRegDesVal" 0 DISPLAY_IDENTIFIER CDD_VrfyCritReg.PerInstanceMemories.dVrfyCritRegCritRegDesVal /end MEASUREMENT
/begin MEASUREMENT CDD_VrfyCritReg.dVrfyCritRegSysCritRegActVal "MICROSAR RTE" ULONG NO_COMPU_METHOD 0 0 0 4294967295 ECU_ADDRESS 0 SYMBOL_LINK "Rte_CDD_VrfyCritReg_dVrfyCritRegSysCritRegActVal" 0 DISPLAY_IDENTIFIER CDD_VrfyCritReg.PerInstanceMemories.dVrfyCritRegSysCritRegActVal /end MEASUREMENT
/begin MEASUREMENT CDD_VrfyCritReg.dVrfyCritRegSysCritRegAdr "MICROSAR RTE" ULONG NO_COMPU_METHOD 0 0 0 4294967295 ECU_ADDRESS 0 SYMBOL_LINK "Rte_CDD_VrfyCritReg_dVrfyCritRegSysCritRegAdr" 0 DISPLAY_IDENTIFIER CDD_VrfyCritReg.PerInstanceMemories.dVrfyCritRegSysCritRegAdr /end MEASUREMENT
/begin MEASUREMENT CDD_VrfyCritReg.dVrfyCritRegSysCritRegDesVal "MICROSAR RTE" ULONG NO_COMPU_METHOD 0 0 0 4294967295 ECU_ADDRESS 0 SYMBOL_LINK "Rte_CDD_VrfyCritReg_dVrfyCritRegSysCritRegDesVal" 0 DISPLAY_IDENTIFIER CDD_VrfyCritReg.PerInstanceMemories.dVrfyCritRegSysCritRegDesVal /end MEASUREMENT
/begin MEASUREMENT CDD_XcpIf.ActvIninIdx.Val "MICROSAR RTE" UBYTE NO_COMPU_METHOD 0 0 0 255 ECU_ADDRESS 0 SYMBOL_LINK "Rte_TunSelnMngt_ActvIninIdx_Val" 0 DISPLAY_IDENTIFIER CDD_XcpIf.ReceiverPorts.ActvIninIdx.Val /end MEASUREMENT
/begin MEASUREMENT CDD_XcpIf.ActvRtIdx.Val "MICROSAR RTE" UBYTE NO_COMPU_METHOD 0 0 0 255 ECU_ADDRESS 0 SYMBOL_LINK "Rte_TunSelnMngt_ActvRtIdx_Val" 0 DISPLAY_IDENTIFIER CDD_XcpIf.ReceiverPorts.ActvRtIdx.Val /end MEASUREMENT
/begin GROUP CDD_MotCurrRegVltgLimr.MotCurrRegVltgLimrMotVltgDaxIntglLoLim.Val "MICROSAR RTE" /begin SUB_GROUP /end SUB_GROUP /begin FUNCTION_LIST /end FUNCTION_LIST
 /begin REF_CHARACTERISTIC CDD_MotCurrRegVltgLimr.MotCurrRegVltgLimrMotVltgDaxIntglLoLim.Val /end REF_CHARACTERISTIC
 /begin REF_MEASUREMENT /end REF_MEASUREMENT
/end GROUP
/begin GROUP CDD_MotCurrRegVltgLimr.MotCurrRegVltgLimrMotVltgQaxFfFilEna.Logl "MICROSAR RTE" /begin SUB_GROUP /end SUB_GROUP /begin FUNCTION_LIST /end FUNCTION_LIST
 /begin REF_CHARACTERISTIC CDD_MotCurrRegVltgLimr.MotCurrRegVltgLimrMotVltgQaxFfFilEna.Logl /end REF_CHARACTERISTIC
 /begin REF_MEASUREMENT /end REF_MEASUREMENT
/end GROUP
/begin GROUP CDD_MotCurrRegVltgLimr.MotCurrRegVltgLimrMotVltgQaxFfLpFilFrq.Val "MICROSAR RTE" /begin SUB_GROUP /end SUB_GROUP /begin FUNCTION_LIST /end FUNCTION_LIST
 /begin REF_CHARACTERISTIC CDD_MotCurrRegVltgLimr.MotCurrRegVltgLimrMotVltgQaxFfLpFilFrq.Val /end REF_CHARACTERISTIC
 /begin REF_MEASUREMENT /end REF_MEASUREMENT
/end GROUP
/begin GROUP CDD_MotCurrRegVltgLimr.MotCurrRegVltgLimrMotVltgQaxIntglHiLim.Val "MICROSAR RTE" /begin SUB_GROUP /end SUB_GROUP /begin FUNCTION_LIST /end FUNCTION_LIST
 /begin REF_CHARACTERISTIC CDD_MotCurrRegVltgLimr.MotCurrRegVltgLimrMotVltgQaxIntglHiLim.Val /end REF_CHARACTERISTIC
 /begin REF_MEASUREMENT /end REF_MEASUREMENT
/end GROUP
/begin GROUP CDD_MotCurrRegVltgLimr.MotCurrRegVltgLimrMotVltgQaxIntglLoLim.Val "MICROSAR RTE" /begin SUB_GROUP /end SUB_GROUP /begin FUNCTION_LIST /end FUNCTION_LIST
 /begin REF_CHARACTERISTIC CDD_MotCurrRegVltgLimr.MotCurrRegVltgLimrMotVltgQaxIntglLoLim.Val /end REF_CHARACTERISTIC
 /begin REF_MEASUREMENT /end REF_MEASUREMENT
/end GROUP
/begin GROUP CDD_MotCurrRegVltgLimr.MotCurrRegVltgLimrQaxAntiWdupCoeff.Val "MICROSAR RTE" /begin SUB_GROUP /end SUB_GROUP /begin FUNCTION_LIST /end FUNCTION_LIST
 /begin REF_CHARACTERISTIC CDD_MotCurrRegVltgLimr.MotCurrRegVltgLimrQaxAntiWdupCoeff.Val /end REF_CHARACTERISTIC
 /begin REF_MEASUREMENT /end REF_MEASUREMENT
/end GROUP
/begin GROUP CDD_MotCurrRegVltgLimr.MotCurrRegVltgLimrQaxAntiWdupScagDi.Logl "MICROSAR RTE" /begin SUB_GROUP /end SUB_GROUP /begin FUNCTION_LIST /end FUNCTION_LIST
 /begin REF_CHARACTERISTIC CDD_MotCurrRegVltgLimr.MotCurrRegVltgLimrQaxAntiWdupScagDi.Logl /end REF_CHARACTERISTIC
 /begin REF_MEASUREMENT /end REF_MEASUREMENT
/end GROUP
/begin GROUP CDD_MotCurrRegVltgLimr.MotRefMdlFbCtrlDi.Logl "MICROSAR RTE" /begin SUB_GROUP /end SUB_GROUP /begin FUNCTION_LIST /end FUNCTION_LIST /begin REF_CHARACTERISTIC CDD_MotCurrRegVltgLimr.MotRefMdlFbCtrlDi.Logl /end REF_CHARACTERISTIC /begin REF_MEASUREMENT /end REF_MEASUREMENT /end GROUP
/begin GROUP CDD_MotCurrRegVltgLimr.MotRefMdlIvtrDeadTiBrdgVltgSca.Val "MICROSAR RTE" /begin SUB_GROUP /end SUB_GROUP /begin FUNCTION_LIST /end FUNCTION_LIST /begin REF_CHARACTERISTIC CDD_MotCurrRegVltgLimr.MotRefMdlIvtrDeadTiBrdgVltgSca.Val /end REF_CHARACTERISTIC /begin REF_MEASUREMENT /end REF_MEASUREMENT /end GROUP
/begin GROUP CDD_MotCurrRegVltgLimr.MotVltgBrdgLpFil "MICROSAR RTE" /begin SUB_GROUP /end SUB_GROUP /begin FUNCTION_LIST /end FUNCTION_LIST /begin REF_CHARACTERISTIC /end REF_CHARACTERISTIC
 /begin REF_MEASUREMENT CDD_MotCurrRegVltgLimr.MotVltgBrdgLpFil.FilGain CDD_MotCurrRegVltgLimr.MotVltgBrdgLpFil.FilSt /end REF_MEASUREMENT
/end GROUP
/begin GROUP CDD_MotCurrRegVltgLimr.MotVltgIntglCmdDaxPrev "MICROSAR RTE" /begin SUB_GROUP /end SUB_GROUP /begin FUNCTION_LIST /end FUNCTION_LIST /begin REF_CHARACTERISTIC /end REF_CHARACTERISTIC /begin REF_MEASUREMENT CDD_MotCurrRegVltgLimr.MotVltgIntglCmdDaxPrev /end REF_MEASUREMENT /end GROUP
/begin GROUP CDD_MotCurrRegVltgLimr.MotVltgIntglCmdQaxPrev "MICROSAR RTE" /begin SUB_GROUP /end SUB_GROUP /begin FUNCTION_LIST /end FUNCTION_LIST /begin REF_CHARACTERISTIC /end REF_CHARACTERISTIC /begin REF_MEASUREMENT CDD_MotCurrRegVltgLimr.MotVltgIntglCmdQaxPrev /end REF_MEASUREMENT /end GROUP
/begin GROUP CDD_MotCurrRegVltgLimr.MotVltgQaxFfLpFil "MICROSAR RTE" /begin SUB_GROUP /end SUB_GROUP /begin FUNCTION_LIST /end FUNCTION_LIST /begin REF_CHARACTERISTIC /end REF_CHARACTERISTIC
 /begin REF_MEASUREMENT CDD_MotCurrRegVltgLimr.MotVltgQaxFfLpFil.FilGain CDD_MotCurrRegVltgLimr.MotVltgQaxFfLpFil.FilSt /end REF_MEASUREMENT
/end GROUP
/begin GROUP CDD_MotCurrRegVltgLimr.PerInstanceMemories "MICROSAR RTE"
 /begin SUB_GROUP CDD_MotCurrRegVltgLimr.AntiWdupCmdScaDax CDD_MotCurrRegVltgLimr.AntiWdupCmdScaQax CDD_MotCurrRegVltgLimr.CurrLoaScarPrev CDD_MotCurrRegVltgLimr.DualEcuLoaScarPrev CDD_MotCurrRegVltgLimr.FETLoaScarPrev CDD_MotCurrRegVltgLimr.IvtrLoaScarPrev CDD_MotCurrRegVltgLimr.MotCtrlMotVltgDaxPrev CDD_MotCurrRegVltgLimr.MotCtrlMotVltgQaxPrev CDD_MotCurrRegVltgLimr.MotVltgBrdgLpFil CDD_MotCurrRegVltgLimr.MotVltgIntglCmdDaxPrev CDD_MotCurrRegVltgLimr.MotVltgIntglCmdQaxPrev CDD_MotCurrRegVltgLimr.MotVltgQaxFfLpFil CDD_MotCurrRegVltgLimr.dMotCurrRegVltgLimrAntiWdupCmdScaDax CDD_MotCurrRegVltgLimr.dMotCurrRegVltgLimrAntiWdupCmdScaQax CDD_MotCurrRegVltgLimr.dMotCurrRegVltgLimrMotCurrCmdErrDax CDD_MotCurrRegVltgLimr.dMotCurrRegVltgLimrMotCurrCmdErrQax CDD_MotCurrRegVltgLimr.dMotCurrRegVltgLimrMotCurrCmdScaDax CDD_MotCurrRegVltgLimr.dMotCurrRegVltgLimrMotCurrCmdScaQax CDD_MotCurrRegVltgLimr.dMotCurrRegVltgLimrMotVltgBrdgFild CDD_MotCurrRegVltgLimr.dMotCurrRegVltgLimrMotVltgCmdFinal CDD_MotCurrRegVltgLimr.dMotCurrRegVltgLimrMotVltgCmdPreLim CDD_MotCurrRegVltgLimr.dMotCurrRegVltgLimrMotVltgDampgDax CDD_MotCurrRegVltgLimr.dMotCurrRegVltgLimrMotVltgDampgQax CDD_MotCurrRegVltgLimr.dMotCurrRegVltgLimrMotVltgDaxFb CDD_MotCurrRegVltgLimr.dMotCurrRegVltgLimrMotVltgDaxIntglPreLim CDD_MotCurrRegVltgLimr.dMotCurrRegVltgLimrMotVltgDecoupldFbDax CDD_MotCurrRegVltgLimr.dMotCurrRegVltgLimrMotVltgDecoupldFbQax CDD_MotCurrRegVltgLimr.dMotCurrRegVltgLimrMotVltgDircFbDax CDD_MotCurrRegVltgLimr.dMotCurrRegVltgLimrMotVltgDircFbQax CDD_MotCurrRegVltgLimr.dMotCurrRegVltgLimrMotVltgPreLimDax CDD_MotCurrRegVltgLimr.dMotCurrRegVltgLimrMotVltgPreLimQax CDD_MotCurrRegVltgLimr.dMotCurrRegVltgLimrMotVltgPropCmdDax CDD_MotCurrRegVltgLimr.dMotCurrRegVltgLimrMotVltgPropCmdQax CDD_MotCurrRegVltgLimr.dMotCurrRegVltgLimrMotVltgQaxFb CDD_MotCurrRegVltgLimr.dMotCurrRegVltgLimrMotVltgQaxFfFild CDD_MotCurrRegVltgLimr.dMotCurrRegVltgLimrMotVltgQaxIntglPreLim CDD_MotCurrRegVltgLimr.dMotCurrRegVltgLimrMotVltgSatnIvsRat CDD_MotCurrRegVltgLimr.dMotCurrRegVltgLimrMotVltgSatnRat CDD_MotCurrRegVltgLimr.dMotCurrRegVltgLimrPhaAdvPreDly /end SUB_GROUP
 /begin FUNCTION_LIST /end FUNCTION_LIST
 /begin REF_CHARACTERISTIC /end REF_CHARACTERISTIC
 /begin REF_MEASUREMENT /end REF_MEASUREMENT
/end GROUP
/begin GROUP CDD_MotCurrRegVltgLimr.dMotCurrRegVltgLimrAntiWdupCmdScaDax "MICROSAR RTE" /begin SUB_GROUP /end SUB_GROUP /begin FUNCTION_LIST /end FUNCTION_LIST /begin REF_CHARACTERISTIC /end REF_CHARACTERISTIC
 /begin REF_MEASUREMENT CDD_MotCurrRegVltgLimr.dMotCurrRegVltgLimrAntiWdupCmdScaDax /end REF_MEASUREMENT
/end GROUP
/begin GROUP CDD_MotCurrRegVltgLimr.dMotCurrRegVltgLimrAntiWdupCmdScaQax "MICROSAR RTE" /begin SUB_GROUP /end SUB_GROUP /begin FUNCTION_LIST /end FUNCTION_LIST /begin REF_CHARACTERISTIC /end REF_CHARACTERISTIC
 /begin REF_MEASUREMENT CDD_MotCurrRegVltgLimr.dMotCurrRegVltgLimrAntiWdupCmdScaQax /end REF_MEASUREMENT
/end GROUP
/begin GROUP CDD_MotCurrRegVltgLimr.dMotCurrRegVltgLimrMotCurrCmdErrDax "MICROSAR RTE" /begin SUB_GROUP /end SUB_GROUP /begin FUNCTION_LIST /end FUNCTION_LIST /begin REF_CHARACTERISTIC /end REF_CHARACTERISTIC /begin REF_MEASUREMENT CDD_MotCurrRegVltgLimr.dMotCurrRegVltgLimrMotCurrCmdErrDax /end REF_MEASUREMENT /end GROUP
/begin GROUP CDD_MotCurrRegVltgLimr.dMotCurrRegVltgLimrMotCurrCmdErrQax "MICROSAR RTE" /begin SUB_GROUP /end SUB_GROUP /begin FUNCTION_LIST /end FUNCTION_LIST /begin REF_CHARACTERISTIC /end REF_CHARACTERISTIC /begin REF_MEASUREMENT CDD_MotCurrRegVltgLimr.dMotCurrRegVltgLimrMotCurrCmdErrQax /end REF_MEASUREMENT /end GROUP
/begin GROUP CDD_MotCurrRegVltgLimr.dMotCurrRegVltgLimrMotCurrCmdScaDax "MICROSAR RTE" /begin SUB_GROUP /end SUB_GROUP /begin FUNCTION_LIST /end FUNCTION_LIST /begin REF_CHARACTERISTIC /end REF_CHARACTERISTIC /begin REF_MEASUREMENT CDD_MotCurrRegVltgLimr.dMotCurrRegVltgLimrMotCurrCmdScaDax /end REF_MEASUREMENT /end GROUP
/begin GROUP CDD_MotCurrRegVltgLimr.dMotCurrRegVltgLimrMotCurrCmdScaQax "MICROSAR RTE" /begin SUB_GROUP /end SUB_GROUP /begin FUNCTION_LIST /end FUNCTION_LIST /begin REF_CHARACTERISTIC /end REF_CHARACTERISTIC /begin REF_MEASUREMENT CDD_MotCurrRegVltgLimr.dMotCurrRegVltgLimrMotCurrCmdScaQax /end REF_MEASUREMENT /end GROUP
/begin GROUP CDD_MotCurrRegVltgLimr.dMotCurrRegVltgLimrMotVltgBrdgFild "MICROSAR RTE" /begin SUB_GROUP /end SUB_GROUP /begin FUNCTION_LIST /end FUNCTION_LIST /begin REF_CHARACTERISTIC /end REF_CHARACTERISTIC /begin REF_MEASUREMENT CDD_MotCurrRegVltgLimr.dMotCurrRegVltgLimrMotVltgBrdgFild /end REF_MEASUREMENT /end GROUP
/begin GROUP CDD_MotCurrRegVltgLimr.dMotCurrRegVltgLimrMotVltgCmdFinal "MICROSAR RTE" /begin SUB_GROUP /end SUB_GROUP /begin FUNCTION_LIST /end FUNCTION_LIST /begin REF_CHARACTERISTIC /end REF_CHARACTERISTIC /begin REF_MEASUREMENT CDD_MotCurrRegVltgLimr.dMotCurrRegVltgLimrMotVltgCmdFinal /end REF_MEASUREMENT /end GROUP
/begin GROUP CDD_MotCurrRegVltgLimr.dMotCurrRegVltgLimrMotVltgCmdPreLim "MICROSAR RTE" /begin SUB_GROUP /end SUB_GROUP /begin FUNCTION_LIST /end FUNCTION_LIST /begin REF_CHARACTERISTIC /end REF_CHARACTERISTIC /begin REF_MEASUREMENT CDD_MotCurrRegVltgLimr.dMotCurrRegVltgLimrMotVltgCmdPreLim /end REF_MEASUREMENT /end GROUP
/begin GROUP CDD_MotCurrRegVltgLimr.dMotCurrRegVltgLimrMotVltgDampgDax "MICROSAR RTE" /begin SUB_GROUP /end SUB_GROUP /begin FUNCTION_LIST /end FUNCTION_LIST /begin REF_CHARACTERISTIC /end REF_CHARACTERISTIC /begin REF_MEASUREMENT CDD_MotCurrRegVltgLimr.dMotCurrRegVltgLimrMotVltgDampgDax /end REF_MEASUREMENT /end GROUP
/begin GROUP CDD_MotCurrRegVltgLimr.dMotCurrRegVltgLimrMotVltgDampgQax "MICROSAR RTE" /begin SUB_GROUP /end SUB_GROUP /begin FUNCTION_LIST /end FUNCTION_LIST /begin REF_CHARACTERISTIC /end REF_CHARACTERISTIC /begin REF_MEASUREMENT CDD_MotCurrRegVltgLimr.dMotCurrRegVltgLimrMotVltgDampgQax /end REF_MEASUREMENT /end GROUP
/begin GROUP CDD_MotCurrRegVltgLimr.dMotCurrRegVltgLimrMotVltgDaxFb "MICROSAR RTE" /begin SUB_GROUP /end SUB_GROUP /begin FUNCTION_LIST /end FUNCTION_LIST /begin REF_CHARACTERISTIC /end REF_CHARACTERISTIC /begin REF_MEASUREMENT CDD_MotCurrRegVltgLimr.dMotCurrRegVltgLimrMotVltgDaxFb /end REF_MEASUREMENT /end GROUP
/begin GROUP CDD_MotCurrRegVltgLimr.dMotCurrRegVltgLimrMotVltgDaxIntglPreLim "MICROSAR RTE" /begin SUB_GROUP /end SUB_GROUP /begin FUNCTION_LIST /end FUNCTION_LIST /begin REF_CHARACTERISTIC /end REF_CHARACTERISTIC
 /begin REF_MEASUREMENT CDD_MotCurrRegVltgLimr.dMotCurrRegVltgLimrMotVltgDaxIntglPreLim /end REF_MEASUREMENT
/end GROUP
/begin GROUP CDD_MotCurrRegVltgLimr.dMotCurrRegVltgLimrMotVltgDecoupldFbDax "MICROSAR RTE" /begin SUB_GROUP /end SUB_GROUP /begin FUNCTION_LIST /end FUNCTION_LIST /begin REF_CHARACTERISTIC /end REF_CHARACTERISTIC
 /begin REF_MEASUREMENT CDD_MotCurrRegVltgLimr.dMotCurrRegVltgLimrMotVltgDecoupldFbDax /end REF_MEASUREMENT
/end GROUP
/begin GROUP CDD_MotCurrRegVltgLimr.dMotCurrRegVltgLimrMotVltgDecoupldFbQax "MICROSAR RTE" /begin SUB_GROUP /end SUB_GROUP /begin FUNCTION_LIST /end FUNCTION_LIST /begin REF_CHARACTERISTIC /end REF_CHARACTERISTIC
 /begin REF_MEASUREMENT CDD_MotCurrRegVltgLimr.dMotCurrRegVltgLimrMotVltgDecoupldFbQax /end REF_MEASUREMENT
/end GROUP
/begin GROUP CDD_MotCurrRegVltgLimr.dMotCurrRegVltgLimrMotVltgDircFbDax "MICROSAR RTE" /begin SUB_GROUP /end SUB_GROUP /begin FUNCTION_LIST /end FUNCTION_LIST /begin REF_CHARACTERISTIC /end REF_CHARACTERISTIC /begin REF_MEASUREMENT CDD_MotCurrRegVltgLimr.dMotCurrRegVltgLimrMotVltgDircFbDax /end REF_MEASUREMENT /end GROUP
/begin GROUP CDD_MotCurrRegVltgLimr.dMotCurrRegVltgLimrMotVltgDircFbQax "MICROSAR RTE" /begin SUB_GROUP /end SUB_GROUP /begin FUNCTION_LIST /end FUNCTION_LIST /begin REF_CHARACTERISTIC /end REF_CHARACTERISTIC /begin REF_MEASUREMENT CDD_MotCurrRegVltgLimr.dMotCurrRegVltgLimrMotVltgDircFbQax /end REF_MEASUREMENT /end GROUP
/begin GROUP CDD_MotCurrRegVltgLimr.dMotCurrRegVltgLimrMotVltgPreLimDax "MICROSAR RTE" /begin SUB_GROUP /end SUB_GROUP /begin FUNCTION_LIST /end FUNCTION_LIST /begin REF_CHARACTERISTIC /end REF_CHARACTERISTIC /begin REF_MEASUREMENT CDD_MotCurrRegVltgLimr.dMotCurrRegVltgLimrMotVltgPreLimDax /end REF_MEASUREMENT /end GROUP
/begin GROUP CDD_MotCurrRegVltgLimr.dMotCurrRegVltgLimrMotVltgPreLimQax "MICROSAR RTE" /begin SUB_GROUP /end SUB_GROUP /begin FUNCTION_LIST /end FUNCTION_LIST /begin REF_CHARACTERISTIC /end REF_CHARACTERISTIC /begin REF_MEASUREMENT CDD_MotCurrRegVltgLimr.dMotCurrRegVltgLimrMotVltgPreLimQax /end REF_MEASUREMENT /end GROUP
/begin GROUP CDD_MotCurrRegVltgLimr.dMotCurrRegVltgLimrMotVltgPropCmdDax "MICROSAR RTE" /begin SUB_GROUP /end SUB_GROUP /begin FUNCTION_LIST /end FUNCTION_LIST /begin REF_CHARACTERISTIC /end REF_CHARACTERISTIC
 /begin REF_MEASUREMENT CDD_MotCurrRegVltgLimr.dMotCurrRegVltgLimrMotVltgPropCmdDax /end REF_MEASUREMENT
/end GROUP
/begin GROUP CDD_MotCurrRegVltgLimr.dMotCurrRegVltgLimrMotVltgPropCmdQax "MICROSAR RTE" /begin SUB_GROUP /end SUB_GROUP /begin FUNCTION_LIST /end FUNCTION_LIST /begin REF_CHARACTERISTIC /end REF_CHARACTERISTIC
 /begin REF_MEASUREMENT CDD_MotCurrRegVltgLimr.dMotCurrRegVltgLimrMotVltgPropCmdQax /end REF_MEASUREMENT
/end GROUP
/begin GROUP CDD_MotCurrRegVltgLimr.dMotCurrRegVltgLimrMotVltgQaxFb "MICROSAR RTE" /begin SUB_GROUP /end SUB_GROUP /begin FUNCTION_LIST /end FUNCTION_LIST /begin REF_CHARACTERISTIC /end REF_CHARACTERISTIC /begin REF_MEASUREMENT CDD_MotCurrRegVltgLimr.dMotCurrRegVltgLimrMotVltgQaxFb /end REF_MEASUREMENT /end GROUP
/begin GROUP CDD_MotCurrRegVltgLimr.dMotCurrRegVltgLimrMotVltgQaxFfFild "MICROSAR RTE" /begin SUB_GROUP /end SUB_GROUP /begin FUNCTION_LIST /end FUNCTION_LIST /begin REF_CHARACTERISTIC /end REF_CHARACTERISTIC /begin REF_MEASUREMENT CDD_MotCurrRegVltgLimr.dMotCurrRegVltgLimrMotVltgQaxFfFild /end REF_MEASUREMENT /end GROUP
/begin GROUP CDD_MotCurrRegVltgLimr.dMotCurrRegVltgLimrMotVltgQaxIntglPreLim "MICROSAR RTE" /begin SUB_GROUP /end SUB_GROUP /begin FUNCTION_LIST /end FUNCTION_LIST /begin REF_CHARACTERISTIC /end REF_CHARACTERISTIC
 /begin REF_MEASUREMENT CDD_MotCurrRegVltgLimr.dMotCurrRegVltgLimrMotVltgQaxIntglPreLim /end REF_MEASUREMENT
/end GROUP
/begin GROUP CDD_MotCurrRegVltgLimr.dMotCurrRegVltgLimrMotVltgSatnIvsRat "MICROSAR RTE" /begin SUB_GROUP /end SUB_GROUP /begin FUNCTION_LIST /end FUNCTION_LIST /begin REF_CHARACTERISTIC /end REF_CHARACTERISTIC
 /begin REF_MEASUREMENT CDD_MotCurrRegVltgLimr.dMotCurrRegVltgLimrMotVltgSatnIvsRat /end REF_MEASUREMENT
/end GROUP
/begin GROUP CDD_MotCurrRegVltgLimr.dMotCurrRegVltgLimrMotVltgSatnRat "MICROSAR RTE" /begin SUB_GROUP /end SUB_GROUP /begin FUNCTION_LIST /end FUNCTION_LIST /begin REF_CHARACTERISTIC /end REF_CHARACTERISTIC /begin REF_MEASUREMENT CDD_MotCurrRegVltgLimr.dMotCurrRegVltgLimrMotVltgSatnRat /end REF_MEASUREMENT /end GROUP
/begin GROUP CDD_MotCurrRegVltgLimr.dMotCurrRegVltgLimrPhaAdvPreDly "MICROSAR RTE" /begin SUB_GROUP /end SUB_GROUP /begin FUNCTION_LIST /end FUNCTION_LIST /begin REF_CHARACTERISTIC /end REF_CHARACTERISTIC /begin REF_MEASUREMENT CDD_MotCurrRegVltgLimr.dMotCurrRegVltgLimrPhaAdvPreDly /end REF_MEASUREMENT /end GROUP
/begin GROUP CDD_MotRplCoggCmd "MICROSAR RTE"
 /begin SUB_GROUP CDD_MotRplCoggCmd.CalibrationPorts CDD_MotRplCoggCmd.PerInstanceMemories /end SUB_GROUP
 /begin FUNCTION_LIST /end FUNCTION_LIST
 /begin REF_CHARACTERISTIC /end REF_CHARACTERISTIC
 /begin REF_MEASUREMENT /end REF_MEASUREMENT
/end GROUP
/begin GROUP CDD_MotRplCoggCmd.CalibrationPorts "MICROSAR RTE"
 /begin SUB_GROUP CDD_MotRplCoggCmd.MotRplCoggCmdHrmncOrder1Elec.Val CDD_MotRplCoggCmd.MotRplCoggCmdHrmncOrder2Elec.Val CDD_MotRplCoggCmd.MotRplCoggCmdHrmncOrder3Elec.Val /end SUB_GROUP
 /begin FUNCTION_LIST /end FUNCTION_LIST
 /begin REF_CHARACTERISTIC /end REF_CHARACTERISTIC
 /begin REF_MEASUREMENT /end REF_MEASUREMENT
/end GROUP
/begin GROUP CDD_MotRplCoggCmd.MotCoggCmdY "MICROSAR RTE" /begin SUB_GROUP /end SUB_GROUP /begin FUNCTION_LIST /end FUNCTION_LIST /begin REF_CHARACTERISTIC /end REF_CHARACTERISTIC /begin REF_MEASUREMENT CDD_MotRplCoggCmd.MotCoggCmdY /end REF_MEASUREMENT /end GROUP
/begin GROUP CDD_MotRplCoggCmd.MotRplCoggCmdHrmncOrder1Elec.Val "MICROSAR RTE" /begin SUB_GROUP /end SUB_GROUP /begin FUNCTION_LIST /end FUNCTION_LIST /begin REF_CHARACTERISTIC CDD_MotRplCoggCmd.MotRplCoggCmdHrmncOrder1Elec.Val /end REF_CHARACTERISTIC /begin REF_MEASUREMENT /end REF_MEASUREMENT /end GROUP
/begin GROUP CDD_MotRplCoggCmd.MotRplCoggCmdHrmncOrder2Elec.Val "MICROSAR RTE" /begin SUB_GROUP /end SUB_GROUP /begin FUNCTION_LIST /end FUNCTION_LIST /begin REF_CHARACTERISTIC CDD_MotRplCoggCmd.MotRplCoggCmdHrmncOrder2Elec.Val /end REF_CHARACTERISTIC /begin REF_MEASUREMENT /end REF_MEASUREMENT /end GROUP
/begin GROUP CDD_MotRplCoggCmd.MotRplCoggCmdHrmncOrder3Elec.Val "MICROSAR RTE" /begin SUB_GROUP /end SUB_GROUP /begin FUNCTION_LIST /end FUNCTION_LIST /begin REF_CHARACTERISTIC CDD_MotRplCoggCmd.MotRplCoggCmdHrmncOrder3Elec.Val /end REF_CHARACTERISTIC /begin REF_MEASUREMENT /end REF_MEASUREMENT /end GROUP
/begin GROUP CDD_MotRplCoggCmd.PerInstanceMemories "MICROSAR RTE"
 /begin SUB_GROUP CDD_MotRplCoggCmd.MotCoggCmdY CDD_MotRplCoggCmd.dMotRplCoggCmdCoggIdx CDD_MotRplCoggCmd.dMotRplCoggCmdMotCoggCmd CDD_MotRplCoggCmd.dMotRplCoggCmdMotCurrQaxCoggCmdPreLim CDD_MotRplCoggCmd.dMotRplCoggCmdMotRplCmdPreLim /end SUB_GROUP
 /begin FUNCTION_LIST /end FUNCTION_LIST
 /begin REF_CHARACTERISTIC /end REF_CHARACTERISTIC
 /begin REF_MEASUREMENT /end REF_MEASUREMENT
/end GROUP
/begin GROUP CDD_MotRplCoggCmd.dMotRplCoggCmdCoggIdx "MICROSAR RTE" /begin SUB_GROUP /end SUB_GROUP /begin FUNCTION_LIST /end FUNCTION_LIST /begin REF_CHARACTERISTIC /end REF_CHARACTERISTIC /begin REF_MEASUREMENT CDD_MotRplCoggCmd.dMotRplCoggCmdCoggIdx /end REF_MEASUREMENT /end GROUP
/begin GROUP CDD_MotRplCoggCmd.dMotRplCoggCmdMotCoggCmd "MICROSAR RTE" /begin SUB_GROUP /end SUB_GROUP /begin FUNCTION_LIST /end FUNCTION_LIST /begin REF_CHARACTERISTIC /end REF_CHARACTERISTIC /begin REF_MEASUREMENT CDD_MotRplCoggCmd.dMotRplCoggCmdMotCoggCmd /end REF_MEASUREMENT /end GROUP
/begin GROUP CDD_MotRplCoggCmd.dMotRplCoggCmdMotCurrQaxCoggCmdPreLim "MICROSAR RTE" /begin SUB_GROUP /end SUB_GROUP /begin FUNCTION_LIST /end FUNCTION_LIST /begin REF_CHARACTERISTIC /end REF_CHARACTERISTIC /begin REF_MEASUREMENT CDD_MotRplCoggCmd.dMotRplCoggCmdMotCurrQaxCoggCmdPreLim /end REF_MEASUREMENT /end GROUP
/begin GROUP CDD_MotRplCoggCmd.dMotRplCoggCmdMotRplCmdPreLim "MICROSAR RTE" /begin SUB_GROUP /end SUB_GROUP /begin FUNCTION_LIST /end FUNCTION_LIST /begin REF_CHARACTERISTIC /end REF_CHARACTERISTIC /begin REF_MEASUREMENT CDD_MotRplCoggCmd.dMotRplCoggCmdMotRplCmdPreLim /end REF_MEASUREMENT /end GROUP
/begin GROUP CDD_MotVel "MICROSAR RTE"
 /begin SUB_GROUP CDD_MotVel.PerInstanceMemories CDD_MotVel.ReceiverPorts CDD_MotVel.SenderPorts /end SUB_GROUP
 /begin FUNCTION_LIST /end FUNCTION_LIST
 /begin REF_CHARACTERISTIC /end REF_CHARACTERISTIC
 /begin REF_MEASUREMENT /end REF_MEASUREMENT
/end GROUP
/begin GROUP CDD_MotVel.AssiMechPolarity.Val "MICROSAR RTE" /begin SUB_GROUP /end SUB_GROUP /begin FUNCTION_LIST /end FUNCTION_LIST /begin REF_CHARACTERISTIC /end REF_CHARACTERISTIC /begin REF_MEASUREMENT CDD_MotVel.AssiMechPolarity.Val /end REF_MEASUREMENT /end GROUP
/begin GROUP CDD_MotVel.MotAgBuf.Ary1D "MICROSAR RTE" /begin SUB_GROUP /end SUB_GROUP /begin FUNCTION_LIST /end FUNCTION_LIST /begin REF_CHARACTERISTIC /end REF_CHARACTERISTIC /begin REF_MEASUREMENT CDD_MotVel.MotAgBuf.Ary1D /end REF_MEASUREMENT /end GROUP
/begin GROUP CDD_MotVel.MotAgBufIdx.Val "MICROSAR RTE" /begin SUB_GROUP /end SUB_GROUP /begin FUNCTION_LIST /end FUNCTION_LIST /begin REF_CHARACTERISTIC /end REF_CHARACTERISTIC /begin REF_MEASUREMENT CDD_MotVel.MotAgBufIdx.Val /end REF_MEASUREMENT /end GROUP
/begin GROUP CDD_MotVel.MotAgBufIdxPrev "MICROSAR RTE" /begin SUB_GROUP /end SUB_GROUP /begin FUNCTION_LIST /end FUNCTION_LIST /begin REF_CHARACTERISTIC /end REF_CHARACTERISTIC /begin REF_MEASUREMENT CDD_MotVel.MotAgBufIdxPrev /end REF_MEASUREMENT /end GROUP
/begin GROUP CDD_MotVel.MotAgBufIdxPrim "MICROSAR RTE" /begin SUB_GROUP /end SUB_GROUP /begin FUNCTION_LIST /end FUNCTION_LIST /begin REF_CHARACTERISTIC /end REF_CHARACTERISTIC /begin REF_MEASUREMENT CDD_MotVel.MotAgBufIdxPrim /end REF_MEASUREMENT /end GROUP
/begin GROUP CDD_MotVel.MotAgBufPrev "MICROSAR RTE" /begin SUB_GROUP /end SUB_GROUP /begin FUNCTION_LIST /end FUNCTION_LIST /begin REF_CHARACTERISTIC /end REF_CHARACTERISTIC /begin REF_MEASUREMENT CDD_MotVel.MotAgBufPrev /end REF_MEASUREMENT /end GROUP
/begin GROUP CDD_MotVel.MotAgMeclIdptSig.Val "MICROSAR RTE" /begin SUB_GROUP /end SUB_GROUP /begin FUNCTION_LIST /end FUNCTION_LIST /begin REF_CHARACTERISTIC /end REF_CHARACTERISTIC /begin REF_MEASUREMENT CDD_MotVel.MotAgMeclIdptSig.Val /end REF_MEASUREMENT /end GROUP
/begin GROUP CDD_MotVel.MotAgTiBuf.Ary1D "MICROSAR RTE" /begin SUB_GROUP /end SUB_GROUP /begin FUNCTION_LIST /end FUNCTION_LIST /begin REF_CHARACTERISTIC /end REF_CHARACTERISTIC /begin REF_MEASUREMENT CDD_MotVel.MotAgTiBuf.Ary1D /end REF_MEASUREMENT /end GROUP
/begin GROUP CDD_MotVel.MotAgTiBufPrev "MICROSAR RTE" /begin SUB_GROUP /end SUB_GROUP /begin FUNCTION_LIST /end FUNCTION_LIST /begin REF_CHARACTERISTIC /end REF_CHARACTERISTIC /begin REF_MEASUREMENT CDD_MotVel.MotAgTiBufPrev /end REF_MEASUREMENT /end GROUP
/begin GROUP CDD_MotVel.MotVelCrf.Val "MICROSAR RTE" /begin SUB_GROUP /end SUB_GROUP /begin FUNCTION_LIST /end FUNCTION_LIST /begin REF_CHARACTERISTIC /end REF_CHARACTERISTIC /begin REF_MEASUREMENT CDD_MotVel.MotVelCrf.Val /end REF_MEASUREMENT /end GROUP
/begin GROUP CDD_MotVel.MotVelIninCntr "MICROSAR RTE" /begin SUB_GROUP /end SUB_GROUP /begin FUNCTION_LIST /end FUNCTION_LIST /begin REF_CHARACTERISTIC /end REF_CHARACTERISTIC /begin REF_MEASUREMENT CDD_MotVel.MotVelIninCntr /end REF_MEASUREMENT /end GROUP
/begin GROUP CDD_MotVel.MotVelMrf.Val "MICROSAR RTE" /begin SUB_GROUP /end SUB_GROUP /begin FUNCTION_LIST /end FUNCTION_LIST /begin REF_CHARACTERISTIC /end REF_CHARACTERISTIC /begin REF_MEASUREMENT CDD_MotVel.MotVelMrf.Val /end REF_MEASUREMENT /end GROUP
/begin GROUP CDD_MotVel.MotVelVld.Logl "MICROSAR RTE" /begin SUB_GROUP /end SUB_GROUP /begin FUNCTION_LIST /end FUNCTION_LIST /begin REF_CHARACTERISTIC /end REF_CHARACTERISTIC /begin REF_MEASUREMENT CDD_MotVel.MotVelVld.Logl /end REF_MEASUREMENT /end GROUP
/begin GROUP CDD_MotVel.PerInstanceMemories "MICROSAR RTE"
 /begin SUB_GROUP CDD_MotVel.MotAgBufIdxPrev CDD_MotVel.MotAgBufIdxPrim CDD_MotVel.MotAgBufPrev CDD_MotVel.MotAgTiBufPrev CDD_MotVel.MotVelIninCntr CDD_MotVel.dMotVelAvrgTi CDD_MotVel.dMotVelMotAgRef CDD_MotVel.dMotVelTiStampRef /end SUB_GROUP
 /begin FUNCTION_LIST /end FUNCTION_LIST
 /begin REF_CHARACTERISTIC /end REF_CHARACTERISTIC
 /begin REF_MEASUREMENT /end REF_MEASUREMENT
/end GROUP
/begin GROUP CDD_MotVel.ReceiverPorts "MICROSAR RTE"
 /begin SUB_GROUP CDD_MotVel.AssiMechPolarity.Val CDD_MotVel.MotAgBuf.Ary1D CDD_MotVel.MotAgBufIdx.Val CDD_MotVel.MotAgMeclIdptSig.Val CDD_MotVel.MotAgTiBuf.Ary1D /end SUB_GROUP
 /begin FUNCTION_LIST /end FUNCTION_LIST
 /begin REF_CHARACTERISTIC /end REF_CHARACTERISTIC
 /begin REF_MEASUREMENT /end REF_MEASUREMENT
/end GROUP
/begin GROUP CDD_MotVel.SenderPorts "MICROSAR RTE"
 /begin SUB_GROUP CDD_MotVel.MotVelCrf.Val CDD_MotVel.MotVelMrf.Val CDD_MotVel.MotVelVld.Logl /end SUB_GROUP
 /begin FUNCTION_LIST /end FUNCTION_LIST
 /begin REF_CHARACTERISTIC /end REF_CHARACTERISTIC
 /begin REF_MEASUREMENT /end REF_MEASUREMENT
/end GROUP
/begin GROUP CDD_MotVel.dMotVelAvrgTi "MICROSAR RTE" /begin SUB_GROUP /end SUB_GROUP /begin FUNCTION_LIST /end FUNCTION_LIST /begin REF_CHARACTERISTIC /end REF_CHARACTERISTIC /begin REF_MEASUREMENT CDD_MotVel.dMotVelAvrgTi /end REF_MEASUREMENT /end GROUP
/begin GROUP CDD_MotVel.dMotVelMotAgRef "MICROSAR RTE" /begin SUB_GROUP /end SUB_GROUP /begin FUNCTION_LIST /end FUNCTION_LIST /begin REF_CHARACTERISTIC /end REF_CHARACTERISTIC /begin REF_MEASUREMENT CDD_MotVel.dMotVelMotAgRef /end REF_MEASUREMENT /end GROUP
/begin GROUP CDD_MotVel.dMotVelTiStampRef "MICROSAR RTE" /begin SUB_GROUP /end SUB_GROUP /begin FUNCTION_LIST /end FUNCTION_LIST /begin REF_CHARACTERISTIC /end REF_CHARACTERISTIC /begin REF_MEASUREMENT CDD_MotVel.dMotVelTiStampRef /end REF_MEASUREMENT /end GROUP
/begin GROUP CDD_NvMProxy "MICROSAR RTE" /begin SUB_GROUP CDD_NvMProxy.PerInstanceMemories /end SUB_GROUP /begin FUNCTION_LIST /end FUNCTION_LIST /begin REF_CHARACTERISTIC /end REF_CHARACTERISTIC /begin REF_MEASUREMENT /end REF_MEASUREMENT /end GROUP
/begin GROUP CDD_NvMProxy.BlkFltTbl "MICROSAR RTE" /begin SUB_GROUP /end SUB_GROUP /begin FUNCTION_LIST /end FUNCTION_LIST /begin REF_CHARACTERISTIC /end REF_CHARACTERISTIC
 /begin REF_MEASUREMENT CDD_NvMProxy.BlkFltTbl[0].Prm CDD_NvMProxy.BlkFltTbl[0].Sts CDD_NvMProxy.BlkFltTbl[1].Prm CDD_NvMProxy.BlkFltTbl[1].Sts CDD_NvMProxy.BlkFltTbl[2].Prm CDD_NvMProxy.BlkFltTbl[2].Sts CDD_NvMProxy.BlkFltTbl[3].Prm CDD_NvMProxy.BlkFltTbl[3].Sts CDD_NvMProxy.BlkFltTbl[4].Prm CDD_NvMProxy.BlkFltTbl[4].Sts /end REF_MEASUREMENT
/end GROUP
/begin GROUP CDD_NvMProxy.NvmStsCollctd "MICROSAR RTE" /begin SUB_GROUP /end SUB_GROUP /begin FUNCTION_LIST /end FUNCTION_LIST /begin REF_CHARACTERISTIC /end REF_CHARACTERISTIC /begin REF_MEASUREMENT CDD_NvMProxy.NvmStsCollctd /end REF_MEASUREMENT /end GROUP
/begin GROUP CDD_NvMProxy.PerInstanceMemories "MICROSAR RTE"
 /begin SUB_GROUP CDD_NvMProxy.BlkFltTbl CDD_NvMProxy.NvmStsCollctd CDD_NvMProxy.ShtdwnClsChk /end SUB_GROUP
 /begin FUNCTION_LIST /end FUNCTION_LIST
 /begin REF_CHARACTERISTIC /end REF_CHARACTERISTIC
 /begin REF_MEASUREMENT /end REF_MEASUREMENT
/end GROUP
/begin GROUP CDD_NvMProxy.ShtdwnClsChk "MICROSAR RTE" /begin SUB_GROUP /end SUB_GROUP /begin FUNCTION_LIST /end FUNCTION_LIST /begin REF_CHARACTERISTIC /end REF_CHARACTERISTIC /begin REF_MEASUREMENT CDD_NvMProxy.ShtdwnClsChk /end REF_MEASUREMENT /end GROUP
/begin GROUP CDD_NxtrTi "MICROSAR RTE" /begin SUB_GROUP CDD_NxtrTi.PerInstanceMemories /end SUB_GROUP /begin FUNCTION_LIST /end FUNCTION_LIST /begin REF_CHARACTERISTIC /end REF_CHARACTERISTIC /begin REF_MEASUREMENT /end REF_MEASUREMENT /end GROUP
/begin GROUP CDD_NxtrTi.PerInstanceMemories "MICROSAR RTE" /begin SUB_GROUP CDD_NxtrTi.PrevTi /end SUB_GROUP /begin FUNCTION_LIST /end FUNCTION_LIST /begin REF_CHARACTERISTIC /end REF_CHARACTERISTIC /begin REF_MEASUREMENT /end REF_MEASUREMENT /end GROUP
/begin GROUP CDD_NxtrTi.PrevTi "MICROSAR RTE" /begin SUB_GROUP /end SUB_GROUP /begin FUNCTION_LIST /end FUNCTION_LIST /begin REF_CHARACTERISTIC /end REF_CHARACTERISTIC /begin REF_MEASUREMENT CDD_NxtrTi.PrevTi /end REF_MEASUREMENT /end GROUP
/begin GROUP CDD_RamMem "MICROSAR RTE" /begin SUB_GROUP CDD_RamMem.PerInstanceMemories CDD_RamMem.SenderPorts /end SUB_GROUP /begin FUNCTION_LIST /end FUNCTION_LIST /begin REF_CHARACTERISTIC /end REF_CHARACTERISTIC /begin REF_MEASUREMENT /end REF_MEASUREMENT /end GROUP
/begin GROUP CDD_RamMem.GlbRamEccSngBitCntr "MICROSAR RTE" /begin SUB_GROUP /end SUB_GROUP /begin FUNCTION_LIST /end FUNCTION_LIST /begin REF_CHARACTERISTIC /end REF_CHARACTERISTIC /begin REF_MEASUREMENT CDD_RamMem.GlbRamEccSngBitCntr /end REF_MEASUREMENT /end GROUP
/begin GROUP CDD_RamMem.GlbRamEccSngBitCntrOutp.Val "MICROSAR RTE" /begin SUB_GROUP /end SUB_GROUP /begin FUNCTION_LIST /end FUNCTION_LIST /begin REF_CHARACTERISTIC /end REF_CHARACTERISTIC /begin REF_MEASUREMENT CDD_RamMem.GlbRamEccSngBitCntrOutp.Val /end REF_MEASUREMENT /end GROUP
/begin GROUP CDD_RamMem.GlbRamEccSngBitSoftFailr "MICROSAR RTE" /begin SUB_GROUP /end SUB_GROUP /begin FUNCTION_LIST /end FUNCTION_LIST /begin REF_CHARACTERISTIC /end REF_CHARACTERISTIC /begin REF_MEASUREMENT CDD_RamMem.GlbRamEccSngBitSoftFailr /end REF_MEASUREMENT /end GROUP
/begin GROUP CDD_RamMem.GlbRamFailrAdr "MICROSAR RTE" /begin SUB_GROUP /end SUB_GROUP /begin FUNCTION_LIST /end FUNCTION_LIST /begin REF_CHARACTERISTIC /end REF_CHARACTERISTIC /begin REF_MEASUREMENT CDD_RamMem.GlbRamFailrAdr /end REF_MEASUREMENT /end GROUP
/begin GROUP CDD_RamMem.GlbRamWordLineRead "MICROSAR RTE" /begin SUB_GROUP /end SUB_GROUP /begin FUNCTION_LIST /end FUNCTION_LIST /begin REF_CHARACTERISTIC /end REF_CHARACTERISTIC /begin REF_MEASUREMENT CDD_RamMem.GlbRamWordLineRead /end REF_MEASUREMENT /end GROUP
/begin GROUP CDD_RamMem.LclRamEccSngBitCntr "MICROSAR RTE" /begin SUB_GROUP /end SUB_GROUP /begin FUNCTION_LIST /end FUNCTION_LIST /begin REF_CHARACTERISTIC /end REF_CHARACTERISTIC /begin REF_MEASUREMENT CDD_RamMem.LclRamEccSngBitCntr /end REF_MEASUREMENT /end GROUP
/begin GROUP CDD_RamMem.LclRamEccSngBitCntrOutp.Val "MICROSAR RTE" /begin SUB_GROUP /end SUB_GROUP /begin FUNCTION_LIST /end FUNCTION_LIST /begin REF_CHARACTERISTIC /end REF_CHARACTERISTIC /begin REF_MEASUREMENT CDD_RamMem.LclRamEccSngBitCntrOutp.Val /end REF_MEASUREMENT /end GROUP
/begin GROUP CDD_RamMem.LclRamEccSngBitSoftFailr "MICROSAR RTE" /begin SUB_GROUP /end SUB_GROUP /begin FUNCTION_LIST /end FUNCTION_LIST /begin REF_CHARACTERISTIC /end REF_CHARACTERISTIC /begin REF_MEASUREMENT CDD_RamMem.LclRamEccSngBitSoftFailr /end REF_MEASUREMENT /end GROUP
/begin GROUP CDD_RamMem.LclRamFailrAdr "MICROSAR RTE" /begin SUB_GROUP /end SUB_GROUP /begin FUNCTION_LIST /end FUNCTION_LIST /begin REF_CHARACTERISTIC /end REF_CHARACTERISTIC /begin REF_MEASUREMENT CDD_RamMem.LclRamFailrAdr /end REF_MEASUREMENT /end GROUP
/begin GROUP CDD_RamMem.LclRamWordLineRead "MICROSAR RTE" /begin SUB_GROUP /end SUB_GROUP /begin FUNCTION_LIST /end FUNCTION_LIST /begin REF_CHARACTERISTIC /end REF_CHARACTERISTIC /begin REF_MEASUREMENT CDD_RamMem.LclRamWordLineRead /end REF_MEASUREMENT /end GROUP
/begin GROUP CDD_RamMem.PerInstanceMemories "MICROSAR RTE"
 /begin SUB_GROUP CDD_RamMem.GlbRamEccSngBitCntr CDD_RamMem.GlbRamEccSngBitSoftFailr CDD_RamMem.GlbRamFailrAdr CDD_RamMem.GlbRamWordLineRead CDD_RamMem.LclRamEccSngBitCntr CDD_RamMem.LclRamEccSngBitSoftFailr CDD_RamMem.LclRamFailrAdr CDD_RamMem.LclRamWordLineRead CDD_RamMem.dRamMemCanRamDblBitEccErrAdr CDD_RamMem.dRamMemCanRamSngBitEccErrAdr CDD_RamMem.dRamMemDtsRamEccErrAdr CDD_RamMem.dRamMemFrRamDblBitEccErrAdr CDD_RamMem.dRamMemFrRamSngBitEccErrAdr CDD_RamMem.dRamMemFrRamTmpBufADblBitEccErrAdr CDD_RamMem.dRamMemFrRamTmpBufBDblBitEccErrAdr CDD_RamMem.dRamMemGtmRamSngBitEccErrAdr CDD_RamMem.dRamMemMCan0RamDblBitEccErrAdr CDD_RamMem.dRamMemMCan1RamDblBitEccErrAdr CDD_RamMem.dRamMemSpi0RamEccErrAdr CDD_RamMem.dRamMemSpi1RamEccErrAdr CDD_RamMem.dRamMemSpi2RamEccErrAdr CDD_RamMem.dRamMemSpi3RamEccErrAdr CDD_RamMem.dRamMemSpiRamEccErrAdr /end SUB_GROUP
 /begin FUNCTION_LIST /end FUNCTION_LIST
 /begin REF_CHARACTERISTIC /end REF_CHARACTERISTIC
 /begin REF_MEASUREMENT /end REF_MEASUREMENT
/end GROUP
/begin GROUP CDD_RamMem.SenderPorts "MICROSAR RTE"
 /begin SUB_GROUP CDD_RamMem.GlbRamEccSngBitCntrOutp.Val CDD_RamMem.LclRamEccSngBitCntrOutp.Val /end SUB_GROUP
 /begin FUNCTION_LIST /end FUNCTION_LIST
 /begin REF_CHARACTERISTIC /end REF_CHARACTERISTIC
 /begin REF_MEASUREMENT /end REF_MEASUREMENT
/end GROUP
/begin GROUP CDD_RamMem.dRamMemCanRamDblBitEccErrAdr "MICROSAR RTE" /begin SUB_GROUP /end SUB_GROUP /begin FUNCTION_LIST /end FUNCTION_LIST /begin REF_CHARACTERISTIC /end REF_CHARACTERISTIC /begin REF_MEASUREMENT CDD_RamMem.dRamMemCanRamDblBitEccErrAdr /end REF_MEASUREMENT /end GROUP
/begin GROUP CDD_RamMem.dRamMemCanRamSngBitEccErrAdr "MICROSAR RTE" /begin SUB_GROUP /end SUB_GROUP /begin FUNCTION_LIST /end FUNCTION_LIST /begin REF_CHARACTERISTIC /end REF_CHARACTERISTIC /begin REF_MEASUREMENT CDD_RamMem.dRamMemCanRamSngBitEccErrAdr /end REF_MEASUREMENT /end GROUP
/begin GROUP CDD_RamMem.dRamMemDtsRamEccErrAdr "MICROSAR RTE" /begin SUB_GROUP /end SUB_GROUP /begin FUNCTION_LIST /end FUNCTION_LIST /begin REF_CHARACTERISTIC /end REF_CHARACTERISTIC /begin REF_MEASUREMENT CDD_RamMem.dRamMemDtsRamEccErrAdr /end REF_MEASUREMENT /end GROUP
/begin GROUP CDD_RamMem.dRamMemFrRamDblBitEccErrAdr "MICROSAR RTE" /begin SUB_GROUP /end SUB_GROUP /begin FUNCTION_LIST /end FUNCTION_LIST /begin REF_CHARACTERISTIC /end REF_CHARACTERISTIC /begin REF_MEASUREMENT CDD_RamMem.dRamMemFrRamDblBitEccErrAdr /end REF_MEASUREMENT /end GROUP
/begin GROUP CDD_RamMem.dRamMemFrRamSngBitEccErrAdr "MICROSAR RTE" /begin SUB_GROUP /end SUB_GROUP /begin FUNCTION_LIST /end FUNCTION_LIST /begin REF_CHARACTERISTIC /end REF_CHARACTERISTIC /begin REF_MEASUREMENT CDD_RamMem.dRamMemFrRamSngBitEccErrAdr /end REF_MEASUREMENT /end GROUP
/begin GROUP CDD_RamMem.dRamMemFrRamTmpBufADblBitEccErrAdr "MICROSAR RTE" /begin SUB_GROUP /end SUB_GROUP /begin FUNCTION_LIST /end FUNCTION_LIST /begin REF_CHARACTERISTIC /end REF_CHARACTERISTIC /begin REF_MEASUREMENT CDD_RamMem.dRamMemFrRamTmpBufADblBitEccErrAdr /end REF_MEASUREMENT /end GROUP
/begin GROUP CDD_RamMem.dRamMemFrRamTmpBufBDblBitEccErrAdr "MICROSAR RTE" /begin SUB_GROUP /end SUB_GROUP /begin FUNCTION_LIST /end FUNCTION_LIST /begin REF_CHARACTERISTIC /end REF_CHARACTERISTIC /begin REF_MEASUREMENT CDD_RamMem.dRamMemFrRamTmpBufBDblBitEccErrAdr /end REF_MEASUREMENT /end GROUP
/begin GROUP CDD_RamMem.dRamMemGtmRamSngBitEccErrAdr "MICROSAR RTE" /begin SUB_GROUP /end SUB_GROUP /begin FUNCTION_LIST /end FUNCTION_LIST /begin REF_CHARACTERISTIC /end REF_CHARACTERISTIC /begin REF_MEASUREMENT CDD_RamMem.dRamMemGtmRamSngBitEccErrAdr /end REF_MEASUREMENT /end GROUP
/begin GROUP CDD_RamMem.dRamMemMCan0RamDblBitEccErrAdr "MICROSAR RTE" /begin SUB_GROUP /end SUB_GROUP /begin FUNCTION_LIST /end FUNCTION_LIST /begin REF_CHARACTERISTIC /end REF_CHARACTERISTIC /begin REF_MEASUREMENT CDD_RamMem.dRamMemMCan0RamDblBitEccErrAdr /end REF_MEASUREMENT /end GROUP
/begin GROUP CDD_RamMem.dRamMemMCan1RamDblBitEccErrAdr "MICROSAR RTE" /begin SUB_GROUP /end SUB_GROUP /begin FUNCTION_LIST /end FUNCTION_LIST /begin REF_CHARACTERISTIC /end REF_CHARACTERISTIC /begin REF_MEASUREMENT CDD_RamMem.dRamMemMCan1RamDblBitEccErrAdr /end REF_MEASUREMENT /end GROUP
/begin GROUP CDD_RamMem.dRamMemSpi0RamEccErrAdr "MICROSAR RTE" /begin SUB_GROUP /end SUB_GROUP /begin FUNCTION_LIST /end FUNCTION_LIST /begin REF_CHARACTERISTIC /end REF_CHARACTERISTIC /begin REF_MEASUREMENT CDD_RamMem.dRamMemSpi0RamEccErrAdr /end REF_MEASUREMENT /end GROUP
/begin GROUP CDD_RamMem.dRamMemSpi1RamEccErrAdr "MICROSAR RTE" /begin SUB_GROUP /end SUB_GROUP /begin FUNCTION_LIST /end FUNCTION_LIST /begin REF_CHARACTERISTIC /end REF_CHARACTERISTIC /begin REF_MEASUREMENT CDD_RamMem.dRamMemSpi1RamEccErrAdr /end REF_MEASUREMENT /end GROUP
/begin GROUP CDD_RamMem.dRamMemSpi2RamEccErrAdr "MICROSAR RTE" /begin SUB_GROUP /end SUB_GROUP /begin FUNCTION_LIST /end FUNCTION_LIST /begin REF_CHARACTERISTIC /end REF_CHARACTERISTIC /begin REF_MEASUREMENT CDD_RamMem.dRamMemSpi2RamEccErrAdr /end REF_MEASUREMENT /end GROUP
/begin GROUP CDD_RamMem.dRamMemSpi3RamEccErrAdr "MICROSAR RTE" /begin SUB_GROUP /end SUB_GROUP /begin FUNCTION_LIST /end FUNCTION_LIST /begin REF_CHARACTERISTIC /end REF_CHARACTERISTIC /begin REF_MEASUREMENT CDD_RamMem.dRamMemSpi3RamEccErrAdr /end REF_MEASUREMENT /end GROUP
/begin GROUP CDD_RamMem.dRamMemSpiRamEccErrAdr "MICROSAR RTE" /begin SUB_GROUP /end SUB_GROUP /begin FUNCTION_LIST /end FUNCTION_LIST /begin REF_CHARACTERISTIC /end REF_CHARACTERISTIC /begin REF_MEASUREMENT CDD_RamMem.dRamMemSpiRamEccErrAdr /end REF_MEASUREMENT /end GROUP
/begin GROUP CDD_SinVltgGenn "MICROSAR RTE"
 /begin SUB_GROUP CDD_SinVltgGenn.CalibrationPorts CDD_SinVltgGenn.PerInstanceMemories CDD_SinVltgGenn.ReceiverPorts /end SUB_GROUP
 /begin FUNCTION_LIST /end FUNCTION_LIST
 /begin REF_CHARACTERISTIC /end REF_CHARACTERISTIC
 /begin REF_MEASUREMENT /end REF_MEASUREMENT
/end GROUP
/begin GROUP CDD_SinVltgGenn.CalibrationPorts "MICROSAR RTE"
 /begin SUB_GROUP CDD_SinVltgGenn.MotAgSwCalVehSpdThd.Val CDD_SinVltgGenn.SinVltgGennDthrEna.Logl CDD_SinVltgGenn.SinVltgGennDthrLpFilCoeff.Val /end SUB_GROUP
 /begin FUNCTION_LIST /end FUNCTION_LIST
 /begin REF_CHARACTERISTIC /end REF_CHARACTERISTIC
 /begin REF_MEASUREMENT /end REF_MEASUREMENT
/end GROUP
/begin GROUP CDD_SinVltgGenn.Fil1OutpPrev "MICROSAR RTE" /begin SUB_GROUP /end SUB_GROUP /begin FUNCTION_LIST /end FUNCTION_LIST /begin REF_CHARACTERISTIC /end REF_CHARACTERISTIC /begin REF_MEASUREMENT CDD_SinVltgGenn.Fil1OutpPrev /end REF_MEASUREMENT /end GROUP
/begin GROUP CDD_SinVltgGenn.Fil2OutpPrev "MICROSAR RTE" /begin SUB_GROUP /end SUB_GROUP /begin FUNCTION_LIST /end FUNCTION_LIST /begin REF_CHARACTERISTIC /end REF_CHARACTERISTIC /begin REF_MEASUREMENT CDD_SinVltgGenn.Fil2OutpPrev /end REF_MEASUREMENT /end GROUP
/begin GROUP CDD_SinVltgGenn.MotAgSwCalVehSpdThd.Val "MICROSAR RTE" /begin SUB_GROUP /end SUB_GROUP /begin FUNCTION_LIST /end FUNCTION_LIST /begin REF_CHARACTERISTIC CDD_SinVltgGenn.MotAgSwCalVehSpdThd.Val /end REF_CHARACTERISTIC /begin REF_MEASUREMENT /end REF_MEASUREMENT /end GROUP
/begin GROUP CDD_SinVltgGenn.MotElecMeclPolarity.Val "MICROSAR RTE" /begin SUB_GROUP /end SUB_GROUP /begin FUNCTION_LIST /end FUNCTION_LIST /begin REF_CHARACTERISTIC /end REF_CHARACTERISTIC /begin REF_MEASUREMENT CDD_SinVltgGenn.MotElecMeclPolarity.Val /end REF_MEASUREMENT /end GROUP
/begin GROUP CDD_SinVltgGenn.PerInstanceMemories "MICROSAR RTE"
 /begin SUB_GROUP CDD_SinVltgGenn.Fil1OutpPrev CDD_SinVltgGenn.Fil2OutpPrev CDD_SinVltgGenn.PhaDptOffsA CDD_SinVltgGenn.PhaDptOffsB CDD_SinVltgGenn.PhaDptOffsC CDD_SinVltgGenn.PhaOnTiSumAPrev CDD_SinVltgGenn.PhaOnTiSumBPrev CDD_SinVltgGenn.PhaOnTiSumCPrev CDD_SinVltgGenn.PwmPerdRng CDD_SinVltgGenn.RndNrPrev /end SUB_GROUP
 /begin FUNCTION_LIST /end FUNCTION_LIST
 /begin REF_CHARACTERISTIC /end REF_CHARACTERISTIC
 /begin REF_MEASUREMENT /end REF_MEASUREMENT
/end GROUP
/begin GROUP CDD_SinVltgGenn.PhaDptOffsA "MICROSAR RTE" /begin SUB_GROUP /end SUB_GROUP /begin FUNCTION_LIST /end FUNCTION_LIST /begin REF_CHARACTERISTIC /end REF_CHARACTERISTIC /begin REF_MEASUREMENT CDD_SinVltgGenn.PhaDptOffsA /end REF_MEASUREMENT /end GROUP
/begin GROUP CDD_SinVltgGenn.PhaDptOffsB "MICROSAR RTE" /begin SUB_GROUP /end SUB_GROUP /begin FUNCTION_LIST /end FUNCTION_LIST /begin REF_CHARACTERISTIC /end REF_CHARACTERISTIC /begin REF_MEASUREMENT CDD_SinVltgGenn.PhaDptOffsB /end REF_MEASUREMENT /end GROUP
/begin GROUP CDD_SinVltgGenn.PhaDptOffsC "MICROSAR RTE" /begin SUB_GROUP /end SUB_GROUP /begin FUNCTION_LIST /end FUNCTION_LIST /begin REF_CHARACTERISTIC /end REF_CHARACTERISTIC /begin REF_MEASUREMENT CDD_SinVltgGenn.PhaDptOffsC /end REF_MEASUREMENT /end GROUP
/begin GROUP CDD_SinVltgGenn.PhaOnTiSumAPrev "MICROSAR RTE" /begin SUB_GROUP /end SUB_GROUP /begin FUNCTION_LIST /end FUNCTION_LIST /begin REF_CHARACTERISTIC /end REF_CHARACTERISTIC /begin REF_MEASUREMENT CDD_SinVltgGenn.PhaOnTiSumAPrev /end REF_MEASUREMENT /end GROUP
/begin GROUP CDD_SinVltgGenn.PhaOnTiSumBPrev "MICROSAR RTE" /begin SUB_GROUP /end SUB_GROUP /begin FUNCTION_LIST /end FUNCTION_LIST /begin REF_CHARACTERISTIC /end REF_CHARACTERISTIC /begin REF_MEASUREMENT CDD_SinVltgGenn.PhaOnTiSumBPrev /end REF_MEASUREMENT /end GROUP
/begin GROUP CDD_SinVltgGenn.PhaOnTiSumCPrev "MICROSAR RTE" /begin SUB_GROUP /end SUB_GROUP /begin FUNCTION_LIST /end FUNCTION_LIST /begin REF_CHARACTERISTIC /end REF_CHARACTERISTIC /begin REF_MEASUREMENT CDD_SinVltgGenn.PhaOnTiSumCPrev /end REF_MEASUREMENT /end GROUP
/begin GROUP CDD_SinVltgGenn.PwmPerdRng "MICROSAR RTE" /begin SUB_GROUP /end SUB_GROUP /begin FUNCTION_LIST /end FUNCTION_LIST /begin REF_CHARACTERISTIC /end REF_CHARACTERISTIC /begin REF_MEASUREMENT CDD_SinVltgGenn.PwmPerdRng /end REF_MEASUREMENT /end GROUP
/begin GROUP CDD_SinVltgGenn.ReceiverPorts "MICROSAR RTE" /begin SUB_GROUP CDD_SinVltgGenn.MotElecMeclPolarity.Val /end SUB_GROUP /begin FUNCTION_LIST /end FUNCTION_LIST /begin REF_CHARACTERISTIC /end REF_CHARACTERISTIC /begin REF_MEASUREMENT /end REF_MEASUREMENT /end GROUP
/begin GROUP CDD_SinVltgGenn.RndNrPrev "MICROSAR RTE" /begin SUB_GROUP /end SUB_GROUP /begin FUNCTION_LIST /end FUNCTION_LIST /begin REF_CHARACTERISTIC /end REF_CHARACTERISTIC /begin REF_MEASUREMENT CDD_SinVltgGenn.RndNrPrev /end REF_MEASUREMENT /end GROUP
/begin GROUP CDD_SinVltgGenn.SinVltgGennDthrEna.Logl "MICROSAR RTE" /begin SUB_GROUP /end SUB_GROUP /begin FUNCTION_LIST /end FUNCTION_LIST /begin REF_CHARACTERISTIC CDD_SinVltgGenn.SinVltgGennDthrEna.Logl /end REF_CHARACTERISTIC /begin REF_MEASUREMENT /end REF_MEASUREMENT /end GROUP
/begin GROUP CDD_SinVltgGenn.SinVltgGennDthrLpFilCoeff.Val "MICROSAR RTE" /begin SUB_GROUP /end SUB_GROUP /begin FUNCTION_LIST /end FUNCTION_LIST /begin REF_CHARACTERISTIC CDD_SinVltgGenn.SinVltgGennDthrLpFilCoeff.Val /end REF_CHARACTERISTIC /begin REF_MEASUREMENT /end REF_MEASUREMENT /end GROUP
/begin GROUP CDD_SyncCrc "MICROSAR RTE" /begin SUB_GROUP CDD_SyncCrc.PerInstanceMemories /end SUB_GROUP /begin FUNCTION_LIST /end FUNCTION_LIST /begin REF_CHARACTERISTIC /end REF_CHARACTERISTIC /begin REF_MEASUREMENT /end REF_MEASUREMENT /end GROUP
/begin GROUP CDD_SyncCrc.CrcHwSts "MICROSAR RTE" /begin SUB_GROUP /end SUB_GROUP /begin FUNCTION_LIST /end FUNCTION_LIST /begin REF_CHARACTERISTIC /end REF_CHARACTERISTIC
 /begin REF_MEASUREMENT CDD_SyncCrc.CrcHwSts[0].CrcHwSts CDD_SyncCrc.CrcHwSts[0].TaskId CDD_SyncCrc.CrcHwSts[1].CrcHwSts CDD_SyncCrc.CrcHwSts[1].TaskId CDD_SyncCrc.CrcHwSts[2].CrcHwSts CDD_SyncCrc.CrcHwSts[2].TaskId CDD_SyncCrc.CrcHwSts[3].CrcHwSts CDD_SyncCrc.CrcHwSts[3].TaskId CDD_SyncCrc.CrcHwSts[4].CrcHwSts CDD_SyncCrc.CrcHwSts[4].TaskId CDD_SyncCrc.CrcHwSts[5].CrcHwSts CDD_SyncCrc.CrcHwSts[5].TaskId CDD_SyncCrc.CrcHwSts[6].CrcHwSts CDD_SyncCrc.CrcHwSts[6].TaskId CDD_SyncCrc.CrcHwSts[7].CrcHwSts CDD_SyncCrc.CrcHwSts[7].TaskId /end REF_MEASUREMENT
/end GROUP
/begin GROUP CDD_SyncCrc.PerInstanceMemories "MICROSAR RTE" /begin SUB_GROUP CDD_SyncCrc.CrcHwSts /end SUB_GROUP /begin FUNCTION_LIST /end FUNCTION_LIST /begin REF_CHARACTERISTIC /end REF_CHARACTERISTIC /begin REF_MEASUREMENT /end REF_MEASUREMENT /end GROUP
/begin GROUP CDD_Uart0CfgAndUse "MICROSAR RTE" /begin SUB_GROUP CDD_Uart0CfgAndUse.PerInstanceMemories /end SUB_GROUP /begin FUNCTION_LIST /end FUNCTION_LIST /begin REF_CHARACTERISTIC /end REF_CHARACTERISTIC /begin REF_MEASUREMENT /end REF_MEASUREMENT /end GROUP
/begin GROUP CDD_Uart0CfgAndUse.PerInstanceMemories "MICROSAR RTE"
 /begin SUB_GROUP CDD_Uart0CfgAndUse.PrevDmaTrfCnt CDD_Uart0CfgAndUse.Uart0100MilliSecBufCnt CDD_Uart0CfgAndUse.Uart0100MilliSecReadCmpl CDD_Uart0CfgAndUse.Uart010MilliSecBufCnt CDD_Uart0CfgAndUse.Uart010MilliSecReadCmpl CDD_Uart0CfgAndUse.Uart02MilliSecBufCnt CDD_Uart0CfgAndUse.Uart0DiagcFrmErrCntr CDD_Uart0CfgAndUse.Uart0DiagcOvrrunErrCntr CDD_Uart0CfgAndUse.Uart0DiagcParErrCntr CDD_Uart0CfgAndUse.Uart0DiagcRxMaxDataErrCntr CDD_Uart0CfgAndUse.Uart0NrOfPnd100MilliSecFrmCnt CDD_Uart0CfgAndUse.Uart0NrOfPnd10MilliSecFrmCnt CDD_Uart0CfgAndUse.Uart0RxPrevLoopDataUnread /end SUB_GROUP
 /begin FUNCTION_LIST /end FUNCTION_LIST
 /begin REF_CHARACTERISTIC /end REF_CHARACTERISTIC
 /begin REF_MEASUREMENT /end REF_MEASUREMENT
/end GROUP
/begin GROUP CDD_Uart0CfgAndUse.PrevDmaTrfCnt "MICROSAR RTE" /begin SUB_GROUP /end SUB_GROUP /begin FUNCTION_LIST /end FUNCTION_LIST /begin REF_CHARACTERISTIC /end REF_CHARACTERISTIC /begin REF_MEASUREMENT CDD_Uart0CfgAndUse.PrevDmaTrfCnt /end REF_MEASUREMENT /end GROUP
/begin GROUP CDD_Uart0CfgAndUse.Uart0100MilliSecBufCnt "MICROSAR RTE" /begin SUB_GROUP /end SUB_GROUP /begin FUNCTION_LIST /end FUNCTION_LIST /begin REF_CHARACTERISTIC /end REF_CHARACTERISTIC /begin REF_MEASUREMENT CDD_Uart0CfgAndUse.Uart0100MilliSecBufCnt /end REF_MEASUREMENT /end GROUP
/begin GROUP CDD_Uart0CfgAndUse.Uart0100MilliSecReadCmpl "MICROSAR RTE" /begin SUB_GROUP /end SUB_GROUP /begin FUNCTION_LIST /end FUNCTION_LIST /begin REF_CHARACTERISTIC /end REF_CHARACTERISTIC /begin REF_MEASUREMENT CDD_Uart0CfgAndUse.Uart0100MilliSecReadCmpl /end REF_MEASUREMENT /end GROUP
/begin GROUP CDD_Uart0CfgAndUse.Uart010MilliSecBufCnt "MICROSAR RTE" /begin SUB_GROUP /end SUB_GROUP /begin FUNCTION_LIST /end FUNCTION_LIST /begin REF_CHARACTERISTIC /end REF_CHARACTERISTIC /begin REF_MEASUREMENT CDD_Uart0CfgAndUse.Uart010MilliSecBufCnt /end REF_MEASUREMENT /end GROUP
/begin GROUP CDD_Uart0CfgAndUse.Uart010MilliSecReadCmpl "MICROSAR RTE" /begin SUB_GROUP /end SUB_GROUP /begin FUNCTION_LIST /end FUNCTION_LIST /begin REF_CHARACTERISTIC /end REF_CHARACTERISTIC /begin REF_MEASUREMENT CDD_Uart0CfgAndUse.Uart010MilliSecReadCmpl /end REF_MEASUREMENT /end GROUP
/begin GROUP CDD_Uart0CfgAndUse.Uart02MilliSecBufCnt "MICROSAR RTE" /begin SUB_GROUP /end SUB_GROUP /begin FUNCTION_LIST /end FUNCTION_LIST /begin REF_CHARACTERISTIC /end REF_CHARACTERISTIC /begin REF_MEASUREMENT CDD_Uart0CfgAndUse.Uart02MilliSecBufCnt /end REF_MEASUREMENT /end GROUP
/begin GROUP CDD_Uart0CfgAndUse.Uart0DiagcFrmErrCntr "MICROSAR RTE" /begin SUB_GROUP /end SUB_GROUP /begin FUNCTION_LIST /end FUNCTION_LIST /begin REF_CHARACTERISTIC /end REF_CHARACTERISTIC /begin REF_MEASUREMENT CDD_Uart0CfgAndUse.Uart0DiagcFrmErrCntr /end REF_MEASUREMENT /end GROUP
/begin GROUP CDD_Uart0CfgAndUse.Uart0DiagcOvrrunErrCntr "MICROSAR RTE" /begin SUB_GROUP /end SUB_GROUP /begin FUNCTION_LIST /end FUNCTION_LIST /begin REF_CHARACTERISTIC /end REF_CHARACTERISTIC /begin REF_MEASUREMENT CDD_Uart0CfgAndUse.Uart0DiagcOvrrunErrCntr /end REF_MEASUREMENT /end GROUP
/begin GROUP CDD_Uart0CfgAndUse.Uart0DiagcParErrCntr "MICROSAR RTE" /begin SUB_GROUP /end SUB_GROUP /begin FUNCTION_LIST /end FUNCTION_LIST /begin REF_CHARACTERISTIC /end REF_CHARACTERISTIC /begin REF_MEASUREMENT CDD_Uart0CfgAndUse.Uart0DiagcParErrCntr /end REF_MEASUREMENT /end GROUP
/begin GROUP CDD_Uart0CfgAndUse.Uart0DiagcRxMaxDataErrCntr "MICROSAR RTE" /begin SUB_GROUP /end SUB_GROUP /begin FUNCTION_LIST /end FUNCTION_LIST /begin REF_CHARACTERISTIC /end REF_CHARACTERISTIC /begin REF_MEASUREMENT CDD_Uart0CfgAndUse.Uart0DiagcRxMaxDataErrCntr /end REF_MEASUREMENT /end GROUP
/begin GROUP CDD_Uart0CfgAndUse.Uart0NrOfPnd100MilliSecFrmCnt "MICROSAR RTE" /begin SUB_GROUP /end SUB_GROUP /begin FUNCTION_LIST /end FUNCTION_LIST /begin REF_CHARACTERISTIC /end REF_CHARACTERISTIC /begin REF_MEASUREMENT CDD_Uart0CfgAndUse.Uart0NrOfPnd100MilliSecFrmCnt /end REF_MEASUREMENT /end GROUP
/begin GROUP CDD_Uart0CfgAndUse.Uart0NrOfPnd10MilliSecFrmCnt "MICROSAR RTE" /begin SUB_GROUP /end SUB_GROUP /begin FUNCTION_LIST /end FUNCTION_LIST /begin REF_CHARACTERISTIC /end REF_CHARACTERISTIC /begin REF_MEASUREMENT CDD_Uart0CfgAndUse.Uart0NrOfPnd10MilliSecFrmCnt /end REF_MEASUREMENT /end GROUP
/begin GROUP CDD_Uart0CfgAndUse.Uart0RxPrevLoopDataUnread "MICROSAR RTE" /begin SUB_GROUP /end SUB_GROUP /begin FUNCTION_LIST /end FUNCTION_LIST /begin REF_CHARACTERISTIC /end REF_CHARACTERISTIC /begin REF_MEASUREMENT CDD_Uart0CfgAndUse.Uart0RxPrevLoopDataUnread /end REF_MEASUREMENT /end GROUP
/begin GROUP CDD_Uart1CfgAndUse "MICROSAR RTE" /begin SUB_GROUP CDD_Uart1CfgAndUse.PerInstanceMemories /end SUB_GROUP /begin FUNCTION_LIST /end FUNCTION_LIST /begin REF_CHARACTERISTIC /end REF_CHARACTERISTIC /begin REF_MEASUREMENT /end REF_MEASUREMENT /end GROUP
/begin GROUP CDD_Uart1CfgAndUse.PerInstanceMemories "MICROSAR RTE"
 /begin SUB_GROUP CDD_Uart1CfgAndUse.PrevDmaTrfCnt CDD_Uart1CfgAndUse.Uart1100MilliSecBufCnt CDD_Uart1CfgAndUse.Uart1100MilliSecReadCmpl CDD_Uart1CfgAndUse.Uart110MilliSecBufCnt CDD_Uart1CfgAndUse.Uart110MilliSecReadCmpl CDD_Uart1CfgAndUse.Uart12MilliSecBufCnt CDD_Uart1CfgAndUse.Uart1DiagcFrmErrCntr CDD_Uart1CfgAndUse.Uart1DiagcOvrrunErrCntr CDD_Uart1CfgAndUse.Uart1DiagcParErrCntr CDD_Uart1CfgAndUse.Uart1DiagcRxMaxDataErrCntr CDD_Uart1CfgAndUse.Uart1NrOfPnd100MilliSecFrmCnt CDD_Uart1CfgAndUse.Uart1NrOfPnd10MilliSecFrmCnt CDD_Uart1CfgAndUse.Uart1RxPrevLoopDataUnread /end SUB_GROUP
 /begin FUNCTION_LIST /end FUNCTION_LIST
 /begin REF_CHARACTERISTIC /end REF_CHARACTERISTIC
 /begin REF_MEASUREMENT /end REF_MEASUREMENT
/end GROUP
/begin GROUP CDD_Uart1CfgAndUse.PrevDmaTrfCnt "MICROSAR RTE" /begin SUB_GROUP /end SUB_GROUP /begin FUNCTION_LIST /end FUNCTION_LIST /begin REF_CHARACTERISTIC /end REF_CHARACTERISTIC /begin REF_MEASUREMENT CDD_Uart1CfgAndUse.PrevDmaTrfCnt /end REF_MEASUREMENT /end GROUP
/begin GROUP CDD_Uart1CfgAndUse.Uart1100MilliSecBufCnt "MICROSAR RTE" /begin SUB_GROUP /end SUB_GROUP /begin FUNCTION_LIST /end FUNCTION_LIST /begin REF_CHARACTERISTIC /end REF_CHARACTERISTIC /begin REF_MEASUREMENT CDD_Uart1CfgAndUse.Uart1100MilliSecBufCnt /end REF_MEASUREMENT /end GROUP
/begin GROUP CDD_Uart1CfgAndUse.Uart1100MilliSecReadCmpl "MICROSAR RTE" /begin SUB_GROUP /end SUB_GROUP /begin FUNCTION_LIST /end FUNCTION_LIST /begin REF_CHARACTERISTIC /end REF_CHARACTERISTIC /begin REF_MEASUREMENT CDD_Uart1CfgAndUse.Uart1100MilliSecReadCmpl /end REF_MEASUREMENT /end GROUP
/begin GROUP CDD_Uart1CfgAndUse.Uart110MilliSecBufCnt "MICROSAR RTE" /begin SUB_GROUP /end SUB_GROUP /begin FUNCTION_LIST /end FUNCTION_LIST /begin REF_CHARACTERISTIC /end REF_CHARACTERISTIC /begin REF_MEASUREMENT CDD_Uart1CfgAndUse.Uart110MilliSecBufCnt /end REF_MEASUREMENT /end GROUP
/begin GROUP CDD_Uart1CfgAndUse.Uart110MilliSecReadCmpl "MICROSAR RTE" /begin SUB_GROUP /end SUB_GROUP /begin FUNCTION_LIST /end FUNCTION_LIST /begin REF_CHARACTERISTIC /end REF_CHARACTERISTIC /begin REF_MEASUREMENT CDD_Uart1CfgAndUse.Uart110MilliSecReadCmpl /end REF_MEASUREMENT /end GROUP
/begin GROUP CDD_Uart1CfgAndUse.Uart12MilliSecBufCnt "MICROSAR RTE" /begin SUB_GROUP /end SUB_GROUP /begin FUNCTION_LIST /end FUNCTION_LIST /begin REF_CHARACTERISTIC /end REF_CHARACTERISTIC /begin REF_MEASUREMENT CDD_Uart1CfgAndUse.Uart12MilliSecBufCnt /end REF_MEASUREMENT /end GROUP
/begin GROUP CDD_Uart1CfgAndUse.Uart1DiagcFrmErrCntr "MICROSAR RTE" /begin SUB_GROUP /end SUB_GROUP /begin FUNCTION_LIST /end FUNCTION_LIST /begin REF_CHARACTERISTIC /end REF_CHARACTERISTIC /begin REF_MEASUREMENT CDD_Uart1CfgAndUse.Uart1DiagcFrmErrCntr /end REF_MEASUREMENT /end GROUP
/begin GROUP CDD_Uart1CfgAndUse.Uart1DiagcOvrrunErrCntr "MICROSAR RTE" /begin SUB_GROUP /end SUB_GROUP /begin FUNCTION_LIST /end FUNCTION_LIST /begin REF_CHARACTERISTIC /end REF_CHARACTERISTIC /begin REF_MEASUREMENT CDD_Uart1CfgAndUse.Uart1DiagcOvrrunErrCntr /end REF_MEASUREMENT /end GROUP
/begin GROUP CDD_Uart1CfgAndUse.Uart1DiagcParErrCntr "MICROSAR RTE" /begin SUB_GROUP /end SUB_GROUP /begin FUNCTION_LIST /end FUNCTION_LIST /begin REF_CHARACTERISTIC /end REF_CHARACTERISTIC /begin REF_MEASUREMENT CDD_Uart1CfgAndUse.Uart1DiagcParErrCntr /end REF_MEASUREMENT /end GROUP
/begin GROUP CDD_Uart1CfgAndUse.Uart1DiagcRxMaxDataErrCntr "MICROSAR RTE" /begin SUB_GROUP /end SUB_GROUP /begin FUNCTION_LIST /end FUNCTION_LIST /begin REF_CHARACTERISTIC /end REF_CHARACTERISTIC /begin REF_MEASUREMENT CDD_Uart1CfgAndUse.Uart1DiagcRxMaxDataErrCntr /end REF_MEASUREMENT /end GROUP
/begin GROUP CDD_Uart1CfgAndUse.Uart1NrOfPnd100MilliSecFrmCnt "MICROSAR RTE" /begin SUB_GROUP /end SUB_GROUP /begin FUNCTION_LIST /end FUNCTION_LIST /begin REF_CHARACTERISTIC /end REF_CHARACTERISTIC /begin REF_MEASUREMENT CDD_Uart1CfgAndUse.Uart1NrOfPnd100MilliSecFrmCnt /end REF_MEASUREMENT /end GROUP
/begin GROUP CDD_Uart1CfgAndUse.Uart1NrOfPnd10MilliSecFrmCnt "MICROSAR RTE" /begin SUB_GROUP /end SUB_GROUP /begin FUNCTION_LIST /end FUNCTION_LIST /begin REF_CHARACTERISTIC /end REF_CHARACTERISTIC /begin REF_MEASUREMENT CDD_Uart1CfgAndUse.Uart1NrOfPnd10MilliSecFrmCnt /end REF_MEASUREMENT /end GROUP
/begin GROUP CDD_Uart1CfgAndUse.Uart1RxPrevLoopDataUnread "MICROSAR RTE" /begin SUB_GROUP /end SUB_GROUP /begin FUNCTION_LIST /end FUNCTION_LIST /begin REF_CHARACTERISTIC /end REF_CHARACTERISTIC /begin REF_MEASUREMENT CDD_Uart1CfgAndUse.Uart1RxPrevLoopDataUnread /end REF_MEASUREMENT /end GROUP
/begin GROUP CDD_VrfyCritReg "MICROSAR RTE" /begin SUB_GROUP CDD_VrfyCritReg.PerInstanceMemories /end SUB_GROUP /begin FUNCTION_LIST /end FUNCTION_LIST /begin REF_CHARACTERISTIC /end REF_CHARACTERISTIC /begin REF_MEASUREMENT /end REF_MEASUREMENT /end GROUP
/begin GROUP CDD_VrfyCritReg.MCalReadVrfyCritRegFltInfo "MICROSAR RTE" /begin SUB_GROUP /end SUB_GROUP /begin FUNCTION_LIST /end FUNCTION_LIST /begin REF_CHARACTERISTIC /end REF_CHARACTERISTIC /begin REF_MEASUREMENT CDD_VrfyCritReg.MCalReadVrfyCritRegFltInfo /end REF_MEASUREMENT /end GROUP
/begin GROUP CDD_VrfyCritReg.MCalReadVrfyCritRegFltNvmInfo "MICROSAR RTE" /begin SUB_GROUP /end SUB_GROUP /begin FUNCTION_LIST /end FUNCTION_LIST /begin REF_CHARACTERISTIC /end REF_CHARACTERISTIC /begin REF_MEASUREMENT CDD_VrfyCritReg.MCalReadVrfyCritRegFltNvmInfo /end REF_MEASUREMENT /end GROUP
/begin GROUP CDD_VrfyCritReg.PerInstanceMemories "MICROSAR RTE"
 /begin SUB_GROUP CDD_VrfyCritReg.MCalReadVrfyCritRegFltInfo CDD_VrfyCritReg.MCalReadVrfyCritRegFltNvmInfo CDD_VrfyCritReg.dVrfyCritRegCritRegActVal CDD_VrfyCritReg.dVrfyCritRegCritRegAdr CDD_VrfyCritReg.dVrfyCritRegCritRegDesVal CDD_VrfyCritReg.dVrfyCritRegSysCritRegActVal CDD_VrfyCritReg.dVrfyCritRegSysCritRegAdr CDD_VrfyCritReg.dVrfyCritRegSysCritRegDesVal /end SUB_GROUP
 /begin FUNCTION_LIST /end FUNCTION_LIST
 /begin REF_CHARACTERISTIC /end REF_CHARACTERISTIC
 /begin REF_MEASUREMENT /end REF_MEASUREMENT
/end GROUP
/begin GROUP CDD_VrfyCritReg.dVrfyCritRegCritRegActVal "MICROSAR RTE" /begin SUB_GROUP /end SUB_GROUP /begin FUNCTION_LIST /end FUNCTION_LIST /begin REF_CHARACTERISTIC /end REF_CHARACTERISTIC /begin REF_MEASUREMENT CDD_VrfyCritReg.dVrfyCritRegCritRegActVal /end REF_MEASUREMENT /end GROUP
/begin GROUP CDD_VrfyCritReg.dVrfyCritRegCritRegAdr "MICROSAR RTE" /begin SUB_GROUP /end SUB_GROUP /begin FUNCTION_LIST /end FUNCTION_LIST /begin REF_CHARACTERISTIC /end REF_CHARACTERISTIC /begin REF_MEASUREMENT CDD_VrfyCritReg.dVrfyCritRegCritRegAdr /end REF_MEASUREMENT /end GROUP
/begin GROUP CDD_VrfyCritReg.dVrfyCritRegCritRegDesVal "MICROSAR RTE" /begin SUB_GROUP /end SUB_GROUP /begin FUNCTION_LIST /end FUNCTION_LIST /begin REF_CHARACTERISTIC /end REF_CHARACTERISTIC /begin REF_MEASUREMENT CDD_VrfyCritReg.dVrfyCritRegCritRegDesVal /end REF_MEASUREMENT /end GROUP
/begin GROUP CDD_VrfyCritReg.dVrfyCritRegSysCritRegActVal "MICROSAR RTE" /begin SUB_GROUP /end SUB_GROUP /begin FUNCTION_LIST /end FUNCTION_LIST /begin REF_CHARACTERISTIC /end REF_CHARACTERISTIC /begin REF_MEASUREMENT CDD_VrfyCritReg.dVrfyCritRegSysCritRegActVal /end REF_MEASUREMENT /end GROUP
/begin GROUP CDD_VrfyCritReg.dVrfyCritRegSysCritRegAdr "MICROSAR RTE" /begin SUB_GROUP /end SUB_GROUP /begin FUNCTION_LIST /end FUNCTION_LIST /begin REF_CHARACTERISTIC /end REF_CHARACTERISTIC /begin REF_MEASUREMENT CDD_VrfyCritReg.dVrfyCritRegSysCritRegAdr /end REF_MEASUREMENT /end GROUP
/begin GROUP CDD_VrfyCritReg.dVrfyCritRegSysCritRegDesVal "MICROSAR RTE" /begin SUB_GROUP /end SUB_GROUP /begin FUNCTION_LIST /end FUNCTION_LIST /begin REF_CHARACTERISTIC /end REF_CHARACTERISTIC /begin REF_MEASUREMENT CDD_VrfyCritReg.dVrfyCritRegSysCritRegDesVal /end REF_MEASUREMENT /end GROUP
/begin GROUP CDD_XcpIf "MICROSAR RTE" /begin SUB_GROUP CDD_XcpIf.ReceiverPorts /end SUB_GROUP /begin FUNCTION_LIST /end FUNCTION_LIST /begin REF_CHARACTERISTIC /end REF_CHARACTERISTIC /begin REF_MEASUREMENT /end REF_MEASUREMENT /end GROUP
/begin GROUP CDD_XcpIf.ActvIninIdx.Val "MICROSAR RTE" /begin SUB_GROUP /end SUB_GROUP /begin FUNCTION_LIST /end FUNCTION_LIST /begin REF_CHARACTERISTIC /end REF_CHARACTERISTIC /begin REF_MEASUREMENT CDD_XcpIf.ActvIninIdx.Val /end REF_MEASUREMENT /end GROUP
/begin GROUP CDD_XcpIf.ActvRtIdx.Val "MICROSAR RTE" /begin SUB_GROUP /end SUB_GROUP /begin FUNCTION_LIST /end FUNCTION_LIST /begin REF_CHARACTERISTIC /end REF_CHARACTERISTIC /begin REF_MEASUREMENT CDD_XcpIf.ActvRtIdx.Val /end REF_MEASUREMENT /end GROUP
/begin GROUP CDD_XcpIf.ReceiverPorts "MICROSAR RTE" /begin SUB_GROUP CDD_XcpIf.ActvIninIdx.Val CDD_XcpIf.ActvRtIdx.Val /end SUB_GROUP /begin FUNCTION_LIST /end FUNCTION_LIST /begin REF_CHARACTERISTIC /end REF_CHARACTERISTIC /begin REF_MEASUREMENT /end REF_MEASUREMENT /end GROUP
/begin GROUP CalRegn01Cmn "MICROSAR RTE" /begin SUB_GROUP CalRegn01Cmn.CalibrationPorts /end SUB_GROUP /begin FUNCTION_LIST /end FUNCTION_LIST /begin REF_CHARACTERISTIC /end REF_CHARACTERISTIC /begin REF_MEASUREMENT /end REF_MEASUREMENT /end GROUP
/begin GROUP CalRegn01Cmn.AssiSumLimCmdSumFilActv.Logl "MICROSAR RTE" /begin SUB_GROUP /end SUB_GROUP /begin FUNCTION_LIST /end FUNCTION_LIST /begin REF_CHARACTERISTIC CalRegn01Cmn.AssiSumLimCmdSumFilActv.Logl /end REF_CHARACTERISTIC /begin REF_MEASUREMENT /end REF_MEASUREMENT /end GROUP
/begin GROUP CalRegn01Cmn.AssiSumLimNtc0x0C4FailStep.Val "MICROSAR RTE" /begin SUB_GROUP /end SUB_GROUP /begin FUNCTION_LIST /end FUNCTION_LIST /begin REF_CHARACTERISTIC CalRegn01Cmn.AssiSumLimNtc0x0C4FailStep.Val /end REF_CHARACTERISTIC /begin REF_MEASUREMENT /end REF_MEASUREMENT /end GROUP
/begin GROUP CalRegn01Cmn.AssiSumLimNtc0x0C4PassStep.Val "MICROSAR RTE" /begin SUB_GROUP /end SUB_GROUP /begin FUNCTION_LIST /end FUNCTION_LIST /begin REF_CHARACTERISTIC CalRegn01Cmn.AssiSumLimNtc0x0C4PassStep.Val /end REF_CHARACTERISTIC /begin REF_MEASUREMENT /end REF_MEASUREMENT /end GROUP
/begin GROUP CalRegn01Cmn.AssiSumLimPullCmpLim.Val "MICROSAR RTE" /begin SUB_GROUP /end SUB_GROUP /begin FUNCTION_LIST /end FUNCTION_LIST /begin REF_CHARACTERISTIC CalRegn01Cmn.AssiSumLimPullCmpLim.Val /end REF_CHARACTERISTIC /begin REF_MEASUREMENT /end REF_MEASUREMENT /end GROUP
/begin GROUP CalRegn01Cmn.BattVltgCorrlnAllwdVltgDif.Val "MICROSAR RTE" /begin SUB_GROUP /end SUB_GROUP /begin FUNCTION_LIST /end FUNCTION_LIST /begin REF_CHARACTERISTIC CalRegn01Cmn.BattVltgCorrlnAllwdVltgDif.Val /end REF_CHARACTERISTIC /begin REF_MEASUREMENT /end REF_MEASUREMENT /end GROUP
/begin GROUP CalRegn01Cmn.BattVltgCorrlnBattLoVltg.Val "MICROSAR RTE" /begin SUB_GROUP /end SUB_GROUP /begin FUNCTION_LIST /end FUNCTION_LIST /begin REF_CHARACTERISTIC CalRegn01Cmn.BattVltgCorrlnBattLoVltg.Val /end REF_CHARACTERISTIC /begin REF_MEASUREMENT /end REF_MEASUREMENT /end GROUP
/begin GROUP CalRegn01Cmn.BattVltgCorrlnBattOverVltg.Val "MICROSAR RTE" /begin SUB_GROUP /end SUB_GROUP /begin FUNCTION_LIST /end FUNCTION_LIST /begin REF_CHARACTERISTIC CalRegn01Cmn.BattVltgCorrlnBattOverVltg.Val /end REF_CHARACTERISTIC /begin REF_MEASUREMENT /end REF_MEASUREMENT /end GROUP
/begin GROUP CalRegn01Cmn.BattVltgCorrlnBattUnderVltg.Val "MICROSAR RTE" /begin SUB_GROUP /end SUB_GROUP /begin FUNCTION_LIST /end FUNCTION_LIST /begin REF_CHARACTERISTIC CalRegn01Cmn.BattVltgCorrlnBattUnderVltg.Val /end REF_CHARACTERISTIC /begin REF_MEASUREMENT /end REF_MEASUREMENT /end GROUP
/begin GROUP CalRegn01Cmn.BattVltgCorrlnNtc0x03C0x044FailStep.Val "MICROSAR RTE" /begin SUB_GROUP /end SUB_GROUP /begin FUNCTION_LIST /end FUNCTION_LIST /begin REF_CHARACTERISTIC CalRegn01Cmn.BattVltgCorrlnNtc0x03C0x044FailStep.Val /end REF_CHARACTERISTIC /begin REF_MEASUREMENT /end REF_MEASUREMENT /end GROUP
/begin GROUP CalRegn01Cmn.BattVltgCorrlnNtc0x03C0x044PassStep.Val "MICROSAR RTE" /begin SUB_GROUP /end SUB_GROUP /begin FUNCTION_LIST /end FUNCTION_LIST /begin REF_CHARACTERISTIC CalRegn01Cmn.BattVltgCorrlnNtc0x03C0x044PassStep.Val /end REF_CHARACTERISTIC /begin REF_MEASUREMENT /end REF_MEASUREMENT /end GROUP
/begin GROUP CalRegn01Cmn.BattVltgCorrlnNtc0x0B0FailStep.Val "MICROSAR RTE" /begin SUB_GROUP /end SUB_GROUP /begin FUNCTION_LIST /end FUNCTION_LIST /begin REF_CHARACTERISTIC CalRegn01Cmn.BattVltgCorrlnNtc0x0B0FailStep.Val /end REF_CHARACTERISTIC /begin REF_MEASUREMENT /end REF_MEASUREMENT /end GROUP
/begin GROUP CalRegn01Cmn.BattVltgCorrlnNtc0x0B0PassStep.Val "MICROSAR RTE" /begin SUB_GROUP /end SUB_GROUP /begin FUNCTION_LIST /end FUNCTION_LIST /begin REF_CHARACTERISTIC CalRegn01Cmn.BattVltgCorrlnNtc0x0B0PassStep.Val /end REF_CHARACTERISTIC /begin REF_MEASUREMENT /end REF_MEASUREMENT /end GROUP
/begin GROUP CalRegn01Cmn.BattVltgCorrlnNtc0x0B1FailStep.Val "MICROSAR RTE" /begin SUB_GROUP /end SUB_GROUP /begin FUNCTION_LIST /end FUNCTION_LIST /begin REF_CHARACTERISTIC CalRegn01Cmn.BattVltgCorrlnNtc0x0B1FailStep.Val /end REF_CHARACTERISTIC /begin REF_MEASUREMENT /end REF_MEASUREMENT /end GROUP
/begin GROUP CalRegn01Cmn.BattVltgCorrlnNtc0x0B1PassStep.Val "MICROSAR RTE" /begin SUB_GROUP /end SUB_GROUP /begin FUNCTION_LIST /end FUNCTION_LIST /begin REF_CHARACTERISTIC CalRegn01Cmn.BattVltgCorrlnNtc0x0B1PassStep.Val /end REF_CHARACTERISTIC /begin REF_MEASUREMENT /end REF_MEASUREMENT /end GROUP
/begin GROUP CalRegn01Cmn.BattVltgCorrlnNtc0x0B5FailStep.Val "MICROSAR RTE" /begin SUB_GROUP /end SUB_GROUP /begin FUNCTION_LIST /end FUNCTION_LIST /begin REF_CHARACTERISTIC CalRegn01Cmn.BattVltgCorrlnNtc0x0B5FailStep.Val /end REF_CHARACTERISTIC /begin REF_MEASUREMENT /end REF_MEASUREMENT /end GROUP
/begin GROUP CalRegn01Cmn.BattVltgCorrlnNtc0x0B5PassStep.Val "MICROSAR RTE" /begin SUB_GROUP /end SUB_GROUP /begin FUNCTION_LIST /end FUNCTION_LIST /begin REF_CHARACTERISTIC CalRegn01Cmn.BattVltgCorrlnNtc0x0B5PassStep.Val /end REF_CHARACTERISTIC /begin REF_MEASUREMENT /end REF_MEASUREMENT /end GROUP
/begin GROUP CalRegn01Cmn.BattVltgCorrlnRcvrlBattLoVltg.Val "MICROSAR RTE" /begin SUB_GROUP /end SUB_GROUP /begin FUNCTION_LIST /end FUNCTION_LIST /begin REF_CHARACTERISTIC CalRegn01Cmn.BattVltgCorrlnRcvrlBattLoVltg.Val /end REF_CHARACTERISTIC /begin REF_MEASUREMENT /end REF_MEASUREMENT /end GROUP
/begin GROUP CalRegn01Cmn.BattVltgCorrlnRcvrlBattOverVltg.Val "MICROSAR RTE" /begin SUB_GROUP /end SUB_GROUP /begin FUNCTION_LIST /end FUNCTION_LIST /begin REF_CHARACTERISTIC CalRegn01Cmn.BattVltgCorrlnRcvrlBattOverVltg.Val /end REF_CHARACTERISTIC /begin REF_MEASUREMENT /end REF_MEASUREMENT /end GROUP
/begin GROUP CalRegn01Cmn.BattVltgCorrlnRcvrlBattUnderVltg.Val "MICROSAR RTE" /begin SUB_GROUP /end SUB_GROUP /begin FUNCTION_LIST /end FUNCTION_LIST /begin REF_CHARACTERISTIC CalRegn01Cmn.BattVltgCorrlnRcvrlBattUnderVltg.Val /end REF_CHARACTERISTIC /begin REF_MEASUREMENT /end REF_MEASUREMENT /end GROUP
/begin GROUP CalRegn01Cmn.BattVltgCorrlnSwdMax.Val "MICROSAR RTE" /begin SUB_GROUP /end SUB_GROUP /begin FUNCTION_LIST /end FUNCTION_LIST /begin REF_CHARACTERISTIC CalRegn01Cmn.BattVltgCorrlnSwdMax.Val /end REF_CHARACTERISTIC /begin REF_MEASUREMENT /end REF_MEASUREMENT /end GROUP
/begin GROUP CalRegn01Cmn.BattVltgCorrlnSysMinVltg.Val "MICROSAR RTE" /begin SUB_GROUP /end SUB_GROUP /begin FUNCTION_LIST /end FUNCTION_LIST /begin REF_CHARACTERISTIC CalRegn01Cmn.BattVltgCorrlnSysMinVltg.Val /end REF_CHARACTERISTIC /begin REF_MEASUREMENT /end REF_MEASUREMENT /end GROUP
/begin GROUP CalRegn01Cmn.BattVltgSwdMax.Val "MICROSAR RTE" /begin SUB_GROUP /end SUB_GROUP /begin FUNCTION_LIST /end FUNCTION_LIST /begin REF_CHARACTERISTIC CalRegn01Cmn.BattVltgSwdMax.Val /end REF_CHARACTERISTIC /begin REF_MEASUREMENT /end REF_MEASUREMENT /end GROUP
/begin GROUP CalRegn01Cmn.CalibrationPorts "MICROSAR RTE"
 /begin SUB_GROUP CalRegn01Cmn.AssiSumLimCmdSumFilActv.Logl CalRegn01Cmn.AssiSumLimNtc0x0C4FailStep.Val CalRegn01Cmn.AssiSumLimNtc0x0C4PassStep.Val CalRegn01Cmn.AssiSumLimPullCmpLim.Val CalRegn01Cmn.BattVltgCorrlnAllwdVltgDif.Val CalRegn01Cmn.BattVltgCorrlnBattLoVltg.Val CalRegn01Cmn.BattVltgCorrlnBattOverVltg.Val CalRegn01Cmn.BattVltgCorrlnBattUnderVltg.Val CalRegn01Cmn.BattVltgCorrlnNtc0x03C0x044FailStep.Val CalRegn01Cmn.BattVltgCorrlnNtc0x03C0x044PassStep.Val CalRegn01Cmn.BattVltgCorrlnNtc0x0B0FailStep.Val CalRegn01Cmn.BattVltgCorrlnNtc0x0B0PassStep.Val CalRegn01Cmn.BattVltgCorrlnNtc0x0B1FailStep.Val CalRegn01Cmn.BattVltgCorrlnNtc0x0B1PassStep.Val CalRegn01Cmn.BattVltgCorrlnNtc0x0B5FailStep.Val CalRegn01Cmn.BattVltgCorrlnNtc0x0B5PassStep.Val CalRegn01Cmn.BattVltgCorrlnRcvrlBattLoVltg.Val CalRegn01Cmn.BattVltgCorrlnRcvrlBattOverVltg.Val CalRegn01Cmn.BattVltgCorrlnRcvrlBattUnderVltg.Val CalRegn01Cmn.BattVltgCorrlnSwdMax.Val CalRegn01Cmn.BattVltgCorrlnSysMinVltg.Val CalRegn01Cmn.BattVltgSwdMax.Val CalRegn01Cmn.CmnMfgSrvSecuAcsAtmptTiOut.Val CalRegn01Cmn.CmnMfgSrvSecuAcsMaxNrAtmpt.Val CalRegn01Cmn.CurrMeasArbnMaxStallCntr.Val CalRegn01Cmn.CurrMeasCorrlnMaxErrCurr.Val CalRegn01Cmn.CurrMeasCorrlnMaxStallCntr.Val CalRegn01Cmn.CurrMeasCorrlnNtc0x04DFailStep.Val CalRegn01Cmn.CurrMeasCorrlnNtc0x04DPassStep.Val CalRegn01Cmn.CurrMeasEolFixdPwmPerd.Val CalRegn01Cmn.CurrMeasEolGainMax.Val CalRegn01Cmn.CurrMeasEolGainMin.Val CalRegn01Cmn.CurrMeasEolGainNom.Val CalRegn01Cmn.CurrMeasEolGainNrOfSample.Val CalRegn01Cmn.CurrMeasEolGainNumer.Val CalRegn01Cmn.CurrMeasEolMaxMotVel.Val CalRegn01Cmn.CurrMeasEolOffsHiBrdgVltgMin.Val CalRegn01Cmn.CurrMeasEolOffsHiCmuOffs.Val CalRegn01Cmn.CurrMeasEolOffsLoCmuOffs.Val CalRegn01Cmn.CurrMeasEolOffsMax.Val CalRegn01Cmn.CurrMeasEolOffsMin.Val CalRegn01Cmn.CurrMeasEolOffsNom.Val CalRegn01Cmn.CurrMeasEolOffsNrOfSample.Val CalRegn01Cmn.CurrMeasEolTranCntrThd.Val CalRegn01Cmn.CurrMeasMinRqrdPhaOnTi.Val CalRegn01Cmn.CurrMeasMotAgCompuDly.Val CalRegn01Cmn.CurrMeasMotCurrAdcVlyWrmIninMax.Val CalRegn01Cmn.CurrMeasMotCurrAdcVlyWrmIninMin.Val CalRegn01Cmn.CurrMeasNtc0x05DFailStep.Val CalRegn01Cmn.CurrMeasNtc0x05DPassStep.Val CalRegn01Cmn.DiagcMgrFltResp.Ary1D CalRegn01Cmn.DrvrTqEstimnMtrxA.Ary2D CalRegn01Cmn.DrvrTqEstimnMtrxB.Ary2D CalRegn01Cmn.DrvrTqEstimnMtrxC.Ary1D CalRegn01Cmn.DrvrTqEstimnMtrxD.Ary1D CalRegn01Cmn.DutyCycThermProtnAbsltCtrlTFetMtgtnTblX.Ary1D CalRegn01Cmn.DutyCycThermProtnAbsltCtrlTTblX.Ary1D CalRegn01Cmn.DutyCycThermProtnAbsltCtrlTTqFetMtgtnTblY.Ary1D CalRegn01Cmn.DutyCycThermProtnAbsltCtrlTTqTblY.Ary1D CalRegn01Cmn.DutyCycThermProtnAbsltCuTFetMtgtnTblX.Ary1D CalRegn01Cmn.DutyCycThermProtnAbsltCuTTblX.Ary1D CalRegn01Cmn.DutyCycThermProtnAbsltCuTTqFetMtgtnTblY.Ary1D CalRegn01Cmn.DutyCycThermProtnAbsltCuTTqTblY.Ary1D CalRegn01Cmn.DutyCycThermProtnAbsltMotVelBreakPt.Val CalRegn01Cmn.DutyCycThermProtnAbsltTTqSlewHiLim.Val CalRegn01Cmn.DutyCycThermProtnAbsltTTqSlewLoLim.Val CalRegn01Cmn.DutyCycThermProtnCtrlT.Val CalRegn01Cmn.DutyCycThermProtnCtrlTSeln.Logl CalRegn01Cmn.DutyCycThermProtnDutyCycFildThd.Val CalRegn01Cmn.DutyCycThermProtnIgnOffCtrlEna.Logl CalRegn01Cmn.DutyCycThermProtnIgnOffMsgWaitTi.Val CalRegn01Cmn.DutyCycThermProtnLstTblValNonStall.Ary2D CalRegn01Cmn.DutyCycThermProtnLstTblValStall.Ary2D CalRegn01Cmn.DutyCycThermProtnMotPrTSeln.Logl CalRegn01Cmn.DutyCycThermProtnMplr1FetMtgtnNonStallTblY.Ary1D CalRegn01Cmn.DutyCycThermProtnMplr1FetMtgtnStallTblY.Ary1D CalRegn01Cmn.DutyCycThermProtnMplr1NonStallTblY.Ary1D CalRegn01Cmn.DutyCycThermProtnMplr1StallTblY.Ary1D CalRegn01Cmn.DutyCycThermProtnMplr2FetMtgtnNonStallTblY.Ary1D CalRegn01Cmn.DutyCycThermProtnMplr2FetMtgtnStallTblY.Ary1D CalRegn01Cmn.DutyCycThermProtnMplr2NonStallTblY.Ary1D CalRegn01Cmn.DutyCycThermProtnMplr2StallTblY.Ary1D CalRegn01Cmn.DutyCycThermProtnMplr3FetMtgtnNonStallTblY.Ary1D CalRegn01Cmn.DutyCycThermProtnMplr3FetMtgtnStallTblY.Ary1D CalRegn01Cmn.DutyCycThermProtnMplr3NonStallTblY.Ary1D CalRegn01Cmn.DutyCycThermProtnMplr3StallTblY.Ary1D CalRegn01Cmn.DutyCycThermProtnMplr4FetMtgtnNonStallTblY.Ary1D CalRegn01Cmn.DutyCycThermProtnMplr4FetMtgtnStallTblY.Ary1D CalRegn01Cmn.DutyCycThermProtnMplr4NonStallTblY.Ary1D CalRegn01Cmn.DutyCycThermProtnMplr4StallTblY.Ary1D CalRegn01Cmn.DutyCycThermProtnMplr5FetMtgtnNonStallTblY.Ary1D CalRegn01Cmn.DutyCycThermProtnMplr5FetMtgtnStallTblY.Ary1D CalRegn01Cmn.DutyCycThermProtnMplr5NonStallTblY.Ary1D CalRegn01Cmn.DutyCycThermProtnMplr5StallTblY.Ary1D CalRegn01Cmn.DutyCycThermProtnMplr6FetMtgtnNonStallTblY.Ary1D CalRegn01Cmn.DutyCycThermProtnMplr6FetMtgtnStallTblY.Ary1D CalRegn01Cmn.DutyCycThermProtnMplr6NonStallTblY.Ary1D CalRegn01Cmn.DutyCycThermProtnMplr6StallTblY.Ary1D CalRegn01Cmn.DutyCycThermProtnMplrFetMtgtnTblX.Ary1D CalRegn01Cmn.DutyCycThermProtnMplrTSeln.Logl CalRegn01Cmn.DutyCycThermProtnMplrTblX.Ary1D CalRegn01Cmn.DutyCycThermProtnSlowFilTSeln.Logl CalRegn01Cmn.DutyCycThermProtnThermLimScaFac.Val CalRegn01Cmn.DutyCycThermProtnThermLoadLimTblX.Ary2D CalRegn01Cmn.DutyCycThermProtnThermLoadLimTblY.Ary2D CalRegn01Cmn.DutyCycThermProtnTqCmdSlewDwn.Val CalRegn01Cmn.DutyCycThermProtnTqCmdSlewUp.Val CalRegn01Cmn.ElecPwrCnsCtrlrInpR.Val CalRegn01Cmn.FordMsg077BusHiSpdCanDtcInhbThd.Val CalRegn01Cmn.FordMsg077BusHiSpdLatACmpdInvldSigFaildThd.Val CalRegn01Cmn.FordMsg077BusHiSpdLatACmpdInvldSigPassdThd.Val CalRegn01Cmn.FordMsg077BusHiSpdLatACmpdVldMissThd.Val CalRegn01Cmn.FordMsg077BusHiSpdLgtACmpdInvldSigFaildThd.Val CalRegn01Cmn.FordMsg077BusHiSpdLgtACmpdInvldSigPassdThd.Val CalRegn01Cmn.FordMsg077BusHiSpdLgtACmpdVldMissThd.Val CalRegn01Cmn.FordMsg077BusHiSpdMissMsgFaildThd.Val CalRegn01Cmn.FordMsg077BusHiSpdMissMsgPassdThd.Val CalRegn01Cmn.FordMsg077BusHiSpdOverGndInvldSigFaildThd.Val CalRegn01Cmn.FordMsg077BusHiSpdOverGndInvldSigPassdThd.Val CalRegn01Cmn.FordMsg077BusHiSpdVehLatACmpdVldFaildThd.Val CalRegn01Cmn.FordMsg077BusHiSpdVehLatACmpdVldPassdThd.Val CalRegn01Cmn.FordMsg077BusHiSpdVehLgtACmpdVldFaildThd.Val CalRegn01Cmn.FordMsg077BusHiSpdVehLgtACmpdVldPassdThd.Val CalRegn01Cmn.FordMsg077BusHiSpdVehSpdOverGndVldFaildThd.Val CalRegn01Cmn.FordMsg077BusHiSpdVehSpdOverGndVldMissThd.Val CalRegn01Cmn.FordMsg077BusHiSpdVehSpdOverGndVldPassdThd.Val CalRegn01Cmn.FordMsg077BusHiSpdVehYawRateCmpdVldFaildThd.Val CalRegn01Cmn.FordMsg077BusHiSpdVehYawRateCmpdVldPassdThd.Val CalRegn01Cmn.FordMsg077BusHiSpdYawRateCmpdInvldSigFaildThd.Val CalRegn01Cmn.FordMsg077BusHiSpdYawRateCmpdInvldSigPassdThd.Val CalRegn01Cmn.FordMsg077BusHiSpdYawRateCmpdVldMissThd.Val CalRegn01Cmn.FordMsg07DBusHiSpdActBrkTqSigInvldPassdThd.Val CalRegn01Cmn.FordMsg07DBusHiSpdFordVehActBrkTqInvldThd.Val CalRegn01Cmn.FordMsg07DBusHiSpdFordVehActBrkTqVldThd.Val CalRegn01Cmn.FordMsg07DBusHiSpdFordVehBrkTqVldMissMsgThd.Val CalRegn01Cmn.FordMsg07DBusHiSpdFordVehVertACmpdSigInvldThd.Val CalRegn01Cmn.FordMsg07DBusHiSpdFordVehVertACmpdSigVldThd.Val CalRegn01Cmn.FordMsg07DBusHiSpdFordVehVertAVldMissMsgThd.Val CalRegn01Cmn.FordMsg07DBusHiSpdMissMsgFaildThd.Val CalRegn01Cmn.FordMsg07DBusHiSpdMissMsgPassdThd.Val CalRegn01Cmn.FordMsg07DBusHiSpdVehActTqBrkInvldFaildThd.Val CalRegn01Cmn.FordMsg07DBusHiSpdVertACmpdSigInvldFaildThd.Val CalRegn01Cmn.FordMsg07DBusHiSpdVertACmpdSigInvldPassdThd.Val CalRegn01Cmn.FordMsg083BusHiSpdFordVehTurnSigVldThd.Val CalRegn01Cmn.FordMsg083BusHiSpdMissMsgFaildThd.Val CalRegn01Cmn.FordMsg083BusHiSpdMissMsgPassdThd.Val CalRegn01Cmn.FordMsg083BusHiSpdVehTurnSigVldMissMsgThd.Val CalRegn01Cmn.FordMsg091BusHiSpdInvldMsgFaildThd.Val CalRegn01Cmn.FordMsg091BusHiSpdInvldMsgPassdThd.Val CalRegn01Cmn.FordMsg091BusHiSpdMissMsgFaildThd.Val CalRegn01Cmn.FordMsg091BusHiSpdMissMsgPassdThd.Val CalRegn01Cmn.FordMsg091BusHiSpdYawRateRawVldMissFaildThd.Val CalRegn01Cmn.FordMsg091BusHiSpdYawRateRawVldSigFaildThd.Val CalRegn01Cmn.FordMsg091BusHiSpdYawRateRawVldSigPassdThd.Val CalRegn01Cmn.FordMsg167BusHiSpdMissMsgFaildTiThd.Val CalRegn01Cmn.FordMsg167BusHiSpdMissMsgPassdTiThd.Val CalRegn01Cmn.FordMsg167BusHiSpdPrpnWhlTqFaildTiThd.Val CalRegn01Cmn.FordMsg167BusHiSpdPrpnWhlTqMissTiThd.Val CalRegn01Cmn.FordMsg167BusHiSpdPrpnWhlTqPassdTiThd.Val CalRegn01Cmn.FordMsg167BusHiSpdPrpnWhlTqSigInvldFaildTiThd.Val CalRegn01Cmn.FordMsg167BusHiSpdPrpnWhlTqSigInvldPassdTiThd.Val CalRegn01Cmn.FordMsg202BusHiSpdEngModLoQlyVldFaildThd.Val CalRegn01Cmn.FordMsg202BusHiSpdEngModLoQlyVldMissThd.Val CalRegn01Cmn.FordMsg202BusHiSpdEngModLoQlyVldPassdThd.Val CalRegn01Cmn.FordMsg202BusHiSpdEngModlVldFaildThd.Val CalRegn01Cmn.FordMsg202BusHiSpdEngModlVldMissThd.Val CalRegn01Cmn.FordMsg202BusHiSpdGearRvsStsInvldFaildThd.Val CalRegn01Cmn.FordMsg202BusHiSpdGearRvsStsInvldPassdThd.Val CalRegn01Cmn.FordMsg202BusHiSpdGearRvsStsVldFaildThd.Val CalRegn01Cmn.FordMsg202BusHiSpdGearRvsStsVldMissThd.Val CalRegn01Cmn.FordMsg202BusHiSpdGearRvsStsVldPassdThd.Val CalRegn01Cmn.FordMsg202BusHiSpdMissMsgFaildAbsPrsntDisadThd.Val CalRegn01Cmn.FordMsg202BusHiSpdMissMsgFaildAbsPrsntEnadThd.Val CalRegn01Cmn.FordMsg202BusHiSpdMissMsgPassdThd.Val CalRegn01Cmn.FordMsg202BusHiSpdQlyFacEngModInvldFaildThd.Val CalRegn01Cmn.FordMsg202BusHiSpdQlyFacEngModInvldPassdThd.Val CalRegn01Cmn.FordMsg202BusHiSpdTrlrBackupAssiAvlVldMissThd.Val CalRegn01Cmn.FordMsg202BusHiSpdTrlrBackupAssiAvlVldPassdThd.Val CalRegn01Cmn.FordMsg213BusHiSpdAbsActvVldFaildThd.Val CalRegn01Cmn.FordMsg213BusHiSpdAbsActvVldPassdThd.Val CalRegn01Cmn.FordMsg213BusHiSpdEvasSteerAssiEnadThd.Val CalRegn01Cmn.FordMsg213BusHiSpdMissMsgFaildThd.Val CalRegn01Cmn.FordMsg213BusHiSpdMissMsgPassdThd.Val CalRegn01Cmn.FordMsg215BusHiSpdFordVehTrlrAidModReqVldNotRxdTiThd.Val CalRegn01Cmn.FordMsg215BusHiSpdFordVehTrlrAidModReqVldRxdTiThd.Val CalRegn01Cmn.FordMsg215BusHiSpdMissMsgFaildTiThd.Val CalRegn01Cmn.FordMsg215BusHiSpdMissMsgPassdTiThd.Val CalRegn01Cmn.FordMsg216BusHiSpdFrntLeWhlCntrDirFaildTiThd.Val CalRegn01Cmn.FordMsg216BusHiSpdFrntLeWhlCntrDirPassdTiThd.Val CalRegn01Cmn.FordMsg216BusHiSpdFrntLeWhlVldMissMsgThd.Val CalRegn01Cmn.FordMsg216BusHiSpdFrntRiWhlCntrDirFaildTiThd.Val CalRegn01Cmn.FordMsg216BusHiSpdFrntRiWhlCntrDirPassdTiThd.Val CalRegn01Cmn.FordMsg216BusHiSpdFrntRiWhlVldMissMsgThd.Val CalRegn01Cmn.FordMsg216BusHiSpdMissMsgFaildTiThd.Val CalRegn01Cmn.FordMsg216BusHiSpdMissMsgPassdTiThd.Val CalRegn01Cmn.FordMsg216BusHiSpdReLeWhlCntrDirFaildTiThd.Val CalRegn01Cmn.FordMsg216BusHiSpdReLeWhlCntrDirPassdTiThd.Val CalRegn01Cmn.FordMsg216BusHiSpdReLeWhlVldMissMsgThd.Val CalRegn01Cmn.FordMsg216BusHiSpdReRiWhlCntrDirFaildTiThd.Val CalRegn01Cmn.FordMsg216BusHiSpdReRiWhlCntrDirPassdTiThd.Val CalRegn01Cmn.FordMsg216BusHiSpdReRiWhlVldMissMsgThd.Val CalRegn01Cmn.FordMsg217BusHiSpdFrntLeWhlSpdInvldFaildThd.Val CalRegn01Cmn.FordMsg217BusHiSpdFrntLeWhlSpdInvldPassdThd.Val CalRegn01Cmn.FordMsg217BusHiSpdFrntLeWhlVldFaildThd.Val CalRegn01Cmn.FordMsg217BusHiSpdFrntLeWhlVldMissThd.Val CalRegn01Cmn.FordMsg217BusHiSpdFrntLeWhlVldPassdThd.Val CalRegn01Cmn.FordMsg217BusHiSpdFrntRiWhlSpdInvldFaildThd.Val CalRegn01Cmn.FordMsg217BusHiSpdFrntRiWhlSpdInvldPassdThd.Val CalRegn01Cmn.FordMsg217BusHiSpdFrntRiWhlVldFaildThd.Val CalRegn01Cmn.FordMsg217BusHiSpdFrntRiWhlVldMissThd.Val CalRegn01Cmn.FordMsg217BusHiSpdFrntRiWhlVldPassdThd.Val CalRegn01Cmn.FordMsg217BusHiSpdMissMsgFaildThd.Val CalRegn01Cmn.FordMsg217BusHiSpdMissMsgPassdThd.Val CalRegn01Cmn.FordMsg217BusHiSpdReLeWhlSpdInvldFaildThd.Val CalRegn01Cmn.FordMsg217BusHiSpdReLeWhlSpdInvldPassdThd.Val CalRegn01Cmn.FordMsg217BusHiSpdReLeWhlVldFaildThd.Val CalRegn01Cmn.FordMsg217BusHiSpdReLeWhlVldMissThd.Val CalRegn01Cmn.FordMsg217BusHiSpdReLeWhlVldPassdThd.Val CalRegn01Cmn.FordMsg217BusHiSpdReRiWhlSpdInvldFaildThd.Val CalRegn01Cmn.FordMsg217BusHiSpdReRiWhlSpdInvldPassdThd.Val CalRegn01Cmn.FordMsg217BusHiSpdReRiWhlVldFaildThd.Val CalRegn01Cmn.FordMsg217BusHiSpdReRiWhlVldMissThd.Val CalRegn01Cmn.FordMsg217BusHiSpdReRiWhlVldPassdThd.Val CalRegn01Cmn.FordMsg230BusHiSpdFordVehGearLvrPosnFaildTiThd.Val CalRegn01Cmn.FordMsg230BusHiSpdFordVehGearLvrPosnPassdTiThd.Val CalRegn01Cmn.FordMsg230BusHiSpdGearLvrPosnMissTiThd.Val CalRegn01Cmn.FordMsg230BusHiSpdInvldSigFaildThd.Val CalRegn01Cmn.FordMsg230BusHiSpdInvldSigPassdThd.Val CalRegn01Cmn.FordMsg230BusHiSpdMissMsgFaildThd.Val CalRegn01Cmn.FordMsg230BusHiSpdMissMsgPassdThd.Val CalRegn01Cmn.FordMsg2FDBusHiSpdFordVehEvasSteerAssiReqVldNotRxdTiThd.Val CalRegn01Cmn.FordMsg2FDBusHiSpdFordVehEvasSteerAssiReqVldRxdTiThd.Val CalRegn01Cmn.FordMsg2FDBusHiSpdMissMsgFaildTiThd.Val CalRegn01Cmn.FordMsg2FDBusHiSpdMissMsgPassdTiThd.Val CalRegn01Cmn.FordMsg3B3BusHiSpdIgnStsVldFaildThd.Val CalRegn01Cmn.FordMsg3B3BusHiSpdIgnStsVldMissThd.Val CalRegn01Cmn.FordMsg3B3BusHiSpdIgnStsVldPassdThd.Val CalRegn01Cmn.FordMsg3B3BusHiSpdInvldSigFaildThd.Val CalRegn01Cmn.FordMsg3B3BusHiSpdInvldSigPassdThd.Val CalRegn01Cmn.FordMsg3B3BusHiSpdMissMsgFaildThd.Val CalRegn01Cmn.FordMsg3B3BusHiSpdMissMsgPassdThd.Val CalRegn01Cmn.FordMsg3CABusHiSpdLaneAssiImgProcgModlAFaildCrvtTiThd.Val CalRegn01Cmn.FordMsg3CABusHiSpdLaneAssiImgProcgModlAFaildReqdAgTiThd.Val CalRegn01Cmn.FordMsg3CABusHiSpdLaneAssiImgProcgModlAPassdTiThd.Val CalRegn01Cmn.FordMsg3CABusHiSpdLaneAssiImgProcgModlAVldMissTiThd.Val CalRegn01Cmn.FordMsg3CABusHiSpdLaneKeepSysCrvtInvldFaildTiThd.Val CalRegn01Cmn.FordMsg3CABusHiSpdLaneKeepSysCrvtInvldPassdTiThd.Val CalRegn01Cmn.FordMsg3CABusHiSpdLaneKeepSysReqdAgInvldFaildTiThd.Val CalRegn01Cmn.FordMsg3CABusHiSpdLaneKeepSysReqdAgInvldPassdTiThd.Val CalRegn01Cmn.FordMsg3CABusHiSpdMissMsgFaildTiThd.Val CalRegn01Cmn.FordMsg3CABusHiSpdMissMsgPassdTiThd.Val CalRegn01Cmn.FordMsg3D3BusHiSpdImgProcrModlAVldFaildThd.Val CalRegn01Cmn.FordMsg3D3BusHiSpdImgProcrModlAVldPassdThd.Val CalRegn01Cmn.FordMsg3D3BusHiSpdMissMsgFaildThd.Val CalRegn01Cmn.FordMsg3D3BusHiSpdMissMsgPassdThd.Val CalRegn01Cmn.FordMsg3D7BusHiSpdImgProcrModlAVldMissThd.Val CalRegn01Cmn.FordMsg3D7BusHiSpdImgProcrModlAVldPassdThd.Val CalRegn01Cmn.FordMsg3D7BusHiSpdLatDstInvldFaildThd.Val CalRegn01Cmn.FordMsg3D7BusHiSpdLatDstInvldPassdThd.Val CalRegn01Cmn.FordMsg3D7BusHiSpdLatDstRawVldFaildThd.Val CalRegn01Cmn.FordMsg3D7BusHiSpdLgtDstInvldFaildThd.Val CalRegn01Cmn.FordMsg3D7BusHiSpdLgtDstInvldPassdThd.Val CalRegn01Cmn.FordMsg3D7BusHiSpdLgtDstRawVldFaildThd.Val CalRegn01Cmn.FordMsg3D7BusHiSpdMissMsgFaildThd.Val CalRegn01Cmn.FordMsg3D7BusHiSpdMissMsgPassdThd.Val CalRegn01Cmn.FordMsg3D7BusHiSpdRelLatVelInvldFaildThd.Val CalRegn01Cmn.FordMsg3D7BusHiSpdRelLatVelInvldPassdThd.Val CalRegn01Cmn.FordMsg3D7BusHiSpdRelLatVelRawVldFaildThd.Val CalRegn01Cmn.FordMsg3D7BusHiSpdRelLgtVelInvldFaildThd.Val CalRegn01Cmn.FordMsg3D7BusHiSpdRelLgtVelInvldPassdThd.Val CalRegn01Cmn.FordMsg3D7BusHiSpdRelLgtVelRawVldFaildThd.Val CalRegn01Cmn.FordMsg3D7BusHiSpdTiToCllsnInvldFaildThd.Val CalRegn01Cmn.FordMsg3D7BusHiSpdTiToCllsnInvldPassdThd.Val CalRegn01Cmn.FordMsg3D7BusHiSpdTiToCllsnRawVldFaildThd.Val CalRegn01Cmn.FordMsg40ABusHiSpdMissMsgFaildThd.Val CalRegn01Cmn.FordMsg40ABusHiSpdMissMsgPassdThd.Val CalRegn01Cmn.FordMsg414BusHiSpdAgOffsVldFaildThd.Val CalRegn01Cmn.FordMsg414BusHiSpdAgOffsVldMissThd.Val CalRegn01Cmn.FordMsg414BusHiSpdAgOffsVldPassdThd.Val CalRegn01Cmn.FordMsg414BusHiSpdChksVldFaildThd.Val CalRegn01Cmn.FordMsg414BusHiSpdChksVldMissThd.Val CalRegn01Cmn.FordMsg414BusHiSpdCntrVldMissThd.Val CalRegn01Cmn.FordMsg415BusHiSpdBrkModlLoQlyVldFaildThd.Val CalRegn01Cmn.FordMsg415BusHiSpdBrkModlLoQlyVldMissThd.Val CalRegn01Cmn.FordMsg415BusHiSpdBrkModlLoQlyVldPassdThd.Val CalRegn01Cmn.FordMsg415BusHiSpdBrkModlVldFaildThd.Val CalRegn01Cmn.FordMsg415BusHiSpdBrkModlVldMissThd.Val CalRegn01Cmn.FordMsg415BusHiSpdBrkModlVldPassdThd.Val CalRegn01Cmn.FordMsg415BusHiSpdBrkSprtVldMissThd.Val CalRegn01Cmn.FordMsg415BusHiSpdBrkSprtVldPassdThd.Val CalRegn01Cmn.FordMsg415BusHiSpdChksBrkModlInvldFaildThd.Val CalRegn01Cmn.FordMsg415BusHiSpdChksBrkModlInvldPassdThd.Val CalRegn01Cmn.FordMsg415BusHiSpdCntrBrkModlInvldFaildThd.Val CalRegn01Cmn.FordMsg415BusHiSpdCntrBrkModlInvldPassdThd.Val CalRegn01Cmn.FordMsg415BusHiSpdMissMsgFaildThd.Val CalRegn01Cmn.FordMsg415BusHiSpdMissMsgPassdThd.Val CalRegn01Cmn.FordMsg415BusHiSpdQlyFacBrkModlInvldFaildThd.Val CalRegn01Cmn.FordMsg415BusHiSpdQlyFacBrkModlInvldSigPassdThd.Val CalRegn01Cmn.FordMsg41ABusHiSpdMissMsgFaildThd.Val CalRegn01Cmn.FordMsg41ABusHiSpdMissMsgPassdThd.Val CalRegn01Cmn.FordMsg41EBusHiSpdChassisVldMissFaildThd.Val CalRegn01Cmn.FordMsg41EBusHiSpdChassisVldSigFaildThd.Val CalRegn01Cmn.FordMsg41EBusHiSpdChassisVldSigPassdThd.Val CalRegn01Cmn.FordMsg41EBusHiSpdInvldMsgFaildThd.Val CalRegn01Cmn.FordMsg41EBusHiSpdInvldMsgPassdThd.Val CalRegn01Cmn.FordMsg41EBusHiSpdMissMsgFaildThd.Val CalRegn01Cmn.FordMsg41EBusHiSpdMissMsgPassdThd.Val CalRegn01Cmn.FordMsg430BusHiSpdMissMsgFaildThd.Val CalRegn01Cmn.FordMsg430BusHiSpdMissMsgPassdThd.Val CalRegn01Cmn.FordMsg443BusHiSpdMissMsgFaildThd.Val CalRegn01Cmn.FordMsg443BusHiSpdMissMsgPassdThd.Val CalRegn01Cmn.FordMsg459BusHiSpdDiagMsgMissTmrThd.Val CalRegn01Cmn.FordMsg459BusHiSpdHitchAgInvldFaildThd.Val CalRegn01Cmn.FordMsg459BusHiSpdHitchAgInvldPassdThd.Val CalRegn01Cmn.FordMsg459BusHiSpdHitchAgRateInvldFaildThd.Val CalRegn01Cmn.FordMsg459BusHiSpdHitchAgRateInvldPassdThd.Val CalRegn01Cmn.FordMsg459BusHiSpdPrsntFlgMsgMissTmrThd.Val CalRegn01Cmn.FordMsg459BusHiSpdRcvrDiagMsgMissTmrThd.Val CalRegn01Cmn.FordMsg459BusHiSpdRcvrPrsntFlgTmrThd.Val CalRegn01Cmn.FordMsg459BusHiSpdTrackStInvldFaildThd.Val CalRegn01Cmn.FordMsg459BusHiSpdTrackStInvldPassdThd.Val CalRegn01Cmn.FordMsg459BusHiSpdTrlrHitchAgVldInvldMsgThd.Val CalRegn01Cmn.FordMsg459BusHiSpdTrlrHitchAgVldMissMsgThd.Val CalRegn01Cmn.FordMsg459BusHiSpdTrlrHitchRateVldInvldMsgThd.Val CalRegn01Cmn.FordMsg459BusHiSpdTrlrHitchRateVldMissMsgThd.Val CalRegn01Cmn.FordMsg459BusHiSpdTrlrRcvrHitchAgVldThd.Val CalRegn01Cmn.FordMsg459BusHiSpdTrlrRcvrHitchRateVldThd.Val CalRegn01Cmn.FordMsg459BusHiSpdTrlrRcvrTarVldThd.Val CalRegn01Cmn.FordMsg459BusHiSpdTrlrRcvrTrackStVldThd.Val CalRegn01Cmn.FordMsg459BusHiSpdTrlrTarVldMissMsgThd.Val CalRegn01Cmn.FordMsg459BusHiSpdTrlrTrackStVldInvldMsgThd.Val CalRegn01Cmn.FordMsg459BusHiSpdTrlrTrackStVldMissMsgThd.Val CalRegn01Cmn.FordMsg47ABusHiSpdMissMsgFaildTiThd.Val CalRegn01Cmn.FordMsg47ABusHiSpdMissMsgPassdTiThd.Val CalRegn01Cmn.FordMsg47ABusHiSpdTrlrAidKnobBtnFaildTiThd.Val CalRegn01Cmn.FordMsg47ABusHiSpdTrlrAidKnobBtnInvldPassdTiThd.Val CalRegn01Cmn.FordMsg47ABusHiSpdTrlrAidKnobBtnMissTiThd.Val CalRegn01Cmn.FordMsg47ABusHiSpdTrlrAidKnobBtnPassdTiThd.Val CalRegn01Cmn.FordMsg47ABusHiSpdTrlrAidKnobPosFaildTiThd.Val CalRegn01Cmn.FordMsg47ABusHiSpdTrlrAidKnobPosInvldPassdTiThd.Val CalRegn01Cmn.FordMsg47ABusHiSpdTrlrAidKnobPosMissTiThd.Val CalRegn01Cmn.FordMsg47ABusHiSpdTrlrAidKnobPosPassdTiThd.Val CalRegn01Cmn.FordMsg4B0BusHiSpdCanDtcInhbTiThd.Val CalRegn01Cmn.FordMsg4B0BusHiSpdMsgFltNtcDiagcTiThd.Val CalRegn01Cmn.FordMsg4B0BusHiSpdMsgFltTiThd.Val CalRegn01Cmn.FordMsg4B0BusHiSpdMsgMissNtcDiagcTiThd.Val CalRegn01Cmn.FordMsg4B0BusHiSpdMsgMissTiThd.Val CalRegn01Cmn.FordMsg4B0BusHiSpdMsgRxdNtcDiagcTiThd.Val CalRegn01Cmn.FordMsg4B0BusHiSpdMsgVldNtcDiagcTiThd.Val CalRegn01Cmn.FordMsg4B0BusHiSpdMsgVldTiThd.Val CalRegn01Cmn.GateDrv0CtrlErrFilFrq.Val CalRegn01Cmn.GateDrv0CtrlErrOffs.Val CalRegn01Cmn.GateDrv0CtrlErrThd.Val CalRegn01Cmn.GateDrv0CtrlNtcNr0x050FailStep.Val CalRegn01Cmn.GateDrv0CtrlNtcNr0x050PassStep.Val CalRegn01Cmn.GateDrv0CtrlNtcNr0x051FailStep.Val CalRegn01Cmn.GateDrv0CtrlNtcNr0x051PassStep.Val CalRegn01Cmn.GateDrv0CtrlNtcNr0x055FailStep.Val CalRegn01Cmn.GateDrv0CtrlNtcNr0x055PassStep.Val CalRegn01Cmn.GateDrv0CtrlUnit0Cfg2WrVal.Val CalRegn01Cmn.GateDrv0CtrlUnit0Cfg3WrVal.Val CalRegn01Cmn.GateDrv0CtrlUnit0Cfg4WrVal.Val CalRegn01Cmn.GateDrv0CtrlUnit0Cfg7WrVal.Val CalRegn01Cmn.GtmCfgAndUseAdcStrtOfCnvn2Offs.Val CalRegn01Cmn.GtmCfgAndUseAdcStrtOfCnvnPeakOffs.Val CalRegn01Cmn.GtmCfgAndUseDma2MilliSecToMotCtrlTrig.Val CalRegn01Cmn.GtmCfgAndUseDmaMotAgATrig.Val CalRegn01Cmn.GtmCfgAndUseDmaMotCtrlTo2MilliSecTrig.Val CalRegn01Cmn.GtmCfgAndUsePwmDbnd.Val CalRegn01Cmn.HwAgSnsrlsCorrdPinionAgConfThd.Val CalRegn01Cmn.HwAgSnsrlsCorrdPinionAgHwConf.Val CalRegn01Cmn.HwAgSnsrlsFCentrHwConf.Val CalRegn01Cmn.HwAgSnsrlsMotAgIdptSigThd.Val CalRegn01Cmn.HwAgSnsrlsPinionTqFilFrq.Val CalRegn01Cmn.HwAgSnsrlsRelHwAgFil1Frq.Val CalRegn01Cmn.HwAgSnsrlsRelHwAgFil2Frq.Val CalRegn01Cmn.HwAgSnsrlsSmotngCoeff.Val CalRegn01Cmn.HwAgSnsrlsSmotngStepThd.Val CalRegn01Cmn.HwAgSnsrlsStordPinionConf.Val CalRegn01Cmn.HwAgSnsrlsStordPinionConfThd.Val CalRegn01Cmn.HwAgSnsrlsVehDynDifThd.Val CalRegn01Cmn.HwAgSnsrlsVehDynHwConf.Val CalRegn01Cmn.HwAgSnsrlsVehDynMotVelThd.Val CalRegn01Cmn.HwAgSnsrlsVehDynPinionTqThd.Val CalRegn01Cmn.HwAgSnsrlsVehDynTmr1Thd.Val CalRegn01Cmn.HwAgSnsrlsVehDynTmr2Thd.Val CalRegn01Cmn.HwAgSnsrlsWhlFrqThd.Val CalRegn01Cmn.HwAgSnsrlsWhlSpdHwAgCoeff1.Val CalRegn01Cmn.HwAgSnsrlsWhlSpdHwAgCoeff2.Val CalRegn01Cmn.HwAgSnsrlsWhlSpdHwAgThd.Val CalRegn01Cmn.HwAgSnsrlsWhlSpdHwConf.Val CalRegn01Cmn.HwAgSnsrlsWhlSpdRatThd.Val CalRegn01Cmn.HwAgSnsrlsWhlSpdTmrThd.Val CalRegn01Cmn.HwAgSnsrlsWhlSpdVehSpdThd.Val CalRegn01Cmn.HwAgSysArbnHwAgConf1Snsr.Val CalRegn01Cmn.HwAgSysArbnHwAgConf1SnsrHwAgTrimNotPrfmd.Val CalRegn01Cmn.HwAgSysArbnHwAgConf2Snsr.Val CalRegn01Cmn.HwAgSysArbnHwAgConf2SnsrHwAgTrimNotPrfmd.Val CalRegn01Cmn.HwAgSysArbnHwAgConfNoSnsr.Val CalRegn01Cmn.HwAgSysArbnHwAgConfTiThd.Val CalRegn01Cmn.HwAgSysArbnHwAgCorrdCorrlnThd.Val CalRegn01Cmn.HwAgSysArbnHwAgCorrlnFailDebStep.Val CalRegn01Cmn.HwAgSysArbnHwAgCorrlnPassDebStep.Val CalRegn01Cmn.HwAgSysArbnHwAgCorrlnRng.Val CalRegn01Cmn.HwAgSysArbnHwAgIdptSigLim.Val CalRegn01Cmn.HwAgSysArbnHwAgSlewRate.Val CalRegn01Cmn.HwAgSysArbnHwAgSnsrlsCorrlnThd.Val CalRegn01Cmn.HwAgSysArbnHwAgSnsrlsKineThd.Val CalRegn01Cmn.HwAgSysArbnImcHwAgCorrlnRng.Val CalRegn01Cmn.HwAgSysArbnPinionAgConfThd.Val CalRegn01Cmn.HwAgSysArbnSerlComHwAgCorrdConf.Val CalRegn01Cmn.HwAgSysArbnSerlComHwAgSnsrlsConf.Val CalRegn01Cmn.HwAgSysArbnSlewRateTmr.Val CalRegn01Cmn.HwTqArbnHwTqMaxStallCnt.Val CalRegn01Cmn.HwTqCorrlnImdtCorrlnChkFailThd.Val CalRegn01Cmn.HwTqCorrlnNtcFailStep.Val CalRegn01Cmn.HwTqCorrlnNtcPassStep.Val CalRegn01Cmn.ImcArbnEcuIninTiOutThd.Val CalRegn01Cmn.ImcArbnFrmFltThd.Val CalRegn01Cmn.LoaMgrCurrIvtrMtgtnScaZeroEna.Logl CalRegn01Cmn.LoaMgrCurrMeasIdptSig0Resp.Val CalRegn01Cmn.LoaMgrCurrMeasIdptSig1Resp.Val CalRegn01Cmn.LoaMgrCurrMeasIdptSig2Resp.Val CalRegn01Cmn.LoaMgrCurrMeasIdptSigFltThd.Val CalRegn01Cmn.LoaMgrCurrMeasMtgtnScaZeroEna.Logl CalRegn01Cmn.LoaMgrFadeOutStRate.Val CalRegn01Cmn.LoaMgrHwTqIdptSig0NoTqLoaResp.Val CalRegn01Cmn.LoaMgrHwTqIdptSig1NoTqLoaResp.Val CalRegn01Cmn.LoaMgrHwTqIdptSig2Resp.Val CalRegn01Cmn.LoaMgrHwTqIdptSig3Resp.Val CalRegn01Cmn.LoaMgrHwTqIdptSig4Resp.Val CalRegn01Cmn.LoaMgrHwTqIdptSigFltThd.Val CalRegn01Cmn.LoaMgrHwTqLoaAvlResp.Val CalRegn01Cmn.LoaMgrIvtrIdptSig0Resp.Val CalRegn01Cmn.LoaMgrIvtrIdptSig1Resp.Val CalRegn01Cmn.LoaMgrIvtrIdptSig2Resp.Val CalRegn01Cmn.LoaMgrIvtrIdptSigFltThd.Val CalRegn01Cmn.LoaMgrIvtrMtgtnScaZeroEna.Logl CalRegn01Cmn.LoaMgrMotAgAvlSnsrlsResp.Val CalRegn01Cmn.LoaMgrMotAgIdptSig0NoSnsrlsResp.Val CalRegn01Cmn.LoaMgrMotAgIdptSig1NoSnsrlsResp.Val CalRegn01Cmn.LoaMgrMotAgIdptSig2Resp.Val CalRegn01Cmn.LoaMgrMotAgIdptSig3Resp.Val CalRegn01Cmn.LoaMgrMotAgIdptSigFltThd.Val CalRegn01Cmn.LoaMgrMotAgMtgtnScaZeroEna.Logl CalRegn01Cmn.MotAg2MeasOffs.Val CalRegn01Cmn.MotAg5MeasAmpSqdMaxThd.Val CalRegn01Cmn.MotAg5MeasAmpSqdMinThd.Val CalRegn01Cmn.MotAg5MeasLpFilFrq.Val CalRegn01Cmn.MotAg5MeasOffs.Val CalRegn01Cmn.MotAg5MeasRtAmpRecprLim.Val CalRegn01Cmn.MotAg5MeasRtFilEnaThd.Val CalRegn01Cmn.MotAg5MeasRtMotVelFilEnaThd.Val CalRegn01Cmn.MotAg5MeasRtOffsLim.Val CalRegn01Cmn.MotAg5MeasRtToNomRatLim.Val CalRegn01Cmn.MotAg6MeasAmpSqdMaxThd.Val CalRegn01Cmn.MotAg6MeasAmpSqdMinThd.Val CalRegn01Cmn.MotAg6MeasLpFilFrq.Val CalRegn01Cmn.MotAg6MeasOffs.Val CalRegn01Cmn.MotAg6MeasRtAmpRecprLim.Val CalRegn01Cmn.MotAg6MeasRtFilEnaThd.Val CalRegn01Cmn.MotAg6MeasRtMotVelFilEnaThd.Val CalRegn01Cmn.MotAg6MeasRtOffsLim.Val CalRegn01Cmn.MotAg6MeasRtToNomRatLim.Val CalRegn01Cmn.MotAgSwCalVehSpdThd.Val CalRegn01Cmn.MotCtrlPrmEstimnFetRNom.Val CalRegn01Cmn.MotCtrlPrmEstimnFetThermCoeff.Val CalRegn01Cmn.MotCtrlPrmEstimnMagThermCoeff.Val CalRegn01Cmn.MotCtrlPrmEstimnMotBackEmfConHiLim.Val CalRegn01Cmn.MotCtrlPrmEstimnMotBackEmfConLoLim.Val CalRegn01Cmn.MotCtrlPrmEstimnMotBackEmfConNom.Val CalRegn01Cmn.MotCtrlPrmEstimnMotBackEmfConSatnScaIvtrLoaMtgtn.Val CalRegn01Cmn.MotCtrlPrmEstimnMotBackEmfConSatnX.Ary1D CalRegn01Cmn.MotCtrlPrmEstimnMotBackEmfConSatnY.Ary1D CalRegn01Cmn.MotCtrlPrmEstimnMotCurrDaxInduSatnBilnrSeln.Ary1D CalRegn01Cmn.MotCtrlPrmEstimnMotCurrQaxInduSatnX.Ary1D CalRegn01Cmn.MotCtrlPrmEstimnMotInduDaxHiLim.Val CalRegn01Cmn.MotCtrlPrmEstimnMotInduDaxIvtrLoaMtgtn.Val CalRegn01Cmn.MotCtrlPrmEstimnMotInduDaxLoLim.Val CalRegn01Cmn.MotCtrlPrmEstimnMotInduDaxNom.Val CalRegn01Cmn.MotCtrlPrmEstimnMotInduDaxSatnScaY.Ary2D CalRegn01Cmn.MotCtrlPrmEstimnMotInduQaxHiLim.Val CalRegn01Cmn.MotCtrlPrmEstimnMotInduQaxIvtrLoaMtgtn.Val CalRegn01Cmn.MotCtrlPrmEstimnMotInduQaxLoLim.Val CalRegn01Cmn.MotCtrlPrmEstimnMotInduQaxNom.Val CalRegn01Cmn.MotCtrlPrmEstimnMotInduQaxSatnScaY.Ary2D CalRegn01Cmn.MotCtrlPrmEstimnMotRHiLim.Val CalRegn01Cmn.MotCtrlPrmEstimnMotRLoLim.Val CalRegn01Cmn.MotCtrlPrmEstimnMotRNom.Val CalRegn01Cmn.MotCtrlPrmEstimnMotWidgThermCoeff.Val CalRegn01Cmn.MotCtrlPrmEstimnTNom.Val CalRegn01Cmn.MotCurrPeakEstimnCurrFilFrq.Val CalRegn01Cmn.MotCurrPeakEstimnCurrPeakEstimdFilFrq.Val CalRegn01Cmn.MotCurrRegCfgCtrlrDynGainVehSpdCutOff.Val CalRegn01Cmn.MotCurrRegCfgCurrLoopSecOrderTrfFctEna.Logl CalRegn01Cmn.MotCurrRegCfgIntglGainSampleTi.Val CalRegn01Cmn.MotCurrRegCfgMotAgCompuDly.Val CalRegn01Cmn.MotCurrRegCfgMotClsdLoopBwDaxY.Ary1D CalRegn01Cmn.MotCurrRegCfgMotClsdLoopBwQaxY.Ary1D CalRegn01Cmn.MotCurrRegCfgMotCtrlPrmSelnX.Ary1D CalRegn01Cmn.MotCurrRegCfgMotDampgRatDax.Val CalRegn01Cmn.MotCurrRegCfgMotDampgRatQax.Val CalRegn01Cmn.MotCurrRegCfgMotNatFrqDaxY.Ary1D CalRegn01Cmn.MotCurrRegCfgMotNatFrqQaxY.Ary1D CalRegn01Cmn.MotCurrRegCfgMotRVirtDax.Val CalRegn01Cmn.MotCurrRegCfgMotRVirtQax.Val CalRegn01Cmn.MotCurrRegCfgMotVelFilFrq.Val CalRegn01Cmn.MotCurrRegVltgLimrCurrLoaScarSlewRate.Val CalRegn01Cmn.MotCurrRegVltgLimrDaxAntiWdupCoeff.Val CalRegn01Cmn.MotCurrRegVltgLimrDualEcuLoaScarSlewRate.Val CalRegn01Cmn.MotCurrRegVltgLimrFETLoaScarSlewRate.Val CalRegn01Cmn.MotCurrRegVltgLimrIvtrLoaScarSlewRate.Val CalRegn01Cmn.MotCurrRegVltgLimrMotCurrPredEna.Logl CalRegn01Cmn.MotCurrRegVltgLimrMotCurrPredTi.Val CalRegn01Cmn.MotCurrRegVltgLimrMotCurrQaxRefMdfnRplEna.Logl CalRegn01Cmn.MotCurrRegVltgLimrMotVltgBrdgFilEna.Logl CalRegn01Cmn.MotCurrRegVltgLimrMotVltgBrdgLpFilFrq.Val CalRegn01Cmn.MotCurrRegVltgLimrMotVltgDaxIntglHiLim.Val CalRegn01Cmn.MotCurrRegVltgLimrMotVltgDaxIntglLoLim.Val CalRegn01Cmn.MotCurrRegVltgLimrMotVltgQaxFfFilEna.Logl CalRegn01Cmn.MotCurrRegVltgLimrMotVltgQaxFfLpFilFrq.Val CalRegn01Cmn.MotCurrRegVltgLimrMotVltgQaxIntglHiLim.Val CalRegn01Cmn.MotCurrRegVltgLimrMotVltgQaxIntglLoLim.Val CalRegn01Cmn.MotCurrRegVltgLimrQaxAntiWdupCoeff.Val CalRegn01Cmn.MotCurrRegVltgLimrQaxAntiWdupScagDi.Logl CalRegn01Cmn.MotQuadDetnMotDirHysInsts.Val CalRegn01Cmn.MotRefMdlCurrDaxBoostGain.Val CalRegn01Cmn.MotRefMdlCurrDaxBoostTqScaX.Ary1D CalRegn01Cmn.MotRefMdlCurrDaxBoostTqScaY.Ary1D CalRegn01Cmn.MotRefMdlCurrDaxQaxRefDelta.Ary1D CalRegn01Cmn.MotRefMdlCurrItrnTolr.Val CalRegn01Cmn.MotRefMdlFbCtrlDi.Logl CalRegn01Cmn.MotRefMdlIvtrDeadTiBrdgVltgSca.Val CalRegn01Cmn.MotRefMdlMinCurrItrnLim.Val CalRegn01Cmn.MotRefMdlMotCurrDaxMaxSca.Val CalRegn01Cmn.MotRefMdlMotVelLpFilFrq.Val CalRegn01Cmn.MotRefMdlMotVltgDerivtvTiCon.Val CalRegn01Cmn.MotRefMdlQuad13VltgSdlX.Ary1D CalRegn01Cmn.MotRefMdlQuad13VltgSdlY.Ary1D CalRegn01Cmn.MotRefMdlQuad24VltgSdlX.Ary1D CalRegn01Cmn.MotRefMdlQuad24VltgSdlY.Ary1D CalRegn01Cmn.MotRefMdlRefLocnItrnLim.Val CalRegn01Cmn.MotRefMdlTqItrnLim.Val CalRegn01Cmn.MotRefMdlTqItrnTolr.Val CalRegn01Cmn.MotRefMdlVltgModDynCmpEna.Logl CalRegn01Cmn.MotRefMdlVltgOverRThdSca.Val CalRegn01Cmn.MotTqTranlDampgVehSpdBlndY.Ary1D CalRegn01Cmn.NxtrCalIdsCal0DevlpAuthor.Ary1D CalRegn01Cmn.NxtrCalIdsCal0DevlpDesc.Ary1D CalRegn01Cmn.NxtrCalIdsCal0DevlpRelNr.Val CalRegn01Cmn.NxtrCalIdsCal0DevlpRelSt.Val CalRegn01Cmn.NxtrCalIdsCal0DevlpTiStamp.Val CalRegn01Cmn.NxtrCalIdsCal0DevlpVers.Val CalRegn01Cmn.NxtrCalIdsCal2DevlpAuthor.Ary1D CalRegn01Cmn.NxtrCalIdsCal2DevlpDesc.Ary1D CalRegn01Cmn.NxtrCalIdsCal2DevlpRelNr.Val CalRegn01Cmn.NxtrCalIdsCal2DevlpRelSt.Val CalRegn01Cmn.NxtrCalIdsCal2DevlpTiStamp.Val CalRegn01Cmn.NxtrCalIdsCal2DevlpVers.Val CalRegn01Cmn.PwrLimrAssiRednLpFilFrq.Val CalRegn01Cmn.PwrLimrBackEmfConStdT.Val CalRegn01Cmn.PwrLimrBrdgVltgAdjSlew.Val CalRegn01Cmn.PwrLimrBrdgVltgAltFltAdj.Val CalRegn01Cmn.PwrLimrFilAssiRednThd.Val CalRegn01Cmn.PwrLimrLoVoltAssiRcvrThd.Val CalRegn01Cmn.PwrLimrLoVoltAssiRcvrTi.Val CalRegn01Cmn.PwrLimrMotEnvlpX.Ary1D CalRegn01Cmn.PwrLimrMotEnvlpY.Ary1D CalRegn01Cmn.PwrLimrMotVelLpFilFrq.Val CalRegn01Cmn.PwrLimrSpdAdjSlewDec.Val CalRegn01Cmn.PwrLimrSpdAdjSlewEna.Logl CalRegn01Cmn.PwrLimrSpdAdjSlewInc.Val CalRegn01Cmn.PwrLimrStdOperMotEnvlpX.Ary1D CalRegn01Cmn.PwrLimrStdOperMotEnvlpY.Ary1D CalRegn01Cmn.PwrLimrVltgDptMotVelOffsX.Ary1D CalRegn01Cmn.PwrLimrVltgDptMotVelOffsY.Ary1D CalRegn01Cmn.PwrSplyNtc0x07BFailStep.Val CalRegn01Cmn.PwrSplyNtc0x07BPassStep.Val CalRegn01Cmn.PwrSplyNtc0x07CFailStep.Val CalRegn01Cmn.PwrSplyNtc0x07CPassStep.Val CalRegn01Cmn.PwrSplyNtc0x07DFailStep.Val CalRegn01Cmn.PwrSplyNtc0x07DPassStep.Val CalRegn01Cmn.SinVltgGennDthrEna.Logl CalRegn01Cmn.SinVltgGennDthrLpFilCoeff.Val CalRegn01Cmn.SysPrfmncStsAbsltCtrlTFltThd.Val CalRegn01Cmn.SysPrfmncStsAssiStallLimDecThd.Val CalRegn01Cmn.SysPrfmncStsBattDiagcHiCrit.Val CalRegn01Cmn.SysPrfmncStsBattDiagcHiWarn.Val CalRegn01Cmn.SysPrfmncStsBattDiagcLoCrit.Val CalRegn01Cmn.SysPrfmncStsBattDiagcLoWarn.Val CalRegn01Cmn.SysPrfmncStsBattVltgFilFrq.Val CalRegn01Cmn.SysPrfmncStsDutyCycLvlFltThd.Val CalRegn01Cmn.SysPrfmncStsLoadDptLimDecThd.Val CalRegn01Cmn.SysPrfmncStsTDptLimThd.Val CalRegn01Cmn.TEstimnIgnOffCtrlEna.Logl CalRegn01Cmn.TEstimnIgnOffMsgWaitTi.Val CalRegn01Cmn.TqLoaDrvrTqNom.Val CalRegn01Cmn.TqLoaMotTqCmdLim.Val CalRegn01Cmn.TqLoaMotVelAndTqBasdScaFacFallRate.Val CalRegn01Cmn.TqLoaMotVelAndTqBasdScaFacMax.Val CalRegn01Cmn.TqLoaMotVelAndTqBasdScaFacMin.Val CalRegn01Cmn.TqLoaMotVelAndTqBasdScaFacRiseRate.Val CalRegn01Cmn.TqLoaMotVelMgnThd.Val CalRegn01Cmn.TqLoaTqCmdLimY.Ary1D CalRegn01Cmn.TqLoaTqCmdMgnThd.Val CalRegn01Cmn.TqLoaVehLatADifScaFacFallRate.Val CalRegn01Cmn.TqLoaVehLatADifScaFacRiseRate.Val CalRegn01Cmn.TqLoaVehLatADifScaFacX.Ary1D CalRegn01Cmn.TqLoaVehLatADifScaFacY.Ary2D CalRegn01Cmn.TqLoaVehLatAEstimnFilFrq.Val CalRegn01Cmn.TqLoaVehLatAGainY.Ary1D CalRegn01Cmn.TqLoaVehSpdScaFacX.Ary1D CalRegn01Cmn.TqLoaVehSpdScaFacY.Ary1D CalRegn01Cmn.TqLoaVehSpdX.Ary1D CalRegn01Cmn.TqLoaVehSteerRat.Val CalRegn01Cmn.TqLoaVehUnderSteerGrdt.Val CalRegn01Cmn.TqLoaVehWhlBas.Val CalRegn01Cmn.VehSigCdngDftLatA.Val CalRegn01Cmn.VehSigCdngDftLgtA.Val CalRegn01Cmn.VehSigCdngDftVehSpd.Val CalRegn01Cmn.VehSigCdngDftYawRate.Val CalRegn01Cmn.VehSigCdngLatADifThd.Val CalRegn01Cmn.VehSigCdngLatAFilFrq.Val CalRegn01Cmn.VehSigCdngLtgADifThd.Val CalRegn01Cmn.VehSigCdngVehSpdDifThd.Val CalRegn01Cmn.VehSigCdngVehYawSlewRate.Val CalRegn01Cmn.VehSigCdngYawRateDifThd.Val CalRegn01Cmn.VehSpdLimrMaxAssiX.Ary1D CalRegn01Cmn.VehSpdLimrMaxAssiY.Ary1D CalRegn01Cmn.VehSpdLimrPosMaxOffs1.Val CalRegn01Cmn.VehSpdLimrPosMaxOffs2.Val /end SUB_GROUP
 /begin FUNCTION_LIST /end FUNCTION_LIST
 /begin REF_CHARACTERISTIC /end REF_CHARACTERISTIC
 /begin REF_MEASUREMENT /end REF_MEASUREMENT
/end GROUP
/begin GROUP CalRegn01Cmn.CmnMfgSrvSecuAcsAtmptTiOut.Val "MICROSAR RTE" /begin SUB_GROUP /end SUB_GROUP /begin FUNCTION_LIST /end FUNCTION_LIST /begin REF_CHARACTERISTIC CalRegn01Cmn.CmnMfgSrvSecuAcsAtmptTiOut.Val /end REF_CHARACTERISTIC /begin REF_MEASUREMENT /end REF_MEASUREMENT /end GROUP
/begin GROUP CalRegn01Cmn.CmnMfgSrvSecuAcsMaxNrAtmpt.Val "MICROSAR RTE" /begin SUB_GROUP /end SUB_GROUP /begin FUNCTION_LIST /end FUNCTION_LIST /begin REF_CHARACTERISTIC CalRegn01Cmn.CmnMfgSrvSecuAcsMaxNrAtmpt.Val /end REF_CHARACTERISTIC /begin REF_MEASUREMENT /end REF_MEASUREMENT /end GROUP
/begin GROUP CalRegn01Cmn.CurrMeasArbnMaxStallCntr.Val "MICROSAR RTE" /begin SUB_GROUP /end SUB_GROUP /begin FUNCTION_LIST /end FUNCTION_LIST /begin REF_CHARACTERISTIC CalRegn01Cmn.CurrMeasArbnMaxStallCntr.Val /end REF_CHARACTERISTIC /begin REF_MEASUREMENT /end REF_MEASUREMENT /end GROUP
/begin GROUP CalRegn01Cmn.CurrMeasCorrlnMaxErrCurr.Val "MICROSAR RTE" /begin SUB_GROUP /end SUB_GROUP /begin FUNCTION_LIST /end FUNCTION_LIST /begin REF_CHARACTERISTIC CalRegn01Cmn.CurrMeasCorrlnMaxErrCurr.Val /end REF_CHARACTERISTIC /begin REF_MEASUREMENT /end REF_MEASUREMENT /end GROUP
/begin GROUP CalRegn01Cmn.CurrMeasCorrlnMaxStallCntr.Val "MICROSAR RTE" /begin SUB_GROUP /end SUB_GROUP /begin FUNCTION_LIST /end FUNCTION_LIST /begin REF_CHARACTERISTIC CalRegn01Cmn.CurrMeasCorrlnMaxStallCntr.Val /end REF_CHARACTERISTIC /begin REF_MEASUREMENT /end REF_MEASUREMENT /end GROUP
/begin GROUP CalRegn01Cmn.CurrMeasCorrlnNtc0x04DFailStep.Val "MICROSAR RTE" /begin SUB_GROUP /end SUB_GROUP /begin FUNCTION_LIST /end FUNCTION_LIST /begin REF_CHARACTERISTIC CalRegn01Cmn.CurrMeasCorrlnNtc0x04DFailStep.Val /end REF_CHARACTERISTIC /begin REF_MEASUREMENT /end REF_MEASUREMENT /end GROUP
/begin GROUP CalRegn01Cmn.CurrMeasCorrlnNtc0x04DPassStep.Val "MICROSAR RTE" /begin SUB_GROUP /end SUB_GROUP /begin FUNCTION_LIST /end FUNCTION_LIST /begin REF_CHARACTERISTIC CalRegn01Cmn.CurrMeasCorrlnNtc0x04DPassStep.Val /end REF_CHARACTERISTIC /begin REF_MEASUREMENT /end REF_MEASUREMENT /end GROUP
/begin GROUP CalRegn01Cmn.CurrMeasEolFixdPwmPerd.Val "MICROSAR RTE" /begin SUB_GROUP /end SUB_GROUP /begin FUNCTION_LIST /end FUNCTION_LIST /begin REF_CHARACTERISTIC CalRegn01Cmn.CurrMeasEolFixdPwmPerd.Val /end REF_CHARACTERISTIC /begin REF_MEASUREMENT /end REF_MEASUREMENT /end GROUP
/begin GROUP CalRegn01Cmn.CurrMeasEolGainMax.Val "MICROSAR RTE" /begin SUB_GROUP /end SUB_GROUP /begin FUNCTION_LIST /end FUNCTION_LIST /begin REF_CHARACTERISTIC CalRegn01Cmn.CurrMeasEolGainMax.Val /end REF_CHARACTERISTIC /begin REF_MEASUREMENT /end REF_MEASUREMENT /end GROUP
/begin GROUP CalRegn01Cmn.CurrMeasEolGainMin.Val "MICROSAR RTE" /begin SUB_GROUP /end SUB_GROUP /begin FUNCTION_LIST /end FUNCTION_LIST /begin REF_CHARACTERISTIC CalRegn01Cmn.CurrMeasEolGainMin.Val /end REF_CHARACTERISTIC /begin REF_MEASUREMENT /end REF_MEASUREMENT /end GROUP
/begin GROUP CalRegn01Cmn.CurrMeasEolGainNom.Val "MICROSAR RTE" /begin SUB_GROUP /end SUB_GROUP /begin FUNCTION_LIST /end FUNCTION_LIST /begin REF_CHARACTERISTIC CalRegn01Cmn.CurrMeasEolGainNom.Val /end REF_CHARACTERISTIC /begin REF_MEASUREMENT /end REF_MEASUREMENT /end GROUP
/begin GROUP CalRegn01Cmn.CurrMeasEolGainNrOfSample.Val "MICROSAR RTE" /begin SUB_GROUP /end SUB_GROUP /begin FUNCTION_LIST /end FUNCTION_LIST /begin REF_CHARACTERISTIC CalRegn01Cmn.CurrMeasEolGainNrOfSample.Val /end REF_CHARACTERISTIC /begin REF_MEASUREMENT /end REF_MEASUREMENT /end GROUP
/begin GROUP CalRegn01Cmn.CurrMeasEolGainNumer.Val "MICROSAR RTE" /begin SUB_GROUP /end SUB_GROUP /begin FUNCTION_LIST /end FUNCTION_LIST /begin REF_CHARACTERISTIC CalRegn01Cmn.CurrMeasEolGainNumer.Val /end REF_CHARACTERISTIC /begin REF_MEASUREMENT /end REF_MEASUREMENT /end GROUP
/begin GROUP CalRegn01Cmn.CurrMeasEolMaxMotVel.Val "MICROSAR RTE" /begin SUB_GROUP /end SUB_GROUP /begin FUNCTION_LIST /end FUNCTION_LIST /begin REF_CHARACTERISTIC CalRegn01Cmn.CurrMeasEolMaxMotVel.Val /end REF_CHARACTERISTIC /begin REF_MEASUREMENT /end REF_MEASUREMENT /end GROUP
/begin GROUP CalRegn01Cmn.CurrMeasEolOffsHiBrdgVltgMin.Val "MICROSAR RTE" /begin SUB_GROUP /end SUB_GROUP /begin FUNCTION_LIST /end FUNCTION_LIST /begin REF_CHARACTERISTIC CalRegn01Cmn.CurrMeasEolOffsHiBrdgVltgMin.Val /end REF_CHARACTERISTIC /begin REF_MEASUREMENT /end REF_MEASUREMENT /end GROUP
/begin GROUP CalRegn01Cmn.CurrMeasEolOffsHiCmuOffs.Val "MICROSAR RTE" /begin SUB_GROUP /end SUB_GROUP /begin FUNCTION_LIST /end FUNCTION_LIST /begin REF_CHARACTERISTIC CalRegn01Cmn.CurrMeasEolOffsHiCmuOffs.Val /end REF_CHARACTERISTIC /begin REF_MEASUREMENT /end REF_MEASUREMENT /end GROUP
/begin GROUP CalRegn01Cmn.CurrMeasEolOffsLoCmuOffs.Val "MICROSAR RTE" /begin SUB_GROUP /end SUB_GROUP /begin FUNCTION_LIST /end FUNCTION_LIST /begin REF_CHARACTERISTIC CalRegn01Cmn.CurrMeasEolOffsLoCmuOffs.Val /end REF_CHARACTERISTIC /begin REF_MEASUREMENT /end REF_MEASUREMENT /end GROUP
/begin GROUP CalRegn01Cmn.CurrMeasEolOffsMax.Val "MICROSAR RTE" /begin SUB_GROUP /end SUB_GROUP /begin FUNCTION_LIST /end FUNCTION_LIST /begin REF_CHARACTERISTIC CalRegn01Cmn.CurrMeasEolOffsMax.Val /end REF_CHARACTERISTIC /begin REF_MEASUREMENT /end REF_MEASUREMENT /end GROUP
/begin GROUP CalRegn01Cmn.CurrMeasEolOffsMin.Val "MICROSAR RTE" /begin SUB_GROUP /end SUB_GROUP /begin FUNCTION_LIST /end FUNCTION_LIST /begin REF_CHARACTERISTIC CalRegn01Cmn.CurrMeasEolOffsMin.Val /end REF_CHARACTERISTIC /begin REF_MEASUREMENT /end REF_MEASUREMENT /end GROUP
/begin GROUP CalRegn01Cmn.CurrMeasEolOffsNom.Val "MICROSAR RTE" /begin SUB_GROUP /end SUB_GROUP /begin FUNCTION_LIST /end FUNCTION_LIST /begin REF_CHARACTERISTIC CalRegn01Cmn.CurrMeasEolOffsNom.Val /end REF_CHARACTERISTIC /begin REF_MEASUREMENT /end REF_MEASUREMENT /end GROUP
/begin GROUP CalRegn01Cmn.CurrMeasEolOffsNrOfSample.Val "MICROSAR RTE" /begin SUB_GROUP /end SUB_GROUP /begin FUNCTION_LIST /end FUNCTION_LIST /begin REF_CHARACTERISTIC CalRegn01Cmn.CurrMeasEolOffsNrOfSample.Val /end REF_CHARACTERISTIC /begin REF_MEASUREMENT /end REF_MEASUREMENT /end GROUP
/begin GROUP CalRegn01Cmn.CurrMeasEolTranCntrThd.Val "MICROSAR RTE" /begin SUB_GROUP /end SUB_GROUP /begin FUNCTION_LIST /end FUNCTION_LIST /begin REF_CHARACTERISTIC CalRegn01Cmn.CurrMeasEolTranCntrThd.Val /end REF_CHARACTERISTIC /begin REF_MEASUREMENT /end REF_MEASUREMENT /end GROUP
/begin GROUP CalRegn01Cmn.CurrMeasMinRqrdPhaOnTi.Val "MICROSAR RTE" /begin SUB_GROUP /end SUB_GROUP /begin FUNCTION_LIST /end FUNCTION_LIST /begin REF_CHARACTERISTIC CalRegn01Cmn.CurrMeasMinRqrdPhaOnTi.Val /end REF_CHARACTERISTIC /begin REF_MEASUREMENT /end REF_MEASUREMENT /end GROUP
/begin GROUP CalRegn01Cmn.CurrMeasMotAgCompuDly.Val "MICROSAR RTE" /begin SUB_GROUP /end SUB_GROUP /begin FUNCTION_LIST /end FUNCTION_LIST /begin REF_CHARACTERISTIC CalRegn01Cmn.CurrMeasMotAgCompuDly.Val /end REF_CHARACTERISTIC /begin REF_MEASUREMENT /end REF_MEASUREMENT /end GROUP
/begin GROUP CalRegn01Cmn.CurrMeasMotCurrAdcVlyWrmIninMax.Val "MICROSAR RTE" /begin SUB_GROUP /end SUB_GROUP /begin FUNCTION_LIST /end FUNCTION_LIST /begin REF_CHARACTERISTIC CalRegn01Cmn.CurrMeasMotCurrAdcVlyWrmIninMax.Val /end REF_CHARACTERISTIC /begin REF_MEASUREMENT /end REF_MEASUREMENT /end GROUP
/begin GROUP CalRegn01Cmn.CurrMeasMotCurrAdcVlyWrmIninMin.Val "MICROSAR RTE" /begin SUB_GROUP /end SUB_GROUP /begin FUNCTION_LIST /end FUNCTION_LIST /begin REF_CHARACTERISTIC CalRegn01Cmn.CurrMeasMotCurrAdcVlyWrmIninMin.Val /end REF_CHARACTERISTIC /begin REF_MEASUREMENT /end REF_MEASUREMENT /end GROUP
/begin GROUP CalRegn01Cmn.CurrMeasNtc0x05DFailStep.Val "MICROSAR RTE" /begin SUB_GROUP /end SUB_GROUP /begin FUNCTION_LIST /end FUNCTION_LIST /begin REF_CHARACTERISTIC CalRegn01Cmn.CurrMeasNtc0x05DFailStep.Val /end REF_CHARACTERISTIC /begin REF_MEASUREMENT /end REF_MEASUREMENT /end GROUP
/begin GROUP CalRegn01Cmn.CurrMeasNtc0x05DPassStep.Val "MICROSAR RTE" /begin SUB_GROUP /end SUB_GROUP /begin FUNCTION_LIST /end FUNCTION_LIST /begin REF_CHARACTERISTIC CalRegn01Cmn.CurrMeasNtc0x05DPassStep.Val /end REF_CHARACTERISTIC /begin REF_MEASUREMENT /end REF_MEASUREMENT /end GROUP
/begin GROUP CalRegn01Cmn.DiagcMgrFltResp.Ary1D "MICROSAR RTE" /begin SUB_GROUP /end SUB_GROUP /begin FUNCTION_LIST /end FUNCTION_LIST /begin REF_CHARACTERISTIC CalRegn01Cmn.DiagcMgrFltResp.Ary1D /end REF_CHARACTERISTIC /begin REF_MEASUREMENT /end REF_MEASUREMENT /end GROUP
/begin GROUP CalRegn01Cmn.DrvrTqEstimnMtrxA.Ary2D "MICROSAR RTE" /begin SUB_GROUP /end SUB_GROUP /begin FUNCTION_LIST /end FUNCTION_LIST /begin REF_CHARACTERISTIC CalRegn01Cmn.DrvrTqEstimnMtrxA.Ary2D /end REF_CHARACTERISTIC /begin REF_MEASUREMENT /end REF_MEASUREMENT /end GROUP
/begin GROUP CalRegn01Cmn.DrvrTqEstimnMtrxB.Ary2D "MICROSAR RTE" /begin SUB_GROUP /end SUB_GROUP /begin FUNCTION_LIST /end FUNCTION_LIST /begin REF_CHARACTERISTIC CalRegn01Cmn.DrvrTqEstimnMtrxB.Ary2D /end REF_CHARACTERISTIC /begin REF_MEASUREMENT /end REF_MEASUREMENT /end GROUP
/begin GROUP CalRegn01Cmn.DrvrTqEstimnMtrxC.Ary1D "MICROSAR RTE" /begin SUB_GROUP /end SUB_GROUP /begin FUNCTION_LIST /end FUNCTION_LIST /begin REF_CHARACTERISTIC CalRegn01Cmn.DrvrTqEstimnMtrxC.Ary1D /end REF_CHARACTERISTIC /begin REF_MEASUREMENT /end REF_MEASUREMENT /end GROUP
/begin GROUP CalRegn01Cmn.DrvrTqEstimnMtrxD.Ary1D "MICROSAR RTE" /begin SUB_GROUP /end SUB_GROUP /begin FUNCTION_LIST /end FUNCTION_LIST /begin REF_CHARACTERISTIC CalRegn01Cmn.DrvrTqEstimnMtrxD.Ary1D /end REF_CHARACTERISTIC /begin REF_MEASUREMENT /end REF_MEASUREMENT /end GROUP
/begin GROUP CalRegn01Cmn.DutyCycThermProtnAbsltCtrlTFetMtgtnTblX.Ary1D "MICROSAR RTE" /begin SUB_GROUP /end SUB_GROUP /begin FUNCTION_LIST /end FUNCTION_LIST /begin REF_CHARACTERISTIC CalRegn01Cmn.DutyCycThermProtnAbsltCtrlTFetMtgtnTblX.Ary1D /end REF_CHARACTERISTIC /begin REF_MEASUREMENT /end REF_MEASUREMENT /end GROUP
/begin GROUP CalRegn01Cmn.DutyCycThermProtnAbsltCtrlTTblX.Ary1D "MICROSAR RTE" /begin SUB_GROUP /end SUB_GROUP /begin FUNCTION_LIST /end FUNCTION_LIST /begin REF_CHARACTERISTIC CalRegn01Cmn.DutyCycThermProtnAbsltCtrlTTblX.Ary1D /end REF_CHARACTERISTIC /begin REF_MEASUREMENT /end REF_MEASUREMENT /end GROUP
/begin GROUP CalRegn01Cmn.DutyCycThermProtnAbsltCtrlTTqFetMtgtnTblY.Ary1D "MICROSAR RTE" /begin SUB_GROUP /end SUB_GROUP /begin FUNCTION_LIST /end FUNCTION_LIST
 /begin REF_CHARACTERISTIC CalRegn01Cmn.DutyCycThermProtnAbsltCtrlTTqFetMtgtnTblY.Ary1D /end REF_CHARACTERISTIC
 /begin REF_MEASUREMENT /end REF_MEASUREMENT
/end GROUP
/begin GROUP CalRegn01Cmn.DutyCycThermProtnAbsltCtrlTTqTblY.Ary1D "MICROSAR RTE" /begin SUB_GROUP /end SUB_GROUP /begin FUNCTION_LIST /end FUNCTION_LIST /begin REF_CHARACTERISTIC CalRegn01Cmn.DutyCycThermProtnAbsltCtrlTTqTblY.Ary1D /end REF_CHARACTERISTIC /begin REF_MEASUREMENT /end REF_MEASUREMENT /end GROUP
/begin GROUP CalRegn01Cmn.DutyCycThermProtnAbsltCuTFetMtgtnTblX.Ary1D "MICROSAR RTE" /begin SUB_GROUP /end SUB_GROUP /begin FUNCTION_LIST /end FUNCTION_LIST /begin REF_CHARACTERISTIC CalRegn01Cmn.DutyCycThermProtnAbsltCuTFetMtgtnTblX.Ary1D /end REF_CHARACTERISTIC /begin REF_MEASUREMENT /end REF_MEASUREMENT /end GROUP
/begin GROUP CalRegn01Cmn.DutyCycThermProtnAbsltCuTTblX.Ary1D "MICROSAR RTE" /begin SUB_GROUP /end SUB_GROUP /begin FUNCTION_LIST /end FUNCTION_LIST /begin REF_CHARACTERISTIC CalRegn01Cmn.DutyCycThermProtnAbsltCuTTblX.Ary1D /end REF_CHARACTERISTIC /begin REF_MEASUREMENT /end REF_MEASUREMENT /end GROUP
/begin GROUP CalRegn01Cmn.DutyCycThermProtnAbsltCuTTqFetMtgtnTblY.Ary1D "MICROSAR RTE" /begin SUB_GROUP /end SUB_GROUP /begin FUNCTION_LIST /end FUNCTION_LIST /begin REF_CHARACTERISTIC CalRegn01Cmn.DutyCycThermProtnAbsltCuTTqFetMtgtnTblY.Ary1D /end REF_CHARACTERISTIC /begin REF_MEASUREMENT /end REF_MEASUREMENT /end GROUP
/begin GROUP CalRegn01Cmn.DutyCycThermProtnAbsltCuTTqTblY.Ary1D "MICROSAR RTE" /begin SUB_GROUP /end SUB_GROUP /begin FUNCTION_LIST /end FUNCTION_LIST /begin REF_CHARACTERISTIC CalRegn01Cmn.DutyCycThermProtnAbsltCuTTqTblY.Ary1D /end REF_CHARACTERISTIC /begin REF_MEASUREMENT /end REF_MEASUREMENT /end GROUP
/begin GROUP CalRegn01Cmn.DutyCycThermProtnAbsltMotVelBreakPt.Val "MICROSAR RTE" /begin SUB_GROUP /end SUB_GROUP /begin FUNCTION_LIST /end FUNCTION_LIST /begin REF_CHARACTERISTIC CalRegn01Cmn.DutyCycThermProtnAbsltMotVelBreakPt.Val /end REF_CHARACTERISTIC /begin REF_MEASUREMENT /end REF_MEASUREMENT /end GROUP
/begin GROUP CalRegn01Cmn.DutyCycThermProtnAbsltTTqSlewHiLim.Val "MICROSAR RTE" /begin SUB_GROUP /end SUB_GROUP /begin FUNCTION_LIST /end FUNCTION_LIST /begin REF_CHARACTERISTIC CalRegn01Cmn.DutyCycThermProtnAbsltTTqSlewHiLim.Val /end REF_CHARACTERISTIC /begin REF_MEASUREMENT /end REF_MEASUREMENT /end GROUP
/begin GROUP CalRegn01Cmn.DutyCycThermProtnAbsltTTqSlewLoLim.Val "MICROSAR RTE" /begin SUB_GROUP /end SUB_GROUP /begin FUNCTION_LIST /end FUNCTION_LIST /begin REF_CHARACTERISTIC CalRegn01Cmn.DutyCycThermProtnAbsltTTqSlewLoLim.Val /end REF_CHARACTERISTIC /begin REF_MEASUREMENT /end REF_MEASUREMENT /end GROUP
/begin GROUP CalRegn01Cmn.DutyCycThermProtnCtrlT.Val "MICROSAR RTE" /begin SUB_GROUP /end SUB_GROUP /begin FUNCTION_LIST /end FUNCTION_LIST /begin REF_CHARACTERISTIC CalRegn01Cmn.DutyCycThermProtnCtrlT.Val /end REF_CHARACTERISTIC /begin REF_MEASUREMENT /end REF_MEASUREMENT /end GROUP
/begin GROUP CalRegn01Cmn.DutyCycThermProtnCtrlTSeln.Logl "MICROSAR RTE" /begin SUB_GROUP /end SUB_GROUP /begin FUNCTION_LIST /end FUNCTION_LIST /begin REF_CHARACTERISTIC CalRegn01Cmn.DutyCycThermProtnCtrlTSeln.Logl /end REF_CHARACTERISTIC /begin REF_MEASUREMENT /end REF_MEASUREMENT /end GROUP
/begin GROUP CalRegn01Cmn.DutyCycThermProtnDutyCycFildThd.Val "MICROSAR RTE" /begin SUB_GROUP /end SUB_GROUP /begin FUNCTION_LIST /end FUNCTION_LIST /begin REF_CHARACTERISTIC CalRegn01Cmn.DutyCycThermProtnDutyCycFildThd.Val /end REF_CHARACTERISTIC /begin REF_MEASUREMENT /end REF_MEASUREMENT /end GROUP
/begin GROUP CalRegn01Cmn.DutyCycThermProtnIgnOffCtrlEna.Logl "MICROSAR RTE" /begin SUB_GROUP /end SUB_GROUP /begin FUNCTION_LIST /end FUNCTION_LIST /begin REF_CHARACTERISTIC CalRegn01Cmn.DutyCycThermProtnIgnOffCtrlEna.Logl /end REF_CHARACTERISTIC /begin REF_MEASUREMENT /end REF_MEASUREMENT /end GROUP
/begin GROUP CalRegn01Cmn.DutyCycThermProtnIgnOffMsgWaitTi.Val "MICROSAR RTE" /begin SUB_GROUP /end SUB_GROUP /begin FUNCTION_LIST /end FUNCTION_LIST /begin REF_CHARACTERISTIC CalRegn01Cmn.DutyCycThermProtnIgnOffMsgWaitTi.Val /end REF_CHARACTERISTIC /begin REF_MEASUREMENT /end REF_MEASUREMENT /end GROUP
/**********************************************************************************************************************
* RECORD_LAYOUT
*********************************************************************************************************************/
/begin RECORD_LAYOUT RTE_RL_UBYTE FNC_VALUES 1 UBYTE ROW_DIR DIRECT /end RECORD_LAYOUT
/begin RECORD_LAYOUT RTE_RL_UWORD FNC_VALUES 1 UWORD ROW_DIR DIRECT /end RECORD_LAYOUT
/begin RECORD_LAYOUT RTE_RL_ULONG FNC_VALUES 1 ULONG ROW_DIR DIRECT /end RECORD_LAYOUT
/begin RECORD_LAYOUT RTE_RL_SWORD FNC_VALUES 1 SWORD ROW_DIR DIRECT /end RECORD_LAYOUT
/begin RECORD_LAYOUT RTE_RL_FLOAT32_IEEE FNC_VALUES 1 FLOAT32_IEEE ROW_DIR DIRECT /end RECORD_LAYOUT
/begin RECORD_LAYOUT RTE_RL_BOOLEAN FNC_VALUES 1 UBYTE ROW_DIR DIRECT /end RECORD_LAYOUT
/**********************************************************************************************************************
* COMPU_METHOD / COMPU_VTAB_RANGE
*********************************************************************************************************************/
/begin COMPU_METHOD RTE_CM_BOOLEAN "" TAB_VERB "%3.1" "" COMPU_TAB_REF RTE_CM_BOOLEAN /end COMPU_METHOD
/begin COMPU_VTAB_RANGE RTE_CM_BOOLEAN "" 2 0 0 "false" 1 255 "true" /end COMPU_VTAB_RANGE
/begin COMPU_METHOD RTE_CM_ENUM_NtcSts1 "" TAB_VERB "%.1" "" COMPU_TAB_REF RTE_CM_ENUM_NtcSts1 /end COMPU_METHOD
/begin COMPU_VTAB_RANGE RTE_CM_ENUM_NtcSts1 "" 4 0 0 "NTCSTS_PASSD" 1 1 "NTCSTS_FAILD" 2 2 "NTCSTS_PREPASSD" 3 3 "NTCSTS_PREFAILD" /end COMPU_VTAB_RANGE
/begin COMPU_METHOD RTE_CM_ENUM_CrcHwSts1 "" TAB_VERB "%.1" "" COMPU_TAB_REF RTE_CM_ENUM_CrcHwSts1 /end COMPU_METHOD
/begin COMPU_VTAB_RANGE RTE_CM_ENUM_CrcHwSts1 "" 6 0 0 "CRCHWSTS_NOTAVL" 1 1 "CRCHWSTS_AVL" 2 2 "CRCHWSTS_BUSY" 3 3 "CRCHWSTS_NOTENAD" 4 4 "CRCHWSTS_RESV" 255 255 "CRCHWSTS_IDXINVLD" /end COMPU_VTAB_RANGE
