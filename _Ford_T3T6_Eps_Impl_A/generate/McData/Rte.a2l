/begin CHARACTERISTIC PwrSply.PwrSplyNtc0x07BFailStep.Val "MICROSAR RTE" VALUE 0x0 RTE_RL_UWORD 0 NO_COMPU_METHOD 0 65535 SYMBOL_LINK "Rte_CalprmRom_CalRegn01Cmn_DEFAULT_RTE_CALPRM_GROUP.PwrSplyNtc0x07BFailStep_Val" 0 DISPLAY_IDENTIFIER PwrSply.CalibrationPorts.PwrSplyNtc0x07BFailStep.Val /end CHARACTERISTIC
/begin CHARACTERISTIC PwrSply.PwrSplyNtc0x07BPassStep.Val "MICROSAR RTE" VALUE 0x0 RTE_RL_UWORD 0 NO_COMPU_METHOD 0 65535 SYMBOL_LINK "Rte_CalprmRom_CalRegn01Cmn_DEFAULT_RTE_CALPRM_GROUP.PwrSplyNtc0x07BPassStep_Val" 0 DISPLAY_IDENTIFIER PwrSply.CalibrationPorts.PwrSplyNtc0x07BPassStep.Val /end CHARACTERISTIC
/begin CHARACTERISTIC PwrSply.PwrSplyNtc0x07CFailStep.Val "MICROSAR RTE" VALUE 0x0 RTE_RL_UWORD 0 NO_COMPU_METHOD 0 65535 SYMBOL_LINK "Rte_CalprmRom_CalRegn01Cmn_DEFAULT_RTE_CALPRM_GROUP.PwrSplyNtc0x07CFailStep_Val" 0 DISPLAY_IDENTIFIER PwrSply.CalibrationPorts.PwrSplyNtc0x07CFailStep.Val /end CHARACTERISTIC
/begin CHARACTERISTIC PwrSply.PwrSplyNtc0x07CPassStep.Val "MICROSAR RTE" VALUE 0x0 RTE_RL_UWORD 0 NO_COMPU_METHOD 0 65535 SYMBOL_LINK "Rte_CalprmRom_CalRegn01Cmn_DEFAULT_RTE_CALPRM_GROUP.PwrSplyNtc0x07CPassStep_Val" 0 DISPLAY_IDENTIFIER PwrSply.CalibrationPorts.PwrSplyNtc0x07CPassStep.Val /end CHARACTERISTIC
/begin CHARACTERISTIC PwrSply.PwrSplyNtc0x07DFailStep.Val "MICROSAR RTE" VALUE 0x0 RTE_RL_UWORD 0 NO_COMPU_METHOD 0 65535 SYMBOL_LINK "Rte_CalprmRom_CalRegn01Cmn_DEFAULT_RTE_CALPRM_GROUP.PwrSplyNtc0x07DFailStep_Val" 0 DISPLAY_IDENTIFIER PwrSply.CalibrationPorts.PwrSplyNtc0x07DFailStep.Val /end CHARACTERISTIC
/begin CHARACTERISTIC PwrSply.PwrSplyNtc0x07DPassStep.Val "MICROSAR RTE" VALUE 0x0 RTE_RL_UWORD 0 NO_COMPU_METHOD 0 65535 SYMBOL_LINK "Rte_CalprmRom_CalRegn01Cmn_DEFAULT_RTE_CALPRM_GROUP.PwrSplyNtc0x07DPassStep_Val" 0 DISPLAY_IDENTIFIER PwrSply.CalibrationPorts.PwrSplyNtc0x07DPassStep.Val /end CHARACTERISTIC
/begin CHARACTERISTIC Rtn.RtnHwAgOffsCalcdX.Ary2D "MICROSAR RTE" VAL_BLK 0x0 RTE_RL_UWORD 0 NO_COMPU_METHOD 0 65535 MATRIX_DIM 16 9 1 SYMBOL_LINK "Rte_CalprmRom_CalRegn02Rt00GroupB_DEFAULT_RTE_CALPRM_GROUP.RtnHwAgOffsCalcdX_Ary2D" 0 DISPLAY_IDENTIFIER Rtn.CalibrationPorts.RtnHwAgOffsCalcdX.Ary2D /end CHARACTERISTIC
/begin CHARACTERISTIC Rtn.RtnHwAgOffsCalcdY.Ary2D "MICROSAR RTE" VAL_BLK 0x0 RTE_RL_UWORD 0 NO_COMPU_METHOD 0 65535 MATRIX_DIM 16 9 1 SYMBOL_LINK "Rte_CalprmRom_CalRegn02Rt00GroupB_DEFAULT_RTE_CALPRM_GROUP.RtnHwAgOffsCalcdY_Ary2D" 0 DISPLAY_IDENTIFIER Rtn.CalibrationPorts.RtnHwAgOffsCalcdY.Ary2D /end CHARACTERISTIC
/begin CHARACTERISTIC Rtn.RtnHwAuthyScaX.Ary1D "MICROSAR RTE" VAL_BLK 0x0 RTE_RL_UWORD 0 NO_COMPU_METHOD 0 65535 MATRIX_DIM 4 1 1 SYMBOL_LINK "Rte_CalprmRom_CalRegn02Inin00GroupB_DEFAULT_RTE_CALPRM_GROUP.RtnHwAuthyScaX_Ary1D" 0 DISPLAY_IDENTIFIER Rtn.CalibrationPorts.RtnHwAuthyScaX.Ary1D /end CHARACTERISTIC
/begin CHARACTERISTIC Rtn.RtnHwAuthyScaY.Ary1D "MICROSAR RTE" VAL_BLK 0x0 RTE_RL_UWORD 0 NO_COMPU_METHOD 0 65535 MATRIX_DIM 4 1 1 SYMBOL_LINK "Rte_CalprmRom_CalRegn02Inin00GroupB_DEFAULT_RTE_CALPRM_GROUP.RtnHwAuthyScaY_Ary1D" 0 DISPLAY_IDENTIFIER Rtn.CalibrationPorts.RtnHwAuthyScaY.Ary1D /end CHARACTERISTIC
/begin CHARACTERISTIC Rtn.RtnHwAuthySlew.Val "MICROSAR RTE" VALUE 0x0 RTE_RL_FLOAT32_IEEE 0 NO_COMPU_METHOD -3.402823466e+38 3.402823466e+38 SYMBOL_LINK "Rte_CalprmRom_CalRegn02Inin00GroupB_DEFAULT_RTE_CALPRM_GROUP.RtnHwAuthySlew_Val" 0 DISPLAY_IDENTIFIER Rtn.CalibrationPorts.RtnHwAuthySlew.Val /end CHARACTERISTIC
/begin CHARACTERISTIC Rtn.RtnOffsRng.Val "MICROSAR RTE" VALUE 0x0 RTE_RL_FLOAT32_IEEE 0 NO_COMPU_METHOD -3.402823466e+38 3.402823466e+38 SYMBOL_LINK "Rte_CalprmRom_CalRegn02Inin00GroupB_DEFAULT_RTE_CALPRM_GROUP.RtnOffsRng_Val" 0 DISPLAY_IDENTIFIER Rtn.CalibrationPorts.RtnOffsRng.Val /end CHARACTERISTIC
/begin CHARACTERISTIC Rtn.RtnOffsSlew.Val "MICROSAR RTE" VALUE 0x0 RTE_RL_FLOAT32_IEEE 0 NO_COMPU_METHOD -3.402823466e+38 3.402823466e+38 SYMBOL_LINK "Rte_CalprmRom_CalRegn02Inin00GroupB_DEFAULT_RTE_CALPRM_GROUP.RtnOffsSlew_Val" 0 DISPLAY_IDENTIFIER Rtn.CalibrationPorts.RtnOffsSlew.Val /end CHARACTERISTIC
/begin CHARACTERISTIC Rtn.RtnScaTqX.Ary2D "MICROSAR RTE" VAL_BLK 0x0 RTE_RL_UWORD 0 NO_COMPU_METHOD 0 65535 MATRIX_DIM 8 9 1 SYMBOL_LINK "Rte_CalprmRom_CalRegn02Rt00GroupB_DEFAULT_RTE_CALPRM_GROUP.RtnScaTqX_Ary2D" 0 DISPLAY_IDENTIFIER Rtn.CalibrationPorts.RtnScaTqX.Ary2D /end CHARACTERISTIC
/begin CHARACTERISTIC Rtn.RtnScaTqY.Ary2D "MICROSAR RTE" VAL_BLK 0x0 RTE_RL_UWORD 0 NO_COMPU_METHOD 0 65535 MATRIX_DIM 8 9 1 SYMBOL_LINK "Rte_CalprmRom_CalRegn02Rt00GroupB_DEFAULT_RTE_CALPRM_GROUP.RtnScaTqY_Ary2D" 0 DISPLAY_IDENTIFIER Rtn.CalibrationPorts.RtnScaTqY.Ary2D /end CHARACTERISTIC
/begin CHARACTERISTIC Rtn.RtnScaVelX.Ary2D "MICROSAR RTE" VAL_BLK 0x0 RTE_RL_UWORD 0 NO_COMPU_METHOD 0 65535 MATRIX_DIM 4 9 1 SYMBOL_LINK "Rte_CalprmRom_CalRegn02Rt00GroupB_DEFAULT_RTE_CALPRM_GROUP.RtnScaVelX_Ary2D" 0 DISPLAY_IDENTIFIER Rtn.CalibrationPorts.RtnScaVelX.Ary2D /end CHARACTERISTIC
/begin CHARACTERISTIC Rtn.RtnScaVelY.Ary2D "MICROSAR RTE" VAL_BLK 0x0 RTE_RL_UWORD 0 NO_COMPU_METHOD 0 65535 MATRIX_DIM 4 9 1 SYMBOL_LINK "Rte_CalprmRom_CalRegn02Rt00GroupB_DEFAULT_RTE_CALPRM_GROUP.RtnScaVelY_Ary2D" 0 DISPLAY_IDENTIFIER Rtn.CalibrationPorts.RtnScaVelY.Ary2D /end CHARACTERISTIC
/begin CHARACTERISTIC Rtn.RtnTScaX.Ary1D "MICROSAR RTE" VAL_BLK 0x0 RTE_RL_SWORD 0 NO_COMPU_METHOD -32768 32767 MATRIX_DIM 14 1 1 SYMBOL_LINK "Rte_CalprmRom_CalRegn02Inin00GroupB_DEFAULT_RTE_CALPRM_GROUP.RtnTScaX_Ary1D" 0 DISPLAY_IDENTIFIER Rtn.CalibrationPorts.RtnTScaX.Ary1D /end CHARACTERISTIC
/begin CHARACTERISTIC Rtn.RtnTScaY.Ary1D "MICROSAR RTE" VAL_BLK 0x0 RTE_RL_UWORD 0 NO_COMPU_METHOD 0 65535 MATRIX_DIM 14 1 1 SYMBOL_LINK "Rte_CalprmRom_CalRegn02Inin00GroupB_DEFAULT_RTE_CALPRM_GROUP.RtnTScaY_Ary1D" 0 DISPLAY_IDENTIFIER Rtn.CalibrationPorts.RtnTScaY.Ary1D /end CHARACTERISTIC
/begin CHARACTERISTIC Rtn.RtnVehSpdSeln.Ary1D "MICROSAR RTE" VAL_BLK 0x0 RTE_RL_UWORD 0 NO_COMPU_METHOD 0 65535 MATRIX_DIM 9 1 1 SYMBOL_LINK "Rte_CalprmRom_CalRegn02Rt00GroupB_DEFAULT_RTE_CALPRM_GROUP.RtnVehSpdSeln_Ary1D" 0 DISPLAY_IDENTIFIER Rtn.CalibrationPorts.RtnVehSpdSeln.Ary1D /end CHARACTERISTIC
/begin CHARACTERISTIC RtnPahFwl.RtnPahFwlUpprBndTblX.Ary1D "MICROSAR RTE" VAL_BLK 0x0 RTE_RL_SWORD 0 NO_COMPU_METHOD -32768 32767 MATRIX_DIM 11 1 1 SYMBOL_LINK "Rte_CalprmRom_CalRegn02Inin00GroupB_DEFAULT_RTE_CALPRM_GROUP.RtnPahFwlUpprBndTblX_Ary1D" 0 DISPLAY_IDENTIFIER RtnPahFwl.CalibrationPorts.RtnPahFwlUpprBndTblX.Ary1D /end CHARACTERISTIC
/begin CHARACTERISTIC RtnPahFwl.RtnPahFwlUpprBndTblY.Ary2D "MICROSAR RTE" VAL_BLK 0x0 RTE_RL_SWORD 0 NO_COMPU_METHOD -32768 32767 MATRIX_DIM 11 8 1 SYMBOL_LINK "Rte_CalprmRom_CalRegn02Inin00GroupB_DEFAULT_RTE_CALPRM_GROUP.RtnPahFwlUpprBndTblY_Ary2D" 0 DISPLAY_IDENTIFIER RtnPahFwl.CalibrationPorts.RtnPahFwlUpprBndTblY.Ary2D /end CHARACTERISTIC
/begin CHARACTERISTIC RtnPahFwl.RtnPahFwlVehSpd.Ary1D "MICROSAR RTE" VAL_BLK 0x0 RTE_RL_UWORD 0 NO_COMPU_METHOD 0 65535 MATRIX_DIM 8 1 1 SYMBOL_LINK "Rte_CalprmRom_CalRegn02Inin00GroupB_DEFAULT_RTE_CALPRM_GROUP.RtnPahFwlVehSpd_Ary1D" 0 DISPLAY_IDENTIFIER RtnPahFwl.CalibrationPorts.RtnPahFwlVehSpd.Ary1D /end CHARACTERISTIC
/begin CHARACTERISTIC StabyCmp.StabyCmpAssiScaBlndX.Ary1D "MICROSAR RTE" VAL_BLK 0x0 RTE_RL_UWORD 0 NO_COMPU_METHOD 0 65535 MATRIX_DIM 2 1 1 SYMBOL_LINK "Rte_CalprmRom_CalRegn01Inin00GroupD_DEFAULT_RTE_CALPRM_GROUP.StabyCmpAssiScaBlndX_Ary1D" 0 DISPLAY_IDENTIFIER StabyCmp.CalibrationPorts.StabyCmpAssiScaBlndX.Ary1D /end CHARACTERISTIC
/begin CHARACTERISTIC StabyCmp.StabyCmpAssiScaBlndY.Ary1D "MICROSAR RTE" VAL_BLK 0x0 RTE_RL_UWORD 0 NO_COMPU_METHOD 0 65535 MATRIX_DIM 2 1 1 SYMBOL_LINK "Rte_CalprmRom_CalRegn01Inin00GroupD_DEFAULT_RTE_CALPRM_GROUP.StabyCmpAssiScaBlndY_Ary1D" 0 DISPLAY_IDENTIFIER StabyCmp.CalibrationPorts.StabyCmpAssiScaBlndY.Ary1D /end CHARACTERISTIC
/begin CHARACTERISTIC StabyCmp.StabyCmpHwTqLpFilFrq.Val "MICROSAR RTE" VALUE 0x0 RTE_RL_FLOAT32_IEEE 0 NO_COMPU_METHOD -3.402823466e+38 3.402823466e+38 SYMBOL_LINK "Rte_CalprmRom_CalRegn01Inin00GroupD_DEFAULT_RTE_CALPRM_GROUP.StabyCmpHwTqLpFilFrq_Val" 0 DISPLAY_IDENTIFIER StabyCmp.CalibrationPorts.StabyCmpHwTqLpFilFrq.Val /end CHARACTERISTIC
/begin CHARACTERISTIC StabyCmp.StabyCmpNotchFil1Struct.Rec.FilGainA1 "MICROSAR RTE" VALUE 0x0 RTE_RL_FLOAT32_IEEE 0 NO_COMPU_METHOD -3.402823466e+38 3.402823466e+38 SYMBOL_LINK "Rte_CalprmRom_CalRegn01Inin00GroupD_DEFAULT_RTE_CALPRM_GROUP.StabyCmpNotchFil1Struct_Rec.FilGainA1" 0 DISPLAY_IDENTIFIER StabyCmp.CalibrationPorts.StabyCmpNotchFil1Struct.Rec.FilGainA1 /end CHARACTERISTIC
/begin CHARACTERISTIC StabyCmp.StabyCmpNotchFil1Struct.Rec.FilGainA2 "MICROSAR RTE" VALUE 0x0 RTE_RL_FLOAT32_IEEE 0 NO_COMPU_METHOD -3.402823466e+38 3.402823466e+38 SYMBOL_LINK "Rte_CalprmRom_CalRegn01Inin00GroupD_DEFAULT_RTE_CALPRM_GROUP.StabyCmpNotchFil1Struct_Rec.FilGainA2" 0 DISPLAY_IDENTIFIER StabyCmp.CalibrationPorts.StabyCmpNotchFil1Struct.Rec.FilGainA2 /end CHARACTERISTIC
/begin CHARACTERISTIC StabyCmp.StabyCmpNotchFil1Struct.Rec.FilGainB0 "MICROSAR RTE" VALUE 0x0 RTE_RL_FLOAT32_IEEE 0 NO_COMPU_METHOD -3.402823466e+38 3.402823466e+38 SYMBOL_LINK "Rte_CalprmRom_CalRegn01Inin00GroupD_DEFAULT_RTE_CALPRM_GROUP.StabyCmpNotchFil1Struct_Rec.FilGainB0" 0 DISPLAY_IDENTIFIER StabyCmp.CalibrationPorts.StabyCmpNotchFil1Struct.Rec.FilGainB0 /end CHARACTERISTIC
/begin CHARACTERISTIC StabyCmp.StabyCmpNotchFil1Struct.Rec.FilGainB1 "MICROSAR RTE" VALUE 0x0 RTE_RL_FLOAT32_IEEE 0 NO_COMPU_METHOD -3.402823466e+38 3.402823466e+38 SYMBOL_LINK "Rte_CalprmRom_CalRegn01Inin00GroupD_DEFAULT_RTE_CALPRM_GROUP.StabyCmpNotchFil1Struct_Rec.FilGainB1" 0 DISPLAY_IDENTIFIER StabyCmp.CalibrationPorts.StabyCmpNotchFil1Struct.Rec.FilGainB1 /end CHARACTERISTIC
/begin CHARACTERISTIC StabyCmp.StabyCmpNotchFil1Struct.Rec.FilGainB2 "MICROSAR RTE" VALUE 0x0 RTE_RL_FLOAT32_IEEE 0 NO_COMPU_METHOD -3.402823466e+38 3.402823466e+38 SYMBOL_LINK "Rte_CalprmRom_CalRegn01Inin00GroupD_DEFAULT_RTE_CALPRM_GROUP.StabyCmpNotchFil1Struct_Rec.FilGainB2" 0 DISPLAY_IDENTIFIER StabyCmp.CalibrationPorts.StabyCmpNotchFil1Struct.Rec.FilGainB2 /end CHARACTERISTIC
/begin CHARACTERISTIC StabyCmp.StabyCmpNotchFil2Struct.Rec.FilGainA1 "MICROSAR RTE" VALUE 0x0 RTE_RL_FLOAT32_IEEE 0 NO_COMPU_METHOD -3.402823466e+38 3.402823466e+38 SYMBOL_LINK "Rte_CalprmRom_CalRegn01Inin00GroupD_DEFAULT_RTE_CALPRM_GROUP.StabyCmpNotchFil2Struct_Rec.FilGainA1" 0 DISPLAY_IDENTIFIER StabyCmp.CalibrationPorts.StabyCmpNotchFil2Struct.Rec.FilGainA1 /end CHARACTERISTIC
/begin CHARACTERISTIC StabyCmp.StabyCmpNotchFil2Struct.Rec.FilGainA2 "MICROSAR RTE" VALUE 0x0 RTE_RL_FLOAT32_IEEE 0 NO_COMPU_METHOD -3.402823466e+38 3.402823466e+38 SYMBOL_LINK "Rte_CalprmRom_CalRegn01Inin00GroupD_DEFAULT_RTE_CALPRM_GROUP.StabyCmpNotchFil2Struct_Rec.FilGainA2" 0 DISPLAY_IDENTIFIER StabyCmp.CalibrationPorts.StabyCmpNotchFil2Struct.Rec.FilGainA2 /end CHARACTERISTIC
/begin CHARACTERISTIC StabyCmp.StabyCmpNotchFil2Struct.Rec.FilGainB0 "MICROSAR RTE" VALUE 0x0 RTE_RL_FLOAT32_IEEE 0 NO_COMPU_METHOD -3.402823466e+38 3.402823466e+38 SYMBOL_LINK "Rte_CalprmRom_CalRegn01Inin00GroupD_DEFAULT_RTE_CALPRM_GROUP.StabyCmpNotchFil2Struct_Rec.FilGainB0" 0 DISPLAY_IDENTIFIER StabyCmp.CalibrationPorts.StabyCmpNotchFil2Struct.Rec.FilGainB0 /end CHARACTERISTIC
/begin CHARACTERISTIC StabyCmp.StabyCmpNotchFil2Struct.Rec.FilGainB1 "MICROSAR RTE" VALUE 0x0 RTE_RL_FLOAT32_IEEE 0 NO_COMPU_METHOD -3.402823466e+38 3.402823466e+38 SYMBOL_LINK "Rte_CalprmRom_CalRegn01Inin00GroupD_DEFAULT_RTE_CALPRM_GROUP.StabyCmpNotchFil2Struct_Rec.FilGainB1" 0 DISPLAY_IDENTIFIER StabyCmp.CalibrationPorts.StabyCmpNotchFil2Struct.Rec.FilGainB1 /end CHARACTERISTIC
/begin CHARACTERISTIC StabyCmp.StabyCmpNotchFil2Struct.Rec.FilGainB2 "MICROSAR RTE" VALUE 0x0 RTE_RL_FLOAT32_IEEE 0 NO_COMPU_METHOD -3.402823466e+38 3.402823466e+38 SYMBOL_LINK "Rte_CalprmRom_CalRegn01Inin00GroupD_DEFAULT_RTE_CALPRM_GROUP.StabyCmpNotchFil2Struct_Rec.FilGainB2" 0 DISPLAY_IDENTIFIER StabyCmp.CalibrationPorts.StabyCmpNotchFil2Struct.Rec.FilGainB2 /end CHARACTERISTIC
/begin CHARACTERISTIC StabyCmp.StabyCmpNotchFil3Struct.Rec.FilGainA1 "MICROSAR RTE" VALUE 0x0 RTE_RL_FLOAT32_IEEE 0 NO_COMPU_METHOD -3.402823466e+38 3.402823466e+38 SYMBOL_LINK "Rte_CalprmRom_CalRegn01Inin00GroupD_DEFAULT_RTE_CALPRM_GROUP.StabyCmpNotchFil3Struct_Rec.FilGainA1" 0 DISPLAY_IDENTIFIER StabyCmp.CalibrationPorts.StabyCmpNotchFil3Struct.Rec.FilGainA1 /end CHARACTERISTIC
/begin CHARACTERISTIC StabyCmp.StabyCmpNotchFil3Struct.Rec.FilGainA2 "MICROSAR RTE" VALUE 0x0 RTE_RL_FLOAT32_IEEE 0 NO_COMPU_METHOD -3.402823466e+38 3.402823466e+38 SYMBOL_LINK "Rte_CalprmRom_CalRegn01Inin00GroupD_DEFAULT_RTE_CALPRM_GROUP.StabyCmpNotchFil3Struct_Rec.FilGainA2" 0 DISPLAY_IDENTIFIER StabyCmp.CalibrationPorts.StabyCmpNotchFil3Struct.Rec.FilGainA2 /end CHARACTERISTIC
/begin CHARACTERISTIC StabyCmp.StabyCmpNotchFil3Struct.Rec.FilGainB0 "MICROSAR RTE" VALUE 0x0 RTE_RL_FLOAT32_IEEE 0 NO_COMPU_METHOD -3.402823466e+38 3.402823466e+38 SYMBOL_LINK "Rte_CalprmRom_CalRegn01Inin00GroupD_DEFAULT_RTE_CALPRM_GROUP.StabyCmpNotchFil3Struct_Rec.FilGainB0" 0 DISPLAY_IDENTIFIER StabyCmp.CalibrationPorts.StabyCmpNotchFil3Struct.Rec.FilGainB0 /end CHARACTERISTIC
/begin CHARACTERISTIC StabyCmp.StabyCmpNotchFil3Struct.Rec.FilGainB1 "MICROSAR RTE" VALUE 0x0 RTE_RL_FLOAT32_IEEE 0 NO_COMPU_METHOD -3.402823466e+38 3.402823466e+38 SYMBOL_LINK "Rte_CalprmRom_CalRegn01Inin00GroupD_DEFAULT_RTE_CALPRM_GROUP.StabyCmpNotchFil3Struct_Rec.FilGainB1" 0 DISPLAY_IDENTIFIER StabyCmp.CalibrationPorts.StabyCmpNotchFil3Struct.Rec.FilGainB1 /end CHARACTERISTIC
/begin CHARACTERISTIC StabyCmp.StabyCmpNotchFil3Struct.Rec.FilGainB2 "MICROSAR RTE" VALUE 0x0 RTE_RL_FLOAT32_IEEE 0 NO_COMPU_METHOD -3.402823466e+38 3.402823466e+38 SYMBOL_LINK "Rte_CalprmRom_CalRegn01Inin00GroupD_DEFAULT_RTE_CALPRM_GROUP.StabyCmpNotchFil3Struct_Rec.FilGainB2" 0 DISPLAY_IDENTIFIER StabyCmp.CalibrationPorts.StabyCmpNotchFil3Struct.Rec.FilGainB2 /end CHARACTERISTIC
/begin CHARACTERISTIC StabyCmp.StabyCmpNotchFil4Struct.Rec.FilGainA1 "MICROSAR RTE" VALUE 0x0 RTE_RL_FLOAT32_IEEE 0 NO_COMPU_METHOD -3.402823466e+38 3.402823466e+38 SYMBOL_LINK "Rte_CalprmRom_CalRegn01Inin00GroupD_DEFAULT_RTE_CALPRM_GROUP.StabyCmpNotchFil4Struct_Rec.FilGainA1" 0 DISPLAY_IDENTIFIER StabyCmp.CalibrationPorts.StabyCmpNotchFil4Struct.Rec.FilGainA1 /end CHARACTERISTIC
/begin CHARACTERISTIC StabyCmp.StabyCmpNotchFil4Struct.Rec.FilGainA2 "MICROSAR RTE" VALUE 0x0 RTE_RL_FLOAT32_IEEE 0 NO_COMPU_METHOD -3.402823466e+38 3.402823466e+38 SYMBOL_LINK "Rte_CalprmRom_CalRegn01Inin00GroupD_DEFAULT_RTE_CALPRM_GROUP.StabyCmpNotchFil4Struct_Rec.FilGainA2" 0 DISPLAY_IDENTIFIER StabyCmp.CalibrationPorts.StabyCmpNotchFil4Struct.Rec.FilGainA2 /end CHARACTERISTIC
/begin CHARACTERISTIC StabyCmp.StabyCmpNotchFil4Struct.Rec.FilGainB0 "MICROSAR RTE" VALUE 0x0 RTE_RL_FLOAT32_IEEE 0 NO_COMPU_METHOD -3.402823466e+38 3.402823466e+38 SYMBOL_LINK "Rte_CalprmRom_CalRegn01Inin00GroupD_DEFAULT_RTE_CALPRM_GROUP.StabyCmpNotchFil4Struct_Rec.FilGainB0" 0 DISPLAY_IDENTIFIER StabyCmp.CalibrationPorts.StabyCmpNotchFil4Struct.Rec.FilGainB0 /end CHARACTERISTIC
/begin CHARACTERISTIC StabyCmp.StabyCmpNotchFil4Struct.Rec.FilGainB1 "MICROSAR RTE" VALUE 0x0 RTE_RL_FLOAT32_IEEE 0 NO_COMPU_METHOD -3.402823466e+38 3.402823466e+38 SYMBOL_LINK "Rte_CalprmRom_CalRegn01Inin00GroupD_DEFAULT_RTE_CALPRM_GROUP.StabyCmpNotchFil4Struct_Rec.FilGainB1" 0 DISPLAY_IDENTIFIER StabyCmp.CalibrationPorts.StabyCmpNotchFil4Struct.Rec.FilGainB1 /end CHARACTERISTIC
/begin CHARACTERISTIC StabyCmp.StabyCmpNotchFil4Struct.Rec.FilGainB2 "MICROSAR RTE" VALUE 0x0 RTE_RL_FLOAT32_IEEE 0 NO_COMPU_METHOD -3.402823466e+38 3.402823466e+38 SYMBOL_LINK "Rte_CalprmRom_CalRegn01Inin00GroupD_DEFAULT_RTE_CALPRM_GROUP.StabyCmpNotchFil4Struct_Rec.FilGainB2" 0 DISPLAY_IDENTIFIER StabyCmp.CalibrationPorts.StabyCmpNotchFil4Struct.Rec.FilGainB2 /end CHARACTERISTIC
/begin CHARACTERISTIC StabyCmp.StabyCmpNotchFilBilnrBlndVehSpd.Ary1D "MICROSAR RTE" VAL_BLK 0x0 RTE_RL_UWORD 0 NO_COMPU_METHOD 0 65535 MATRIX_DIM 6 1 1 SYMBOL_LINK "Rte_CalprmRom_CalRegn01Inin00GroupD_DEFAULT_RTE_CALPRM_GROUP.StabyCmpNotchFilBilnrBlndVehSpd_Ary1D" 0 DISPLAY_IDENTIFIER StabyCmp.CalibrationPorts.StabyCmpNotchFilBilnrBlndVehSpd.Ary1D /end CHARACTERISTIC
/begin CHARACTERISTIC StabyCmp.StabyCmpNotchFilBlnd02Y.Ary2D "MICROSAR RTE" VAL_BLK 0x0 RTE_RL_UWORD 0 NO_COMPU_METHOD 0 65535 MATRIX_DIM 5 6 1 SYMBOL_LINK "Rte_CalprmRom_CalRegn01Inin00GroupD_DEFAULT_RTE_CALPRM_GROUP.StabyCmpNotchFilBlnd02Y_Ary2D" 0 DISPLAY_IDENTIFIER StabyCmp.CalibrationPorts.StabyCmpNotchFilBlnd02Y.Ary2D /end CHARACTERISTIC
/begin CHARACTERISTIC StabyCmp.StabyCmpNotchFilBlnd04Y.Ary2D "MICROSAR RTE" VAL_BLK 0x0 RTE_RL_UWORD 0 NO_COMPU_METHOD 0 65535 MATRIX_DIM 5 6 1 SYMBOL_LINK "Rte_CalprmRom_CalRegn01Inin00GroupD_DEFAULT_RTE_CALPRM_GROUP.StabyCmpNotchFilBlnd04Y_Ary2D" 0 DISPLAY_IDENTIFIER StabyCmp.CalibrationPorts.StabyCmpNotchFilBlnd04Y.Ary2D /end CHARACTERISTIC
/begin CHARACTERISTIC StabyCmp.StabyCmpNotchFilBlnd12TqX.Ary2D "MICROSAR RTE" VAL_BLK 0x0 RTE_RL_UWORD 0 NO_COMPU_METHOD 0 65535 MATRIX_DIM 5 6 1 SYMBOL_LINK "Rte_CalprmRom_CalRegn01Inin00GroupD_DEFAULT_RTE_CALPRM_GROUP.StabyCmpNotchFilBlnd12TqX_Ary2D" 0 DISPLAY_IDENTIFIER StabyCmp.CalibrationPorts.StabyCmpNotchFilBlnd12TqX.Ary2D /end CHARACTERISTIC
/begin CHARACTERISTIC StabyCmp.StabyCmpNotchFilBlnd12Y.Ary2D "MICROSAR RTE" VAL_BLK 0x0 RTE_RL_UWORD 0 NO_COMPU_METHOD 0 65535 MATRIX_DIM 5 6 1 SYMBOL_LINK "Rte_CalprmRom_CalRegn01Inin00GroupD_DEFAULT_RTE_CALPRM_GROUP.StabyCmpNotchFilBlnd12Y_Ary2D" 0 DISPLAY_IDENTIFIER StabyCmp.CalibrationPorts.StabyCmpNotchFilBlnd12Y.Ary2D /end CHARACTERISTIC
/begin CHARACTERISTIC StabyCmp.StabyCmpNotchFilBlnd34TqX.Ary2D "MICROSAR RTE" VAL_BLK 0x0 RTE_RL_UWORD 0 NO_COMPU_METHOD 0 65535 MATRIX_DIM 5 6 1 SYMBOL_LINK "Rte_CalprmRom_CalRegn01Inin00GroupD_DEFAULT_RTE_CALPRM_GROUP.StabyCmpNotchFilBlnd34TqX_Ary2D" 0 DISPLAY_IDENTIFIER StabyCmp.CalibrationPorts.StabyCmpNotchFilBlnd34TqX.Ary2D /end CHARACTERISTIC
/begin CHARACTERISTIC StabyCmp.StabyCmpNotchFilBlnd34Y.Ary2D "MICROSAR RTE" VAL_BLK 0x0 RTE_RL_UWORD 0 NO_COMPU_METHOD 0 65535 MATRIX_DIM 5 6 1 SYMBOL_LINK "Rte_CalprmRom_CalRegn01Inin00GroupD_DEFAULT_RTE_CALPRM_GROUP.StabyCmpNotchFilBlnd34Y_Ary2D" 0 DISPLAY_IDENTIFIER StabyCmp.CalibrationPorts.StabyCmpNotchFilBlnd34Y.Ary2D /end CHARACTERISTIC
/begin CHARACTERISTIC StackMeas.StackMeasResDft "MICROSAR RTE" VAL_BLK 0x0 RTE_RL_UBYTE 0 NO_COMPU_METHOD 0 255 MATRIX_DIM 48 1 1 SYMBOL_LINK "Rte_CalprmRom_StackMeas_DEFAULT_RTE_CDATA_GROUP.StackMeasResDft" 0 DISPLAY_IDENTIFIER StackMeas.CalibrationParameters.StackMeasResDft /end CHARACTERISTIC
/begin CHARACTERISTIC SysFricLrng.FricLrngDataDft.BasLineFric "MICROSAR RTE" VAL_BLK 0x0 RTE_RL_FLOAT32_IEEE 0 NO_COMPU_METHOD -3.402823466e+38 3.402823466e+38 MATRIX_DIM 4 1 1 SYMBOL_LINK "Rte_CalprmRom_SysFricLrng_DEFAULT_RTE_CDATA_GROUP.FricLrngDataDft.BasLineFric" 0 DISPLAY_IDENTIFIER SysFricLrng.CalibrationParameters.FricLrngDataDft.BasLineFric /end CHARACTERISTIC
/begin CHARACTERISTIC SysFricLrng.FricLrngDataDft.FricOffs "MICROSAR RTE" VALUE 0x0 RTE_RL_FLOAT32_IEEE 0 NO_COMPU_METHOD -3.402823466e+38 3.402823466e+38 SYMBOL_LINK "Rte_CalprmRom_SysFricLrng_DEFAULT_RTE_CDATA_GROUP.FricLrngDataDft.FricOffs" 0 DISPLAY_IDENTIFIER SysFricLrng.CalibrationParameters.FricLrngDataDft.FricOffs /end CHARACTERISTIC
/begin CHARACTERISTIC SysFricLrng.FricLrngDataDft.Hys "MICROSAR RTE" VAL_BLK 0x0 RTE_RL_FLOAT32_IEEE 0 NO_COMPU_METHOD -3.402823466e+38 3.402823466e+38 MATRIX_DIM 4 8 1 SYMBOL_LINK "Rte_CalprmRom_SysFricLrng_DEFAULT_RTE_CDATA_GROUP.FricLrngDataDft.Hys" 0 DISPLAY_IDENTIFIER SysFricLrng.CalibrationParameters.FricLrngDataDft.Hys /end CHARACTERISTIC
/begin CHARACTERISTIC SysFricLrng.FricLrngDataDft.RngCntr "MICROSAR RTE" VAL_BLK 0x0 RTE_RL_UWORD 0 NO_COMPU_METHOD 0 65535 MATRIX_DIM 3 8 1 SYMBOL_LINK "Rte_CalprmRom_SysFricLrng_DEFAULT_RTE_CDATA_GROUP.FricLrngDataDft.RngCntr" 0 DISPLAY_IDENTIFIER SysFricLrng.CalibrationParameters.FricLrngDataDft.RngCntr /end CHARACTERISTIC
/begin CHARACTERISTIC SysFricLrng.FricLrngDataDft.SysFricLrngOperMod "MICROSAR RTE" VALUE 0x0 RTE_RL_UBYTE 0 RTE_CM_ENUM_SysFricLrngOperMod1 0 255 SYMBOL_LINK "Rte_CalprmRom_SysFricLrng_DEFAULT_RTE_CDATA_GROUP.FricLrngDataDft.SysFricLrngOperMod" 0 DISPLAY_IDENTIFIER SysFricLrng.CalibrationParameters.FricLrngDataDft.SysFricLrngOperMod /end CHARACTERISTIC
/begin CHARACTERISTIC SysFricLrng.FricLrngDataDft.VehLrndFric "MICROSAR RTE" VAL_BLK 0x0 RTE_RL_FLOAT32_IEEE 0 NO_COMPU_METHOD -3.402823466e+38 3.402823466e+38 MATRIX_DIM 4 1 1 SYMBOL_LINK "Rte_CalprmRom_SysFricLrng_DEFAULT_RTE_CDATA_GROUP.FricLrngDataDft.VehLrndFric" 0 DISPLAY_IDENTIFIER SysFricLrng.CalibrationParameters.FricLrngDataDft.VehLrndFric /end CHARACTERISTIC
/begin CHARACTERISTIC SysFricLrng.FricNonLrngDataDft.EnaFricLrng "MICROSAR RTE" VALUE 0x0 RTE_RL_BOOLEAN 0 RTE_CM_BOOLEAN 0 255 SYMBOL_LINK "Rte_CalprmRom_SysFricLrng_DEFAULT_RTE_CDATA_GROUP.FricNonLrngDataDft.EnaFricLrng" 0 DISPLAY_IDENTIFIER SysFricLrng.CalibrationParameters.FricNonLrngDataDft.EnaFricLrng /end CHARACTERISTIC
/begin CHARACTERISTIC SysFricLrng.FricNonLrngDataDft.EnaFricOffsOutp "MICROSAR RTE" VALUE 0x0 RTE_RL_BOOLEAN 0 RTE_CM_BOOLEAN 0 255 SYMBOL_LINK "Rte_CalprmRom_SysFricLrng_DEFAULT_RTE_CDATA_GROUP.FricNonLrngDataDft.EnaFricOffsOutp" 0 DISPLAY_IDENTIFIER SysFricLrng.CalibrationParameters.FricNonLrngDataDft.EnaFricOffsOutp /end CHARACTERISTIC
/begin CHARACTERISTIC SysFricLrng.FricNonLrngDataDft.EolFric "MICROSAR RTE" VALUE 0x0 RTE_RL_FLOAT32_IEEE 0 NO_COMPU_METHOD -3.402823466e+38 3.402823466e+38 SYMBOL_LINK "Rte_CalprmRom_SysFricLrng_DEFAULT_RTE_CDATA_GROUP.FricNonLrngDataDft.EolFric" 0 DISPLAY_IDENTIFIER SysFricLrng.CalibrationParameters.FricNonLrngDataDft.EolFric /end CHARACTERISTIC
/begin CHARACTERISTIC SysFricLrng.SysFricLrngAvrgFricFrq.Val "MICROSAR RTE" VALUE 0x0 RTE_RL_FLOAT32_IEEE 0 NO_COMPU_METHOD -3.402823466e+38 3.402823466e+38 SYMBOL_LINK "Rte_CalprmRom_CalRegn01Inin00_DEFAULT_RTE_CALPRM_GROUP.SysFricLrngAvrgFricFrq_Val" 0 DISPLAY_IDENTIFIER SysFricLrng.CalibrationPorts.SysFricLrngAvrgFricFrq.Val /end CHARACTERISTIC
/begin CHARACTERISTIC SysFricLrng.SysFricLrngBasLineEolFric.Val "MICROSAR RTE" VALUE 0x0 RTE_RL_FLOAT32_IEEE 0 NO_COMPU_METHOD -3.402823466e+38 3.402823466e+38 SYMBOL_LINK "Rte_CalprmRom_CalRegn01Inin00_DEFAULT_RTE_CALPRM_GROUP.SysFricLrngBasLineEolFric_Val" 0 DISPLAY_IDENTIFIER SysFricLrng.CalibrationPorts.SysFricLrngBasLineEolFric.Val /end CHARACTERISTIC
/begin CHARACTERISTIC SysFricLrng.SysFricLrngBasLineFric.Ary1D "MICROSAR RTE" VAL_BLK 0x0 RTE_RL_FLOAT32_IEEE 0 NO_COMPU_METHOD -3.402823466e+38 3.402823466e+38 MATRIX_DIM 4 1 1 SYMBOL_LINK "Rte_CalprmRom_CalRegn01Inin00_DEFAULT_RTE_CALPRM_GROUP.SysFricLrngBasLineFric_Ary1D" 0 DISPLAY_IDENTIFIER SysFricLrng.CalibrationPorts.SysFricLrngBasLineFric.Ary1D /end CHARACTERISTIC
/begin CHARACTERISTIC SysFricLrng.SysFricLrngBasLineHys.Ary2D "MICROSAR RTE" VAL_BLK 0x0 RTE_RL_FLOAT32_IEEE 0 NO_COMPU_METHOD -3.402823466e+38 3.402823466e+38 MATRIX_DIM 4 8 1 SYMBOL_LINK "Rte_CalprmRom_CalRegn01Inin00_DEFAULT_RTE_CALPRM_GROUP.SysFricLrngBasLineHys_Ary2D" 0 DISPLAY_IDENTIFIER SysFricLrng.CalibrationPorts.SysFricLrngBasLineHys.Ary2D /end CHARACTERISTIC
/begin CHARACTERISTIC SysFricLrng.SysFricLrngBasLineRngCntr.Ary2D "MICROSAR RTE" VAL_BLK 0x0 RTE_RL_UWORD 0 NO_COMPU_METHOD 0 65535 MATRIX_DIM 3 8 1 SYMBOL_LINK "Rte_CalprmRom_CalRegn01Inin00_DEFAULT_RTE_CALPRM_GROUP.SysFricLrngBasLineRngCntr_Ary2D" 0 DISPLAY_IDENTIFIER SysFricLrng.CalibrationPorts.SysFricLrngBasLineRngCntr.Ary2D /end CHARACTERISTIC
/begin CHARACTERISTIC SysFricLrng.SysFricLrngDataPrepLpFilFrq.Val "MICROSAR RTE" VALUE 0x0 RTE_RL_FLOAT32_IEEE 0 NO_COMPU_METHOD -3.402823466e+38 3.402823466e+38 SYMBOL_LINK "Rte_CalprmRom_CalRegn01Inin00_DEFAULT_RTE_CALPRM_GROUP.SysFricLrngDataPrepLpFilFrq_Val" 0 DISPLAY_IDENTIFIER SysFricLrng.CalibrationPorts.SysFricLrngDataPrepLpFilFrq.Val /end CHARACTERISTIC
/begin CHARACTERISTIC SysFricLrng.SysFricLrngDebStep.Val "MICROSAR RTE" VALUE 0x0 RTE_RL_UWORD 0 NO_COMPU_METHOD 0 65535 SYMBOL_LINK "Rte_CalprmRom_CalRegn01Inin00_DEFAULT_RTE_CALPRM_GROUP.SysFricLrngDebStep_Val" 0 DISPLAY_IDENTIFIER SysFricLrng.CalibrationPorts.SysFricLrngDebStep.Val /end CHARACTERISTIC
/begin CHARACTERISTIC SysFricLrng.SysFricLrngEolFricDifHiLim.Val "MICROSAR RTE" VALUE 0x0 RTE_RL_FLOAT32_IEEE 0 NO_COMPU_METHOD -3.402823466e+38 3.402823466e+38 SYMBOL_LINK "Rte_CalprmRom_CalRegn01Inin00_DEFAULT_RTE_CALPRM_GROUP.SysFricLrngEolFricDifHiLim_Val" 0 DISPLAY_IDENTIFIER SysFricLrng.CalibrationPorts.SysFricLrngEolFricDifHiLim.Val /end CHARACTERISTIC
/begin CHARACTERISTIC SysFricLrng.SysFricLrngEolFricDifLoLim.Val "MICROSAR RTE" VALUE 0x0 RTE_RL_FLOAT32_IEEE 0 NO_COMPU_METHOD -3.402823466e+38 3.402823466e+38 SYMBOL_LINK "Rte_CalprmRom_CalRegn01Inin00_DEFAULT_RTE_CALPRM_GROUP.SysFricLrngEolFricDifLoLim_Val" 0 DISPLAY_IDENTIFIER SysFricLrng.CalibrationPorts.SysFricLrngEolFricDifLoLim.Val /end CHARACTERISTIC
/begin CHARACTERISTIC SysFricLrng.SysFricLrngEolFricDifScagFac.Val "MICROSAR RTE" VALUE 0x0 RTE_RL_FLOAT32_IEEE 0 NO_COMPU_METHOD -3.402823466e+38 3.402823466e+38 SYMBOL_LINK "Rte_CalprmRom_CalRegn01Inin00_DEFAULT_RTE_CALPRM_GROUP.SysFricLrngEolFricDifScagFac_Val" 0 DISPLAY_IDENTIFIER SysFricLrng.CalibrationPorts.SysFricLrngEolFricDifScagFac.Val /end CHARACTERISTIC
/begin CHARACTERISTIC SysFricLrng.SysFricLrngFricChgWght.Ary1D "MICROSAR RTE" VAL_BLK 0x0 RTE_RL_FLOAT32_IEEE 0 NO_COMPU_METHOD -3.402823466e+38 3.402823466e+38 MATRIX_DIM 4 1 1 SYMBOL_LINK "Rte_CalprmRom_CalRegn01Inin00_DEFAULT_RTE_CALPRM_GROUP.SysFricLrngFricChgWght_Ary1D" 0 DISPLAY_IDENTIFIER SysFricLrng.CalibrationPorts.SysFricLrngFricChgWght.Ary1D /end CHARACTERISTIC
/begin CHARACTERISTIC SysFricLrng.SysFricLrngFricDiagcThd.Val "MICROSAR RTE" VALUE 0x0 RTE_RL_FLOAT32_IEEE 0 NO_COMPU_METHOD -3.402823466e+38 3.402823466e+38 SYMBOL_LINK "Rte_CalprmRom_CalRegn01Inin00_DEFAULT_RTE_CALPRM_GROUP.SysFricLrngFricDiagcThd_Val" 0 DISPLAY_IDENTIFIER SysFricLrng.CalibrationPorts.SysFricLrngFricDiagcThd.Val /end CHARACTERISTIC
/begin CHARACTERISTIC SysFricLrng.SysFricLrngFricHysHwAgPt.Ary1D "MICROSAR RTE" VAL_BLK 0x0 RTE_RL_FLOAT32_IEEE 0 NO_COMPU_METHOD -3.402823466e+38 3.402823466e+38 MATRIX_DIM 4 1 1 SYMBOL_LINK "Rte_CalprmRom_CalRegn01Inin00_DEFAULT_RTE_CALPRM_GROUP.SysFricLrngFricHysHwAgPt_Ary1D" 0 DISPLAY_IDENTIFIER SysFricLrng.CalibrationPorts.SysFricLrngFricHysHwAgPt.Ary1D /end CHARACTERISTIC
/begin CHARACTERISTIC SysFricLrng.SysFricLrngFricOffs.Val "MICROSAR RTE" VALUE 0x0 RTE_RL_FLOAT32_IEEE 0 NO_COMPU_METHOD -3.402823466e+38 3.402823466e+38 SYMBOL_LINK "Rte_CalprmRom_CalRegn01Inin00_DEFAULT_RTE_CALPRM_GROUP.SysFricLrngFricOffs_Val" 0 DISPLAY_IDENTIFIER SysFricLrng.CalibrationPorts.SysFricLrngFricOffs.Val /end CHARACTERISTIC
/begin CHARACTERISTIC SysFricLrng.SysFricLrngFricOffsHiLim.Val "MICROSAR RTE" VALUE 0x0 RTE_RL_FLOAT32_IEEE 0 NO_COMPU_METHOD -3.402823466e+38 3.402823466e+38 SYMBOL_LINK "Rte_CalprmRom_CalRegn01Inin00_DEFAULT_RTE_CALPRM_GROUP.SysFricLrngFricOffsHiLim_Val" 0 DISPLAY_IDENTIFIER SysFricLrng.CalibrationPorts.SysFricLrngFricOffsHiLim.Val /end CHARACTERISTIC
/begin CHARACTERISTIC SysFricLrng.SysFricLrngFricOffsLoLim.Val "MICROSAR RTE" VALUE 0x0 RTE_RL_FLOAT32_IEEE 0 NO_COMPU_METHOD -3.402823466e+38 3.402823466e+38 SYMBOL_LINK "Rte_CalprmRom_CalRegn01Inin00_DEFAULT_RTE_CALPRM_GROUP.SysFricLrngFricOffsLoLim_Val" 0 DISPLAY_IDENTIFIER SysFricLrng.CalibrationPorts.SysFricLrngFricOffsLoLim.Val /end CHARACTERISTIC
/begin CHARACTERISTIC SysFricLrng.SysFricLrngFricOffsLpFilFrq.Val "MICROSAR RTE" VALUE 0x0 RTE_RL_FLOAT32_IEEE 0 NO_COMPU_METHOD -3.402823466e+38 3.402823466e+38 SYMBOL_LINK "Rte_CalprmRom_CalRegn01Inin00_DEFAULT_RTE_CALPRM_GROUP.SysFricLrngFricOffsLpFilFrq_Val" 0 DISPLAY_IDENTIFIER SysFricLrng.CalibrationPorts.SysFricLrngFricOffsLpFilFrq.Val /end CHARACTERISTIC
/begin CHARACTERISTIC SysFricLrng.SysFricLrngGain.Val "MICROSAR RTE" VALUE 0x0 RTE_RL_FLOAT32_IEEE 0 NO_COMPU_METHOD -3.402823466e+38 3.402823466e+38 SYMBOL_LINK "Rte_CalprmRom_CalRegn01Inin00_DEFAULT_RTE_CALPRM_GROUP.SysFricLrngGain_Val" 0 DISPLAY_IDENTIFIER SysFricLrng.CalibrationPorts.SysFricLrngGain.Val /end CHARACTERISTIC
/begin CHARACTERISTIC SysFricLrng.SysFricLrngHiFricDebStep.Val "MICROSAR RTE" VALUE 0x0 RTE_RL_UWORD 0 NO_COMPU_METHOD 0 65535 SYMBOL_LINK "Rte_CalprmRom_CalRegn01Inin00_DEFAULT_RTE_CALPRM_GROUP.SysFricLrngHiFricDebStep_Val" 0 DISPLAY_IDENTIFIER SysFricLrng.CalibrationPorts.SysFricLrngHiFricDebStep.Val /end CHARACTERISTIC
/begin CHARACTERISTIC SysFricLrng.SysFricLrngHiFricDiagcThd.Val "MICROSAR RTE" VALUE 0x0 RTE_RL_FLOAT32_IEEE 0 NO_COMPU_METHOD -3.402823466e+38 3.402823466e+38 SYMBOL_LINK "Rte_CalprmRom_CalRegn01Inin00_DEFAULT_RTE_CALPRM_GROUP.SysFricLrngHiFricDiagcThd_Val" 0 DISPLAY_IDENTIFIER SysFricLrng.CalibrationPorts.SysFricLrngHiFricDiagcThd.Val /end CHARACTERISTIC
/begin CHARACTERISTIC SysFricLrng.SysFricLrngHwPosnAuthyThd.Val "MICROSAR RTE" VALUE 0x0 RTE_RL_FLOAT32_IEEE 0 NO_COMPU_METHOD -3.402823466e+38 3.402823466e+38 SYMBOL_LINK "Rte_CalprmRom_CalRegn01Inin00_DEFAULT_RTE_CALPRM_GROUP.SysFricLrngHwPosnAuthyThd_Val" 0 DISPLAY_IDENTIFIER SysFricLrng.CalibrationPorts.SysFricLrngHwPosnAuthyThd.Val /end CHARACTERISTIC
/begin CHARACTERISTIC SysFricLrng.SysFricLrngHwVelConstrLim.Val "MICROSAR RTE" VALUE 0x0 RTE_RL_FLOAT32_IEEE 0 NO_COMPU_METHOD -3.402823466e+38 3.402823466e+38 SYMBOL_LINK "Rte_CalprmRom_CalRegn01Inin00_DEFAULT_RTE_CALPRM_GROUP.SysFricLrngHwVelConstrLim_Val" 0 DISPLAY_IDENTIFIER SysFricLrng.CalibrationPorts.SysFricLrngHwVelConstrLim.Val /end CHARACTERISTIC
/begin CHARACTERISTIC SysFricLrng.SysFricLrngHwVelHiLim.Val "MICROSAR RTE" VALUE 0x0 RTE_RL_FLOAT32_IEEE 0 NO_COMPU_METHOD -3.402823466e+38 3.402823466e+38 SYMBOL_LINK "Rte_CalprmRom_CalRegn01Inin00_DEFAULT_RTE_CALPRM_GROUP.SysFricLrngHwVelHiLim_Val" 0 DISPLAY_IDENTIFIER SysFricLrng.CalibrationPorts.SysFricLrngHwVelHiLim.Val /end CHARACTERISTIC
/begin CHARACTERISTIC SysFricLrng.SysFricLrngHwVelLoLim.Val "MICROSAR RTE" VALUE 0x0 RTE_RL_FLOAT32_IEEE 0 NO_COMPU_METHOD -3.402823466e+38 3.402823466e+38 SYMBOL_LINK "Rte_CalprmRom_CalRegn01Inin00_DEFAULT_RTE_CALPRM_GROUP.SysFricLrngHwVelLoLim_Val" 0 DISPLAY_IDENTIFIER SysFricLrng.CalibrationPorts.SysFricLrngHwVelLoLim.Val /end CHARACTERISTIC
/begin CHARACTERISTIC SysFricLrng.SysFricLrngIgnCycFricChgLim.Val "MICROSAR RTE" VALUE 0x0 RTE_RL_FLOAT32_IEEE 0 NO_COMPU_METHOD -3.402823466e+38 3.402823466e+38 SYMBOL_LINK "Rte_CalprmRom_CalRegn01Inin00_DEFAULT_RTE_CALPRM_GROUP.SysFricLrngIgnCycFricChgLim_Val" 0 DISPLAY_IDENTIFIER SysFricLrng.CalibrationPorts.SysFricLrngIgnCycFricChgLim.Val /end CHARACTERISTIC
/begin CHARACTERISTIC SysFricLrng.SysFricLrngIgnCycFricOffs.Val "MICROSAR RTE" VALUE 0x0 RTE_RL_FLOAT32_IEEE 0 NO_COMPU_METHOD -3.402823466e+38 3.402823466e+38 SYMBOL_LINK "Rte_CalprmRom_CalRegn01Inin00_DEFAULT_RTE_CALPRM_GROUP.SysFricLrngIgnCycFricOffs_Val" 0 DISPLAY_IDENTIFIER SysFricLrng.CalibrationPorts.SysFricLrngIgnCycFricOffs.Val /end CHARACTERISTIC
/begin CHARACTERISTIC SysFricLrng.SysFricLrngIvsTrsmRatX.Ary1D "MICROSAR RTE" VAL_BLK 0x0 RTE_RL_UWORD 0 NO_COMPU_METHOD 0 65535 MATRIX_DIM 10 1 1 SYMBOL_LINK "Rte_CalprmRom_CalRegn01Inin00_DEFAULT_RTE_CALPRM_GROUP.SysFricLrngIvsTrsmRatX_Ary1D" 0 DISPLAY_IDENTIFIER SysFricLrng.CalibrationPorts.SysFricLrngIvsTrsmRatX.Ary1D /end CHARACTERISTIC
/begin CHARACTERISTIC SysFricLrng.SysFricLrngIvsTrsmRatY.Ary1D "MICROSAR RTE" VAL_BLK 0x0 RTE_RL_UWORD 0 NO_COMPU_METHOD 0 65535 MATRIX_DIM 10 1 1 SYMBOL_LINK "Rte_CalprmRom_CalRegn01Inin00_DEFAULT_RTE_CALPRM_GROUP.SysFricLrngIvsTrsmRatY_Ary1D" 0 DISPLAY_IDENTIFIER SysFricLrng.CalibrationPorts.SysFricLrngIvsTrsmRatY.Ary1D /end CHARACTERISTIC
/begin CHARACTERISTIC SysFricLrng.SysFricLrngLatAHiLim.Val "MICROSAR RTE" VALUE 0x0 RTE_RL_FLOAT32_IEEE 0 NO_COMPU_METHOD -3.402823466e+38 3.402823466e+38 SYMBOL_LINK "Rte_CalprmRom_CalRegn01Inin00_DEFAULT_RTE_CALPRM_GROUP.SysFricLrngLatAHiLim_Val" 0 DISPLAY_IDENTIFIER SysFricLrng.CalibrationPorts.SysFricLrngLatAHiLim.Val /end CHARACTERISTIC
/begin CHARACTERISTIC SysFricLrng.SysFricLrngLatALoLim.Val "MICROSAR RTE" VALUE 0x0 RTE_RL_FLOAT32_IEEE 0 NO_COMPU_METHOD -3.402823466e+38 3.402823466e+38 SYMBOL_LINK "Rte_CalprmRom_CalRegn01Inin00_DEFAULT_RTE_CALPRM_GROUP.SysFricLrngLatALoLim_Val" 0 DISPLAY_IDENTIFIER SysFricLrng.CalibrationPorts.SysFricLrngLatALoLim.Val /end CHARACTERISTIC
/begin CHARACTERISTIC SysFricLrng.SysFricLrngMaskVehSpd.Ary1D "MICROSAR RTE" VAL_BLK 0x0 RTE_RL_BOOLEAN 0 RTE_CM_BOOLEAN 0 255 MATRIX_DIM 4 1 1 SYMBOL_LINK "Rte_CalprmRom_CalRegn01Inin00_DEFAULT_RTE_CALPRM_GROUP.SysFricLrngMaskVehSpd_Ary1D" 0 DISPLAY_IDENTIFIER SysFricLrng.CalibrationPorts.SysFricLrngMaskVehSpd.Ary1D /end CHARACTERISTIC
/begin CHARACTERISTIC SysFricLrng.SysFricLrngRngCntrThd.Val "MICROSAR RTE" VALUE 0x0 RTE_RL_UWORD 0 NO_COMPU_METHOD 0 65535 SYMBOL_LINK "Rte_CalprmRom_CalRegn01Inin00_DEFAULT_RTE_CALPRM_GROUP.SysFricLrngRngCntrThd_Val" 0 DISPLAY_IDENTIFIER SysFricLrng.CalibrationPorts.SysFricLrngRngCntrThd.Val /end CHARACTERISTIC
/begin CHARACTERISTIC SysFricLrng.SysFricLrngTHiLim.Val "MICROSAR RTE" VALUE 0x0 RTE_RL_FLOAT32_IEEE 0 NO_COMPU_METHOD -3.402823466e+38 3.402823466e+38 SYMBOL_LINK "Rte_CalprmRom_CalRegn01Inin00_DEFAULT_RTE_CALPRM_GROUP.SysFricLrngTHiLim_Val" 0 DISPLAY_IDENTIFIER SysFricLrng.CalibrationPorts.SysFricLrngTHiLim.Val /end CHARACTERISTIC
/begin CHARACTERISTIC SysFricLrng.SysFricLrngTLoLim.Val "MICROSAR RTE" VALUE 0x0 RTE_RL_FLOAT32_IEEE 0 NO_COMPU_METHOD -3.402823466e+38 3.402823466e+38 SYMBOL_LINK "Rte_CalprmRom_CalRegn01Inin00_DEFAULT_RTE_CALPRM_GROUP.SysFricLrngTLoLim_Val" 0 DISPLAY_IDENTIFIER SysFricLrng.CalibrationPorts.SysFricLrngTLoLim.Val /end CHARACTERISTIC
/begin CHARACTERISTIC SysFricLrng.SysFricLrngThd.Val "MICROSAR RTE" VALUE 0x0 RTE_RL_ULONG 0 NO_COMPU_METHOD 0 4294967295 SYMBOL_LINK "Rte_CalprmRom_CalRegn01Inin00_DEFAULT_RTE_CALPRM_GROUP.SysFricLrngThd_Val" 0 DISPLAY_IDENTIFIER SysFricLrng.CalibrationPorts.SysFricLrngThd.Val /end CHARACTERISTIC
/begin CHARACTERISTIC SysFricLrng.SysFricLrngVehSpd.Ary2D "MICROSAR RTE" VAL_BLK 0x0 RTE_RL_FLOAT32_IEEE 0 NO_COMPU_METHOD -3.402823466e+38 3.402823466e+38 MATRIX_DIM 2 4 1 SYMBOL_LINK "Rte_CalprmRom_CalRegn01Inin00_DEFAULT_RTE_CALPRM_GROUP.SysFricLrngVehSpd_Ary2D" 0 DISPLAY_IDENTIFIER SysFricLrng.CalibrationPorts.SysFricLrngVehSpd.Ary2D /end CHARACTERISTIC
/begin CHARACTERISTIC SysPrfmncSts.SysPrfmncStsAbsltCtrlTFltThd.Val "MICROSAR RTE" VALUE 0x0 RTE_RL_FLOAT32_IEEE 0 NO_COMPU_METHOD -3.402823466e+38 3.402823466e+38 SYMBOL_LINK "Rte_CalprmRom_CalRegn01Cmn_DEFAULT_RTE_CALPRM_GROUP.SysPrfmncStsAbsltCtrlTFltThd_Val" 0 DISPLAY_IDENTIFIER SysPrfmncSts.CalibrationPorts.SysPrfmncStsAbsltCtrlTFltThd.Val /end CHARACTERISTIC
/begin CHARACTERISTIC SysPrfmncSts.SysPrfmncStsAssiStallLimDecThd.Val "MICROSAR RTE" VALUE 0x0 RTE_RL_FLOAT32_IEEE 0 NO_COMPU_METHOD -3.402823466e+38 3.402823466e+38 SYMBOL_LINK "Rte_CalprmRom_CalRegn01Cmn_DEFAULT_RTE_CALPRM_GROUP.SysPrfmncStsAssiStallLimDecThd_Val" 0 DISPLAY_IDENTIFIER SysPrfmncSts.CalibrationPorts.SysPrfmncStsAssiStallLimDecThd.Val /end CHARACTERISTIC
/begin CHARACTERISTIC SysPrfmncSts.SysPrfmncStsBattDiagcHiCrit.Val "MICROSAR RTE" VALUE 0x0 RTE_RL_FLOAT32_IEEE 0 NO_COMPU_METHOD -3.402823466e+38 3.402823466e+38 SYMBOL_LINK "Rte_CalprmRom_CalRegn01Cmn_DEFAULT_RTE_CALPRM_GROUP.SysPrfmncStsBattDiagcHiCrit_Val" 0 DISPLAY_IDENTIFIER SysPrfmncSts.CalibrationPorts.SysPrfmncStsBattDiagcHiCrit.Val /end CHARACTERISTIC
/begin CHARACTERISTIC SysPrfmncSts.SysPrfmncStsBattDiagcHiWarn.Val "MICROSAR RTE" VALUE 0x0 RTE_RL_FLOAT32_IEEE 0 NO_COMPU_METHOD -3.402823466e+38 3.402823466e+38 SYMBOL_LINK "Rte_CalprmRom_CalRegn01Cmn_DEFAULT_RTE_CALPRM_GROUP.SysPrfmncStsBattDiagcHiWarn_Val" 0 DISPLAY_IDENTIFIER SysPrfmncSts.CalibrationPorts.SysPrfmncStsBattDiagcHiWarn.Val /end CHARACTERISTIC
/begin CHARACTERISTIC SysPrfmncSts.SysPrfmncStsBattDiagcLoCrit.Val "MICROSAR RTE" VALUE 0x0 RTE_RL_FLOAT32_IEEE 0 NO_COMPU_METHOD -3.402823466e+38 3.402823466e+38 SYMBOL_LINK "Rte_CalprmRom_CalRegn01Cmn_DEFAULT_RTE_CALPRM_GROUP.SysPrfmncStsBattDiagcLoCrit_Val" 0 DISPLAY_IDENTIFIER SysPrfmncSts.CalibrationPorts.SysPrfmncStsBattDiagcLoCrit.Val /end CHARACTERISTIC
/begin CHARACTERISTIC SysPrfmncSts.SysPrfmncStsBattDiagcLoWarn.Val "MICROSAR RTE" VALUE 0x0 RTE_RL_FLOAT32_IEEE 0 NO_COMPU_METHOD -3.402823466e+38 3.402823466e+38 SYMBOL_LINK "Rte_CalprmRom_CalRegn01Cmn_DEFAULT_RTE_CALPRM_GROUP.SysPrfmncStsBattDiagcLoWarn_Val" 0 DISPLAY_IDENTIFIER SysPrfmncSts.CalibrationPorts.SysPrfmncStsBattDiagcLoWarn.Val /end CHARACTERISTIC
/begin CHARACTERISTIC SysPrfmncSts.SysPrfmncStsBattVltgFilFrq.Val "MICROSAR RTE" VALUE 0x0 RTE_RL_FLOAT32_IEEE 0 NO_COMPU_METHOD -3.402823466e+38 3.402823466e+38 SYMBOL_LINK "Rte_CalprmRom_CalRegn01Cmn_DEFAULT_RTE_CALPRM_GROUP.SysPrfmncStsBattVltgFilFrq_Val" 0 DISPLAY_IDENTIFIER SysPrfmncSts.CalibrationPorts.SysPrfmncStsBattVltgFilFrq.Val /end CHARACTERISTIC
/begin CHARACTERISTIC SysPrfmncSts.SysPrfmncStsDutyCycLvlFltThd.Val "MICROSAR RTE" VALUE 0x0 RTE_RL_UWORD 0 NO_COMPU_METHOD 0 65535 SYMBOL_LINK "Rte_CalprmRom_CalRegn01Cmn_DEFAULT_RTE_CALPRM_GROUP.SysPrfmncStsDutyCycLvlFltThd_Val" 0 DISPLAY_IDENTIFIER SysPrfmncSts.CalibrationPorts.SysPrfmncStsDutyCycLvlFltThd.Val /end CHARACTERISTIC
/begin CHARACTERISTIC SysPrfmncSts.SysPrfmncStsLoadDptLimDecThd.Val "MICROSAR RTE" VALUE 0x0 RTE_RL_FLOAT32_IEEE 0 NO_COMPU_METHOD -3.402823466e+38 3.402823466e+38 SYMBOL_LINK "Rte_CalprmRom_CalRegn01Cmn_DEFAULT_RTE_CALPRM_GROUP.SysPrfmncStsLoadDptLimDecThd_Val" 0 DISPLAY_IDENTIFIER SysPrfmncSts.CalibrationPorts.SysPrfmncStsLoadDptLimDecThd.Val /end CHARACTERISTIC
/begin CHARACTERISTIC SysPrfmncSts.SysPrfmncStsTDptLimThd.Val "MICROSAR RTE" VALUE 0x0 RTE_RL_FLOAT32_IEEE 0 NO_COMPU_METHOD -3.402823466e+38 3.402823466e+38 SYMBOL_LINK "Rte_CalprmRom_CalRegn01Cmn_DEFAULT_RTE_CALPRM_GROUP.SysPrfmncStsTDptLimThd_Val" 0 DISPLAY_IDENTIFIER SysPrfmncSts.CalibrationPorts.SysPrfmncStsTDptLimThd.Val /end CHARACTERISTIC
/begin MEASUREMENT PwrLimr.dPwrLimrSpdAdj "MICROSAR RTE" FLOAT32_IEEE NO_COMPU_METHOD 0 0 -3.402823466e+38 3.402823466e+38 ECU_ADDRESS 0 SYMBOL_LINK "Rte_PwrLimr_dPwrLimrSpdAdj" 0 DISPLAY_IDENTIFIER PwrLimr.PerInstanceMemories.dPwrLimrSpdAdj /end MEASUREMENT
/begin MEASUREMENT PwrLimr.dPwrLimrTLimMaxCurr "MICROSAR RTE" FLOAT32_IEEE NO_COMPU_METHOD 0 0 -3.402823466e+38 3.402823466e+38 ECU_ADDRESS 0 SYMBOL_LINK "Rte_PwrLimr_dPwrLimrTLimMaxCurr" 0 DISPLAY_IDENTIFIER PwrLimr.PerInstanceMemories.dPwrLimrTLimMaxCurr /end MEASUREMENT
/begin MEASUREMENT PwrLimr.dPwrLimrTqEnvlpLim1 "MICROSAR RTE" FLOAT32_IEEE NO_COMPU_METHOD 0 0 -3.402823466e+38 3.402823466e+38 ECU_ADDRESS 0 SYMBOL_LINK "Rte_PwrLimr_dPwrLimrTqEnvlpLim1" 0 DISPLAY_IDENTIFIER PwrLimr.PerInstanceMemories.dPwrLimrTqEnvlpLim1 /end MEASUREMENT
/begin MEASUREMENT PwrLimr.dPwrLimrTqEnvlpLim4 "MICROSAR RTE" FLOAT32_IEEE NO_COMPU_METHOD 0 0 -3.402823466e+38 3.402823466e+38 ECU_ADDRESS 0 SYMBOL_LINK "Rte_PwrLimr_dPwrLimrTqEnvlpLim4" 0 DISPLAY_IDENTIFIER PwrLimr.PerInstanceMemories.dPwrLimrTqEnvlpLim4 /end MEASUREMENT
/begin MEASUREMENT PwrLimr.dPwrLimrTqLim "MICROSAR RTE" FLOAT32_IEEE NO_COMPU_METHOD 0 0 -3.402823466e+38 3.402823466e+38 ECU_ADDRESS 0 SYMBOL_LINK "Rte_PwrLimr_dPwrLimrTqLim" 0 DISPLAY_IDENTIFIER PwrLimr.PerInstanceMemories.dPwrLimrTqLim /end MEASUREMENT
/begin MEASUREMENT PwrLimr.dPwrLimrTqLim1 "MICROSAR RTE" FLOAT32_IEEE NO_COMPU_METHOD 0 0 -3.402823466e+38 3.402823466e+38 ECU_ADDRESS 0 SYMBOL_LINK "Rte_PwrLimr_dPwrLimrTqLim1" 0 DISPLAY_IDENTIFIER PwrLimr.PerInstanceMemories.dPwrLimrTqLim1 /end MEASUREMENT
/begin MEASUREMENT PwrLimr.dPwrLimrTqLim4 "MICROSAR RTE" FLOAT32_IEEE NO_COMPU_METHOD 0 0 -3.402823466e+38 3.402823466e+38 ECU_ADDRESS 0 SYMBOL_LINK "Rte_PwrLimr_dPwrLimrTqLim4" 0 DISPLAY_IDENTIFIER PwrLimr.PerInstanceMemories.dPwrLimrTqLim4 /end MEASUREMENT
/begin MEASUREMENT PwrSply.ReadWrOrderFlg1 "MICROSAR RTE" UBYTE RTE_CM_BOOLEAN 0 0 0 255 ECU_ADDRESS 0 SYMBOL_LINK "Rte_PwrSply_ReadWrOrderFlg1" 0 DISPLAY_IDENTIFIER PwrSply.PerInstanceMemories.ReadWrOrderFlg1 /end MEASUREMENT
/begin MEASUREMENT PwrSply.ReadWrOrderFlg2 "MICROSAR RTE" UBYTE RTE_CM_BOOLEAN 0 0 0 255 ECU_ADDRESS 0 SYMBOL_LINK "Rte_PwrSply_ReadWrOrderFlg2" 0 DISPLAY_IDENTIFIER PwrSply.PerInstanceMemories.ReadWrOrderFlg2 /end MEASUREMENT
/begin MEASUREMENT PwrSply.SpiTrsmErrCntr "MICROSAR RTE" UWORD NO_COMPU_METHOD 0 0 0 65535 ECU_ADDRESS 0 SYMBOL_LINK "Rte_PwrSply_SpiTrsmErrCntr" 0 DISPLAY_IDENTIFIER PwrSply.PerInstanceMemories.SpiTrsmErrCntr /end MEASUREMENT
/begin MEASUREMENT PwrSply.StrtUpSelfTestCmpl "MICROSAR RTE" UBYTE RTE_CM_BOOLEAN 0 0 0 255 ECU_ADDRESS 0 SYMBOL_LINK "Rte_PwrSply_StrtUpSelfTestCmpl" 0 DISPLAY_IDENTIFIER PwrSply.PerInstanceMemories.StrtUpSelfTestCmpl /end MEASUREMENT
/begin MEASUREMENT PwrSply.SysSt.Val "MICROSAR RTE" UBYTE RTE_CM_ENUM_SysSt1 0 0 0 255 ECU_ADDRESS 0 SYMBOL_LINK "Rte_SysStMod_SysSt_Val" 0 DISPLAY_IDENTIFIER PwrSply.ReceiverPorts.SysSt.Val /end MEASUREMENT
/begin MEASUREMENT PwrUpSeq.CodFlsCrcChkCmpl.Logl "MICROSAR RTE" UBYTE RTE_CM_BOOLEAN 0 0 0 255 ECU_ADDRESS 0 SYMBOL_LINK "Rte_CDD_FlsMem_CodFlsCrcChkCmpl_Logl" 0 DISPLAY_IDENTIFIER PwrUpSeq.ReceiverPorts.CodFlsCrcChkCmpl.Logl /end MEASUREMENT
/begin MEASUREMENT PwrUpSeq.CurrMeasWrmIninTestCmpl.Logl "MICROSAR RTE" UBYTE RTE_CM_BOOLEAN 0 0 0 255 ECU_ADDRESS 0 SYMBOL_LINK "Rte_CDD_CurrMeas_CurrMeasWrmIninTestCmpl_Logl" 0 DISPLAY_IDENTIFIER PwrUpSeq.ReceiverPorts.CurrMeasWrmIninTestCmpl.Logl /end MEASUREMENT
/begin MEASUREMENT PwrUpSeq.MotDrvr0IninTestCmpl.Logl "MICROSAR RTE" UBYTE RTE_CM_BOOLEAN 0 0 0 255 ECU_ADDRESS 0 SYMBOL_LINK "Rte_GateDrv0Ctrl_MotDrvr0IninTestCmpl_Logl" 0 DISPLAY_IDENTIFIER PwrUpSeq.ReceiverPorts.MotDrvr0IninTestCmpl.Logl /end MEASUREMENT
/begin MEASUREMENT PwrUpSeq.MotDrvr1IninTestCmpl.Logl "MICROSAR RTE" UBYTE RTE_CM_BOOLEAN 0 0 0 255 ECU_ADDRESS 0 SYMBOL_LINK "Rte_CDD_FordT3T6McuCfg_MotDrvr1IninTestCmpl_Logl" 0 DISPLAY_IDENTIFIER PwrUpSeq.ReceiverPorts.MotDrvr1IninTestCmpl.Logl /end MEASUREMENT
/begin MEASUREMENT PwrUpSeq.PwrDiscnctATestCmpl.Logl "MICROSAR RTE" UBYTE RTE_CM_BOOLEAN 0 0 0 255 ECU_ADDRESS 0 SYMBOL_LINK "Rte_PwrDiscnct_PwrDiscnctATestCmpl_Logl" 0 DISPLAY_IDENTIFIER PwrUpSeq.ReceiverPorts.PwrDiscnctATestCmpl.Logl /end MEASUREMENT
/begin MEASUREMENT PwrUpSeq.PwrDiscnctBTestCmpl.Logl "MICROSAR RTE" UBYTE RTE_CM_BOOLEAN 0 0 0 255 ECU_ADDRESS 0 SYMBOL_LINK "Rte_PwrDiscnct_PwrDiscnctBTestCmpl_Logl" 0 DISPLAY_IDENTIFIER PwrUpSeq.ReceiverPorts.PwrDiscnctBTestCmpl.Logl /end MEASUREMENT
/begin MEASUREMENT PwrUpSeq.PwrTurnOffCtrlPrev "MICROSAR RTE" UBYTE NO_COMPU_METHOD 0 0 0 255 ECU_ADDRESS 0 SYMBOL_LINK "Rte_PwrUpSeq_PwrTurnOffCtrlPrev" 0 DISPLAY_IDENTIFIER PwrUpSeq.PerInstanceMemories.PwrTurnOffCtrlPrev /end MEASUREMENT
/begin MEASUREMENT PwrUpSeq.StrtUpSt.Val "MICROSAR RTE" UBYTE NO_COMPU_METHOD 0 0 0 255 ECU_ADDRESS 0 SYMBOL_LINK "Rte_PwrUpSeq_StrtUpSt_Val" 0 DISPLAY_IDENTIFIER PwrUpSeq.SenderPorts.StrtUpSt.Val /end MEASUREMENT
/begin MEASUREMENT PwrUpSeq.SysSt.Val "MICROSAR RTE" UBYTE RTE_CM_ENUM_SysSt1 0 0 0 255 ECU_ADDRESS 0 SYMBOL_LINK "Rte_SysStMod_SysSt_Val" 0 DISPLAY_IDENTIFIER PwrUpSeq.ReceiverPorts.SysSt.Val /end MEASUREMENT
/begin MEASUREMENT PwrUpSeq.SysStWrmIninCmpl.Logl "MICROSAR RTE" UBYTE RTE_CM_BOOLEAN 0 0 0 255 ECU_ADDRESS 0 SYMBOL_LINK "Rte_PwrUpSeq_SysStWrmIninCmpl_Logl" 0 DISPLAY_IDENTIFIER PwrUpSeq.SenderPorts.SysStWrmIninCmpl.Logl /end MEASUREMENT
/begin MEASUREMENT PwrUpSeq.TmplMonIninTestCmpl.Logl "MICROSAR RTE" UBYTE RTE_CM_BOOLEAN 0 0 0 255 ECU_ADDRESS 0 SYMBOL_LINK "Rte_TmplMonr_TmplMonrIninTestCmpl_Logl" 0 DISPLAY_IDENTIFIER PwrUpSeq.ReceiverPorts.TmplMonIninTestCmpl.Logl /end MEASUREMENT
/begin MEASUREMENT Rtn.AssiMechT.Val "MICROSAR RTE" FLOAT32_IEEE NO_COMPU_METHOD 0 0 -3.402823466e+38 3.402823466e+38 ECU_ADDRESS 0 SYMBOL_LINK "Rte_TEstimn_AssiMechT_Val" 0 DISPLAY_IDENTIFIER Rtn.ReceiverPorts.AssiMechT.Val /end MEASUREMENT
/begin MEASUREMENT Rtn.HwAg.Val "MICROSAR RTE" FLOAT32_IEEE NO_COMPU_METHOD 0 0 -3.402823466e+38 3.402823466e+38 ECU_ADDRESS 0 SYMBOL_LINK "Rte_ImcSigArbn_HwAgImcCorrd_Val" 0 DISPLAY_IDENTIFIER Rtn.ReceiverPorts.HwAg.Val /end MEASUREMENT
/begin MEASUREMENT Rtn.HwAgAuthySca.Val "MICROSAR RTE" FLOAT32_IEEE NO_COMPU_METHOD 0 0 -3.402823466e+38 3.402823466e+38 ECU_ADDRESS 0 SYMBOL_LINK "Rte_HwAgSysArbn_PinionAgConf_Val" 0 DISPLAY_IDENTIFIER Rtn.ReceiverPorts.HwAgAuthySca.Val /end MEASUREMENT
/begin MEASUREMENT Rtn.HwAgRtnOffs.Val "MICROSAR RTE" FLOAT32_IEEE NO_COMPU_METHOD 0 0 -3.402823466e+38 3.402823466e+38 ECU_ADDRESS 0 SYMBOL_LINK "Rte_Rtn_HwAgRtnOffs_Val" 0 DISPLAY_IDENTIFIER Rtn.ReceiverPorts.HwAgRtnOffs.Val /end MEASUREMENT
/begin MEASUREMENT Rtn.HwTq.Val "MICROSAR RTE" FLOAT32_IEEE NO_COMPU_METHOD 0 0 -3.402823466e+38 3.402823466e+38 ECU_ADDRESS 0 SYMBOL_LINK "Rte_ImcSigArbn_HwTqImcCorrd_Val" 0 DISPLAY_IDENTIFIER Rtn.ReceiverPorts.HwTq.Val /end MEASUREMENT
/begin MEASUREMENT Rtn.HwVel.Val "MICROSAR RTE" FLOAT32_IEEE NO_COMPU_METHOD 0 0 -3.402823466e+38 3.402823466e+38 ECU_ADDRESS 0 SYMBOL_LINK "Rte_HwAgSysArbn_HwVel_Val" 0 DISPLAY_IDENTIFIER Rtn.ReceiverPorts.HwVel.Val /end MEASUREMENT
/begin MEASUREMENT Rtn.PrevHwAgAuthy "MICROSAR RTE" FLOAT32_IEEE NO_COMPU_METHOD 0 0 -3.402823466e+38 3.402823466e+38 ECU_ADDRESS 0 SYMBOL_LINK "Rte_Rtn_PrevHwAgAuthy" 0 DISPLAY_IDENTIFIER Rtn.PerInstanceMemories.PrevHwAgAuthy /end MEASUREMENT
/begin MEASUREMENT Rtn.PrevHwAgOffsLimd "MICROSAR RTE" FLOAT32_IEEE NO_COMPU_METHOD 0 0 -3.402823466e+38 3.402823466e+38 ECU_ADDRESS 0 SYMBOL_LINK "Rte_Rtn_PrevHwAgOffsLimd" 0 DISPLAY_IDENTIFIER Rtn.PerInstanceMemories.PrevHwAgOffsLimd /end MEASUREMENT
/begin MEASUREMENT Rtn.RtnCmd.Val "MICROSAR RTE" FLOAT32_IEEE NO_COMPU_METHOD 0 0 -3.402823466e+38 3.402823466e+38 ECU_ADDRESS 0 SYMBOL_LINK "Rte_Rtn_RtnCmd_Val" 0 DISPLAY_IDENTIFIER Rtn.SenderPorts.RtnCmd.Val /end MEASUREMENT
/begin MEASUREMENT Rtn.RtnCmdDi.Logl "MICROSAR RTE" UBYTE RTE_CM_BOOLEAN 0 0 0 255 ECU_ADDRESS 0 SYMBOL_LINK "Rte_CmnMfgSrv_RtnCmdDi_Logl" 0 DISPLAY_IDENTIFIER Rtn.ReceiverPorts.RtnCmdDi.Logl /end MEASUREMENT
/begin MEASUREMENT Rtn.RtnCmdDiagcDi.Logl "MICROSAR RTE" UBYTE RTE_CM_BOOLEAN 0 0 0 255 ECU_ADDRESS 0 SYMBOL_LINK "Rte_CustDiag_FordActvRtnEnad_Logl" 0 DISPLAY_IDENTIFIER Rtn.ReceiverPorts.RtnCmdDiagcDi.Logl /end MEASUREMENT
/begin MEASUREMENT Rtn.RtnCmdSca.Val "MICROSAR RTE" FLOAT32_IEEE NO_COMPU_METHOD 0 0 -3.402823466e+38 3.402823466e+38 ECU_ADDRESS 0 SYMBOL_LINK "Rte_Rtn_RtnCmdSca_Val" 0 DISPLAY_IDENTIFIER Rtn.ReceiverPorts.RtnCmdSca.Val /end MEASUREMENT
/begin MEASUREMENT Rtn.RtnCmdScaServo.Val "MICROSAR RTE" FLOAT32_IEEE NO_COMPU_METHOD 0 0 -3.402823466e+38 3.402823466e+38 ECU_ADDRESS 0 SYMBOL_LINK "Rte_Rtn_RtnCmdScaServo_Val" 0 DISPLAY_IDENTIFIER Rtn.ReceiverPorts.RtnCmdScaServo.Val /end MEASUREMENT
/begin MEASUREMENT Rtn.VehSpd.Val "MICROSAR RTE" FLOAT32_IEEE NO_COMPU_METHOD 0 0 -3.402823466e+38 3.402823466e+38 ECU_ADDRESS 0 SYMBOL_LINK "Rte_ImcSigArbn_VehSpdImcCorrd_Val" 0 DISPLAY_IDENTIFIER Rtn.ReceiverPorts.VehSpd.Val /end MEASUREMENT
/begin MEASUREMENT Rtn.VehSpdVld.Logl "MICROSAR RTE" UBYTE RTE_CM_BOOLEAN 0 0 0 255 ECU_ADDRESS 0 SYMBOL_LINK "Rte_VehSigCdng_VehSpdVld_Logl" 0 DISPLAY_IDENTIFIER Rtn.ReceiverPorts.VehSpdVld.Logl /end MEASUREMENT
/begin MEASUREMENT Rtn.dRtnAbsltHwAg "MICROSAR RTE" FLOAT32_IEEE NO_COMPU_METHOD 0 0 -3.402823466e+38 3.402823466e+38 ECU_ADDRESS 0 SYMBOL_LINK "Rte_Rtn_dRtnAbsltHwAg" 0 DISPLAY_IDENTIFIER Rtn.PerInstanceMemories.dRtnAbsltHwAg /end MEASUREMENT
/begin MEASUREMENT Rtn.dRtnAssiMechTRtnSca "MICROSAR RTE" FLOAT32_IEEE NO_COMPU_METHOD 0 0 -3.402823466e+38 3.402823466e+38 ECU_ADDRESS 0 SYMBOL_LINK "Rte_Rtn_dRtnAssiMechTRtnSca" 0 DISPLAY_IDENTIFIER Rtn.PerInstanceMemories.dRtnAssiMechTRtnSca /end MEASUREMENT
/begin MEASUREMENT Rtn.dRtnBascRtn "MICROSAR RTE" FLOAT32_IEEE NO_COMPU_METHOD 0 0 -3.402823466e+38 3.402823466e+38 ECU_ADDRESS 0 SYMBOL_LINK "Rte_Rtn_dRtnBascRtn" 0 DISPLAY_IDENTIFIER Rtn.PerInstanceMemories.dRtnBascRtn /end MEASUREMENT
/begin MEASUREMENT Rtn.dRtnHwAgAuthySca "MICROSAR RTE" FLOAT32_IEEE NO_COMPU_METHOD 0 0 -3.402823466e+38 3.402823466e+38 ECU_ADDRESS 0 SYMBOL_LINK "Rte_Rtn_dRtnHwAgAuthySca" 0 DISPLAY_IDENTIFIER Rtn.PerInstanceMemories.dRtnHwAgAuthySca /end MEASUREMENT
/begin MEASUREMENT Rtn.dRtnHwAgRtnCmd "MICROSAR RTE" FLOAT32_IEEE NO_COMPU_METHOD 0 0 -3.402823466e+38 3.402823466e+38 ECU_ADDRESS 0 SYMBOL_LINK "Rte_Rtn_dRtnHwAgRtnCmd" 0 DISPLAY_IDENTIFIER Rtn.PerInstanceMemories.dRtnHwAgRtnCmd /end MEASUREMENT
/begin MEASUREMENT Rtn.dRtnHwTqRtnSca "MICROSAR RTE" FLOAT32_IEEE NO_COMPU_METHOD 0 0 -3.402823466e+38 3.402823466e+38 ECU_ADDRESS 0 SYMBOL_LINK "Rte_Rtn_dRtnHwTqRtnSca" 0 DISPLAY_IDENTIFIER Rtn.PerInstanceMemories.dRtnHwTqRtnSca /end MEASUREMENT
/begin MEASUREMENT Rtn.dRtnHwVelRtnSca "MICROSAR RTE" FLOAT32_IEEE NO_COMPU_METHOD 0 0 -3.402823466e+38 3.402823466e+38 ECU_ADDRESS 0 SYMBOL_LINK "Rte_Rtn_dRtnHwVelRtnSca" 0 DISPLAY_IDENTIFIER Rtn.PerInstanceMemories.dRtnHwVelRtnSca /end MEASUREMENT
/begin MEASUREMENT RtnPahFwl.HwAg.Val "MICROSAR RTE" FLOAT32_IEEE NO_COMPU_METHOD 0 0 -3.402823466e+38 3.402823466e+38 ECU_ADDRESS 0 SYMBOL_LINK "Rte_ImcSigArbn_HwAgImcCorrd_Val" 0 DISPLAY_IDENTIFIER RtnPahFwl.ReceiverPorts.HwAg.Val /end MEASUREMENT
/begin MEASUREMENT RtnPahFwl.RtnCmd.Val "MICROSAR RTE" FLOAT32_IEEE NO_COMPU_METHOD 0 0 -3.402823466e+38 3.402823466e+38 ECU_ADDRESS 0 SYMBOL_LINK "Rte_Rtn_RtnCmd_Val" 0 DISPLAY_IDENTIFIER RtnPahFwl.ReceiverPorts.RtnCmd.Val /end MEASUREMENT
/begin MEASUREMENT RtnPahFwl.RtnCmdDi.Logl "MICROSAR RTE" UBYTE RTE_CM_BOOLEAN 0 0 0 255 ECU_ADDRESS 0 SYMBOL_LINK "Rte_CmnMfgSrv_RtnCmdDi_Logl" 0 DISPLAY_IDENTIFIER RtnPahFwl.ReceiverPorts.RtnCmdDi.Logl /end MEASUREMENT
/begin MEASUREMENT RtnPahFwl.RtnCmdLimd.Val "MICROSAR RTE" FLOAT32_IEEE NO_COMPU_METHOD 0 0 -3.402823466e+38 3.402823466e+38 ECU_ADDRESS 0 SYMBOL_LINK "Rte_RtnPahFwl_RtnCmdLimd_Val" 0 DISPLAY_IDENTIFIER RtnPahFwl.SenderPorts.RtnCmdLimd.Val /end MEASUREMENT
/begin MEASUREMENT RtnPahFwl.VehSpd.Val "MICROSAR RTE" FLOAT32_IEEE NO_COMPU_METHOD 0 0 -3.402823466e+38 3.402823466e+38 ECU_ADDRESS 0 SYMBOL_LINK "Rte_ImcSigArbn_VehSpdImcCorrd_Val" 0 DISPLAY_IDENTIFIER RtnPahFwl.ReceiverPorts.VehSpd.Val /end MEASUREMENT
/begin MEASUREMENT RtnPahFwl.dRtnPahFwlLowrBnd "MICROSAR RTE" FLOAT32_IEEE NO_COMPU_METHOD 0 0 -3.402823466e+38 3.402823466e+38 ECU_ADDRESS 0 SYMBOL_LINK "Rte_RtnPahFwl_dRtnPahFwlLowrBnd" 0 DISPLAY_IDENTIFIER RtnPahFwl.PerInstanceMemories.dRtnPahFwlLowrBnd /end MEASUREMENT
/begin MEASUREMENT RtnPahFwl.dRtnPahFwlOverBnd "MICROSAR RTE" UBYTE RTE_CM_BOOLEAN 0 0 0 255 ECU_ADDRESS 0 SYMBOL_LINK "Rte_RtnPahFwl_dRtnPahFwlOverBnd" 0 DISPLAY_IDENTIFIER RtnPahFwl.PerInstanceMemories.dRtnPahFwlOverBnd /end MEASUREMENT
/begin MEASUREMENT RtnPahFwl.dRtnPahFwlUpprBnd "MICROSAR RTE" FLOAT32_IEEE NO_COMPU_METHOD 0 0 -3.402823466e+38 3.402823466e+38 ECU_ADDRESS 0 SYMBOL_LINK "Rte_RtnPahFwl_dRtnPahFwlUpprBnd" 0 DISPLAY_IDENTIFIER RtnPahFwl.PerInstanceMemories.dRtnPahFwlUpprBnd /end MEASUREMENT
/begin MEASUREMENT ShtdwnMech.DiagcStsIvtr1Inactv.Logl "MICROSAR RTE" UBYTE RTE_CM_BOOLEAN 0 0 0 255 ECU_ADDRESS 0 SYMBOL_LINK "Rte_GateDrv0Ctrl_DiagcStsIvtr1Inactv_Logl" 0 DISPLAY_IDENTIFIER ShtdwnMech.ReceiverPorts.DiagcStsIvtr1Inactv.Logl /end MEASUREMENT
/begin MEASUREMENT ShtdwnMech.StrtUpSt.Val "MICROSAR RTE" UBYTE NO_COMPU_METHOD 0 0 0 255 ECU_ADDRESS 0 SYMBOL_LINK "Rte_PwrUpSeq_StrtUpSt_Val" 0 DISPLAY_IDENTIFIER ShtdwnMech.ReceiverPorts.StrtUpSt.Val /end MEASUREMENT
/begin MEASUREMENT StOutpCtrl.DiagcStsCtrldShtDwnFltPrsnt.Logl "MICROSAR RTE" UBYTE RTE_CM_BOOLEAN 0 0 0 255 ECU_ADDRESS 0 SYMBOL_LINK "Rte_DiagcMgr_DiagcStsCtrldShtDwnFltPrsnt_Logl" 0 DISPLAY_IDENTIFIER StOutpCtrl.ReceiverPorts.DiagcStsCtrldShtDwnFltPrsnt.Logl /end MEASUREMENT
/begin MEASUREMENT StOutpCtrl.LoaRateLim.Val "MICROSAR RTE" FLOAT32_IEEE NO_COMPU_METHOD 0 0 -3.402823466e+38 3.402823466e+38 ECU_ADDRESS 0 SYMBOL_LINK "Rte_LoaMgr_LoaRateLim_Val" 0 DISPLAY_IDENTIFIER StOutpCtrl.ReceiverPorts.LoaRateLim.Val /end MEASUREMENT
/begin MEASUREMENT StOutpCtrl.LoaSca.Val "MICROSAR RTE" FLOAT32_IEEE NO_COMPU_METHOD 0 0 -3.402823466e+38 3.402823466e+38 ECU_ADDRESS 0 SYMBOL_LINK "Rte_LoaMgr_LoaSca_Val" 0 DISPLAY_IDENTIFIER StOutpCtrl.ReceiverPorts.LoaSca.Val /end MEASUREMENT
/begin MEASUREMENT StOutpCtrl.MotTqTranlDampgCmpl.Logl "MICROSAR RTE" UBYTE RTE_CM_BOOLEAN 0 0 0 255 ECU_ADDRESS 0 SYMBOL_LINK "Rte_MotTqTranlDampg_MotTqTranlDampgCmpl_Logl" 0 DISPLAY_IDENTIFIER StOutpCtrl.ReceiverPorts.MotTqTranlDampgCmpl.Logl /end MEASUREMENT
/begin MEASUREMENT StOutpCtrl.StOutpCtrlPrevCmdSca "MICROSAR RTE" FLOAT32_IEEE NO_COMPU_METHOD 0 0 -3.402823466e+38 3.402823466e+38 ECU_ADDRESS 0 SYMBOL_LINK "Rte_StOutpCtrl_StOutpCtrlPrevCmdSca" 0 DISPLAY_IDENTIFIER StOutpCtrl.PerInstanceMemories.StOutpCtrlPrevCmdSca /end MEASUREMENT
/begin MEASUREMENT StOutpCtrl.StOutpCtrlPrevSrc "MICROSAR RTE" UBYTE NO_COMPU_METHOD 0 0 0 255 ECU_ADDRESS 0 SYMBOL_LINK "Rte_StOutpCtrl_StOutpCtrlPrevSrc" 0 DISPLAY_IDENTIFIER StOutpCtrl.PerInstanceMemories.StOutpCtrlPrevSrc /end MEASUREMENT
/begin MEASUREMENT StOutpCtrl.SysDiMotTqCmdSca.Val "MICROSAR RTE" FLOAT32_IEEE NO_COMPU_METHOD 0 0 -3.402823466e+38 3.402823466e+38 ECU_ADDRESS 0 SYMBOL_LINK "Rte_DiagcMgr_SysDiMotTqCmdSca_Val" 0 DISPLAY_IDENTIFIER StOutpCtrl.ReceiverPorts.SysDiMotTqCmdSca.Val /end MEASUREMENT
/begin MEASUREMENT StOutpCtrl.SysDiRampRate.Val "MICROSAR RTE" FLOAT32_IEEE NO_COMPU_METHOD 0 0 -3.402823466e+38 3.402823466e+38 ECU_ADDRESS 0 SYMBOL_LINK "Rte_DiagcMgr_SysDiRampRate_Val" 0 DISPLAY_IDENTIFIER StOutpCtrl.ReceiverPorts.SysDiRampRate.Val /end MEASUREMENT
/begin MEASUREMENT StOutpCtrl.SysMotTqCmdRampRateDi.Logl "MICROSAR RTE" UBYTE RTE_CM_BOOLEAN 0 0 0 255 ECU_ADDRESS 0 SYMBOL_LINK "Rte_CmnMfgSrv_SysMotTqCmdRampRateDi_Logl" 0 DISPLAY_IDENTIFIER StOutpCtrl.ReceiverPorts.SysMotTqCmdRampRateDi.Logl /end MEASUREMENT
/begin MEASUREMENT StOutpCtrl.SysMotTqCmdSca.Val "MICROSAR RTE" FLOAT32_IEEE NO_COMPU_METHOD 0 0 -3.402823466e+38 3.402823466e+38 ECU_ADDRESS 0 SYMBOL_LINK "Rte_StOutpCtrl_SysMotTqCmdSca_Val" 0 DISPLAY_IDENTIFIER StOutpCtrl.SenderPorts.SysMotTqCmdSca.Val /end MEASUREMENT
/begin MEASUREMENT StOutpCtrl.SysOperMotTqCmdSca.Val "MICROSAR RTE" FLOAT32_IEEE NO_COMPU_METHOD 0 0 -3.402823466e+38 3.402823466e+38 ECU_ADDRESS 0 SYMBOL_LINK "Rte_FordSysSt_OperScaFctr_Val" 0 DISPLAY_IDENTIFIER StOutpCtrl.ReceiverPorts.SysOperMotTqCmdSca.Val /end MEASUREMENT
/begin MEASUREMENT StOutpCtrl.SysOperRampRate.Val "MICROSAR RTE" FLOAT32_IEEE NO_COMPU_METHOD 0 0 -3.402823466e+38 3.402823466e+38 ECU_ADDRESS 0 SYMBOL_LINK "Rte_FordSysSt_OperRampRate_Val" 0 DISPLAY_IDENTIFIER StOutpCtrl.ReceiverPorts.SysOperRampRate.Val /end MEASUREMENT
/begin MEASUREMENT StOutpCtrl.SysStFltOutpReqDi.Logl "MICROSAR RTE" UBYTE RTE_CM_BOOLEAN 0 0 0 255 ECU_ADDRESS 0 SYMBOL_LINK "Rte_DiagcMgr_SysStFltOutpReqDi_Logl" 0 DISPLAY_IDENTIFIER StOutpCtrl.ReceiverPorts.SysStFltOutpReqDi.Logl /end MEASUREMENT
/begin MEASUREMENT StOutpCtrl.SysStReqDi.Logl "MICROSAR RTE" UBYTE RTE_CM_BOOLEAN 0 0 0 255 ECU_ADDRESS 0 SYMBOL_LINK "Rte_StOutpCtrl_SysStReqDi_Logl" 0 DISPLAY_IDENTIFIER StOutpCtrl.SenderPorts.SysStReqDi.Logl /end MEASUREMENT
/begin MEASUREMENT StOutpCtrl.VehStrtStopMotTqCmdSca.Val "MICROSAR RTE" FLOAT32_IEEE NO_COMPU_METHOD 0 0 -3.402823466e+38 3.402823466e+38 ECU_ADDRESS 0 SYMBOL_LINK "Rte_StOutpCtrl_VehStrtStopMotTqCmdSca_Val" 0 DISPLAY_IDENTIFIER StOutpCtrl.ReceiverPorts.VehStrtStopMotTqCmdSca.Val /end MEASUREMENT
/begin MEASUREMENT StOutpCtrl.VehStrtStopRampRate.Val "MICROSAR RTE" FLOAT32_IEEE NO_COMPU_METHOD 0 0 -3.402823466e+38 3.402823466e+38 ECU_ADDRESS 0 SYMBOL_LINK "Rte_StOutpCtrl_VehStrtStopRampRate_Val" 0 DISPLAY_IDENTIFIER StOutpCtrl.ReceiverPorts.VehStrtStopRampRate.Val /end MEASUREMENT
/begin MEASUREMENT StOutpCtrl.dStOutpCtrlRateLim "MICROSAR RTE" FLOAT32_IEEE NO_COMPU_METHOD 0 0 -3.402823466e+38 3.402823466e+38 ECU_ADDRESS 0 SYMBOL_LINK "Rte_StOutpCtrl_dStOutpCtrlRateLim" 0 DISPLAY_IDENTIFIER StOutpCtrl.PerInstanceMemories.dStOutpCtrlRateLim /end MEASUREMENT
/begin MEASUREMENT StOutpCtrl.dStOutpCtrlTarSca "MICROSAR RTE" FLOAT32_IEEE NO_COMPU_METHOD 0 0 -3.402823466e+38 3.402823466e+38 ECU_ADDRESS 0 SYMBOL_LINK "Rte_StOutpCtrl_dStOutpCtrlTarSca" 0 DISPLAY_IDENTIFIER StOutpCtrl.PerInstanceMemories.dStOutpCtrlTarSca /end MEASUREMENT
/begin MEASUREMENT StabyCmp.AssiCmd.Val "MICROSAR RTE" FLOAT32_IEEE NO_COMPU_METHOD 0 0 -3.402823466e+38 3.402823466e+38 ECU_ADDRESS 0 SYMBOL_LINK "Rte_StabyCmp_AssiCmd_Val" 0 DISPLAY_IDENTIFIER StabyCmp.SenderPorts.AssiCmd.Val /end MEASUREMENT
/begin MEASUREMENT StabyCmp.AssiCmdBasSca.Val "MICROSAR RTE" FLOAT32_IEEE NO_COMPU_METHOD 0 0 -3.402823466e+38 3.402823466e+38 ECU_ADDRESS 0 SYMBOL_LINK "Rte_StabyCmp_AssiCmdBasSca_Val" 0 DISPLAY_IDENTIFIER StabyCmp.ReceiverPorts.AssiCmdBasSca.Val /end MEASUREMENT
/begin MEASUREMENT StabyCmp.AssiCmdSum.Val "MICROSAR RTE" FLOAT32_IEEE NO_COMPU_METHOD 0 0 -3.402823466e+38 3.402823466e+38 ECU_ADDRESS 0 SYMBOL_LINK "Rte_AssiPahSum_AssiCmdSum_Val" 0 DISPLAY_IDENTIFIER StabyCmp.ReceiverPorts.AssiCmdSum.Val /end MEASUREMENT
/begin MEASUREMENT StabyCmp.AssiNotch1Fil.FilSt1 "MICROSAR RTE" FLOAT32_IEEE NO_COMPU_METHOD 0 0 -3.402823466e+38 3.402823466e+38 ECU_ADDRESS 0 SYMBOL_LINK "Rte_StabyCmp_AssiNotch1Fil.FilSt1" 0 DISPLAY_IDENTIFIER StabyCmp.PerInstanceMemories.AssiNotch1Fil.FilSt1 /end MEASUREMENT
/begin MEASUREMENT StabyCmp.AssiNotch1Fil.FilSt2 "MICROSAR RTE" FLOAT32_IEEE NO_COMPU_METHOD 0 0 -3.402823466e+38 3.402823466e+38 ECU_ADDRESS 0 SYMBOL_LINK "Rte_StabyCmp_AssiNotch1Fil.FilSt2" 0 DISPLAY_IDENTIFIER StabyCmp.PerInstanceMemories.AssiNotch1Fil.FilSt2 /end MEASUREMENT
/begin MEASUREMENT StabyCmp.AssiNotch2Fil.FilSt1 "MICROSAR RTE" FLOAT32_IEEE NO_COMPU_METHOD 0 0 -3.402823466e+38 3.402823466e+38 ECU_ADDRESS 0 SYMBOL_LINK "Rte_StabyCmp_AssiNotch2Fil.FilSt1" 0 DISPLAY_IDENTIFIER StabyCmp.PerInstanceMemories.AssiNotch2Fil.FilSt1 /end MEASUREMENT
/begin MEASUREMENT StabyCmp.AssiNotch2Fil.FilSt2 "MICROSAR RTE" FLOAT32_IEEE NO_COMPU_METHOD 0 0 -3.402823466e+38 3.402823466e+38 ECU_ADDRESS 0 SYMBOL_LINK "Rte_StabyCmp_AssiNotch2Fil.FilSt2" 0 DISPLAY_IDENTIFIER StabyCmp.PerInstanceMemories.AssiNotch2Fil.FilSt2 /end MEASUREMENT
/begin MEASUREMENT StabyCmp.AssiNotch3Fil.FilSt1 "MICROSAR RTE" FLOAT32_IEEE NO_COMPU_METHOD 0 0 -3.402823466e+38 3.402823466e+38 ECU_ADDRESS 0 SYMBOL_LINK "Rte_StabyCmp_AssiNotch3Fil.FilSt1" 0 DISPLAY_IDENTIFIER StabyCmp.PerInstanceMemories.AssiNotch3Fil.FilSt1 /end MEASUREMENT
/begin MEASUREMENT StabyCmp.AssiNotch3Fil.FilSt2 "MICROSAR RTE" FLOAT32_IEEE NO_COMPU_METHOD 0 0 -3.402823466e+38 3.402823466e+38 ECU_ADDRESS 0 SYMBOL_LINK "Rte_StabyCmp_AssiNotch3Fil.FilSt2" 0 DISPLAY_IDENTIFIER StabyCmp.PerInstanceMemories.AssiNotch3Fil.FilSt2 /end MEASUREMENT
/begin MEASUREMENT StabyCmp.AssiNotch4Fil.FilSt1 "MICROSAR RTE" FLOAT32_IEEE NO_COMPU_METHOD 0 0 -3.402823466e+38 3.402823466e+38 ECU_ADDRESS 0 SYMBOL_LINK "Rte_StabyCmp_AssiNotch4Fil.FilSt1" 0 DISPLAY_IDENTIFIER StabyCmp.PerInstanceMemories.AssiNotch4Fil.FilSt1 /end MEASUREMENT
/begin MEASUREMENT StabyCmp.AssiNotch4Fil.FilSt2 "MICROSAR RTE" FLOAT32_IEEE NO_COMPU_METHOD 0 0 -3.402823466e+38 3.402823466e+38 ECU_ADDRESS 0 SYMBOL_LINK "Rte_StabyCmp_AssiNotch4Fil.FilSt2" 0 DISPLAY_IDENTIFIER StabyCmp.PerInstanceMemories.AssiNotch4Fil.FilSt2 /end MEASUREMENT
/begin MEASUREMENT StabyCmp.AssiPahLimrActv.Val "MICROSAR RTE" FLOAT32_IEEE NO_COMPU_METHOD 0 0 -3.402823466e+38 3.402823466e+38 ECU_ADDRESS 0 SYMBOL_LINK "Rte_StabyCmp_AssiPahLimrActv_Val" 0 DISPLAY_IDENTIFIER StabyCmp.ReceiverPorts.AssiPahLimrActv.Val /end MEASUREMENT
/begin MEASUREMENT StabyCmp.HwTq.Val "MICROSAR RTE" FLOAT32_IEEE NO_COMPU_METHOD 0 0 -3.402823466e+38 3.402823466e+38 ECU_ADDRESS 0 SYMBOL_LINK "Rte_ImcSigArbn_HwTqImcCorrd_Val" 0 DISPLAY_IDENTIFIER StabyCmp.ReceiverPorts.HwTq.Val /end MEASUREMENT
/begin MEASUREMENT StabyCmp.HwTqLpFil.FilGain "MICROSAR RTE" FLOAT32_IEEE NO_COMPU_METHOD 0 0 -3.402823466e+38 3.402823466e+38 ECU_ADDRESS 0 SYMBOL_LINK "Rte_StabyCmp_HwTqLpFil.FilGain" 0 DISPLAY_IDENTIFIER StabyCmp.PerInstanceMemories.HwTqLpFil.FilGain /end MEASUREMENT
/begin MEASUREMENT StabyCmp.HwTqLpFil.FilSt "MICROSAR RTE" FLOAT32_IEEE NO_COMPU_METHOD 0 0 -3.402823466e+38 3.402823466e+38 ECU_ADDRESS 0 SYMBOL_LINK "Rte_StabyCmp_HwTqLpFil.FilSt" 0 DISPLAY_IDENTIFIER StabyCmp.PerInstanceMemories.HwTqLpFil.FilSt /end MEASUREMENT
/begin MEASUREMENT StabyCmp.VehSpd.Val "MICROSAR RTE" FLOAT32_IEEE NO_COMPU_METHOD 0 0 -3.402823466e+38 3.402823466e+38 ECU_ADDRESS 0 SYMBOL_LINK "Rte_ImcSigArbn_VehSpdImcCorrd_Val" 0 DISPLAY_IDENTIFIER StabyCmp.ReceiverPorts.VehSpd.Val /end MEASUREMENT
/begin MEASUREMENT StabyCmp.dStabyCmpAssiScaCmpBlnd "MICROSAR RTE" FLOAT32_IEEE NO_COMPU_METHOD 0 0 -3.402823466e+38 3.402823466e+38 ECU_ADDRESS 0 SYMBOL_LINK "Rte_StabyCmp_dStabyCmpAssiScaCmpBlnd" 0 DISPLAY_IDENTIFIER StabyCmp.PerInstanceMemories.dStabyCmpAssiScaCmpBlnd /end MEASUREMENT
/begin MEASUREMENT StabyCmp.dStabyCmpNotchFil02Blnd "MICROSAR RTE" FLOAT32_IEEE NO_COMPU_METHOD 0 0 -3.402823466e+38 3.402823466e+38 ECU_ADDRESS 0 SYMBOL_LINK "Rte_StabyCmp_dStabyCmpNotchFil02Blnd" 0 DISPLAY_IDENTIFIER StabyCmp.PerInstanceMemories.dStabyCmpNotchFil02Blnd /end MEASUREMENT
/begin MEASUREMENT StabyCmp.dStabyCmpNotchFil04Blnd "MICROSAR RTE" FLOAT32_IEEE NO_COMPU_METHOD 0 0 -3.402823466e+38 3.402823466e+38 ECU_ADDRESS 0 SYMBOL_LINK "Rte_StabyCmp_dStabyCmpNotchFil04Blnd" 0 DISPLAY_IDENTIFIER StabyCmp.PerInstanceMemories.dStabyCmpNotchFil04Blnd /end MEASUREMENT
/begin MEASUREMENT StabyCmp.dStabyCmpNotchFil12Blnd "MICROSAR RTE" FLOAT32_IEEE NO_COMPU_METHOD 0 0 -3.402823466e+38 3.402823466e+38 ECU_ADDRESS 0 SYMBOL_LINK "Rte_StabyCmp_dStabyCmpNotchFil12Blnd" 0 DISPLAY_IDENTIFIER StabyCmp.PerInstanceMemories.dStabyCmpNotchFil12Blnd /end MEASUREMENT
/begin MEASUREMENT StabyCmp.dStabyCmpNotchFil12Outp "MICROSAR RTE" FLOAT32_IEEE NO_COMPU_METHOD 0 0 -3.402823466e+38 3.402823466e+38 ECU_ADDRESS 0 SYMBOL_LINK "Rte_StabyCmp_dStabyCmpNotchFil12Outp" 0 DISPLAY_IDENTIFIER StabyCmp.PerInstanceMemories.dStabyCmpNotchFil12Outp /end MEASUREMENT
/begin MEASUREMENT StabyCmp.dStabyCmpNotchFil1Outp "MICROSAR RTE" FLOAT32_IEEE NO_COMPU_METHOD 0 0 -3.402823466e+38 3.402823466e+38 ECU_ADDRESS 0 SYMBOL_LINK "Rte_StabyCmp_dStabyCmpNotchFil1Outp" 0 DISPLAY_IDENTIFIER StabyCmp.PerInstanceMemories.dStabyCmpNotchFil1Outp /end MEASUREMENT
/begin MEASUREMENT StabyCmp.dStabyCmpNotchFil2Outp "MICROSAR RTE" FLOAT32_IEEE NO_COMPU_METHOD 0 0 -3.402823466e+38 3.402823466e+38 ECU_ADDRESS 0 SYMBOL_LINK "Rte_StabyCmp_dStabyCmpNotchFil2Outp" 0 DISPLAY_IDENTIFIER StabyCmp.PerInstanceMemories.dStabyCmpNotchFil2Outp /end MEASUREMENT
/begin MEASUREMENT StabyCmp.dStabyCmpNotchFil34Blnd "MICROSAR RTE" FLOAT32_IEEE NO_COMPU_METHOD 0 0 -3.402823466e+38 3.402823466e+38 ECU_ADDRESS 0 SYMBOL_LINK "Rte_StabyCmp_dStabyCmpNotchFil34Blnd" 0 DISPLAY_IDENTIFIER StabyCmp.PerInstanceMemories.dStabyCmpNotchFil34Blnd /end MEASUREMENT
/begin MEASUREMENT StabyCmp.dStabyCmpNotchFil34Outp "MICROSAR RTE" FLOAT32_IEEE NO_COMPU_METHOD 0 0 -3.402823466e+38 3.402823466e+38 ECU_ADDRESS 0 SYMBOL_LINK "Rte_StabyCmp_dStabyCmpNotchFil34Outp" 0 DISPLAY_IDENTIFIER StabyCmp.PerInstanceMemories.dStabyCmpNotchFil34Outp /end MEASUREMENT
/begin MEASUREMENT StabyCmp.dStabyCmpNotchFil3Outp "MICROSAR RTE" FLOAT32_IEEE NO_COMPU_METHOD 0 0 -3.402823466e+38 3.402823466e+38 ECU_ADDRESS 0 SYMBOL_LINK "Rte_StabyCmp_dStabyCmpNotchFil3Outp" 0 DISPLAY_IDENTIFIER StabyCmp.PerInstanceMemories.dStabyCmpNotchFil3Outp /end MEASUREMENT
/begin MEASUREMENT StabyCmp.dStabyCmpNotchFil4Outp "MICROSAR RTE" FLOAT32_IEEE NO_COMPU_METHOD 0 0 -3.402823466e+38 3.402823466e+38 ECU_ADDRESS 0 SYMBOL_LINK "Rte_StabyCmp_dStabyCmpNotchFil4Outp" 0 DISPLAY_IDENTIFIER StabyCmp.PerInstanceMemories.dStabyCmpNotchFil4Outp /end MEASUREMENT
/begin MEASUREMENT StackMeas.StackMeasApplCrc "MICROSAR RTE" ULONG NO_COMPU_METHOD 0 0 0 4294967295 ECU_ADDRESS 0 SYMBOL_LINK "Rte_StackMeas_StackMeasApplCrc" 0 DISPLAY_IDENTIFIER StackMeas.PerInstanceMemories.StackMeasApplCrc /end MEASUREMENT
/begin MEASUREMENT StackMeas.StackMeasRes "MICROSAR RTE" UBYTE NO_COMPU_METHOD 0 0 0 255 MATRIX_DIM 48 1 1 ECU_ADDRESS 0 SYMBOL_LINK "Rte_StackMeas_StackMeasRes" 0 DISPLAY_IDENTIFIER StackMeas.PerInstanceMemories.StackMeasRes /end MEASUREMENT
/begin MEASUREMENT Swp.HwTq.Val "MICROSAR RTE" FLOAT32_IEEE NO_COMPU_METHOD 0 0 -3.402823466e+38 3.402823466e+38 ECU_ADDRESS 0 SYMBOL_LINK "Rte_HwTqArbn_HwTq_Val" 0 DISPLAY_IDENTIFIER Swp.ReceiverPorts.HwTq.Val /end MEASUREMENT
/begin MEASUREMENT Swp.HwTqSwp.Val "MICROSAR RTE" FLOAT32_IEEE NO_COMPU_METHOD 0 0 -3.402823466e+38 3.402823466e+38 ECU_ADDRESS 0 SYMBOL_LINK "Rte_Swp_HwTqSwp_Val" 0 DISPLAY_IDENTIFIER Swp.SenderPorts.HwTqSwp.Val /end MEASUREMENT
/begin MEASUREMENT Swp.MotTqCmd.Val "MICROSAR RTE" FLOAT32_IEEE NO_COMPU_METHOD 0 0 -3.402823466e+38 3.402823466e+38 ECU_ADDRESS 0 SYMBOL_LINK "Rte_AssiSumLim_MotTqCmd_Val" 0 DISPLAY_IDENTIFIER Swp.ReceiverPorts.MotTqCmd.Val /end MEASUREMENT
/begin MEASUREMENT Swp.MotTqCmdSwp.Val "MICROSAR RTE" FLOAT32_IEEE NO_COMPU_METHOD 0 0 -3.402823466e+38 3.402823466e+38 ECU_ADDRESS 0 SYMBOL_LINK "Rte_Swp_MotTqCmdSwp_Val" 0 DISPLAY_IDENTIFIER Swp.SenderPorts.MotTqCmdSwp.Val /end MEASUREMENT
/begin MEASUREMENT Swp.VehSpd.Val "MICROSAR RTE" FLOAT32_IEEE NO_COMPU_METHOD 0 0 -3.402823466e+38 3.402823466e+38 ECU_ADDRESS 0 SYMBOL_LINK "Rte_VehSigCdng_VehSpd_Val" 0 DISPLAY_IDENTIFIER Swp.ReceiverPorts.VehSpd.Val /end MEASUREMENT
/begin MEASUREMENT Swp.VehSpdVld.Logl "MICROSAR RTE" UBYTE RTE_CM_BOOLEAN 0 0 0 255 ECU_ADDRESS 0 SYMBOL_LINK "Rte_VehSigCdng_VehSpdVld_Logl" 0 DISPLAY_IDENTIFIER Swp.ReceiverPorts.VehSpdVld.Logl /end MEASUREMENT
/begin MEASUREMENT SysFricLrng.AssiMechT.Val "MICROSAR RTE" FLOAT32_IEEE NO_COMPU_METHOD 0 0 -3.402823466e+38 3.402823466e+38 ECU_ADDRESS 0 SYMBOL_LINK "Rte_TEstimn_AssiMechT_Val" 0 DISPLAY_IDENTIFIER SysFricLrng.ReceiverPorts.AssiMechT.Val /end MEASUREMENT
/begin MEASUREMENT SysFricLrng.AssiMechTLpFil.FilGain "MICROSAR RTE" FLOAT32_IEEE NO_COMPU_METHOD 0 0 -3.402823466e+38 3.402823466e+38 ECU_ADDRESS 0 SYMBOL_LINK "Rte_SysFricLrng_AssiMechTLpFil.FilGain" 0 DISPLAY_IDENTIFIER SysFricLrng.PerInstanceMemories.AssiMechTLpFil.FilGain /end MEASUREMENT
/begin MEASUREMENT SysFricLrng.AssiMechTLpFil.FilSt "MICROSAR RTE" FLOAT32_IEEE NO_COMPU_METHOD 0 0 -3.402823466e+38 3.402823466e+38 ECU_ADDRESS 0 SYMBOL_LINK "Rte_SysFricLrng_AssiMechTLpFil.FilSt" 0 DISPLAY_IDENTIFIER SysFricLrng.PerInstanceMemories.AssiMechTLpFil.FilSt /end MEASUREMENT
/begin MEASUREMENT SysFricLrng.AvrgFricLpFil1.FilGain "MICROSAR RTE" FLOAT32_IEEE NO_COMPU_METHOD 0 0 -3.402823466e+38 3.402823466e+38 ECU_ADDRESS 0 SYMBOL_LINK "Rte_SysFricLrng_AvrgFricLpFil1.FilGain" 0 DISPLAY_IDENTIFIER SysFricLrng.PerInstanceMemories.AvrgFricLpFil1.FilGain /end MEASUREMENT
/begin MEASUREMENT SysFricLrng.AvrgFricLpFil1.FilSt "MICROSAR RTE" FLOAT32_IEEE NO_COMPU_METHOD 0 0 -3.402823466e+38 3.402823466e+38 ECU_ADDRESS 0 SYMBOL_LINK "Rte_SysFricLrng_AvrgFricLpFil1.FilSt" 0 DISPLAY_IDENTIFIER SysFricLrng.PerInstanceMemories.AvrgFricLpFil1.FilSt /end MEASUREMENT
/begin MEASUREMENT SysFricLrng.AvrgFricLpFil2.FilGain "MICROSAR RTE" FLOAT32_IEEE NO_COMPU_METHOD 0 0 -3.402823466e+38 3.402823466e+38 ECU_ADDRESS 0 SYMBOL_LINK "Rte_SysFricLrng_AvrgFricLpFil2.FilGain" 0 DISPLAY_IDENTIFIER SysFricLrng.PerInstanceMemories.AvrgFricLpFil2.FilGain /end MEASUREMENT
/begin MEASUREMENT SysFricLrng.AvrgFricLpFil2.FilSt "MICROSAR RTE" FLOAT32_IEEE NO_COMPU_METHOD 0 0 -3.402823466e+38 3.402823466e+38 ECU_ADDRESS 0 SYMBOL_LINK "Rte_SysFricLrng_AvrgFricLpFil2.FilSt" 0 DISPLAY_IDENTIFIER SysFricLrng.PerInstanceMemories.AvrgFricLpFil2.FilSt /end MEASUREMENT
/begin MEASUREMENT SysFricLrng.AvrgFricLpFil3.FilGain "MICROSAR RTE" FLOAT32_IEEE NO_COMPU_METHOD 0 0 -3.402823466e+38 3.402823466e+38 ECU_ADDRESS 0 SYMBOL_LINK "Rte_SysFricLrng_AvrgFricLpFil3.FilGain" 0 DISPLAY_IDENTIFIER SysFricLrng.PerInstanceMemories.AvrgFricLpFil3.FilGain /end MEASUREMENT
/begin MEASUREMENT SysFricLrng.AvrgFricLpFil3.FilSt "MICROSAR RTE" FLOAT32_IEEE NO_COMPU_METHOD 0 0 -3.402823466e+38 3.402823466e+38 ECU_ADDRESS 0 SYMBOL_LINK "Rte_SysFricLrng_AvrgFricLpFil3.FilSt" 0 DISPLAY_IDENTIFIER SysFricLrng.PerInstanceMemories.AvrgFricLpFil3.FilSt /end MEASUREMENT
/begin MEASUREMENT SysFricLrng.AvrgFricLpFil4.FilGain "MICROSAR RTE" FLOAT32_IEEE NO_COMPU_METHOD 0 0 -3.402823466e+38 3.402823466e+38 ECU_ADDRESS 0 SYMBOL_LINK "Rte_SysFricLrng_AvrgFricLpFil4.FilGain" 0 DISPLAY_IDENTIFIER SysFricLrng.PerInstanceMemories.AvrgFricLpFil4.FilGain /end MEASUREMENT
/begin MEASUREMENT SysFricLrng.AvrgFricLpFil4.FilSt "MICROSAR RTE" FLOAT32_IEEE NO_COMPU_METHOD 0 0 -3.402823466e+38 3.402823466e+38 ECU_ADDRESS 0 SYMBOL_LINK "Rte_SysFricLrng_AvrgFricLpFil4.FilSt" 0 DISPLAY_IDENTIFIER SysFricLrng.PerInstanceMemories.AvrgFricLpFil4.FilSt /end MEASUREMENT
/begin MEASUREMENT SysFricLrng.ColTqAry "MICROSAR RTE" FLOAT32_IEEE NO_COMPU_METHOD 0 0 -3.402823466e+38 3.402823466e+38 MATRIX_DIM 12 1 1 ECU_ADDRESS 0 SYMBOL_LINK "Rte_SysFricLrng_ColTqAry" 0 DISPLAY_IDENTIFIER SysFricLrng.PerInstanceMemories.ColTqAry /end MEASUREMENT
/begin MEASUREMENT SysFricLrng.ColTqLpFil.FilGain "MICROSAR RTE" FLOAT32_IEEE NO_COMPU_METHOD 0 0 -3.402823466e+38 3.402823466e+38 ECU_ADDRESS 0 SYMBOL_LINK "Rte_SysFricLrng_ColTqLpFil.FilGain" 0 DISPLAY_IDENTIFIER SysFricLrng.PerInstanceMemories.ColTqLpFil.FilGain /end MEASUREMENT
/begin MEASUREMENT SysFricLrng.ColTqLpFil.FilSt "MICROSAR RTE" FLOAT32_IEEE NO_COMPU_METHOD 0 0 -3.402823466e+38 3.402823466e+38 ECU_ADDRESS 0 SYMBOL_LINK "Rte_SysFricLrng_ColTqLpFil.FilSt" 0 DISPLAY_IDENTIFIER SysFricLrng.PerInstanceMemories.ColTqLpFil.FilSt /end MEASUREMENT
/begin MEASUREMENT SysFricLrng.EstimdFric "MICROSAR RTE" FLOAT32_IEEE NO_COMPU_METHOD 0 0 -3.402823466e+38 3.402823466e+38 ECU_ADDRESS 0 SYMBOL_LINK "Rte_SysFricLrng_EstimdFric" 0 DISPLAY_IDENTIFIER SysFricLrng.PerInstanceMemories.EstimdFric /end MEASUREMENT
/begin MEASUREMENT SysFricLrng.FilAvrgFric "MICROSAR RTE" FLOAT32_IEEE NO_COMPU_METHOD 0 0 -3.402823466e+38 3.402823466e+38 MATRIX_DIM 4 1 1 ECU_ADDRESS 0 SYMBOL_LINK "Rte_SysFricLrng_FilAvrgFric" 0 DISPLAY_IDENTIFIER SysFricLrng.PerInstanceMemories.FilAvrgFric /end MEASUREMENT
/begin MEASUREMENT SysFricLrng.FricChgLpFil.FilGain "MICROSAR RTE" FLOAT32_IEEE NO_COMPU_METHOD 0 0 -3.402823466e+38 3.402823466e+38 ECU_ADDRESS 0 SYMBOL_LINK "Rte_SysFricLrng_FricChgLpFil.FilGain" 0 DISPLAY_IDENTIFIER SysFricLrng.PerInstanceMemories.FricChgLpFil.FilGain /end MEASUREMENT
/begin MEASUREMENT SysFricLrng.FricChgLpFil.FilSt "MICROSAR RTE" FLOAT32_IEEE NO_COMPU_METHOD 0 0 -3.402823466e+38 3.402823466e+38 ECU_ADDRESS 0 SYMBOL_LINK "Rte_SysFricLrng_FricChgLpFil.FilSt" 0 DISPLAY_IDENTIFIER SysFricLrng.PerInstanceMemories.FricChgLpFil.FilSt /end MEASUREMENT
/begin MEASUREMENT SysFricLrng.FricLrngCustEna.Logl "MICROSAR RTE" UBYTE RTE_CM_BOOLEAN 0 0 0 255 ECU_ADDRESS 0 SYMBOL_LINK "Rte_SysFricLrng_FricLrngCustEna_Logl" 0 DISPLAY_IDENTIFIER SysFricLrng.ReceiverPorts.FricLrngCustEna.Logl /end MEASUREMENT
/begin MEASUREMENT SysFricLrng.FricLrngData.BasLineFric "MICROSAR RTE" FLOAT32_IEEE NO_COMPU_METHOD 0 0 -3.402823466e+38 3.402823466e+38 MATRIX_DIM 4 1 1 ECU_ADDRESS 0 SYMBOL_LINK "Rte_SysFricLrng_FricLrngData.BasLineFric" 0 DISPLAY_IDENTIFIER SysFricLrng.PerInstanceMemories.FricLrngData.BasLineFric /end MEASUREMENT
/begin MEASUREMENT SysFricLrng.FricLrngData.FricOffs "MICROSAR RTE" FLOAT32_IEEE NO_COMPU_METHOD 0 0 -3.402823466e+38 3.402823466e+38 ECU_ADDRESS 0 SYMBOL_LINK "Rte_SysFricLrng_FricLrngData.FricOffs" 0 DISPLAY_IDENTIFIER SysFricLrng.PerInstanceMemories.FricLrngData.FricOffs /end MEASUREMENT
/begin MEASUREMENT SysFricLrng.FricLrngData.Hys "MICROSAR RTE" FLOAT32_IEEE NO_COMPU_METHOD 0 0 -3.402823466e+38 3.402823466e+38 MATRIX_DIM 4 8 1 ECU_ADDRESS 0 SYMBOL_LINK "Rte_SysFricLrng_FricLrngData.Hys" 0 DISPLAY_IDENTIFIER SysFricLrng.PerInstanceMemories.FricLrngData.Hys /end MEASUREMENT
/begin MEASUREMENT SysFricLrng.FricLrngData.RngCntr "MICROSAR RTE" UWORD NO_COMPU_METHOD 0 0 0 65535 MATRIX_DIM 3 8 1 ECU_ADDRESS 0 SYMBOL_LINK "Rte_SysFricLrng_FricLrngData.RngCntr" 0 DISPLAY_IDENTIFIER SysFricLrng.PerInstanceMemories.FricLrngData.RngCntr /end MEASUREMENT
/begin MEASUREMENT SysFricLrng.FricLrngData.SysFricLrngOperMod "MICROSAR RTE" UBYTE RTE_CM_ENUM_SysFricLrngOperMod1 0 0 0 255 ECU_ADDRESS 0 SYMBOL_LINK "Rte_SysFricLrng_FricLrngData.SysFricLrngOperMod" 0 DISPLAY_IDENTIFIER SysFricLrng.PerInstanceMemories.FricLrngData.SysFricLrngOperMod /end MEASUREMENT
/begin MEASUREMENT SysFricLrng.FricLrngData.VehLrndFric "MICROSAR RTE" FLOAT32_IEEE NO_COMPU_METHOD 0 0 -3.402823466e+38 3.402823466e+38 MATRIX_DIM 4 1 1 ECU_ADDRESS 0 SYMBOL_LINK "Rte_SysFricLrng_FricLrngData.VehLrndFric" 0 DISPLAY_IDENTIFIER SysFricLrng.PerInstanceMemories.FricLrngData.VehLrndFric /end MEASUREMENT
/begin MEASUREMENT SysFricLrng.FricLrngDi.Logl "MICROSAR RTE" UBYTE RTE_CM_BOOLEAN 0 0 0 255 ECU_ADDRESS 0 SYMBOL_LINK "Rte_CmnMfgSrv_FricLrngDi_Logl" 0 DISPLAY_IDENTIFIER SysFricLrng.ReceiverPorts.FricLrngDi.Logl /end MEASUREMENT
/begin MEASUREMENT SysFricLrng.FricLrngOperModPrev "MICROSAR RTE" UBYTE RTE_CM_ENUM_SysFricLrngOperMod1 0 0 0 255 ECU_ADDRESS 0 SYMBOL_LINK "Rte_SysFricLrng_FricLrngOperModPrev" 0 DISPLAY_IDENTIFIER SysFricLrng.PerInstanceMemories.FricLrngOperModPrev /end MEASUREMENT
/begin MEASUREMENT SysFricLrng.FricLrngRunOneTi "MICROSAR RTE" UBYTE RTE_CM_BOOLEAN 0 0 0 255 ECU_ADDRESS 0 SYMBOL_LINK "Rte_SysFricLrng_FricLrngRunOneTi" 0 DISPLAY_IDENTIFIER SysFricLrng.PerInstanceMemories.FricLrngRunOneTi /end MEASUREMENT
/begin MEASUREMENT SysFricLrng.FricNonLrngData.EnaFricLrng "MICROSAR RTE" UBYTE RTE_CM_BOOLEAN 0 0 0 255 ECU_ADDRESS 0 SYMBOL_LINK "Rte_SysFricLrng_FricNonLrngData.EnaFricLrng" 0 DISPLAY_IDENTIFIER SysFricLrng.PerInstanceMemories.FricNonLrngData.EnaFricLrng /end MEASUREMENT
/begin MEASUREMENT SysFricLrng.FricNonLrngData.EnaFricOffsOutp "MICROSAR RTE" UBYTE RTE_CM_BOOLEAN 0 0 0 255 ECU_ADDRESS 0 SYMBOL_LINK "Rte_SysFricLrng_FricNonLrngData.EnaFricOffsOutp" 0 DISPLAY_IDENTIFIER SysFricLrng.PerInstanceMemories.FricNonLrngData.EnaFricOffsOutp /end MEASUREMENT
/begin MEASUREMENT SysFricLrng.FricNonLrngData.EolFric "MICROSAR RTE" FLOAT32_IEEE NO_COMPU_METHOD 0 0 -3.402823466e+38 3.402823466e+38 ECU_ADDRESS 0 SYMBOL_LINK "Rte_SysFricLrng_FricNonLrngData.EolFric" 0 DISPLAY_IDENTIFIER SysFricLrng.PerInstanceMemories.FricNonLrngData.EolFric /end MEASUREMENT
/begin MEASUREMENT SysFricLrng.FricOffs "MICROSAR RTE" FLOAT32_IEEE NO_COMPU_METHOD 0 0 -3.402823466e+38 3.402823466e+38 ECU_ADDRESS 0 SYMBOL_LINK "Rte_SysFricLrng_FricOffs" 0 DISPLAY_IDENTIFIER SysFricLrng.PerInstanceMemories.FricOffs /end MEASUREMENT
/begin MEASUREMENT SysFricLrng.FricOffsOutpDi "MICROSAR RTE" UBYTE RTE_CM_BOOLEAN 0 0 0 255 ECU_ADDRESS 0 SYMBOL_LINK "Rte_SysFricLrng_FricOffsOutpDi" 0 DISPLAY_IDENTIFIER SysFricLrng.PerInstanceMemories.FricOffsOutpDi /end MEASUREMENT
/begin MEASUREMENT SysFricLrng.HwAg.Val "MICROSAR RTE" FLOAT32_IEEE NO_COMPU_METHOD 0 0 -3.402823466e+38 3.402823466e+38 ECU_ADDRESS 0 SYMBOL_LINK "Rte_ImcSigArbn_HwAgImcCorrd_Val" 0 DISPLAY_IDENTIFIER SysFricLrng.ReceiverPorts.HwAg.Val /end MEASUREMENT
/begin MEASUREMENT SysFricLrng.HwAgAuthy.Val "MICROSAR RTE" FLOAT32_IEEE NO_COMPU_METHOD 0 0 -3.402823466e+38 3.402823466e+38 ECU_ADDRESS 0 SYMBOL_LINK "Rte_HwAgSysArbn_PinionAgConf_Val" 0 DISPLAY_IDENTIFIER SysFricLrng.ReceiverPorts.HwAgAuthy.Val /end MEASUREMENT
/begin MEASUREMENT SysFricLrng.HwAgAuthyLpFil.FilGain "MICROSAR RTE" FLOAT32_IEEE NO_COMPU_METHOD 0 0 -3.402823466e+38 3.402823466e+38 ECU_ADDRESS 0 SYMBOL_LINK "Rte_SysFricLrng_HwAgAuthyLpFil.FilGain" 0 DISPLAY_IDENTIFIER SysFricLrng.PerInstanceMemories.HwAgAuthyLpFil.FilGain /end MEASUREMENT
/begin MEASUREMENT SysFricLrng.HwAgAuthyLpFil.FilSt "MICROSAR RTE" FLOAT32_IEEE NO_COMPU_METHOD 0 0 -3.402823466e+38 3.402823466e+38 ECU_ADDRESS 0 SYMBOL_LINK "Rte_SysFricLrng_HwAgAuthyLpFil.FilSt" 0 DISPLAY_IDENTIFIER SysFricLrng.PerInstanceMemories.HwAgAuthyLpFil.FilSt /end MEASUREMENT
/begin MEASUREMENT SysFricLrng.HwAgBuf "MICROSAR RTE" FLOAT32_IEEE NO_COMPU_METHOD 0 0 -3.402823466e+38 3.402823466e+38 MATRIX_DIM 12 1 1 ECU_ADDRESS 0 SYMBOL_LINK "Rte_SysFricLrng_HwAgBuf" 0 DISPLAY_IDENTIFIER SysFricLrng.PerInstanceMemories.HwAgBuf /end MEASUREMENT
/begin MEASUREMENT SysFricLrng.HwAgLpFil.FilGain "MICROSAR RTE" FLOAT32_IEEE NO_COMPU_METHOD 0 0 -3.402823466e+38 3.402823466e+38 ECU_ADDRESS 0 SYMBOL_LINK "Rte_SysFricLrng_HwAgLpFil.FilGain" 0 DISPLAY_IDENTIFIER SysFricLrng.PerInstanceMemories.HwAgLpFil.FilGain /end MEASUREMENT
/begin MEASUREMENT SysFricLrng.HwAgLpFil.FilSt "MICROSAR RTE" FLOAT32_IEEE NO_COMPU_METHOD 0 0 -3.402823466e+38 3.402823466e+38 ECU_ADDRESS 0 SYMBOL_LINK "Rte_SysFricLrng_HwAgLpFil.FilSt" 0 DISPLAY_IDENTIFIER SysFricLrng.PerInstanceMemories.HwAgLpFil.FilSt /end MEASUREMENT
/begin MEASUREMENT SysFricLrng.HwTq.Val "MICROSAR RTE" FLOAT32_IEEE NO_COMPU_METHOD 0 0 -3.402823466e+38 3.402823466e+38 ECU_ADDRESS 0 SYMBOL_LINK "Rte_ImcSigArbn_HwTqImcCorrd_Val" 0 DISPLAY_IDENTIFIER SysFricLrng.ReceiverPorts.HwTq.Val /end MEASUREMENT
/begin MEASUREMENT SysFricLrng.HwVel.Val "MICROSAR RTE" FLOAT32_IEEE NO_COMPU_METHOD 0 0 -3.402823466e+38 3.402823466e+38 ECU_ADDRESS 0 SYMBOL_LINK "Rte_HwAgSysArbn_HwVel_Val" 0 DISPLAY_IDENTIFIER SysFricLrng.ReceiverPorts.HwVel.Val /end MEASUREMENT
/begin MEASUREMENT SysFricLrng.HwVelBuf "MICROSAR RTE" FLOAT32_IEEE NO_COMPU_METHOD 0 0 -3.402823466e+38 3.402823466e+38 MATRIX_DIM 12 1 1 ECU_ADDRESS 0 SYMBOL_LINK "Rte_SysFricLrng_HwVelBuf" 0 DISPLAY_IDENTIFIER SysFricLrng.PerInstanceMemories.HwVelBuf /end MEASUREMENT
/begin MEASUREMENT SysFricLrng.HwVelLpFil.FilGain "MICROSAR RTE" FLOAT32_IEEE NO_COMPU_METHOD 0 0 -3.402823466e+38 3.402823466e+38 ECU_ADDRESS 0 SYMBOL_LINK "Rte_SysFricLrng_HwVelLpFil.FilGain" 0 DISPLAY_IDENTIFIER SysFricLrng.PerInstanceMemories.HwVelLpFil.FilGain /end MEASUREMENT
/begin MEASUREMENT SysFricLrng.HwVelLpFil.FilSt "MICROSAR RTE" FLOAT32_IEEE NO_COMPU_METHOD 0 0 -3.402823466e+38 3.402823466e+38 ECU_ADDRESS 0 SYMBOL_LINK "Rte_SysFricLrng_HwVelLpFil.FilSt" 0 DISPLAY_IDENTIFIER SysFricLrng.PerInstanceMemories.HwVelLpFil.FilSt /end MEASUREMENT
/begin MEASUREMENT SysFricLrng.LatALpFil.FilGain "MICROSAR RTE" FLOAT32_IEEE NO_COMPU_METHOD 0 0 -3.402823466e+38 3.402823466e+38 ECU_ADDRESS 0 SYMBOL_LINK "Rte_SysFricLrng_LatALpFil.FilGain" 0 DISPLAY_IDENTIFIER SysFricLrng.PerInstanceMemories.LatALpFil.FilGain /end MEASUREMENT
/begin MEASUREMENT SysFricLrng.LatALpFil.FilSt "MICROSAR RTE" FLOAT32_IEEE NO_COMPU_METHOD 0 0 -3.402823466e+38 3.402823466e+38 ECU_ADDRESS 0 SYMBOL_LINK "Rte_SysFricLrng_LatALpFil.FilSt" 0 DISPLAY_IDENTIFIER SysFricLrng.PerInstanceMemories.LatALpFil.FilSt /end MEASUREMENT
/begin MEASUREMENT SysFricLrng.MaxLrndFric.Val "MICROSAR RTE" FLOAT32_IEEE NO_COMPU_METHOD 0 0 -3.402823466e+38 3.402823466e+38 ECU_ADDRESS 0 SYMBOL_LINK "Rte_SysFricLrng_MaxLrndFric_Val" 0 DISPLAY_IDENTIFIER SysFricLrng.SenderPorts.MaxLrndFric.Val /end MEASUREMENT
/begin MEASUREMENT SysFricLrng.MotTqCmdCrf.Val "MICROSAR RTE" FLOAT32_IEEE NO_COMPU_METHOD 0 0 -3.402823466e+38 3.402823466e+38 ECU_ADDRESS 0 SYMBOL_LINK "Rte_MotTqTranlDampg_MotTqCmdCrfDampd_Val" 0 DISPLAY_IDENTIFIER SysFricLrng.ReceiverPorts.MotTqCmdCrf.Val /end MEASUREMENT
/begin MEASUREMENT SysFricLrng.PrevMaxRawAvrgFric "MICROSAR RTE" FLOAT32_IEEE NO_COMPU_METHOD 0 0 -3.402823466e+38 3.402823466e+38 ECU_ADDRESS 0 SYMBOL_LINK "Rte_SysFricLrng_PrevMaxRawAvrgFric" 0 DISPLAY_IDENTIFIER SysFricLrng.PerInstanceMemories.PrevMaxRawAvrgFric /end MEASUREMENT
/begin MEASUREMENT SysFricLrng.RawAvrgFric "MICROSAR RTE" FLOAT32_IEEE NO_COMPU_METHOD 0 0 -3.402823466e+38 3.402823466e+38 MATRIX_DIM 4 1 1 ECU_ADDRESS 0 SYMBOL_LINK "Rte_SysFricLrng_RawAvrgFric" 0 DISPLAY_IDENTIFIER SysFricLrng.PerInstanceMemories.RawAvrgFric /end MEASUREMENT
/begin MEASUREMENT SysFricLrng.RefTmrLrngConstr "MICROSAR RTE" ULONG NO_COMPU_METHOD 0 0 0 4294967295 ECU_ADDRESS 0 SYMBOL_LINK "Rte_SysFricLrng_RefTmrLrngConstr" 0 DISPLAY_IDENTIFIER SysFricLrng.PerInstanceMemories.RefTmrLrngConstr /end MEASUREMENT
/begin MEASUREMENT SysFricLrng.SatnAvrgFric "MICROSAR RTE" FLOAT32_IEEE NO_COMPU_METHOD 0 0 -3.402823466e+38 3.402823466e+38 MATRIX_DIM 4 1 1 ECU_ADDRESS 0 SYMBOL_LINK "Rte_SysFricLrng_SatnAvrgFric" 0 DISPLAY_IDENTIFIER SysFricLrng.PerInstanceMemories.SatnAvrgFric /end MEASUREMENT
/begin MEASUREMENT SysFricLrng.SatnEstimdFric "MICROSAR RTE" FLOAT32_IEEE NO_COMPU_METHOD 0 0 -3.402823466e+38 3.402823466e+38 ECU_ADDRESS 0 SYMBOL_LINK "Rte_SysFricLrng_SatnEstimdFric" 0 DISPLAY_IDENTIFIER SysFricLrng.PerInstanceMemories.SatnEstimdFric /end MEASUREMENT
/begin MEASUREMENT SysFricLrng.SysFricEstimd.Val "MICROSAR RTE" FLOAT32_IEEE NO_COMPU_METHOD 0 0 -3.402823466e+38 3.402823466e+38 ECU_ADDRESS 0 SYMBOL_LINK "Rte_SysFricLrng_SysFricEstimd_Val" 0 DISPLAY_IDENTIFIER SysFricLrng.SenderPorts.SysFricEstimd.Val /end MEASUREMENT
/begin MEASUREMENT SysFricLrng.SysFricOffs.Val "MICROSAR RTE" FLOAT32_IEEE NO_COMPU_METHOD 0 0 -3.402823466e+38 3.402823466e+38 ECU_ADDRESS 0 SYMBOL_LINK "Rte_SysFricLrng_SysFricOffs_Val" 0 DISPLAY_IDENTIFIER SysFricLrng.SenderPorts.SysFricOffs.Val /end MEASUREMENT
/begin MEASUREMENT SysFricLrng.SysSatnFricEstimd.Val "MICROSAR RTE" FLOAT32_IEEE NO_COMPU_METHOD 0 0 -3.402823466e+38 3.402823466e+38 ECU_ADDRESS 0 SYMBOL_LINK "Rte_SysFricLrng_SysSatnFricEstimd_Val" 0 DISPLAY_IDENTIFIER SysFricLrng.SenderPorts.SysSatnFricEstimd.Val /end MEASUREMENT
/begin MEASUREMENT SysFricLrng.VehBasLineFric "MICROSAR RTE" FLOAT32_IEEE NO_COMPU_METHOD 0 0 -3.402823466e+38 3.402823466e+38 MATRIX_DIM 4 1 1 ECU_ADDRESS 0 SYMBOL_LINK "Rte_SysFricLrng_VehBasLineFric" 0 DISPLAY_IDENTIFIER SysFricLrng.PerInstanceMemories.VehBasLineFric /end MEASUREMENT
/begin MEASUREMENT SysFricLrng.VehLatA.Val "MICROSAR RTE" FLOAT32_IEEE NO_COMPU_METHOD 0 0 -3.402823466e+38 3.402823466e+38 ECU_ADDRESS 0 SYMBOL_LINK "Rte_VehSigCdng_VehLatA_Val" 0 DISPLAY_IDENTIFIER SysFricLrng.ReceiverPorts.VehLatA.Val /end MEASUREMENT
/begin MEASUREMENT SysFricLrng.VehSpd.Val "MICROSAR RTE" FLOAT32_IEEE NO_COMPU_METHOD 0 0 -3.402823466e+38 3.402823466e+38 ECU_ADDRESS 0 SYMBOL_LINK "Rte_ImcSigArbn_VehSpdImcCorrd_Val" 0 DISPLAY_IDENTIFIER SysFricLrng.ReceiverPorts.VehSpd.Val /end MEASUREMENT
/begin MEASUREMENT SysFricLrng.VehSpdLpFil.FilGain "MICROSAR RTE" FLOAT32_IEEE NO_COMPU_METHOD 0 0 -3.402823466e+38 3.402823466e+38 ECU_ADDRESS 0 SYMBOL_LINK "Rte_SysFricLrng_VehSpdLpFil.FilGain" 0 DISPLAY_IDENTIFIER SysFricLrng.PerInstanceMemories.VehSpdLpFil.FilGain /end MEASUREMENT
/begin MEASUREMENT SysFricLrng.VehSpdLpFil.FilSt "MICROSAR RTE" FLOAT32_IEEE NO_COMPU_METHOD 0 0 -3.402823466e+38 3.402823466e+38 ECU_ADDRESS 0 SYMBOL_LINK "Rte_SysFricLrng_VehSpdLpFil.FilSt" 0 DISPLAY_IDENTIFIER SysFricLrng.PerInstanceMemories.VehSpdLpFil.FilSt /end MEASUREMENT
/begin MEASUREMENT SysFricLrng.VehSpdVld.Logl "MICROSAR RTE" UBYTE RTE_CM_BOOLEAN 0 0 0 255 ECU_ADDRESS 0 SYMBOL_LINK "Rte_VehSigCdng_VehSpdVld_Logl" 0 DISPLAY_IDENTIFIER SysFricLrng.ReceiverPorts.VehSpdVld.Logl /end MEASUREMENT
/begin MEASUREMENT SysPrfmncSts.BattVltg.Val "MICROSAR RTE" FLOAT32_IEEE NO_COMPU_METHOD 0 0 -3.402823466e+38 3.402823466e+38 ECU_ADDRESS 0 SYMBOL_LINK "Rte_CDD_FordT3T6McuCfg_BattVltg_Val" 0 DISPLAY_IDENTIFIER SysPrfmncSts.ReceiverPorts.BattVltg.Val /end MEASUREMENT
/begin MEASUREMENT SysPrfmncSts.BattVltgLpFil.FilGain "MICROSAR RTE" FLOAT32_IEEE NO_COMPU_METHOD 0 0 -3.402823466e+38 3.402823466e+38 ECU_ADDRESS 0 SYMBOL_LINK "Rte_SysPrfmncSts_BattVltgLpFil.FilGain" 0 DISPLAY_IDENTIFIER SysPrfmncSts.PerInstanceMemories.BattVltgLpFil.FilGain /end MEASUREMENT
/begin MEASUREMENT SysPrfmncSts.BattVltgLpFil.FilSt "MICROSAR RTE" FLOAT32_IEEE NO_COMPU_METHOD 0 0 -3.402823466e+38 3.402823466e+38 ECU_ADDRESS 0 SYMBOL_LINK "Rte_SysPrfmncSts_BattVltgLpFil.FilSt" 0 DISPLAY_IDENTIFIER SysPrfmncSts.PerInstanceMemories.BattVltgLpFil.FilSt /end MEASUREMENT
/begin MEASUREMENT SysPrfmncSts.BattVltgSt.Val "MICROSAR RTE" UBYTE RTE_CM_ENUM_BattVltgSt1 0 0 0 255 ECU_ADDRESS 0 SYMBOL_LINK "Rte_SysPrfmncSts_BattVltgSt_Val" 0 DISPLAY_IDENTIFIER SysPrfmncSts.SenderPorts.BattVltgSt.Val /end MEASUREMENT
/begin MEASUREMENT SysPrfmncSts.DutyCycThermProtnMaxOutp.Val "MICROSAR RTE" UWORD NO_COMPU_METHOD 0 0 0 65535 ECU_ADDRESS 0 SYMBOL_LINK "Rte_DutyCycThermProtn_DutyCycThermProtnMaxOutp_Val" 0 DISPLAY_IDENTIFIER SysPrfmncSts.ReceiverPorts.DutyCycThermProtnMaxOutp.Val /end MEASUREMENT
/begin MEASUREMENT SysPrfmncSts.EcuTFild.Val "MICROSAR RTE" FLOAT32_IEEE NO_COMPU_METHOD 0 0 -3.402823466e+38 3.402823466e+38 ECU_ADDRESS 0 SYMBOL_LINK "Rte_EcuTMeas_EcuTFild_Val" 0 DISPLAY_IDENTIFIER SysPrfmncSts.ReceiverPorts.EcuTFild.Val /end MEASUREMENT
/begin MEASUREMENT SysPrfmncSts.LoaSt.Val "MICROSAR RTE" UBYTE RTE_CM_ENUM_LoaSt1 0 0 0 255 ECU_ADDRESS 0 SYMBOL_LINK "Rte_LoaMgr_LoaSt_Val" 0 DISPLAY_IDENTIFIER SysPrfmncSts.ReceiverPorts.LoaSt.Val /end MEASUREMENT
/begin MEASUREMENT SysPrfmncSts.StallMotTqLim.Val "MICROSAR RTE" FLOAT32_IEEE NO_COMPU_METHOD 0 0 -3.402823466e+38 3.402823466e+38 ECU_ADDRESS 0 SYMBOL_LINK "Rte_HiLoadStallLimr_StallMotTqLim_Val" 0 DISPLAY_IDENTIFIER SysPrfmncSts.ReceiverPorts.StallMotTqLim.Val /end MEASUREMENT
/begin MEASUREMENT SysPrfmncSts.SysPrfmncSt.Val "MICROSAR RTE" UWORD NO_COMPU_METHOD 0 0 0 65535 ECU_ADDRESS 0 SYMBOL_LINK "Rte_SysPrfmncSts_SysPrfmncSt_Val" 0 DISPLAY_IDENTIFIER SysPrfmncSts.SenderPorts.SysPrfmncSt.Val /end MEASUREMENT
/begin MEASUREMENT SysPrfmncSts.SysSt.Val "MICROSAR RTE" UBYTE RTE_CM_ENUM_SysSt1 0 0 0 255 ECU_ADDRESS 0 SYMBOL_LINK "Rte_SysStMod_SysSt_Val" 0 DISPLAY_IDENTIFIER SysPrfmncSts.ReceiverPorts.SysSt.Val /end MEASUREMENT
/begin MEASUREMENT SysPrfmncSts.ThermDutyCycProtnLoadDptLim.Val "MICROSAR RTE" FLOAT32_IEEE NO_COMPU_METHOD 0 0 -3.402823466e+38 3.402823466e+38 ECU_ADDRESS 0 SYMBOL_LINK "Rte_DutyCycThermProtn_ThermDutyCycProtnLoadDptLim_Val" 0 DISPLAY_IDENTIFIER SysPrfmncSts.ReceiverPorts.ThermDutyCycProtnLoadDptLim.Val /end MEASUREMENT
/begin MEASUREMENT SysPrfmncSts.ThermDutyCycProtnTDptLim.Val "MICROSAR RTE" FLOAT32_IEEE NO_COMPU_METHOD 0 0 -3.402823466e+38 3.402823466e+38 ECU_ADDRESS 0 SYMBOL_LINK "Rte_DutyCycThermProtn_ThermDutyCycProtnTDptLim_Val" 0 DISPLAY_IDENTIFIER SysPrfmncSts.ReceiverPorts.ThermDutyCycProtnTDptLim.Val /end MEASUREMENT
/begin MEASUREMENT SysPrfmncSts.VehSpdVld.Logl "MICROSAR RTE" UBYTE RTE_CM_BOOLEAN 0 0 0 255 ECU_ADDRESS 0 SYMBOL_LINK "Rte_VehSigCdng_VehSpdVld_Logl" 0 DISPLAY_IDENTIFIER SysPrfmncSts.ReceiverPorts.VehSpdVld.Logl /end MEASUREMENT
/begin MEASUREMENT SysStMod.PwrSplyEnaReq.Logl "MICROSAR RTE" UBYTE RTE_CM_BOOLEAN 0 0 0 255 ECU_ADDRESS 0 SYMBOL_LINK "Rte_FordSysSt_FordPwrSplyEnaReq_Logl" 0 DISPLAY_IDENTIFIER SysStMod.ReceiverPorts.PwrSplyEnaReq.Logl /end MEASUREMENT
/begin MEASUREMENT SysStMod.StrtUpSt.Val "MICROSAR RTE" UBYTE NO_COMPU_METHOD 0 0 0 255 ECU_ADDRESS 0 SYMBOL_LINK "Rte_PwrUpSeq_StrtUpSt_Val" 0 DISPLAY_IDENTIFIER SysStMod.ReceiverPorts.StrtUpSt.Val /end MEASUREMENT
/begin MEASUREMENT SysStMod.SysSt.Val "MICROSAR RTE" UBYTE RTE_CM_ENUM_SysSt1 0 0 0 255 ECU_ADDRESS 0 SYMBOL_LINK "Rte_SysStMod_SysSt_Val" 0 DISPLAY_IDENTIFIER SysStMod.SenderPorts.SysSt.Val /end MEASUREMENT
/begin MEASUREMENT SysStMod.SysStFltOutpReqDi.Logl "MICROSAR RTE" UBYTE RTE_CM_BOOLEAN 0 0 0 255 ECU_ADDRESS 0 SYMBOL_LINK "Rte_DiagcMgr_SysStFltOutpReqDi_Logl" 0 DISPLAY_IDENTIFIER SysStMod.ReceiverPorts.SysStFltOutpReqDi.Logl /end MEASUREMENT
/begin MEASUREMENT SysStMod.SysStImdtTranReqOff.Logl "MICROSAR RTE" UBYTE RTE_CM_BOOLEAN 0 0 0 255 ECU_ADDRESS 0 SYMBOL_LINK "Rte_CmnMfgSrv_SysStImdtTranReqOff_Logl" 0 DISPLAY_IDENTIFIER SysStMod.ReceiverPorts.SysStImdtTranReqOff.Logl /end MEASUREMENT
/begin MEASUREMENT SysStMod.SysStModPrevSysSt "MICROSAR RTE" UBYTE RTE_CM_ENUM_SysSt1 0 0 0 255 ECU_ADDRESS 0 SYMBOL_LINK "Rte_SysStMod_SysStModPrevSysSt" 0 DISPLAY_IDENTIFIER SysStMod.PerInstanceMemories.SysStModPrevSysSt /end MEASUREMENT
/begin MEASUREMENT SysStMod.SysStReqDi.Logl "MICROSAR RTE" UBYTE RTE_CM_BOOLEAN 0 0 0 255 ECU_ADDRESS 0 SYMBOL_LINK "Rte_StOutpCtrl_SysStReqDi_Logl" 0 DISPLAY_IDENTIFIER SysStMod.ReceiverPorts.SysStReqDi.Logl /end MEASUREMENT
/begin GROUP PwrLimr.dPwrLimrSpdAdj "MICROSAR RTE" /begin SUB_GROUP /end SUB_GROUP /begin FUNCTION_LIST /end FUNCTION_LIST /begin REF_CHARACTERISTIC /end REF_CHARACTERISTIC /begin REF_MEASUREMENT PwrLimr.dPwrLimrSpdAdj /end REF_MEASUREMENT /end GROUP
/begin GROUP PwrLimr.dPwrLimrTLimMaxCurr "MICROSAR RTE" /begin SUB_GROUP /end SUB_GROUP /begin FUNCTION_LIST /end FUNCTION_LIST /begin REF_CHARACTERISTIC /end REF_CHARACTERISTIC /begin REF_MEASUREMENT PwrLimr.dPwrLimrTLimMaxCurr /end REF_MEASUREMENT /end GROUP
/begin GROUP PwrLimr.dPwrLimrTqEnvlpLim1 "MICROSAR RTE" /begin SUB_GROUP /end SUB_GROUP /begin FUNCTION_LIST /end FUNCTION_LIST /begin REF_CHARACTERISTIC /end REF_CHARACTERISTIC /begin REF_MEASUREMENT PwrLimr.dPwrLimrTqEnvlpLim1 /end REF_MEASUREMENT /end GROUP
/begin GROUP PwrLimr.dPwrLimrTqEnvlpLim4 "MICROSAR RTE" /begin SUB_GROUP /end SUB_GROUP /begin FUNCTION_LIST /end FUNCTION_LIST /begin REF_CHARACTERISTIC /end REF_CHARACTERISTIC /begin REF_MEASUREMENT PwrLimr.dPwrLimrTqEnvlpLim4 /end REF_MEASUREMENT /end GROUP
/begin GROUP PwrLimr.dPwrLimrTqLim "MICROSAR RTE" /begin SUB_GROUP /end SUB_GROUP /begin FUNCTION_LIST /end FUNCTION_LIST /begin REF_CHARACTERISTIC /end REF_CHARACTERISTIC /begin REF_MEASUREMENT PwrLimr.dPwrLimrTqLim /end REF_MEASUREMENT /end GROUP
/begin GROUP PwrLimr.dPwrLimrTqLim1 "MICROSAR RTE" /begin SUB_GROUP /end SUB_GROUP /begin FUNCTION_LIST /end FUNCTION_LIST /begin REF_CHARACTERISTIC /end REF_CHARACTERISTIC /begin REF_MEASUREMENT PwrLimr.dPwrLimrTqLim1 /end REF_MEASUREMENT /end GROUP
/begin GROUP PwrLimr.dPwrLimrTqLim4 "MICROSAR RTE" /begin SUB_GROUP /end SUB_GROUP /begin FUNCTION_LIST /end FUNCTION_LIST /begin REF_CHARACTERISTIC /end REF_CHARACTERISTIC /begin REF_MEASUREMENT PwrLimr.dPwrLimrTqLim4 /end REF_MEASUREMENT /end GROUP
/begin GROUP PwrSply "MICROSAR RTE"
 /begin SUB_GROUP PwrSply.CalibrationPorts PwrSply.PerInstanceMemories PwrSply.ReceiverPorts /end SUB_GROUP
 /begin FUNCTION_LIST /end FUNCTION_LIST
 /begin REF_CHARACTERISTIC /end REF_CHARACTERISTIC
 /begin REF_MEASUREMENT /end REF_MEASUREMENT
/end GROUP
/begin GROUP PwrSply.CalibrationPorts "MICROSAR RTE"
 /begin SUB_GROUP PwrSply.PwrSplyNtc0x07BFailStep.Val PwrSply.PwrSplyNtc0x07BPassStep.Val PwrSply.PwrSplyNtc0x07CFailStep.Val PwrSply.PwrSplyNtc0x07CPassStep.Val PwrSply.PwrSplyNtc0x07DFailStep.Val PwrSply.PwrSplyNtc0x07DPassStep.Val /end SUB_GROUP
 /begin FUNCTION_LIST /end FUNCTION_LIST
 /begin REF_CHARACTERISTIC /end REF_CHARACTERISTIC
 /begin REF_MEASUREMENT /end REF_MEASUREMENT
/end GROUP
/begin GROUP PwrSply.PerInstanceMemories "MICROSAR RTE"
 /begin SUB_GROUP PwrSply.ReadWrOrderFlg1 PwrSply.ReadWrOrderFlg2 PwrSply.SpiTrsmErrCntr PwrSply.StrtUpSelfTestCmpl /end SUB_GROUP
 /begin FUNCTION_LIST /end FUNCTION_LIST
 /begin REF_CHARACTERISTIC /end REF_CHARACTERISTIC
 /begin REF_MEASUREMENT /end REF_MEASUREMENT
/end GROUP
/begin GROUP PwrSply.PwrSplyNtc0x07BFailStep.Val "MICROSAR RTE" /begin SUB_GROUP /end SUB_GROUP /begin FUNCTION_LIST /end FUNCTION_LIST /begin REF_CHARACTERISTIC PwrSply.PwrSplyNtc0x07BFailStep.Val /end REF_CHARACTERISTIC /begin REF_MEASUREMENT /end REF_MEASUREMENT /end GROUP
/begin GROUP PwrSply.PwrSplyNtc0x07BPassStep.Val "MICROSAR RTE" /begin SUB_GROUP /end SUB_GROUP /begin FUNCTION_LIST /end FUNCTION_LIST /begin REF_CHARACTERISTIC PwrSply.PwrSplyNtc0x07BPassStep.Val /end REF_CHARACTERISTIC /begin REF_MEASUREMENT /end REF_MEASUREMENT /end GROUP
/begin GROUP PwrSply.PwrSplyNtc0x07CFailStep.Val "MICROSAR RTE" /begin SUB_GROUP /end SUB_GROUP /begin FUNCTION_LIST /end FUNCTION_LIST /begin REF_CHARACTERISTIC PwrSply.PwrSplyNtc0x07CFailStep.Val /end REF_CHARACTERISTIC /begin REF_MEASUREMENT /end REF_MEASUREMENT /end GROUP
/begin GROUP PwrSply.PwrSplyNtc0x07CPassStep.Val "MICROSAR RTE" /begin SUB_GROUP /end SUB_GROUP /begin FUNCTION_LIST /end FUNCTION_LIST /begin REF_CHARACTERISTIC PwrSply.PwrSplyNtc0x07CPassStep.Val /end REF_CHARACTERISTIC /begin REF_MEASUREMENT /end REF_MEASUREMENT /end GROUP
/begin GROUP PwrSply.PwrSplyNtc0x07DFailStep.Val "MICROSAR RTE" /begin SUB_GROUP /end SUB_GROUP /begin FUNCTION_LIST /end FUNCTION_LIST /begin REF_CHARACTERISTIC PwrSply.PwrSplyNtc0x07DFailStep.Val /end REF_CHARACTERISTIC /begin REF_MEASUREMENT /end REF_MEASUREMENT /end GROUP
/begin GROUP PwrSply.PwrSplyNtc0x07DPassStep.Val "MICROSAR RTE" /begin SUB_GROUP /end SUB_GROUP /begin FUNCTION_LIST /end FUNCTION_LIST /begin REF_CHARACTERISTIC PwrSply.PwrSplyNtc0x07DPassStep.Val /end REF_CHARACTERISTIC /begin REF_MEASUREMENT /end REF_MEASUREMENT /end GROUP
/begin GROUP PwrSply.ReadWrOrderFlg1 "MICROSAR RTE" /begin SUB_GROUP /end SUB_GROUP /begin FUNCTION_LIST /end FUNCTION_LIST /begin REF_CHARACTERISTIC /end REF_CHARACTERISTIC /begin REF_MEASUREMENT PwrSply.ReadWrOrderFlg1 /end REF_MEASUREMENT /end GROUP
/begin GROUP PwrSply.ReadWrOrderFlg2 "MICROSAR RTE" /begin SUB_GROUP /end SUB_GROUP /begin FUNCTION_LIST /end FUNCTION_LIST /begin REF_CHARACTERISTIC /end REF_CHARACTERISTIC /begin REF_MEASUREMENT PwrSply.ReadWrOrderFlg2 /end REF_MEASUREMENT /end GROUP
/begin GROUP PwrSply.ReceiverPorts "MICROSAR RTE" /begin SUB_GROUP PwrSply.SysSt.Val /end SUB_GROUP /begin FUNCTION_LIST /end FUNCTION_LIST /begin REF_CHARACTERISTIC /end REF_CHARACTERISTIC /begin REF_MEASUREMENT /end REF_MEASUREMENT /end GROUP
/begin GROUP PwrSply.SpiTrsmErrCntr "MICROSAR RTE" /begin SUB_GROUP /end SUB_GROUP /begin FUNCTION_LIST /end FUNCTION_LIST /begin REF_CHARACTERISTIC /end REF_CHARACTERISTIC /begin REF_MEASUREMENT PwrSply.SpiTrsmErrCntr /end REF_MEASUREMENT /end GROUP
/begin GROUP PwrSply.StrtUpSelfTestCmpl "MICROSAR RTE" /begin SUB_GROUP /end SUB_GROUP /begin FUNCTION_LIST /end FUNCTION_LIST /begin REF_CHARACTERISTIC /end REF_CHARACTERISTIC /begin REF_MEASUREMENT PwrSply.StrtUpSelfTestCmpl /end REF_MEASUREMENT /end GROUP
/begin GROUP PwrSply.SysSt.Val "MICROSAR RTE" /begin SUB_GROUP /end SUB_GROUP /begin FUNCTION_LIST /end FUNCTION_LIST /begin REF_CHARACTERISTIC /end REF_CHARACTERISTIC /begin REF_MEASUREMENT PwrSply.SysSt.Val /end REF_MEASUREMENT /end GROUP
/begin GROUP PwrUpSeq "MICROSAR RTE"
 /begin SUB_GROUP PwrUpSeq.PerInstanceMemories PwrUpSeq.ReceiverPorts PwrUpSeq.SenderPorts /end SUB_GROUP
 /begin FUNCTION_LIST /end FUNCTION_LIST
 /begin REF_CHARACTERISTIC /end REF_CHARACTERISTIC
 /begin REF_MEASUREMENT /end REF_MEASUREMENT
/end GROUP
/begin GROUP PwrUpSeq.CodFlsCrcChkCmpl.Logl "MICROSAR RTE" /begin SUB_GROUP /end SUB_GROUP /begin FUNCTION_LIST /end FUNCTION_LIST /begin REF_CHARACTERISTIC /end REF_CHARACTERISTIC /begin REF_MEASUREMENT PwrUpSeq.CodFlsCrcChkCmpl.Logl /end REF_MEASUREMENT /end GROUP
/begin GROUP PwrUpSeq.CurrMeasWrmIninTestCmpl.Logl "MICROSAR RTE" /begin SUB_GROUP /end SUB_GROUP /begin FUNCTION_LIST /end FUNCTION_LIST /begin REF_CHARACTERISTIC /end REF_CHARACTERISTIC /begin REF_MEASUREMENT PwrUpSeq.CurrMeasWrmIninTestCmpl.Logl /end REF_MEASUREMENT /end GROUP
/begin GROUP PwrUpSeq.MotDrvr0IninTestCmpl.Logl "MICROSAR RTE" /begin SUB_GROUP /end SUB_GROUP /begin FUNCTION_LIST /end FUNCTION_LIST /begin REF_CHARACTERISTIC /end REF_CHARACTERISTIC /begin REF_MEASUREMENT PwrUpSeq.MotDrvr0IninTestCmpl.Logl /end REF_MEASUREMENT /end GROUP
/begin GROUP PwrUpSeq.MotDrvr1IninTestCmpl.Logl "MICROSAR RTE" /begin SUB_GROUP /end SUB_GROUP /begin FUNCTION_LIST /end FUNCTION_LIST /begin REF_CHARACTERISTIC /end REF_CHARACTERISTIC /begin REF_MEASUREMENT PwrUpSeq.MotDrvr1IninTestCmpl.Logl /end REF_MEASUREMENT /end GROUP
/begin GROUP PwrUpSeq.PerInstanceMemories "MICROSAR RTE" /begin SUB_GROUP PwrUpSeq.PwrTurnOffCtrlPrev /end SUB_GROUP /begin FUNCTION_LIST /end FUNCTION_LIST /begin REF_CHARACTERISTIC /end REF_CHARACTERISTIC /begin REF_MEASUREMENT /end REF_MEASUREMENT /end GROUP
/begin GROUP PwrUpSeq.PwrDiscnctATestCmpl.Logl "MICROSAR RTE" /begin SUB_GROUP /end SUB_GROUP /begin FUNCTION_LIST /end FUNCTION_LIST /begin REF_CHARACTERISTIC /end REF_CHARACTERISTIC /begin REF_MEASUREMENT PwrUpSeq.PwrDiscnctATestCmpl.Logl /end REF_MEASUREMENT /end GROUP
/begin GROUP PwrUpSeq.PwrDiscnctBTestCmpl.Logl "MICROSAR RTE" /begin SUB_GROUP /end SUB_GROUP /begin FUNCTION_LIST /end FUNCTION_LIST /begin REF_CHARACTERISTIC /end REF_CHARACTERISTIC /begin REF_MEASUREMENT PwrUpSeq.PwrDiscnctBTestCmpl.Logl /end REF_MEASUREMENT /end GROUP
/begin GROUP PwrUpSeq.PwrTurnOffCtrlPrev "MICROSAR RTE" /begin SUB_GROUP /end SUB_GROUP /begin FUNCTION_LIST /end FUNCTION_LIST /begin REF_CHARACTERISTIC /end REF_CHARACTERISTIC /begin REF_MEASUREMENT PwrUpSeq.PwrTurnOffCtrlPrev /end REF_MEASUREMENT /end GROUP
/begin GROUP PwrUpSeq.ReceiverPorts "MICROSAR RTE"
 /begin SUB_GROUP PwrUpSeq.CodFlsCrcChkCmpl.Logl PwrUpSeq.CurrMeasWrmIninTestCmpl.Logl PwrUpSeq.MotDrvr0IninTestCmpl.Logl PwrUpSeq.MotDrvr1IninTestCmpl.Logl PwrUpSeq.PwrDiscnctATestCmpl.Logl PwrUpSeq.PwrDiscnctBTestCmpl.Logl PwrUpSeq.SysSt.Val PwrUpSeq.TmplMonIninTestCmpl.Logl /end SUB_GROUP
 /begin FUNCTION_LIST /end FUNCTION_LIST
 /begin REF_CHARACTERISTIC /end REF_CHARACTERISTIC
 /begin REF_MEASUREMENT /end REF_MEASUREMENT
/end GROUP
/begin GROUP PwrUpSeq.SenderPorts "MICROSAR RTE" /begin SUB_GROUP PwrUpSeq.StrtUpSt.Val PwrUpSeq.SysStWrmIninCmpl.Logl /end SUB_GROUP /begin FUNCTION_LIST /end FUNCTION_LIST /begin REF_CHARACTERISTIC /end REF_CHARACTERISTIC /begin REF_MEASUREMENT /end REF_MEASUREMENT /end GROUP
/begin GROUP PwrUpSeq.StrtUpSt.Val "MICROSAR RTE" /begin SUB_GROUP /end SUB_GROUP /begin FUNCTION_LIST /end FUNCTION_LIST /begin REF_CHARACTERISTIC /end REF_CHARACTERISTIC /begin REF_MEASUREMENT PwrUpSeq.StrtUpSt.Val /end REF_MEASUREMENT /end GROUP
/begin GROUP PwrUpSeq.SysSt.Val "MICROSAR RTE" /begin SUB_GROUP /end SUB_GROUP /begin FUNCTION_LIST /end FUNCTION_LIST /begin REF_CHARACTERISTIC /end REF_CHARACTERISTIC /begin REF_MEASUREMENT PwrUpSeq.SysSt.Val /end REF_MEASUREMENT /end GROUP
/begin GROUP PwrUpSeq.SysStWrmIninCmpl.Logl "MICROSAR RTE" /begin SUB_GROUP /end SUB_GROUP /begin FUNCTION_LIST /end FUNCTION_LIST /begin REF_CHARACTERISTIC /end REF_CHARACTERISTIC /begin REF_MEASUREMENT PwrUpSeq.SysStWrmIninCmpl.Logl /end REF_MEASUREMENT /end GROUP
/begin GROUP PwrUpSeq.TmplMonIninTestCmpl.Logl "MICROSAR RTE" /begin SUB_GROUP /end SUB_GROUP /begin FUNCTION_LIST /end FUNCTION_LIST /begin REF_CHARACTERISTIC /end REF_CHARACTERISTIC /begin REF_MEASUREMENT PwrUpSeq.TmplMonIninTestCmpl.Logl /end REF_MEASUREMENT /end GROUP
/begin GROUP RTE "MICROSAR RTE" /begin SUB_GROUP SWCs /end SUB_GROUP /begin FUNCTION_LIST /end FUNCTION_LIST /begin REF_CHARACTERISTIC /end REF_CHARACTERISTIC /begin REF_MEASUREMENT /end REF_MEASUREMENT /end GROUP
/begin GROUP Rtn "MICROSAR RTE"
 /begin SUB_GROUP Rtn.CalibrationPorts Rtn.PerInstanceMemories Rtn.ReceiverPorts Rtn.SenderPorts /end SUB_GROUP
 /begin FUNCTION_LIST /end FUNCTION_LIST
 /begin REF_CHARACTERISTIC /end REF_CHARACTERISTIC
 /begin REF_MEASUREMENT /end REF_MEASUREMENT
/end GROUP
/begin GROUP Rtn.AssiMechT.Val "MICROSAR RTE" /begin SUB_GROUP /end SUB_GROUP /begin FUNCTION_LIST /end FUNCTION_LIST /begin REF_CHARACTERISTIC /end REF_CHARACTERISTIC /begin REF_MEASUREMENT Rtn.AssiMechT.Val /end REF_MEASUREMENT /end GROUP
/begin GROUP Rtn.CalibrationPorts "MICROSAR RTE"
 /begin SUB_GROUP Rtn.RtnHwAgOffsCalcdX.Ary2D Rtn.RtnHwAgOffsCalcdY.Ary2D Rtn.RtnHwAuthyScaX.Ary1D Rtn.RtnHwAuthyScaY.Ary1D Rtn.RtnHwAuthySlew.Val Rtn.RtnOffsRng.Val Rtn.RtnOffsSlew.Val Rtn.RtnScaTqX.Ary2D Rtn.RtnScaTqY.Ary2D Rtn.RtnScaVelX.Ary2D Rtn.RtnScaVelY.Ary2D Rtn.RtnTScaX.Ary1D Rtn.RtnTScaY.Ary1D Rtn.RtnVehSpdSeln.Ary1D /end SUB_GROUP
 /begin FUNCTION_LIST /end FUNCTION_LIST
 /begin REF_CHARACTERISTIC /end REF_CHARACTERISTIC
 /begin REF_MEASUREMENT /end REF_MEASUREMENT
/end GROUP
/begin GROUP Rtn.HwAg.Val "MICROSAR RTE" /begin SUB_GROUP /end SUB_GROUP /begin FUNCTION_LIST /end FUNCTION_LIST /begin REF_CHARACTERISTIC /end REF_CHARACTERISTIC /begin REF_MEASUREMENT Rtn.HwAg.Val /end REF_MEASUREMENT /end GROUP
/begin GROUP Rtn.HwAgAuthySca.Val "MICROSAR RTE" /begin SUB_GROUP /end SUB_GROUP /begin FUNCTION_LIST /end FUNCTION_LIST /begin REF_CHARACTERISTIC /end REF_CHARACTERISTIC /begin REF_MEASUREMENT Rtn.HwAgAuthySca.Val /end REF_MEASUREMENT /end GROUP
/begin GROUP Rtn.HwAgRtnOffs.Val "MICROSAR RTE" /begin SUB_GROUP /end SUB_GROUP /begin FUNCTION_LIST /end FUNCTION_LIST /begin REF_CHARACTERISTIC /end REF_CHARACTERISTIC /begin REF_MEASUREMENT Rtn.HwAgRtnOffs.Val /end REF_MEASUREMENT /end GROUP
/begin GROUP Rtn.HwTq.Val "MICROSAR RTE" /begin SUB_GROUP /end SUB_GROUP /begin FUNCTION_LIST /end FUNCTION_LIST /begin REF_CHARACTERISTIC /end REF_CHARACTERISTIC /begin REF_MEASUREMENT Rtn.HwTq.Val /end REF_MEASUREMENT /end GROUP
/begin GROUP Rtn.HwVel.Val "MICROSAR RTE" /begin SUB_GROUP /end SUB_GROUP /begin FUNCTION_LIST /end FUNCTION_LIST /begin REF_CHARACTERISTIC /end REF_CHARACTERISTIC /begin REF_MEASUREMENT Rtn.HwVel.Val /end REF_MEASUREMENT /end GROUP
/begin GROUP Rtn.PerInstanceMemories "MICROSAR RTE"
 /begin SUB_GROUP Rtn.PrevHwAgAuthy Rtn.PrevHwAgOffsLimd Rtn.dRtnAbsltHwAg Rtn.dRtnAssiMechTRtnSca Rtn.dRtnBascRtn Rtn.dRtnHwAgAuthySca Rtn.dRtnHwAgRtnCmd Rtn.dRtnHwTqRtnSca Rtn.dRtnHwVelRtnSca /end SUB_GROUP
 /begin FUNCTION_LIST /end FUNCTION_LIST
 /begin REF_CHARACTERISTIC /end REF_CHARACTERISTIC
 /begin REF_MEASUREMENT /end REF_MEASUREMENT
/end GROUP
/begin GROUP Rtn.PrevHwAgAuthy "MICROSAR RTE" /begin SUB_GROUP /end SUB_GROUP /begin FUNCTION_LIST /end FUNCTION_LIST /begin REF_CHARACTERISTIC /end REF_CHARACTERISTIC /begin REF_MEASUREMENT Rtn.PrevHwAgAuthy /end REF_MEASUREMENT /end GROUP
/begin GROUP Rtn.PrevHwAgOffsLimd "MICROSAR RTE" /begin SUB_GROUP /end SUB_GROUP /begin FUNCTION_LIST /end FUNCTION_LIST /begin REF_CHARACTERISTIC /end REF_CHARACTERISTIC /begin REF_MEASUREMENT Rtn.PrevHwAgOffsLimd /end REF_MEASUREMENT /end GROUP
/begin GROUP Rtn.ReceiverPorts "MICROSAR RTE"
 /begin SUB_GROUP Rtn.AssiMechT.Val Rtn.HwAg.Val Rtn.HwAgAuthySca.Val Rtn.HwAgRtnOffs.Val Rtn.HwTq.Val Rtn.HwVel.Val Rtn.RtnCmdDi.Logl Rtn.RtnCmdDiagcDi.Logl Rtn.RtnCmdSca.Val Rtn.RtnCmdScaServo.Val Rtn.VehSpd.Val Rtn.VehSpdVld.Logl /end SUB_GROUP
 /begin FUNCTION_LIST /end FUNCTION_LIST
 /begin REF_CHARACTERISTIC /end REF_CHARACTERISTIC
 /begin REF_MEASUREMENT /end REF_MEASUREMENT
/end GROUP
/begin GROUP Rtn.RtnCmd.Val "MICROSAR RTE" /begin SUB_GROUP /end SUB_GROUP /begin FUNCTION_LIST /end FUNCTION_LIST /begin REF_CHARACTERISTIC /end REF_CHARACTERISTIC /begin REF_MEASUREMENT Rtn.RtnCmd.Val /end REF_MEASUREMENT /end GROUP
/begin GROUP Rtn.RtnCmdDi.Logl "MICROSAR RTE" /begin SUB_GROUP /end SUB_GROUP /begin FUNCTION_LIST /end FUNCTION_LIST /begin REF_CHARACTERISTIC /end REF_CHARACTERISTIC /begin REF_MEASUREMENT Rtn.RtnCmdDi.Logl /end REF_MEASUREMENT /end GROUP
/begin GROUP Rtn.RtnCmdDiagcDi.Logl "MICROSAR RTE" /begin SUB_GROUP /end SUB_GROUP /begin FUNCTION_LIST /end FUNCTION_LIST /begin REF_CHARACTERISTIC /end REF_CHARACTERISTIC /begin REF_MEASUREMENT Rtn.RtnCmdDiagcDi.Logl /end REF_MEASUREMENT /end GROUP
/begin GROUP Rtn.RtnCmdSca.Val "MICROSAR RTE" /begin SUB_GROUP /end SUB_GROUP /begin FUNCTION_LIST /end FUNCTION_LIST /begin REF_CHARACTERISTIC /end REF_CHARACTERISTIC /begin REF_MEASUREMENT Rtn.RtnCmdSca.Val /end REF_MEASUREMENT /end GROUP
/begin GROUP Rtn.RtnCmdScaServo.Val "MICROSAR RTE" /begin SUB_GROUP /end SUB_GROUP /begin FUNCTION_LIST /end FUNCTION_LIST /begin REF_CHARACTERISTIC /end REF_CHARACTERISTIC /begin REF_MEASUREMENT Rtn.RtnCmdScaServo.Val /end REF_MEASUREMENT /end GROUP
/begin GROUP Rtn.RtnHwAgOffsCalcdX.Ary2D "MICROSAR RTE" /begin SUB_GROUP /end SUB_GROUP /begin FUNCTION_LIST /end FUNCTION_LIST /begin REF_CHARACTERISTIC Rtn.RtnHwAgOffsCalcdX.Ary2D /end REF_CHARACTERISTIC /begin REF_MEASUREMENT /end REF_MEASUREMENT /end GROUP
/begin GROUP Rtn.RtnHwAgOffsCalcdY.Ary2D "MICROSAR RTE" /begin SUB_GROUP /end SUB_GROUP /begin FUNCTION_LIST /end FUNCTION_LIST /begin REF_CHARACTERISTIC Rtn.RtnHwAgOffsCalcdY.Ary2D /end REF_CHARACTERISTIC /begin REF_MEASUREMENT /end REF_MEASUREMENT /end GROUP
/begin GROUP Rtn.RtnHwAuthyScaX.Ary1D "MICROSAR RTE" /begin SUB_GROUP /end SUB_GROUP /begin FUNCTION_LIST /end FUNCTION_LIST /begin REF_CHARACTERISTIC Rtn.RtnHwAuthyScaX.Ary1D /end REF_CHARACTERISTIC /begin REF_MEASUREMENT /end REF_MEASUREMENT /end GROUP
/begin GROUP Rtn.RtnHwAuthyScaY.Ary1D "MICROSAR RTE" /begin SUB_GROUP /end SUB_GROUP /begin FUNCTION_LIST /end FUNCTION_LIST /begin REF_CHARACTERISTIC Rtn.RtnHwAuthyScaY.Ary1D /end REF_CHARACTERISTIC /begin REF_MEASUREMENT /end REF_MEASUREMENT /end GROUP
/begin GROUP Rtn.RtnHwAuthySlew.Val "MICROSAR RTE" /begin SUB_GROUP /end SUB_GROUP /begin FUNCTION_LIST /end FUNCTION_LIST /begin REF_CHARACTERISTIC Rtn.RtnHwAuthySlew.Val /end REF_CHARACTERISTIC /begin REF_MEASUREMENT /end REF_MEASUREMENT /end GROUP
/begin GROUP Rtn.RtnOffsRng.Val "MICROSAR RTE" /begin SUB_GROUP /end SUB_GROUP /begin FUNCTION_LIST /end FUNCTION_LIST /begin REF_CHARACTERISTIC Rtn.RtnOffsRng.Val /end REF_CHARACTERISTIC /begin REF_MEASUREMENT /end REF_MEASUREMENT /end GROUP
/begin GROUP Rtn.RtnOffsSlew.Val "MICROSAR RTE" /begin SUB_GROUP /end SUB_GROUP /begin FUNCTION_LIST /end FUNCTION_LIST /begin REF_CHARACTERISTIC Rtn.RtnOffsSlew.Val /end REF_CHARACTERISTIC /begin REF_MEASUREMENT /end REF_MEASUREMENT /end GROUP
/begin GROUP Rtn.RtnScaTqX.Ary2D "MICROSAR RTE" /begin SUB_GROUP /end SUB_GROUP /begin FUNCTION_LIST /end FUNCTION_LIST /begin REF_CHARACTERISTIC Rtn.RtnScaTqX.Ary2D /end REF_CHARACTERISTIC /begin REF_MEASUREMENT /end REF_MEASUREMENT /end GROUP
/begin GROUP Rtn.RtnScaTqY.Ary2D "MICROSAR RTE" /begin SUB_GROUP /end SUB_GROUP /begin FUNCTION_LIST /end FUNCTION_LIST /begin REF_CHARACTERISTIC Rtn.RtnScaTqY.Ary2D /end REF_CHARACTERISTIC /begin REF_MEASUREMENT /end REF_MEASUREMENT /end GROUP
/begin GROUP Rtn.RtnScaVelX.Ary2D "MICROSAR RTE" /begin SUB_GROUP /end SUB_GROUP /begin FUNCTION_LIST /end FUNCTION_LIST /begin REF_CHARACTERISTIC Rtn.RtnScaVelX.Ary2D /end REF_CHARACTERISTIC /begin REF_MEASUREMENT /end REF_MEASUREMENT /end GROUP
/begin GROUP Rtn.RtnScaVelY.Ary2D "MICROSAR RTE" /begin SUB_GROUP /end SUB_GROUP /begin FUNCTION_LIST /end FUNCTION_LIST /begin REF_CHARACTERISTIC Rtn.RtnScaVelY.Ary2D /end REF_CHARACTERISTIC /begin REF_MEASUREMENT /end REF_MEASUREMENT /end GROUP
/begin GROUP Rtn.RtnTScaX.Ary1D "MICROSAR RTE" /begin SUB_GROUP /end SUB_GROUP /begin FUNCTION_LIST /end FUNCTION_LIST /begin REF_CHARACTERISTIC Rtn.RtnTScaX.Ary1D /end REF_CHARACTERISTIC /begin REF_MEASUREMENT /end REF_MEASUREMENT /end GROUP
/begin GROUP Rtn.RtnTScaY.Ary1D "MICROSAR RTE" /begin SUB_GROUP /end SUB_GROUP /begin FUNCTION_LIST /end FUNCTION_LIST /begin REF_CHARACTERISTIC Rtn.RtnTScaY.Ary1D /end REF_CHARACTERISTIC /begin REF_MEASUREMENT /end REF_MEASUREMENT /end GROUP
/begin GROUP Rtn.RtnVehSpdSeln.Ary1D "MICROSAR RTE" /begin SUB_GROUP /end SUB_GROUP /begin FUNCTION_LIST /end FUNCTION_LIST /begin REF_CHARACTERISTIC Rtn.RtnVehSpdSeln.Ary1D /end REF_CHARACTERISTIC /begin REF_MEASUREMENT /end REF_MEASUREMENT /end GROUP
/begin GROUP Rtn.SenderPorts "MICROSAR RTE" /begin SUB_GROUP Rtn.RtnCmd.Val /end SUB_GROUP /begin FUNCTION_LIST /end FUNCTION_LIST /begin REF_CHARACTERISTIC /end REF_CHARACTERISTIC /begin REF_MEASUREMENT /end REF_MEASUREMENT /end GROUP
/begin GROUP Rtn.VehSpd.Val "MICROSAR RTE" /begin SUB_GROUP /end SUB_GROUP /begin FUNCTION_LIST /end FUNCTION_LIST /begin REF_CHARACTERISTIC /end REF_CHARACTERISTIC /begin REF_MEASUREMENT Rtn.VehSpd.Val /end REF_MEASUREMENT /end GROUP
/begin GROUP Rtn.VehSpdVld.Logl "MICROSAR RTE" /begin SUB_GROUP /end SUB_GROUP /begin FUNCTION_LIST /end FUNCTION_LIST /begin REF_CHARACTERISTIC /end REF_CHARACTERISTIC /begin REF_MEASUREMENT Rtn.VehSpdVld.Logl /end REF_MEASUREMENT /end GROUP
/begin GROUP Rtn.dRtnAbsltHwAg "MICROSAR RTE" /begin SUB_GROUP /end SUB_GROUP /begin FUNCTION_LIST /end FUNCTION_LIST /begin REF_CHARACTERISTIC /end REF_CHARACTERISTIC /begin REF_MEASUREMENT Rtn.dRtnAbsltHwAg /end REF_MEASUREMENT /end GROUP
/begin GROUP Rtn.dRtnAssiMechTRtnSca "MICROSAR RTE" /begin SUB_GROUP /end SUB_GROUP /begin FUNCTION_LIST /end FUNCTION_LIST /begin REF_CHARACTERISTIC /end REF_CHARACTERISTIC /begin REF_MEASUREMENT Rtn.dRtnAssiMechTRtnSca /end REF_MEASUREMENT /end GROUP
/begin GROUP Rtn.dRtnBascRtn "MICROSAR RTE" /begin SUB_GROUP /end SUB_GROUP /begin FUNCTION_LIST /end FUNCTION_LIST /begin REF_CHARACTERISTIC /end REF_CHARACTERISTIC /begin REF_MEASUREMENT Rtn.dRtnBascRtn /end REF_MEASUREMENT /end GROUP
/begin GROUP Rtn.dRtnHwAgAuthySca "MICROSAR RTE" /begin SUB_GROUP /end SUB_GROUP /begin FUNCTION_LIST /end FUNCTION_LIST /begin REF_CHARACTERISTIC /end REF_CHARACTERISTIC /begin REF_MEASUREMENT Rtn.dRtnHwAgAuthySca /end REF_MEASUREMENT /end GROUP
/begin GROUP Rtn.dRtnHwAgRtnCmd "MICROSAR RTE" /begin SUB_GROUP /end SUB_GROUP /begin FUNCTION_LIST /end FUNCTION_LIST /begin REF_CHARACTERISTIC /end REF_CHARACTERISTIC /begin REF_MEASUREMENT Rtn.dRtnHwAgRtnCmd /end REF_MEASUREMENT /end GROUP
/begin GROUP Rtn.dRtnHwTqRtnSca "MICROSAR RTE" /begin SUB_GROUP /end SUB_GROUP /begin FUNCTION_LIST /end FUNCTION_LIST /begin REF_CHARACTERISTIC /end REF_CHARACTERISTIC /begin REF_MEASUREMENT Rtn.dRtnHwTqRtnSca /end REF_MEASUREMENT /end GROUP
/begin GROUP Rtn.dRtnHwVelRtnSca "MICROSAR RTE" /begin SUB_GROUP /end SUB_GROUP /begin FUNCTION_LIST /end FUNCTION_LIST /begin REF_CHARACTERISTIC /end REF_CHARACTERISTIC /begin REF_MEASUREMENT Rtn.dRtnHwVelRtnSca /end REF_MEASUREMENT /end GROUP
/begin GROUP RtnPahFwl "MICROSAR RTE"
 /begin SUB_GROUP RtnPahFwl.CalibrationPorts RtnPahFwl.PerInstanceMemories RtnPahFwl.ReceiverPorts RtnPahFwl.SenderPorts /end SUB_GROUP
 /begin FUNCTION_LIST /end FUNCTION_LIST
 /begin REF_CHARACTERISTIC /end REF_CHARACTERISTIC
 /begin REF_MEASUREMENT /end REF_MEASUREMENT
/end GROUP
/begin GROUP RtnPahFwl.CalibrationPorts "MICROSAR RTE"
 /begin SUB_GROUP RtnPahFwl.RtnPahFwlUpprBndTblX.Ary1D RtnPahFwl.RtnPahFwlUpprBndTblY.Ary2D RtnPahFwl.RtnPahFwlVehSpd.Ary1D /end SUB_GROUP
 /begin FUNCTION_LIST /end FUNCTION_LIST
 /begin REF_CHARACTERISTIC /end REF_CHARACTERISTIC
 /begin REF_MEASUREMENT /end REF_MEASUREMENT
/end GROUP
/begin GROUP RtnPahFwl.HwAg.Val "MICROSAR RTE" /begin SUB_GROUP /end SUB_GROUP /begin FUNCTION_LIST /end FUNCTION_LIST /begin REF_CHARACTERISTIC /end REF_CHARACTERISTIC /begin REF_MEASUREMENT RtnPahFwl.HwAg.Val /end REF_MEASUREMENT /end GROUP
/begin GROUP RtnPahFwl.PerInstanceMemories "MICROSAR RTE"
 /begin SUB_GROUP RtnPahFwl.dRtnPahFwlLowrBnd RtnPahFwl.dRtnPahFwlOverBnd RtnPahFwl.dRtnPahFwlUpprBnd /end SUB_GROUP
 /begin FUNCTION_LIST /end FUNCTION_LIST
 /begin REF_CHARACTERISTIC /end REF_CHARACTERISTIC
 /begin REF_MEASUREMENT /end REF_MEASUREMENT
/end GROUP
/begin GROUP RtnPahFwl.ReceiverPorts "MICROSAR RTE"
 /begin SUB_GROUP RtnPahFwl.HwAg.Val RtnPahFwl.RtnCmd.Val RtnPahFwl.RtnCmdDi.Logl RtnPahFwl.VehSpd.Val /end SUB_GROUP
 /begin FUNCTION_LIST /end FUNCTION_LIST
 /begin REF_CHARACTERISTIC /end REF_CHARACTERISTIC
 /begin REF_MEASUREMENT /end REF_MEASUREMENT
/end GROUP
/begin GROUP RtnPahFwl.RtnCmd.Val "MICROSAR RTE" /begin SUB_GROUP /end SUB_GROUP /begin FUNCTION_LIST /end FUNCTION_LIST /begin REF_CHARACTERISTIC /end REF_CHARACTERISTIC /begin REF_MEASUREMENT RtnPahFwl.RtnCmd.Val /end REF_MEASUREMENT /end GROUP
/begin GROUP RtnPahFwl.RtnCmdDi.Logl "MICROSAR RTE" /begin SUB_GROUP /end SUB_GROUP /begin FUNCTION_LIST /end FUNCTION_LIST /begin REF_CHARACTERISTIC /end REF_CHARACTERISTIC /begin REF_MEASUREMENT RtnPahFwl.RtnCmdDi.Logl /end REF_MEASUREMENT /end GROUP
/begin GROUP RtnPahFwl.RtnCmdLimd.Val "MICROSAR RTE" /begin SUB_GROUP /end SUB_GROUP /begin FUNCTION_LIST /end FUNCTION_LIST /begin REF_CHARACTERISTIC /end REF_CHARACTERISTIC /begin REF_MEASUREMENT RtnPahFwl.RtnCmdLimd.Val /end REF_MEASUREMENT /end GROUP
/begin GROUP RtnPahFwl.RtnPahFwlUpprBndTblX.Ary1D "MICROSAR RTE" /begin SUB_GROUP /end SUB_GROUP /begin FUNCTION_LIST /end FUNCTION_LIST /begin REF_CHARACTERISTIC RtnPahFwl.RtnPahFwlUpprBndTblX.Ary1D /end REF_CHARACTERISTIC /begin REF_MEASUREMENT /end REF_MEASUREMENT /end GROUP
/begin GROUP RtnPahFwl.RtnPahFwlUpprBndTblY.Ary2D "MICROSAR RTE" /begin SUB_GROUP /end SUB_GROUP /begin FUNCTION_LIST /end FUNCTION_LIST /begin REF_CHARACTERISTIC RtnPahFwl.RtnPahFwlUpprBndTblY.Ary2D /end REF_CHARACTERISTIC /begin REF_MEASUREMENT /end REF_MEASUREMENT /end GROUP
/begin GROUP RtnPahFwl.RtnPahFwlVehSpd.Ary1D "MICROSAR RTE" /begin SUB_GROUP /end SUB_GROUP /begin FUNCTION_LIST /end FUNCTION_LIST /begin REF_CHARACTERISTIC RtnPahFwl.RtnPahFwlVehSpd.Ary1D /end REF_CHARACTERISTIC /begin REF_MEASUREMENT /end REF_MEASUREMENT /end GROUP
/begin GROUP RtnPahFwl.SenderPorts "MICROSAR RTE" /begin SUB_GROUP RtnPahFwl.RtnCmdLimd.Val /end SUB_GROUP /begin FUNCTION_LIST /end FUNCTION_LIST /begin REF_CHARACTERISTIC /end REF_CHARACTERISTIC /begin REF_MEASUREMENT /end REF_MEASUREMENT /end GROUP
/begin GROUP RtnPahFwl.VehSpd.Val "MICROSAR RTE" /begin SUB_GROUP /end SUB_GROUP /begin FUNCTION_LIST /end FUNCTION_LIST /begin REF_CHARACTERISTIC /end REF_CHARACTERISTIC /begin REF_MEASUREMENT RtnPahFwl.VehSpd.Val /end REF_MEASUREMENT /end GROUP
/begin GROUP RtnPahFwl.dRtnPahFwlLowrBnd "MICROSAR RTE" /begin SUB_GROUP /end SUB_GROUP /begin FUNCTION_LIST /end FUNCTION_LIST /begin REF_CHARACTERISTIC /end REF_CHARACTERISTIC /begin REF_MEASUREMENT RtnPahFwl.dRtnPahFwlLowrBnd /end REF_MEASUREMENT /end GROUP
/begin GROUP RtnPahFwl.dRtnPahFwlOverBnd "MICROSAR RTE" /begin SUB_GROUP /end SUB_GROUP /begin FUNCTION_LIST /end FUNCTION_LIST /begin REF_CHARACTERISTIC /end REF_CHARACTERISTIC /begin REF_MEASUREMENT RtnPahFwl.dRtnPahFwlOverBnd /end REF_MEASUREMENT /end GROUP
/begin GROUP RtnPahFwl.dRtnPahFwlUpprBnd "MICROSAR RTE" /begin SUB_GROUP /end SUB_GROUP /begin FUNCTION_LIST /end FUNCTION_LIST /begin REF_CHARACTERISTIC /end REF_CHARACTERISTIC /begin REF_MEASUREMENT RtnPahFwl.dRtnPahFwlUpprBnd /end REF_MEASUREMENT /end GROUP
/begin GROUP SWCs "MICROSAR RTE"
 /begin SUB_GROUP AAACalRegn01Rt00_Dummy AAACalRegn01Rt01_Dummy AAACalRegn01Rt02_Dummy AAACalRegn01Rt03_Dummy AAACalRegn01Rt04_Dummy AAACalRegn01Rt05_Dummy AAACalRegn02Rt00GroupA_Dummy AAACalRegn02Rt00GroupB_Dummy AAACalRegn02Rt01GroupA_Dummy AAACalRegn02Rt01GroupB_Dummy AAACalRegn02Rt02GroupA_Dummy AAACalRegn02Rt02GroupB_Dummy AAACalRegn02Rt03GroupA_Dummy AAACalRegn02Rt03GroupB_Dummy AAACalRegn02Rt04GroupA_Dummy AAACalRegn02Rt04GroupB_Dummy AAACalRegn02Rt05GroupA_Dummy AAACalRegn02Rt05GroupB_Dummy Adcf1CfgAndUse Assi AssiHiFrq AssiPahSum AssiSumLim BattVltg BattVltgCorrln BswM CDD_Adcf0CfgAndUse CDD_CoreVltgMonr CDD_CurrMeas CDD_CurrMeasArbn CDD_DmaCfgAndUse CDD_EcmOutpAndDiagc CDD_ExcpnHndlg CDD_FlsMem CDD_FordBlaBoxIfCmn CDD_FordBlaBoxIfCmp1 CDD_FordBlaBoxIfCmp2 CDD_FordT3T6McuCfg CDD_GtmCfgAndUse CDD_HwTq1Meas CDD_HwTq8Meas CDD_McuCoreCfgAndDiagc CDD_McuDiagc CDD_MotAg5Meas CDD_MotAg6Meas CDD_MotAgArbn CDD_MotAgCmp CDD_MotAgSwCal CDD_MotCtrlMgr CDD_MotCurrRegVltgLimr CDD_MotRplCoggCmd CDD_MotVel CDD_NvMProxy CDD_NxtrTi CDD_RamMem CDD_SinVltgGenn CDD_SyncCrc CDD_Uart0CfgAndUse CDD_Uart1CfgAndUse CDD_VrfyCritReg CDD_XcpIf CalRegn01Cmn CalRegn01CmnGroupA CalRegn01Inin00 CalRegn01Inin00GroupA CalRegn01Inin00GroupB CalRegn01Inin00GroupD CalRegn01Rt00 CalRegn01Rt01 CalRegn01Rt02 CalRegn01Rt03 CalRegn01Rt04 CalRegn01Rt05 CalRegn02Cmn CalRegn02CmnGroupA CalRegn02CmnGroupB CalRegn02Inin00 CalRegn02Inin00GroupA CalRegn02Inin00GroupB CalRegn02Rt00GroupA CalRegn02Rt00GroupB CalRegn02Rt01GroupA CalRegn02Rt01GroupB CalRegn02Rt02GroupA CalRegn02Rt02GroupB CalRegn02Rt03GroupA CalRegn02Rt03GroupB CalRegn02Rt04GroupA CalRegn02Rt04GroupB CalRegn02Rt05GroupA CalRegn02Rt05GroupB CmnMfgSrv CmplncErr CurrMeasCorrln CustDiag Dampg DampgPahSum Dcm DiagcMgr DiagcMgrProxyAppl10 DrvrTqEstimn DualCtrlrOutpMgr DualEcuIdn DutyCycThermProtn EcuTMeas ElecPwrCns EotLrng EotProtn EotProtnFwl FltInj FordCanDtcInhb FordCmdArbn FordDualEcuFltDiagcCom FordHwAgArbn FordHwTqCdng FordHwTqCmdOvrlLimr FordMotTqCmdOvrlLimr FordMsg077BusHiSpd FordMsg07DBusHiSpd FordMsg07EBusHiSpd FordMsg082BusHiSpd FordMsg083BusHiSpd FordMsg091BusHiSpd FordMsg167BusHiSpd FordMsg202BusHiSpd FordMsg213BusHiSpd FordMsg215BusHiSpd FordMsg216BusHiSpd FordMsg217BusHiSpd FordMsg230BusHiSpd FordMsg2FDBusHiSpd FordMsg3B3BusHiSpd FordMsg3CABusHiSpd FordMsg3CCBusHiSpd FordMsg3D3BusHiSpd FordMsg3D7BusHiSpd FordMsg40ABusHiSpd FordMsg414BusHiSpd FordMsg415BusHiSpd FordMsg417BusHiSpd FordMsg41ABusHiSpd FordMsg41EBusHiSpd FordMsg430BusHiSpd FordMsg443BusHiSpd FordMsg459BusHiSpd FordMsg47ABusHiSpd FordMsg4B0BusHiSpd FordMsg5B5BusHiSpd FordSysSt FordVehSpdArbn FordVltgIf GateDrv0Ctrl HiLoadStallLimr HwAg1Meas HwAgArbn HwAgCorrln HwAgSnsrls HwAgSysArbn HwTq10Meas HwTq9Meas HwTqArbn HwTqCorrln HysCmp ImcArbn ImcSigArbn InertiaCmpVel LimrCdng LoaMgr MotAg2Meas MotAgCorrln MotCtrlPrmEstimn MotCurrPeakEstimn MotCurrRegCfg MotQuadDetn MotRefMdl MotRplCoggCfg MotTqCmdSca MotTqTranlDampg MotVelCtrl NxtrCalIds PolarityCfg PosnTrakgServo PwrDiscnct PwrLimr PwrSply PwrUpSeq Rtn RtnPahFwl ShtdwnMech StOutpCtrl StabyCmp StackMeas Swp SysFricLrng SysPrfmncSts SysStMod TEstimn TmplMonr TqLoa TunSelnAuthy TunSelnMngt VehSigCdng VehSpdLimr /end SUB_GROUP
 /begin FUNCTION_LIST /end FUNCTION_LIST
 /begin REF_CHARACTERISTIC /end REF_CHARACTERISTIC
 /begin REF_MEASUREMENT /end REF_MEASUREMENT
/end GROUP
/begin GROUP ShtdwnMech "MICROSAR RTE" /begin SUB_GROUP ShtdwnMech.ReceiverPorts /end SUB_GROUP /begin FUNCTION_LIST /end FUNCTION_LIST /begin REF_CHARACTERISTIC /end REF_CHARACTERISTIC /begin REF_MEASUREMENT /end REF_MEASUREMENT /end GROUP
/begin GROUP ShtdwnMech.DiagcStsIvtr1Inactv.Logl "MICROSAR RTE" /begin SUB_GROUP /end SUB_GROUP /begin FUNCTION_LIST /end FUNCTION_LIST /begin REF_CHARACTERISTIC /end REF_CHARACTERISTIC /begin REF_MEASUREMENT ShtdwnMech.DiagcStsIvtr1Inactv.Logl /end REF_MEASUREMENT /end GROUP
/begin GROUP ShtdwnMech.ReceiverPorts "MICROSAR RTE"
 /begin SUB_GROUP ShtdwnMech.DiagcStsIvtr1Inactv.Logl ShtdwnMech.StrtUpSt.Val /end SUB_GROUP
 /begin FUNCTION_LIST /end FUNCTION_LIST
 /begin REF_CHARACTERISTIC /end REF_CHARACTERISTIC
 /begin REF_MEASUREMENT /end REF_MEASUREMENT
/end GROUP
/begin GROUP ShtdwnMech.StrtUpSt.Val "MICROSAR RTE" /begin SUB_GROUP /end SUB_GROUP /begin FUNCTION_LIST /end FUNCTION_LIST /begin REF_CHARACTERISTIC /end REF_CHARACTERISTIC /begin REF_MEASUREMENT ShtdwnMech.StrtUpSt.Val /end REF_MEASUREMENT /end GROUP
/begin GROUP StOutpCtrl "MICROSAR RTE"
 /begin SUB_GROUP StOutpCtrl.PerInstanceMemories StOutpCtrl.ReceiverPorts StOutpCtrl.SenderPorts /end SUB_GROUP
 /begin FUNCTION_LIST /end FUNCTION_LIST
 /begin REF_CHARACTERISTIC /end REF_CHARACTERISTIC
 /begin REF_MEASUREMENT /end REF_MEASUREMENT
/end GROUP
/begin GROUP StOutpCtrl.DiagcStsCtrldShtDwnFltPrsnt.Logl "MICROSAR RTE" /begin SUB_GROUP /end SUB_GROUP /begin FUNCTION_LIST /end FUNCTION_LIST /begin REF_CHARACTERISTIC /end REF_CHARACTERISTIC /begin REF_MEASUREMENT StOutpCtrl.DiagcStsCtrldShtDwnFltPrsnt.Logl /end REF_MEASUREMENT /end GROUP
/begin GROUP StOutpCtrl.LoaRateLim.Val "MICROSAR RTE" /begin SUB_GROUP /end SUB_GROUP /begin FUNCTION_LIST /end FUNCTION_LIST /begin REF_CHARACTERISTIC /end REF_CHARACTERISTIC /begin REF_MEASUREMENT StOutpCtrl.LoaRateLim.Val /end REF_MEASUREMENT /end GROUP
/begin GROUP StOutpCtrl.LoaSca.Val "MICROSAR RTE" /begin SUB_GROUP /end SUB_GROUP /begin FUNCTION_LIST /end FUNCTION_LIST /begin REF_CHARACTERISTIC /end REF_CHARACTERISTIC /begin REF_MEASUREMENT StOutpCtrl.LoaSca.Val /end REF_MEASUREMENT /end GROUP
/begin GROUP StOutpCtrl.MotTqTranlDampgCmpl.Logl "MICROSAR RTE" /begin SUB_GROUP /end SUB_GROUP /begin FUNCTION_LIST /end FUNCTION_LIST /begin REF_CHARACTERISTIC /end REF_CHARACTERISTIC /begin REF_MEASUREMENT StOutpCtrl.MotTqTranlDampgCmpl.Logl /end REF_MEASUREMENT /end GROUP
/begin GROUP StOutpCtrl.PerInstanceMemories "MICROSAR RTE"
 /begin SUB_GROUP StOutpCtrl.StOutpCtrlPrevCmdSca StOutpCtrl.StOutpCtrlPrevSrc StOutpCtrl.dStOutpCtrlRateLim StOutpCtrl.dStOutpCtrlTarSca /end SUB_GROUP
 /begin FUNCTION_LIST /end FUNCTION_LIST
 /begin REF_CHARACTERISTIC /end REF_CHARACTERISTIC
 /begin REF_MEASUREMENT /end REF_MEASUREMENT
/end GROUP
/begin GROUP StOutpCtrl.ReceiverPorts "MICROSAR RTE"
 /begin SUB_GROUP StOutpCtrl.DiagcStsCtrldShtDwnFltPrsnt.Logl StOutpCtrl.LoaRateLim.Val StOutpCtrl.LoaSca.Val StOutpCtrl.MotTqTranlDampgCmpl.Logl StOutpCtrl.SysDiMotTqCmdSca.Val StOutpCtrl.SysDiRampRate.Val StOutpCtrl.SysMotTqCmdRampRateDi.Logl StOutpCtrl.SysOperMotTqCmdSca.Val StOutpCtrl.SysOperRampRate.Val StOutpCtrl.SysStFltOutpReqDi.Logl StOutpCtrl.VehStrtStopMotTqCmdSca.Val StOutpCtrl.VehStrtStopRampRate.Val /end SUB_GROUP
 /begin FUNCTION_LIST /end FUNCTION_LIST
 /begin REF_CHARACTERISTIC /end REF_CHARACTERISTIC
 /begin REF_MEASUREMENT /end REF_MEASUREMENT
/end GROUP
/begin GROUP StOutpCtrl.SenderPorts "MICROSAR RTE" /begin SUB_GROUP StOutpCtrl.SysMotTqCmdSca.Val StOutpCtrl.SysStReqDi.Logl /end SUB_GROUP /begin FUNCTION_LIST /end FUNCTION_LIST /begin REF_CHARACTERISTIC /end REF_CHARACTERISTIC /begin REF_MEASUREMENT /end REF_MEASUREMENT /end GROUP
/begin GROUP StOutpCtrl.StOutpCtrlPrevCmdSca "MICROSAR RTE" /begin SUB_GROUP /end SUB_GROUP /begin FUNCTION_LIST /end FUNCTION_LIST /begin REF_CHARACTERISTIC /end REF_CHARACTERISTIC /begin REF_MEASUREMENT StOutpCtrl.StOutpCtrlPrevCmdSca /end REF_MEASUREMENT /end GROUP
/begin GROUP StOutpCtrl.StOutpCtrlPrevSrc "MICROSAR RTE" /begin SUB_GROUP /end SUB_GROUP /begin FUNCTION_LIST /end FUNCTION_LIST /begin REF_CHARACTERISTIC /end REF_CHARACTERISTIC /begin REF_MEASUREMENT StOutpCtrl.StOutpCtrlPrevSrc /end REF_MEASUREMENT /end GROUP
/begin GROUP StOutpCtrl.SysDiMotTqCmdSca.Val "MICROSAR RTE" /begin SUB_GROUP /end SUB_GROUP /begin FUNCTION_LIST /end FUNCTION_LIST /begin REF_CHARACTERISTIC /end REF_CHARACTERISTIC /begin REF_MEASUREMENT StOutpCtrl.SysDiMotTqCmdSca.Val /end REF_MEASUREMENT /end GROUP
/begin GROUP StOutpCtrl.SysDiRampRate.Val "MICROSAR RTE" /begin SUB_GROUP /end SUB_GROUP /begin FUNCTION_LIST /end FUNCTION_LIST /begin REF_CHARACTERISTIC /end REF_CHARACTERISTIC /begin REF_MEASUREMENT StOutpCtrl.SysDiRampRate.Val /end REF_MEASUREMENT /end GROUP
/begin GROUP StOutpCtrl.SysMotTqCmdRampRateDi.Logl "MICROSAR RTE" /begin SUB_GROUP /end SUB_GROUP /begin FUNCTION_LIST /end FUNCTION_LIST /begin REF_CHARACTERISTIC /end REF_CHARACTERISTIC /begin REF_MEASUREMENT StOutpCtrl.SysMotTqCmdRampRateDi.Logl /end REF_MEASUREMENT /end GROUP
/begin GROUP StOutpCtrl.SysMotTqCmdSca.Val "MICROSAR RTE" /begin SUB_GROUP /end SUB_GROUP /begin FUNCTION_LIST /end FUNCTION_LIST /begin REF_CHARACTERISTIC /end REF_CHARACTERISTIC /begin REF_MEASUREMENT StOutpCtrl.SysMotTqCmdSca.Val /end REF_MEASUREMENT /end GROUP
/begin GROUP StOutpCtrl.SysOperMotTqCmdSca.Val "MICROSAR RTE" /begin SUB_GROUP /end SUB_GROUP /begin FUNCTION_LIST /end FUNCTION_LIST /begin REF_CHARACTERISTIC /end REF_CHARACTERISTIC /begin REF_MEASUREMENT StOutpCtrl.SysOperMotTqCmdSca.Val /end REF_MEASUREMENT /end GROUP
/begin GROUP StOutpCtrl.SysOperRampRate.Val "MICROSAR RTE" /begin SUB_GROUP /end SUB_GROUP /begin FUNCTION_LIST /end FUNCTION_LIST /begin REF_CHARACTERISTIC /end REF_CHARACTERISTIC /begin REF_MEASUREMENT StOutpCtrl.SysOperRampRate.Val /end REF_MEASUREMENT /end GROUP
/begin GROUP StOutpCtrl.SysStFltOutpReqDi.Logl "MICROSAR RTE" /begin SUB_GROUP /end SUB_GROUP /begin FUNCTION_LIST /end FUNCTION_LIST /begin REF_CHARACTERISTIC /end REF_CHARACTERISTIC /begin REF_MEASUREMENT StOutpCtrl.SysStFltOutpReqDi.Logl /end REF_MEASUREMENT /end GROUP
/begin GROUP StOutpCtrl.SysStReqDi.Logl "MICROSAR RTE" /begin SUB_GROUP /end SUB_GROUP /begin FUNCTION_LIST /end FUNCTION_LIST /begin REF_CHARACTERISTIC /end REF_CHARACTERISTIC /begin REF_MEASUREMENT StOutpCtrl.SysStReqDi.Logl /end REF_MEASUREMENT /end GROUP
/begin GROUP StOutpCtrl.VehStrtStopMotTqCmdSca.Val "MICROSAR RTE" /begin SUB_GROUP /end SUB_GROUP /begin FUNCTION_LIST /end FUNCTION_LIST /begin REF_CHARACTERISTIC /end REF_CHARACTERISTIC /begin REF_MEASUREMENT StOutpCtrl.VehStrtStopMotTqCmdSca.Val /end REF_MEASUREMENT /end GROUP
/begin GROUP StOutpCtrl.VehStrtStopRampRate.Val "MICROSAR RTE" /begin SUB_GROUP /end SUB_GROUP /begin FUNCTION_LIST /end FUNCTION_LIST /begin REF_CHARACTERISTIC /end REF_CHARACTERISTIC /begin REF_MEASUREMENT StOutpCtrl.VehStrtStopRampRate.Val /end REF_MEASUREMENT /end GROUP
/begin GROUP StOutpCtrl.dStOutpCtrlRateLim "MICROSAR RTE" /begin SUB_GROUP /end SUB_GROUP /begin FUNCTION_LIST /end FUNCTION_LIST /begin REF_CHARACTERISTIC /end REF_CHARACTERISTIC /begin REF_MEASUREMENT StOutpCtrl.dStOutpCtrlRateLim /end REF_MEASUREMENT /end GROUP
/begin GROUP StOutpCtrl.dStOutpCtrlTarSca "MICROSAR RTE" /begin SUB_GROUP /end SUB_GROUP /begin FUNCTION_LIST /end FUNCTION_LIST /begin REF_CHARACTERISTIC /end REF_CHARACTERISTIC /begin REF_MEASUREMENT StOutpCtrl.dStOutpCtrlTarSca /end REF_MEASUREMENT /end GROUP
/begin GROUP StabyCmp "MICROSAR RTE"
 /begin SUB_GROUP StabyCmp.CalibrationPorts StabyCmp.PerInstanceMemories StabyCmp.ReceiverPorts StabyCmp.SenderPorts /end SUB_GROUP
 /begin FUNCTION_LIST /end FUNCTION_LIST
 /begin REF_CHARACTERISTIC /end REF_CHARACTERISTIC
 /begin REF_MEASUREMENT /end REF_MEASUREMENT
/end GROUP
/begin GROUP StabyCmp.AssiCmd.Val "MICROSAR RTE" /begin SUB_GROUP /end SUB_GROUP /begin FUNCTION_LIST /end FUNCTION_LIST /begin REF_CHARACTERISTIC /end REF_CHARACTERISTIC /begin REF_MEASUREMENT StabyCmp.AssiCmd.Val /end REF_MEASUREMENT /end GROUP
/begin GROUP StabyCmp.AssiCmdBasSca.Val "MICROSAR RTE" /begin SUB_GROUP /end SUB_GROUP /begin FUNCTION_LIST /end FUNCTION_LIST /begin REF_CHARACTERISTIC /end REF_CHARACTERISTIC /begin REF_MEASUREMENT StabyCmp.AssiCmdBasSca.Val /end REF_MEASUREMENT /end GROUP
/begin GROUP StabyCmp.AssiCmdSum.Val "MICROSAR RTE" /begin SUB_GROUP /end SUB_GROUP /begin FUNCTION_LIST /end FUNCTION_LIST /begin REF_CHARACTERISTIC /end REF_CHARACTERISTIC /begin REF_MEASUREMENT StabyCmp.AssiCmdSum.Val /end REF_MEASUREMENT /end GROUP
/begin GROUP StabyCmp.AssiNotch1Fil "MICROSAR RTE" /begin SUB_GROUP /end SUB_GROUP /begin FUNCTION_LIST /end FUNCTION_LIST /begin REF_CHARACTERISTIC /end REF_CHARACTERISTIC
 /begin REF_MEASUREMENT StabyCmp.AssiNotch1Fil.FilSt1 StabyCmp.AssiNotch1Fil.FilSt2 /end REF_MEASUREMENT
/end GROUP
/begin GROUP StabyCmp.AssiNotch2Fil "MICROSAR RTE" /begin SUB_GROUP /end SUB_GROUP /begin FUNCTION_LIST /end FUNCTION_LIST /begin REF_CHARACTERISTIC /end REF_CHARACTERISTIC
 /begin REF_MEASUREMENT StabyCmp.AssiNotch2Fil.FilSt1 StabyCmp.AssiNotch2Fil.FilSt2 /end REF_MEASUREMENT
/end GROUP
/begin GROUP StabyCmp.AssiNotch3Fil "MICROSAR RTE" /begin SUB_GROUP /end SUB_GROUP /begin FUNCTION_LIST /end FUNCTION_LIST /begin REF_CHARACTERISTIC /end REF_CHARACTERISTIC
 /begin REF_MEASUREMENT StabyCmp.AssiNotch3Fil.FilSt1 StabyCmp.AssiNotch3Fil.FilSt2 /end REF_MEASUREMENT
/end GROUP
/begin GROUP StabyCmp.AssiNotch4Fil "MICROSAR RTE" /begin SUB_GROUP /end SUB_GROUP /begin FUNCTION_LIST /end FUNCTION_LIST /begin REF_CHARACTERISTIC /end REF_CHARACTERISTIC
 /begin REF_MEASUREMENT StabyCmp.AssiNotch4Fil.FilSt1 StabyCmp.AssiNotch4Fil.FilSt2 /end REF_MEASUREMENT
/end GROUP
/begin GROUP StabyCmp.AssiPahLimrActv.Val "MICROSAR RTE" /begin SUB_GROUP /end SUB_GROUP /begin FUNCTION_LIST /end FUNCTION_LIST /begin REF_CHARACTERISTIC /end REF_CHARACTERISTIC /begin REF_MEASUREMENT StabyCmp.AssiPahLimrActv.Val /end REF_MEASUREMENT /end GROUP
/begin GROUP StabyCmp.CalibrationPorts "MICROSAR RTE"
 /begin SUB_GROUP StabyCmp.StabyCmpAssiScaBlndX.Ary1D StabyCmp.StabyCmpAssiScaBlndY.Ary1D StabyCmp.StabyCmpHwTqLpFilFrq.Val StabyCmp.StabyCmpNotchFil1Struct.Rec StabyCmp.StabyCmpNotchFil2Struct.Rec StabyCmp.StabyCmpNotchFil3Struct.Rec StabyCmp.StabyCmpNotchFil4Struct.Rec StabyCmp.StabyCmpNotchFilBilnrBlndVehSpd.Ary1D StabyCmp.StabyCmpNotchFilBlnd02Y.Ary2D StabyCmp.StabyCmpNotchFilBlnd04Y.Ary2D StabyCmp.StabyCmpNotchFilBlnd12TqX.Ary2D StabyCmp.StabyCmpNotchFilBlnd12Y.Ary2D StabyCmp.StabyCmpNotchFilBlnd34TqX.Ary2D StabyCmp.StabyCmpNotchFilBlnd34Y.Ary2D /end SUB_GROUP
 /begin FUNCTION_LIST /end FUNCTION_LIST
 /begin REF_CHARACTERISTIC /end REF_CHARACTERISTIC
 /begin REF_MEASUREMENT /end REF_MEASUREMENT
/end GROUP
/begin GROUP StabyCmp.HwTq.Val "MICROSAR RTE" /begin SUB_GROUP /end SUB_GROUP /begin FUNCTION_LIST /end FUNCTION_LIST /begin REF_CHARACTERISTIC /end REF_CHARACTERISTIC /begin REF_MEASUREMENT StabyCmp.HwTq.Val /end REF_MEASUREMENT /end GROUP
/begin GROUP StabyCmp.HwTqLpFil "MICROSAR RTE" /begin SUB_GROUP /end SUB_GROUP /begin FUNCTION_LIST /end FUNCTION_LIST /begin REF_CHARACTERISTIC /end REF_CHARACTERISTIC /begin REF_MEASUREMENT StabyCmp.HwTqLpFil.FilGain StabyCmp.HwTqLpFil.FilSt /end REF_MEASUREMENT /end GROUP
/begin GROUP StabyCmp.PerInstanceMemories "MICROSAR RTE"
 /begin SUB_GROUP StabyCmp.AssiNotch1Fil StabyCmp.AssiNotch2Fil StabyCmp.AssiNotch3Fil StabyCmp.AssiNotch4Fil StabyCmp.HwTqLpFil StabyCmp.dStabyCmpAssiScaCmpBlnd StabyCmp.dStabyCmpNotchFil02Blnd StabyCmp.dStabyCmpNotchFil04Blnd StabyCmp.dStabyCmpNotchFil12Blnd StabyCmp.dStabyCmpNotchFil12Outp StabyCmp.dStabyCmpNotchFil1Outp StabyCmp.dStabyCmpNotchFil2Outp StabyCmp.dStabyCmpNotchFil34Blnd StabyCmp.dStabyCmpNotchFil34Outp StabyCmp.dStabyCmpNotchFil3Outp StabyCmp.dStabyCmpNotchFil4Outp /end SUB_GROUP
 /begin FUNCTION_LIST /end FUNCTION_LIST
 /begin REF_CHARACTERISTIC /end REF_CHARACTERISTIC
 /begin REF_MEASUREMENT /end REF_MEASUREMENT
/end GROUP
/begin GROUP StabyCmp.ReceiverPorts "MICROSAR RTE"
 /begin SUB_GROUP StabyCmp.AssiCmdBasSca.Val StabyCmp.AssiCmdSum.Val StabyCmp.AssiPahLimrActv.Val StabyCmp.HwTq.Val StabyCmp.VehSpd.Val /end SUB_GROUP
 /begin FUNCTION_LIST /end FUNCTION_LIST
 /begin REF_CHARACTERISTIC /end REF_CHARACTERISTIC
 /begin REF_MEASUREMENT /end REF_MEASUREMENT
/end GROUP
/begin GROUP StabyCmp.SenderPorts "MICROSAR RTE" /begin SUB_GROUP StabyCmp.AssiCmd.Val /end SUB_GROUP /begin FUNCTION_LIST /end FUNCTION_LIST /begin REF_CHARACTERISTIC /end REF_CHARACTERISTIC /begin REF_MEASUREMENT /end REF_MEASUREMENT /end GROUP
/begin GROUP StabyCmp.StabyCmpAssiScaBlndX.Ary1D "MICROSAR RTE" /begin SUB_GROUP /end SUB_GROUP /begin FUNCTION_LIST /end FUNCTION_LIST /begin REF_CHARACTERISTIC StabyCmp.StabyCmpAssiScaBlndX.Ary1D /end REF_CHARACTERISTIC /begin REF_MEASUREMENT /end REF_MEASUREMENT /end GROUP
/begin GROUP StabyCmp.StabyCmpAssiScaBlndY.Ary1D "MICROSAR RTE" /begin SUB_GROUP /end SUB_GROUP /begin FUNCTION_LIST /end FUNCTION_LIST /begin REF_CHARACTERISTIC StabyCmp.StabyCmpAssiScaBlndY.Ary1D /end REF_CHARACTERISTIC /begin REF_MEASUREMENT /end REF_MEASUREMENT /end GROUP
/begin GROUP StabyCmp.StabyCmpHwTqLpFilFrq.Val "MICROSAR RTE" /begin SUB_GROUP /end SUB_GROUP /begin FUNCTION_LIST /end FUNCTION_LIST /begin REF_CHARACTERISTIC StabyCmp.StabyCmpHwTqLpFilFrq.Val /end REF_CHARACTERISTIC /begin REF_MEASUREMENT /end REF_MEASUREMENT /end GROUP
/begin GROUP StabyCmp.StabyCmpNotchFil1Struct.Rec "MICROSAR RTE" /begin SUB_GROUP /end SUB_GROUP /begin FUNCTION_LIST /end FUNCTION_LIST
 /begin REF_CHARACTERISTIC StabyCmp.StabyCmpNotchFil1Struct.Rec.FilGainA1 StabyCmp.StabyCmpNotchFil1Struct.Rec.FilGainA2 StabyCmp.StabyCmpNotchFil1Struct.Rec.FilGainB0 StabyCmp.StabyCmpNotchFil1Struct.Rec.FilGainB1 StabyCmp.StabyCmpNotchFil1Struct.Rec.FilGainB2 /end REF_CHARACTERISTIC
 /begin REF_MEASUREMENT /end REF_MEASUREMENT
/end GROUP
/begin GROUP StabyCmp.StabyCmpNotchFil2Struct.Rec "MICROSAR RTE" /begin SUB_GROUP /end SUB_GROUP /begin FUNCTION_LIST /end FUNCTION_LIST
 /begin REF_CHARACTERISTIC StabyCmp.StabyCmpNotchFil2Struct.Rec.FilGainA1 StabyCmp.StabyCmpNotchFil2Struct.Rec.FilGainA2 StabyCmp.StabyCmpNotchFil2Struct.Rec.FilGainB0 StabyCmp.StabyCmpNotchFil2Struct.Rec.FilGainB1 StabyCmp.StabyCmpNotchFil2Struct.Rec.FilGainB2 /end REF_CHARACTERISTIC
 /begin REF_MEASUREMENT /end REF_MEASUREMENT
/end GROUP
/begin GROUP StabyCmp.StabyCmpNotchFil3Struct.Rec "MICROSAR RTE" /begin SUB_GROUP /end SUB_GROUP /begin FUNCTION_LIST /end FUNCTION_LIST
 /begin REF_CHARACTERISTIC StabyCmp.StabyCmpNotchFil3Struct.Rec.FilGainA1 StabyCmp.StabyCmpNotchFil3Struct.Rec.FilGainA2 StabyCmp.StabyCmpNotchFil3Struct.Rec.FilGainB0 StabyCmp.StabyCmpNotchFil3Struct.Rec.FilGainB1 StabyCmp.StabyCmpNotchFil3Struct.Rec.FilGainB2 /end REF_CHARACTERISTIC
 /begin REF_MEASUREMENT /end REF_MEASUREMENT
/end GROUP
/begin GROUP StabyCmp.StabyCmpNotchFil4Struct.Rec "MICROSAR RTE" /begin SUB_GROUP /end SUB_GROUP /begin FUNCTION_LIST /end FUNCTION_LIST
 /begin REF_CHARACTERISTIC StabyCmp.StabyCmpNotchFil4Struct.Rec.FilGainA1 StabyCmp.StabyCmpNotchFil4Struct.Rec.FilGainA2 StabyCmp.StabyCmpNotchFil4Struct.Rec.FilGainB0 StabyCmp.StabyCmpNotchFil4Struct.Rec.FilGainB1 StabyCmp.StabyCmpNotchFil4Struct.Rec.FilGainB2 /end REF_CHARACTERISTIC
 /begin REF_MEASUREMENT /end REF_MEASUREMENT
/end GROUP
/begin GROUP StabyCmp.StabyCmpNotchFilBilnrBlndVehSpd.Ary1D "MICROSAR RTE" /begin SUB_GROUP /end SUB_GROUP /begin FUNCTION_LIST /end FUNCTION_LIST /begin REF_CHARACTERISTIC StabyCmp.StabyCmpNotchFilBilnrBlndVehSpd.Ary1D /end REF_CHARACTERISTIC /begin REF_MEASUREMENT /end REF_MEASUREMENT /end GROUP
/begin GROUP StabyCmp.StabyCmpNotchFilBlnd02Y.Ary2D "MICROSAR RTE" /begin SUB_GROUP /end SUB_GROUP /begin FUNCTION_LIST /end FUNCTION_LIST /begin REF_CHARACTERISTIC StabyCmp.StabyCmpNotchFilBlnd02Y.Ary2D /end REF_CHARACTERISTIC /begin REF_MEASUREMENT /end REF_MEASUREMENT /end GROUP
/begin GROUP StabyCmp.StabyCmpNotchFilBlnd04Y.Ary2D "MICROSAR RTE" /begin SUB_GROUP /end SUB_GROUP /begin FUNCTION_LIST /end FUNCTION_LIST /begin REF_CHARACTERISTIC StabyCmp.StabyCmpNotchFilBlnd04Y.Ary2D /end REF_CHARACTERISTIC /begin REF_MEASUREMENT /end REF_MEASUREMENT /end GROUP
/begin GROUP StabyCmp.StabyCmpNotchFilBlnd12TqX.Ary2D "MICROSAR RTE" /begin SUB_GROUP /end SUB_GROUP /begin FUNCTION_LIST /end FUNCTION_LIST /begin REF_CHARACTERISTIC StabyCmp.StabyCmpNotchFilBlnd12TqX.Ary2D /end REF_CHARACTERISTIC /begin REF_MEASUREMENT /end REF_MEASUREMENT /end GROUP
/begin GROUP StabyCmp.StabyCmpNotchFilBlnd12Y.Ary2D "MICROSAR RTE" /begin SUB_GROUP /end SUB_GROUP /begin FUNCTION_LIST /end FUNCTION_LIST /begin REF_CHARACTERISTIC StabyCmp.StabyCmpNotchFilBlnd12Y.Ary2D /end REF_CHARACTERISTIC /begin REF_MEASUREMENT /end REF_MEASUREMENT /end GROUP
/begin GROUP StabyCmp.StabyCmpNotchFilBlnd34TqX.Ary2D "MICROSAR RTE" /begin SUB_GROUP /end SUB_GROUP /begin FUNCTION_LIST /end FUNCTION_LIST /begin REF_CHARACTERISTIC StabyCmp.StabyCmpNotchFilBlnd34TqX.Ary2D /end REF_CHARACTERISTIC /begin REF_MEASUREMENT /end REF_MEASUREMENT /end GROUP
/begin GROUP StabyCmp.StabyCmpNotchFilBlnd34Y.Ary2D "MICROSAR RTE" /begin SUB_GROUP /end SUB_GROUP /begin FUNCTION_LIST /end FUNCTION_LIST /begin REF_CHARACTERISTIC StabyCmp.StabyCmpNotchFilBlnd34Y.Ary2D /end REF_CHARACTERISTIC /begin REF_MEASUREMENT /end REF_MEASUREMENT /end GROUP
/begin GROUP StabyCmp.VehSpd.Val "MICROSAR RTE" /begin SUB_GROUP /end SUB_GROUP /begin FUNCTION_LIST /end FUNCTION_LIST /begin REF_CHARACTERISTIC /end REF_CHARACTERISTIC /begin REF_MEASUREMENT StabyCmp.VehSpd.Val /end REF_MEASUREMENT /end GROUP
/begin GROUP StabyCmp.dStabyCmpAssiScaCmpBlnd "MICROSAR RTE" /begin SUB_GROUP /end SUB_GROUP /begin FUNCTION_LIST /end FUNCTION_LIST /begin REF_CHARACTERISTIC /end REF_CHARACTERISTIC /begin REF_MEASUREMENT StabyCmp.dStabyCmpAssiScaCmpBlnd /end REF_MEASUREMENT /end GROUP
/begin GROUP StabyCmp.dStabyCmpNotchFil02Blnd "MICROSAR RTE" /begin SUB_GROUP /end SUB_GROUP /begin FUNCTION_LIST /end FUNCTION_LIST /begin REF_CHARACTERISTIC /end REF_CHARACTERISTIC /begin REF_MEASUREMENT StabyCmp.dStabyCmpNotchFil02Blnd /end REF_MEASUREMENT /end GROUP
/begin GROUP StabyCmp.dStabyCmpNotchFil04Blnd "MICROSAR RTE" /begin SUB_GROUP /end SUB_GROUP /begin FUNCTION_LIST /end FUNCTION_LIST /begin REF_CHARACTERISTIC /end REF_CHARACTERISTIC /begin REF_MEASUREMENT StabyCmp.dStabyCmpNotchFil04Blnd /end REF_MEASUREMENT /end GROUP
/begin GROUP StabyCmp.dStabyCmpNotchFil12Blnd "MICROSAR RTE" /begin SUB_GROUP /end SUB_GROUP /begin FUNCTION_LIST /end FUNCTION_LIST /begin REF_CHARACTERISTIC /end REF_CHARACTERISTIC /begin REF_MEASUREMENT StabyCmp.dStabyCmpNotchFil12Blnd /end REF_MEASUREMENT /end GROUP
/begin GROUP StabyCmp.dStabyCmpNotchFil12Outp "MICROSAR RTE" /begin SUB_GROUP /end SUB_GROUP /begin FUNCTION_LIST /end FUNCTION_LIST /begin REF_CHARACTERISTIC /end REF_CHARACTERISTIC /begin REF_MEASUREMENT StabyCmp.dStabyCmpNotchFil12Outp /end REF_MEASUREMENT /end GROUP
/begin GROUP StabyCmp.dStabyCmpNotchFil1Outp "MICROSAR RTE" /begin SUB_GROUP /end SUB_GROUP /begin FUNCTION_LIST /end FUNCTION_LIST /begin REF_CHARACTERISTIC /end REF_CHARACTERISTIC /begin REF_MEASUREMENT StabyCmp.dStabyCmpNotchFil1Outp /end REF_MEASUREMENT /end GROUP
/begin GROUP StabyCmp.dStabyCmpNotchFil2Outp "MICROSAR RTE" /begin SUB_GROUP /end SUB_GROUP /begin FUNCTION_LIST /end FUNCTION_LIST /begin REF_CHARACTERISTIC /end REF_CHARACTERISTIC /begin REF_MEASUREMENT StabyCmp.dStabyCmpNotchFil2Outp /end REF_MEASUREMENT /end GROUP
/begin GROUP StabyCmp.dStabyCmpNotchFil34Blnd "MICROSAR RTE" /begin SUB_GROUP /end SUB_GROUP /begin FUNCTION_LIST /end FUNCTION_LIST /begin REF_CHARACTERISTIC /end REF_CHARACTERISTIC /begin REF_MEASUREMENT StabyCmp.dStabyCmpNotchFil34Blnd /end REF_MEASUREMENT /end GROUP
/begin GROUP StabyCmp.dStabyCmpNotchFil34Outp "MICROSAR RTE" /begin SUB_GROUP /end SUB_GROUP /begin FUNCTION_LIST /end FUNCTION_LIST /begin REF_CHARACTERISTIC /end REF_CHARACTERISTIC /begin REF_MEASUREMENT StabyCmp.dStabyCmpNotchFil34Outp /end REF_MEASUREMENT /end GROUP
/begin GROUP StabyCmp.dStabyCmpNotchFil3Outp "MICROSAR RTE" /begin SUB_GROUP /end SUB_GROUP /begin FUNCTION_LIST /end FUNCTION_LIST /begin REF_CHARACTERISTIC /end REF_CHARACTERISTIC /begin REF_MEASUREMENT StabyCmp.dStabyCmpNotchFil3Outp /end REF_MEASUREMENT /end GROUP
/begin GROUP StabyCmp.dStabyCmpNotchFil4Outp "MICROSAR RTE" /begin SUB_GROUP /end SUB_GROUP /begin FUNCTION_LIST /end FUNCTION_LIST /begin REF_CHARACTERISTIC /end REF_CHARACTERISTIC /begin REF_MEASUREMENT StabyCmp.dStabyCmpNotchFil4Outp /end REF_MEASUREMENT /end GROUP
/begin GROUP StackMeas "MICROSAR RTE"
 /begin SUB_GROUP StackMeas.CalibrationParameters StackMeas.PerInstanceMemories /end SUB_GROUP
 /begin FUNCTION_LIST /end FUNCTION_LIST
 /begin REF_CHARACTERISTIC /end REF_CHARACTERISTIC
 /begin REF_MEASUREMENT /end REF_MEASUREMENT
/end GROUP
/begin GROUP StackMeas.CalibrationParameters "MICROSAR RTE" /begin SUB_GROUP StackMeas.StackMeasResDft /end SUB_GROUP /begin FUNCTION_LIST /end FUNCTION_LIST /begin REF_CHARACTERISTIC /end REF_CHARACTERISTIC /begin REF_MEASUREMENT /end REF_MEASUREMENT /end GROUP
/begin GROUP StackMeas.PerInstanceMemories "MICROSAR RTE" /begin SUB_GROUP StackMeas.StackMeasApplCrc StackMeas.StackMeasRes /end SUB_GROUP /begin FUNCTION_LIST /end FUNCTION_LIST /begin REF_CHARACTERISTIC /end REF_CHARACTERISTIC /begin REF_MEASUREMENT /end REF_MEASUREMENT /end GROUP
/begin GROUP StackMeas.StackMeasApplCrc "MICROSAR RTE" /begin SUB_GROUP /end SUB_GROUP /begin FUNCTION_LIST /end FUNCTION_LIST /begin REF_CHARACTERISTIC /end REF_CHARACTERISTIC /begin REF_MEASUREMENT StackMeas.StackMeasApplCrc /end REF_MEASUREMENT /end GROUP
/begin GROUP StackMeas.StackMeasRes "MICROSAR RTE" /begin SUB_GROUP /end SUB_GROUP /begin FUNCTION_LIST /end FUNCTION_LIST /begin REF_CHARACTERISTIC /end REF_CHARACTERISTIC /begin REF_MEASUREMENT StackMeas.StackMeasRes /end REF_MEASUREMENT /end GROUP
/begin GROUP StackMeas.StackMeasResDft "MICROSAR RTE" /begin SUB_GROUP /end SUB_GROUP /begin FUNCTION_LIST /end FUNCTION_LIST /begin REF_CHARACTERISTIC StackMeas.StackMeasResDft /end REF_CHARACTERISTIC /begin REF_MEASUREMENT /end REF_MEASUREMENT /end GROUP
/begin GROUP Swp "MICROSAR RTE" /begin SUB_GROUP Swp.ReceiverPorts Swp.SenderPorts /end SUB_GROUP /begin FUNCTION_LIST /end FUNCTION_LIST /begin REF_CHARACTERISTIC /end REF_CHARACTERISTIC /begin REF_MEASUREMENT /end REF_MEASUREMENT /end GROUP
/begin GROUP Swp.HwTq.Val "MICROSAR RTE" /begin SUB_GROUP /end SUB_GROUP /begin FUNCTION_LIST /end FUNCTION_LIST /begin REF_CHARACTERISTIC /end REF_CHARACTERISTIC /begin REF_MEASUREMENT Swp.HwTq.Val /end REF_MEASUREMENT /end GROUP
/begin GROUP Swp.HwTqSwp.Val "MICROSAR RTE" /begin SUB_GROUP /end SUB_GROUP /begin FUNCTION_LIST /end FUNCTION_LIST /begin REF_CHARACTERISTIC /end REF_CHARACTERISTIC /begin REF_MEASUREMENT Swp.HwTqSwp.Val /end REF_MEASUREMENT /end GROUP
/begin GROUP Swp.MotTqCmd.Val "MICROSAR RTE" /begin SUB_GROUP /end SUB_GROUP /begin FUNCTION_LIST /end FUNCTION_LIST /begin REF_CHARACTERISTIC /end REF_CHARACTERISTIC /begin REF_MEASUREMENT Swp.MotTqCmd.Val /end REF_MEASUREMENT /end GROUP
/begin GROUP Swp.MotTqCmdSwp.Val "MICROSAR RTE" /begin SUB_GROUP /end SUB_GROUP /begin FUNCTION_LIST /end FUNCTION_LIST /begin REF_CHARACTERISTIC /end REF_CHARACTERISTIC /begin REF_MEASUREMENT Swp.MotTqCmdSwp.Val /end REF_MEASUREMENT /end GROUP
/begin GROUP Swp.ReceiverPorts "MICROSAR RTE"
 /begin SUB_GROUP Swp.HwTq.Val Swp.MotTqCmd.Val Swp.VehSpd.Val Swp.VehSpdVld.Logl /end SUB_GROUP
 /begin FUNCTION_LIST /end FUNCTION_LIST
 /begin REF_CHARACTERISTIC /end REF_CHARACTERISTIC
 /begin REF_MEASUREMENT /end REF_MEASUREMENT
/end GROUP
/begin GROUP Swp.SenderPorts "MICROSAR RTE" /begin SUB_GROUP Swp.HwTqSwp.Val Swp.MotTqCmdSwp.Val /end SUB_GROUP /begin FUNCTION_LIST /end FUNCTION_LIST /begin REF_CHARACTERISTIC /end REF_CHARACTERISTIC /begin REF_MEASUREMENT /end REF_MEASUREMENT /end GROUP
/begin GROUP Swp.VehSpd.Val "MICROSAR RTE" /begin SUB_GROUP /end SUB_GROUP /begin FUNCTION_LIST /end FUNCTION_LIST /begin REF_CHARACTERISTIC /end REF_CHARACTERISTIC /begin REF_MEASUREMENT Swp.VehSpd.Val /end REF_MEASUREMENT /end GROUP
/begin GROUP Swp.VehSpdVld.Logl "MICROSAR RTE" /begin SUB_GROUP /end SUB_GROUP /begin FUNCTION_LIST /end FUNCTION_LIST /begin REF_CHARACTERISTIC /end REF_CHARACTERISTIC /begin REF_MEASUREMENT Swp.VehSpdVld.Logl /end REF_MEASUREMENT /end GROUP
/begin GROUP SysFricLrng "MICROSAR RTE"
 /begin SUB_GROUP SysFricLrng.CalibrationParameters SysFricLrng.CalibrationPorts SysFricLrng.PerInstanceMemories SysFricLrng.ReceiverPorts SysFricLrng.SenderPorts /end SUB_GROUP
 /begin FUNCTION_LIST /end FUNCTION_LIST
 /begin REF_CHARACTERISTIC /end REF_CHARACTERISTIC
 /begin REF_MEASUREMENT /end REF_MEASUREMENT
/end GROUP
/begin GROUP SysFricLrng.AssiMechT.Val "MICROSAR RTE" /begin SUB_GROUP /end SUB_GROUP /begin FUNCTION_LIST /end FUNCTION_LIST /begin REF_CHARACTERISTIC /end REF_CHARACTERISTIC /begin REF_MEASUREMENT SysFricLrng.AssiMechT.Val /end REF_MEASUREMENT /end GROUP
/begin GROUP SysFricLrng.AssiMechTLpFil "MICROSAR RTE" /begin SUB_GROUP /end SUB_GROUP /begin FUNCTION_LIST /end FUNCTION_LIST /begin REF_CHARACTERISTIC /end REF_CHARACTERISTIC
 /begin REF_MEASUREMENT SysFricLrng.AssiMechTLpFil.FilGain SysFricLrng.AssiMechTLpFil.FilSt /end REF_MEASUREMENT
/end GROUP
/begin GROUP SysFricLrng.AvrgFricLpFil1 "MICROSAR RTE" /begin SUB_GROUP /end SUB_GROUP /begin FUNCTION_LIST /end FUNCTION_LIST /begin REF_CHARACTERISTIC /end REF_CHARACTERISTIC
 /begin REF_MEASUREMENT SysFricLrng.AvrgFricLpFil1.FilGain SysFricLrng.AvrgFricLpFil1.FilSt /end REF_MEASUREMENT
/end GROUP
/begin GROUP SysFricLrng.AvrgFricLpFil2 "MICROSAR RTE" /begin SUB_GROUP /end SUB_GROUP /begin FUNCTION_LIST /end FUNCTION_LIST /begin REF_CHARACTERISTIC /end REF_CHARACTERISTIC
 /begin REF_MEASUREMENT SysFricLrng.AvrgFricLpFil2.FilGain SysFricLrng.AvrgFricLpFil2.FilSt /end REF_MEASUREMENT
/end GROUP
/begin GROUP SysFricLrng.AvrgFricLpFil3 "MICROSAR RTE" /begin SUB_GROUP /end SUB_GROUP /begin FUNCTION_LIST /end FUNCTION_LIST /begin REF_CHARACTERISTIC /end REF_CHARACTERISTIC
 /begin REF_MEASUREMENT SysFricLrng.AvrgFricLpFil3.FilGain SysFricLrng.AvrgFricLpFil3.FilSt /end REF_MEASUREMENT
/end GROUP
/begin GROUP SysFricLrng.AvrgFricLpFil4 "MICROSAR RTE" /begin SUB_GROUP /end SUB_GROUP /begin FUNCTION_LIST /end FUNCTION_LIST /begin REF_CHARACTERISTIC /end REF_CHARACTERISTIC
 /begin REF_MEASUREMENT SysFricLrng.AvrgFricLpFil4.FilGain SysFricLrng.AvrgFricLpFil4.FilSt /end REF_MEASUREMENT
/end GROUP
/begin GROUP SysFricLrng.CalibrationParameters "MICROSAR RTE" /begin SUB_GROUP SysFricLrng.FricLrngDataDft SysFricLrng.FricNonLrngDataDft /end SUB_GROUP /begin FUNCTION_LIST /end FUNCTION_LIST /begin REF_CHARACTERISTIC /end REF_CHARACTERISTIC /begin REF_MEASUREMENT /end REF_MEASUREMENT /end GROUP
/begin GROUP SysFricLrng.CalibrationPorts "MICROSAR RTE"
 /begin SUB_GROUP SysFricLrng.SysFricLrngAvrgFricFrq.Val SysFricLrng.SysFricLrngBasLineEolFric.Val SysFricLrng.SysFricLrngBasLineFric.Ary1D SysFricLrng.SysFricLrngBasLineHys.Ary2D SysFricLrng.SysFricLrngBasLineRngCntr.Ary2D SysFricLrng.SysFricLrngDataPrepLpFilFrq.Val SysFricLrng.SysFricLrngDebStep.Val SysFricLrng.SysFricLrngEolFricDifHiLim.Val SysFricLrng.SysFricLrngEolFricDifLoLim.Val SysFricLrng.SysFricLrngEolFricDifScagFac.Val SysFricLrng.SysFricLrngFricChgWght.Ary1D SysFricLrng.SysFricLrngFricDiagcThd.Val SysFricLrng.SysFricLrngFricHysHwAgPt.Ary1D SysFricLrng.SysFricLrngFricOffs.Val SysFricLrng.SysFricLrngFricOffsHiLim.Val SysFricLrng.SysFricLrngFricOffsLoLim.Val SysFricLrng.SysFricLrngFricOffsLpFilFrq.Val SysFricLrng.SysFricLrngGain.Val SysFricLrng.SysFricLrngHiFricDebStep.Val SysFricLrng.SysFricLrngHiFricDiagcThd.Val SysFricLrng.SysFricLrngHwPosnAuthyThd.Val SysFricLrng.SysFricLrngHwVelConstrLim.Val SysFricLrng.SysFricLrngHwVelHiLim.Val SysFricLrng.SysFricLrngHwVelLoLim.Val SysFricLrng.SysFricLrngIgnCycFricChgLim.Val SysFricLrng.SysFricLrngIgnCycFricOffs.Val SysFricLrng.SysFricLrngIvsTrsmRatX.Ary1D SysFricLrng.SysFricLrngIvsTrsmRatY.Ary1D SysFricLrng.SysFricLrngLatAHiLim.Val SysFricLrng.SysFricLrngLatALoLim.Val SysFricLrng.SysFricLrngMaskVehSpd.Ary1D SysFricLrng.SysFricLrngRngCntrThd.Val SysFricLrng.SysFricLrngTHiLim.Val SysFricLrng.SysFricLrngTLoLim.Val SysFricLrng.SysFricLrngThd.Val SysFricLrng.SysFricLrngVehSpd.Ary2D /end SUB_GROUP
 /begin FUNCTION_LIST /end FUNCTION_LIST
 /begin REF_CHARACTERISTIC /end REF_CHARACTERISTIC
 /begin REF_MEASUREMENT /end REF_MEASUREMENT
/end GROUP
/begin GROUP SysFricLrng.ColTqAry "MICROSAR RTE" /begin SUB_GROUP /end SUB_GROUP /begin FUNCTION_LIST /end FUNCTION_LIST /begin REF_CHARACTERISTIC /end REF_CHARACTERISTIC /begin REF_MEASUREMENT SysFricLrng.ColTqAry /end REF_MEASUREMENT /end GROUP
/begin GROUP SysFricLrng.ColTqLpFil "MICROSAR RTE" /begin SUB_GROUP /end SUB_GROUP /begin FUNCTION_LIST /end FUNCTION_LIST /begin REF_CHARACTERISTIC /end REF_CHARACTERISTIC
 /begin REF_MEASUREMENT SysFricLrng.ColTqLpFil.FilGain SysFricLrng.ColTqLpFil.FilSt /end REF_MEASUREMENT
/end GROUP
/begin GROUP SysFricLrng.EstimdFric "MICROSAR RTE" /begin SUB_GROUP /end SUB_GROUP /begin FUNCTION_LIST /end FUNCTION_LIST /begin REF_CHARACTERISTIC /end REF_CHARACTERISTIC /begin REF_MEASUREMENT SysFricLrng.EstimdFric /end REF_MEASUREMENT /end GROUP
/begin GROUP SysFricLrng.FilAvrgFric "MICROSAR RTE" /begin SUB_GROUP /end SUB_GROUP /begin FUNCTION_LIST /end FUNCTION_LIST /begin REF_CHARACTERISTIC /end REF_CHARACTERISTIC /begin REF_MEASUREMENT SysFricLrng.FilAvrgFric /end REF_MEASUREMENT /end GROUP
/begin GROUP SysFricLrng.FricChgLpFil "MICROSAR RTE" /begin SUB_GROUP /end SUB_GROUP /begin FUNCTION_LIST /end FUNCTION_LIST /begin REF_CHARACTERISTIC /end REF_CHARACTERISTIC
 /begin REF_MEASUREMENT SysFricLrng.FricChgLpFil.FilGain SysFricLrng.FricChgLpFil.FilSt /end REF_MEASUREMENT
/end GROUP
/begin GROUP SysFricLrng.FricLrngCustEna.Logl "MICROSAR RTE" /begin SUB_GROUP /end SUB_GROUP /begin FUNCTION_LIST /end FUNCTION_LIST /begin REF_CHARACTERISTIC /end REF_CHARACTERISTIC /begin REF_MEASUREMENT SysFricLrng.FricLrngCustEna.Logl /end REF_MEASUREMENT /end GROUP
/begin GROUP SysFricLrng.FricLrngData "MICROSAR RTE" /begin SUB_GROUP /end SUB_GROUP /begin FUNCTION_LIST /end FUNCTION_LIST /begin REF_CHARACTERISTIC /end REF_CHARACTERISTIC
 /begin REF_MEASUREMENT SysFricLrng.FricLrngData.BasLineFric SysFricLrng.FricLrngData.FricOffs SysFricLrng.FricLrngData.Hys SysFricLrng.FricLrngData.RngCntr SysFricLrng.FricLrngData.SysFricLrngOperMod SysFricLrng.FricLrngData.VehLrndFric /end REF_MEASUREMENT
/end GROUP
/begin GROUP SysFricLrng.FricLrngDataDft "MICROSAR RTE" /begin SUB_GROUP /end SUB_GROUP /begin FUNCTION_LIST /end FUNCTION_LIST
 /begin REF_CHARACTERISTIC SysFricLrng.FricLrngDataDft.BasLineFric SysFricLrng.FricLrngDataDft.FricOffs SysFricLrng.FricLrngDataDft.Hys SysFricLrng.FricLrngDataDft.RngCntr SysFricLrng.FricLrngDataDft.SysFricLrngOperMod SysFricLrng.FricLrngDataDft.VehLrndFric /end REF_CHARACTERISTIC
 /begin REF_MEASUREMENT /end REF_MEASUREMENT
/end GROUP
/begin GROUP SysFricLrng.FricLrngDi.Logl "MICROSAR RTE" /begin SUB_GROUP /end SUB_GROUP /begin FUNCTION_LIST /end FUNCTION_LIST /begin REF_CHARACTERISTIC /end REF_CHARACTERISTIC /begin REF_MEASUREMENT SysFricLrng.FricLrngDi.Logl /end REF_MEASUREMENT /end GROUP
/begin GROUP SysFricLrng.FricLrngOperModPrev "MICROSAR RTE" /begin SUB_GROUP /end SUB_GROUP /begin FUNCTION_LIST /end FUNCTION_LIST /begin REF_CHARACTERISTIC /end REF_CHARACTERISTIC /begin REF_MEASUREMENT SysFricLrng.FricLrngOperModPrev /end REF_MEASUREMENT /end GROUP
/begin GROUP SysFricLrng.FricLrngRunOneTi "MICROSAR RTE" /begin SUB_GROUP /end SUB_GROUP /begin FUNCTION_LIST /end FUNCTION_LIST /begin REF_CHARACTERISTIC /end REF_CHARACTERISTIC /begin REF_MEASUREMENT SysFricLrng.FricLrngRunOneTi /end REF_MEASUREMENT /end GROUP
/begin GROUP SysFricLrng.FricNonLrngData "MICROSAR RTE" /begin SUB_GROUP /end SUB_GROUP /begin FUNCTION_LIST /end FUNCTION_LIST /begin REF_CHARACTERISTIC /end REF_CHARACTERISTIC
 /begin REF_MEASUREMENT SysFricLrng.FricNonLrngData.EnaFricLrng SysFricLrng.FricNonLrngData.EnaFricOffsOutp SysFricLrng.FricNonLrngData.EolFric /end REF_MEASUREMENT
/end GROUP
/begin GROUP SysFricLrng.FricNonLrngDataDft "MICROSAR RTE" /begin SUB_GROUP /end SUB_GROUP /begin FUNCTION_LIST /end FUNCTION_LIST
 /begin REF_CHARACTERISTIC SysFricLrng.FricNonLrngDataDft.EnaFricLrng SysFricLrng.FricNonLrngDataDft.EnaFricOffsOutp SysFricLrng.FricNonLrngDataDft.EolFric /end REF_CHARACTERISTIC
 /begin REF_MEASUREMENT /end REF_MEASUREMENT
/end GROUP
/begin GROUP SysFricLrng.FricOffs "MICROSAR RTE" /begin SUB_GROUP /end SUB_GROUP /begin FUNCTION_LIST /end FUNCTION_LIST /begin REF_CHARACTERISTIC /end REF_CHARACTERISTIC /begin REF_MEASUREMENT SysFricLrng.FricOffs /end REF_MEASUREMENT /end GROUP
/begin GROUP SysFricLrng.FricOffsOutpDi "MICROSAR RTE" /begin SUB_GROUP /end SUB_GROUP /begin FUNCTION_LIST /end FUNCTION_LIST /begin REF_CHARACTERISTIC /end REF_CHARACTERISTIC /begin REF_MEASUREMENT SysFricLrng.FricOffsOutpDi /end REF_MEASUREMENT /end GROUP
/begin GROUP SysFricLrng.HwAg.Val "MICROSAR RTE" /begin SUB_GROUP /end SUB_GROUP /begin FUNCTION_LIST /end FUNCTION_LIST /begin REF_CHARACTERISTIC /end REF_CHARACTERISTIC /begin REF_MEASUREMENT SysFricLrng.HwAg.Val /end REF_MEASUREMENT /end GROUP
/begin GROUP SysFricLrng.HwAgAuthy.Val "MICROSAR RTE" /begin SUB_GROUP /end SUB_GROUP /begin FUNCTION_LIST /end FUNCTION_LIST /begin REF_CHARACTERISTIC /end REF_CHARACTERISTIC /begin REF_MEASUREMENT SysFricLrng.HwAgAuthy.Val /end REF_MEASUREMENT /end GROUP
/begin GROUP SysFricLrng.HwAgAuthyLpFil "MICROSAR RTE" /begin SUB_GROUP /end SUB_GROUP /begin FUNCTION_LIST /end FUNCTION_LIST /begin REF_CHARACTERISTIC /end REF_CHARACTERISTIC
 /begin REF_MEASUREMENT SysFricLrng.HwAgAuthyLpFil.FilGain SysFricLrng.HwAgAuthyLpFil.FilSt /end REF_MEASUREMENT
/end GROUP
/begin GROUP SysFricLrng.HwAgBuf "MICROSAR RTE" /begin SUB_GROUP /end SUB_GROUP /begin FUNCTION_LIST /end FUNCTION_LIST /begin REF_CHARACTERISTIC /end REF_CHARACTERISTIC /begin REF_MEASUREMENT SysFricLrng.HwAgBuf /end REF_MEASUREMENT /end GROUP
/begin GROUP SysFricLrng.HwAgLpFil "MICROSAR RTE" /begin SUB_GROUP /end SUB_GROUP /begin FUNCTION_LIST /end FUNCTION_LIST /begin REF_CHARACTERISTIC /end REF_CHARACTERISTIC /begin REF_MEASUREMENT SysFricLrng.HwAgLpFil.FilGain SysFricLrng.HwAgLpFil.FilSt /end REF_MEASUREMENT /end GROUP
/begin GROUP SysFricLrng.HwTq.Val "MICROSAR RTE" /begin SUB_GROUP /end SUB_GROUP /begin FUNCTION_LIST /end FUNCTION_LIST /begin REF_CHARACTERISTIC /end REF_CHARACTERISTIC /begin REF_MEASUREMENT SysFricLrng.HwTq.Val /end REF_MEASUREMENT /end GROUP
/begin GROUP SysFricLrng.HwVel.Val "MICROSAR RTE" /begin SUB_GROUP /end SUB_GROUP /begin FUNCTION_LIST /end FUNCTION_LIST /begin REF_CHARACTERISTIC /end REF_CHARACTERISTIC /begin REF_MEASUREMENT SysFricLrng.HwVel.Val /end REF_MEASUREMENT /end GROUP
/begin GROUP SysFricLrng.HwVelBuf "MICROSAR RTE" /begin SUB_GROUP /end SUB_GROUP /begin FUNCTION_LIST /end FUNCTION_LIST /begin REF_CHARACTERISTIC /end REF_CHARACTERISTIC /begin REF_MEASUREMENT SysFricLrng.HwVelBuf /end REF_MEASUREMENT /end GROUP
/begin GROUP SysFricLrng.HwVelLpFil "MICROSAR RTE" /begin SUB_GROUP /end SUB_GROUP /begin FUNCTION_LIST /end FUNCTION_LIST /begin REF_CHARACTERISTIC /end REF_CHARACTERISTIC
 /begin REF_MEASUREMENT SysFricLrng.HwVelLpFil.FilGain SysFricLrng.HwVelLpFil.FilSt /end REF_MEASUREMENT
/end GROUP
/begin GROUP SysFricLrng.LatALpFil "MICROSAR RTE" /begin SUB_GROUP /end SUB_GROUP /begin FUNCTION_LIST /end FUNCTION_LIST /begin REF_CHARACTERISTIC /end REF_CHARACTERISTIC /begin REF_MEASUREMENT SysFricLrng.LatALpFil.FilGain SysFricLrng.LatALpFil.FilSt /end REF_MEASUREMENT /end GROUP
/begin GROUP SysFricLrng.MaxLrndFric.Val "MICROSAR RTE" /begin SUB_GROUP /end SUB_GROUP /begin FUNCTION_LIST /end FUNCTION_LIST /begin REF_CHARACTERISTIC /end REF_CHARACTERISTIC /begin REF_MEASUREMENT SysFricLrng.MaxLrndFric.Val /end REF_MEASUREMENT /end GROUP
/begin GROUP SysFricLrng.MotTqCmdCrf.Val "MICROSAR RTE" /begin SUB_GROUP /end SUB_GROUP /begin FUNCTION_LIST /end FUNCTION_LIST /begin REF_CHARACTERISTIC /end REF_CHARACTERISTIC /begin REF_MEASUREMENT SysFricLrng.MotTqCmdCrf.Val /end REF_MEASUREMENT /end GROUP
/begin GROUP SysFricLrng.PerInstanceMemories "MICROSAR RTE"
 /begin SUB_GROUP SysFricLrng.AssiMechTLpFil SysFricLrng.AvrgFricLpFil1 SysFricLrng.AvrgFricLpFil2 SysFricLrng.AvrgFricLpFil3 SysFricLrng.AvrgFricLpFil4 SysFricLrng.ColTqAry SysFricLrng.ColTqLpFil SysFricLrng.EstimdFric SysFricLrng.FilAvrgFric SysFricLrng.FricChgLpFil SysFricLrng.FricLrngData SysFricLrng.FricLrngOperModPrev SysFricLrng.FricLrngRunOneTi SysFricLrng.FricNonLrngData SysFricLrng.FricOffs SysFricLrng.FricOffsOutpDi SysFricLrng.HwAgAuthyLpFil SysFricLrng.HwAgBuf SysFricLrng.HwAgLpFil SysFricLrng.HwVelBuf SysFricLrng.HwVelLpFil SysFricLrng.LatALpFil SysFricLrng.PrevMaxRawAvrgFric SysFricLrng.RawAvrgFric SysFricLrng.RefTmrLrngConstr SysFricLrng.SatnAvrgFric SysFricLrng.SatnEstimdFric SysFricLrng.VehBasLineFric SysFricLrng.VehSpdLpFil /end SUB_GROUP
 /begin FUNCTION_LIST /end FUNCTION_LIST
 /begin REF_CHARACTERISTIC /end REF_CHARACTERISTIC
 /begin REF_MEASUREMENT /end REF_MEASUREMENT
/end GROUP
/begin GROUP SysFricLrng.PrevMaxRawAvrgFric "MICROSAR RTE" /begin SUB_GROUP /end SUB_GROUP /begin FUNCTION_LIST /end FUNCTION_LIST /begin REF_CHARACTERISTIC /end REF_CHARACTERISTIC /begin REF_MEASUREMENT SysFricLrng.PrevMaxRawAvrgFric /end REF_MEASUREMENT /end GROUP
/begin GROUP SysFricLrng.RawAvrgFric "MICROSAR RTE" /begin SUB_GROUP /end SUB_GROUP /begin FUNCTION_LIST /end FUNCTION_LIST /begin REF_CHARACTERISTIC /end REF_CHARACTERISTIC /begin REF_MEASUREMENT SysFricLrng.RawAvrgFric /end REF_MEASUREMENT /end GROUP
/begin GROUP SysFricLrng.ReceiverPorts "MICROSAR RTE"
 /begin SUB_GROUP SysFricLrng.AssiMechT.Val SysFricLrng.FricLrngCustEna.Logl SysFricLrng.FricLrngDi.Logl SysFricLrng.HwAg.Val SysFricLrng.HwAgAuthy.Val SysFricLrng.HwTq.Val SysFricLrng.HwVel.Val SysFricLrng.MotTqCmdCrf.Val SysFricLrng.VehLatA.Val SysFricLrng.VehSpd.Val SysFricLrng.VehSpdVld.Logl /end SUB_GROUP
 /begin FUNCTION_LIST /end FUNCTION_LIST
 /begin REF_CHARACTERISTIC /end REF_CHARACTERISTIC
 /begin REF_MEASUREMENT /end REF_MEASUREMENT
/end GROUP
/begin GROUP SysFricLrng.RefTmrLrngConstr "MICROSAR RTE" /begin SUB_GROUP /end SUB_GROUP /begin FUNCTION_LIST /end FUNCTION_LIST /begin REF_CHARACTERISTIC /end REF_CHARACTERISTIC /begin REF_MEASUREMENT SysFricLrng.RefTmrLrngConstr /end REF_MEASUREMENT /end GROUP
/begin GROUP SysFricLrng.SatnAvrgFric "MICROSAR RTE" /begin SUB_GROUP /end SUB_GROUP /begin FUNCTION_LIST /end FUNCTION_LIST /begin REF_CHARACTERISTIC /end REF_CHARACTERISTIC /begin REF_MEASUREMENT SysFricLrng.SatnAvrgFric /end REF_MEASUREMENT /end GROUP
/begin GROUP SysFricLrng.SatnEstimdFric "MICROSAR RTE" /begin SUB_GROUP /end SUB_GROUP /begin FUNCTION_LIST /end FUNCTION_LIST /begin REF_CHARACTERISTIC /end REF_CHARACTERISTIC /begin REF_MEASUREMENT SysFricLrng.SatnEstimdFric /end REF_MEASUREMENT /end GROUP
/begin GROUP SysFricLrng.SenderPorts "MICROSAR RTE"
 /begin SUB_GROUP SysFricLrng.MaxLrndFric.Val SysFricLrng.SysFricEstimd.Val SysFricLrng.SysFricOffs.Val SysFricLrng.SysSatnFricEstimd.Val /end SUB_GROUP
 /begin FUNCTION_LIST /end FUNCTION_LIST
 /begin REF_CHARACTERISTIC /end REF_CHARACTERISTIC
 /begin REF_MEASUREMENT /end REF_MEASUREMENT
/end GROUP
/begin GROUP SysFricLrng.SysFricEstimd.Val "MICROSAR RTE" /begin SUB_GROUP /end SUB_GROUP /begin FUNCTION_LIST /end FUNCTION_LIST /begin REF_CHARACTERISTIC /end REF_CHARACTERISTIC /begin REF_MEASUREMENT SysFricLrng.SysFricEstimd.Val /end REF_MEASUREMENT /end GROUP
/begin GROUP SysFricLrng.SysFricLrngAvrgFricFrq.Val "MICROSAR RTE" /begin SUB_GROUP /end SUB_GROUP /begin FUNCTION_LIST /end FUNCTION_LIST /begin REF_CHARACTERISTIC SysFricLrng.SysFricLrngAvrgFricFrq.Val /end REF_CHARACTERISTIC /begin REF_MEASUREMENT /end REF_MEASUREMENT /end GROUP
/begin GROUP SysFricLrng.SysFricLrngBasLineEolFric.Val "MICROSAR RTE" /begin SUB_GROUP /end SUB_GROUP /begin FUNCTION_LIST /end FUNCTION_LIST /begin REF_CHARACTERISTIC SysFricLrng.SysFricLrngBasLineEolFric.Val /end REF_CHARACTERISTIC /begin REF_MEASUREMENT /end REF_MEASUREMENT /end GROUP
/begin GROUP SysFricLrng.SysFricLrngBasLineFric.Ary1D "MICROSAR RTE" /begin SUB_GROUP /end SUB_GROUP /begin FUNCTION_LIST /end FUNCTION_LIST /begin REF_CHARACTERISTIC SysFricLrng.SysFricLrngBasLineFric.Ary1D /end REF_CHARACTERISTIC /begin REF_MEASUREMENT /end REF_MEASUREMENT /end GROUP
/begin GROUP SysFricLrng.SysFricLrngBasLineHys.Ary2D "MICROSAR RTE" /begin SUB_GROUP /end SUB_GROUP /begin FUNCTION_LIST /end FUNCTION_LIST /begin REF_CHARACTERISTIC SysFricLrng.SysFricLrngBasLineHys.Ary2D /end REF_CHARACTERISTIC /begin REF_MEASUREMENT /end REF_MEASUREMENT /end GROUP
/begin GROUP SysFricLrng.SysFricLrngBasLineRngCntr.Ary2D "MICROSAR RTE" /begin SUB_GROUP /end SUB_GROUP /begin FUNCTION_LIST /end FUNCTION_LIST /begin REF_CHARACTERISTIC SysFricLrng.SysFricLrngBasLineRngCntr.Ary2D /end REF_CHARACTERISTIC /begin REF_MEASUREMENT /end REF_MEASUREMENT /end GROUP
/begin GROUP SysFricLrng.SysFricLrngDataPrepLpFilFrq.Val "MICROSAR RTE" /begin SUB_GROUP /end SUB_GROUP /begin FUNCTION_LIST /end FUNCTION_LIST /begin REF_CHARACTERISTIC SysFricLrng.SysFricLrngDataPrepLpFilFrq.Val /end REF_CHARACTERISTIC /begin REF_MEASUREMENT /end REF_MEASUREMENT /end GROUP
/begin GROUP SysFricLrng.SysFricLrngDebStep.Val "MICROSAR RTE" /begin SUB_GROUP /end SUB_GROUP /begin FUNCTION_LIST /end FUNCTION_LIST /begin REF_CHARACTERISTIC SysFricLrng.SysFricLrngDebStep.Val /end REF_CHARACTERISTIC /begin REF_MEASUREMENT /end REF_MEASUREMENT /end GROUP
/begin GROUP SysFricLrng.SysFricLrngEolFricDifHiLim.Val "MICROSAR RTE" /begin SUB_GROUP /end SUB_GROUP /begin FUNCTION_LIST /end FUNCTION_LIST /begin REF_CHARACTERISTIC SysFricLrng.SysFricLrngEolFricDifHiLim.Val /end REF_CHARACTERISTIC /begin REF_MEASUREMENT /end REF_MEASUREMENT /end GROUP
/begin GROUP SysFricLrng.SysFricLrngEolFricDifLoLim.Val "MICROSAR RTE" /begin SUB_GROUP /end SUB_GROUP /begin FUNCTION_LIST /end FUNCTION_LIST /begin REF_CHARACTERISTIC SysFricLrng.SysFricLrngEolFricDifLoLim.Val /end REF_CHARACTERISTIC /begin REF_MEASUREMENT /end REF_MEASUREMENT /end GROUP
/begin GROUP SysFricLrng.SysFricLrngEolFricDifScagFac.Val "MICROSAR RTE" /begin SUB_GROUP /end SUB_GROUP /begin FUNCTION_LIST /end FUNCTION_LIST /begin REF_CHARACTERISTIC SysFricLrng.SysFricLrngEolFricDifScagFac.Val /end REF_CHARACTERISTIC /begin REF_MEASUREMENT /end REF_MEASUREMENT /end GROUP
/begin GROUP SysFricLrng.SysFricLrngFricChgWght.Ary1D "MICROSAR RTE" /begin SUB_GROUP /end SUB_GROUP /begin FUNCTION_LIST /end FUNCTION_LIST /begin REF_CHARACTERISTIC SysFricLrng.SysFricLrngFricChgWght.Ary1D /end REF_CHARACTERISTIC /begin REF_MEASUREMENT /end REF_MEASUREMENT /end GROUP
/begin GROUP SysFricLrng.SysFricLrngFricDiagcThd.Val "MICROSAR RTE" /begin SUB_GROUP /end SUB_GROUP /begin FUNCTION_LIST /end FUNCTION_LIST /begin REF_CHARACTERISTIC SysFricLrng.SysFricLrngFricDiagcThd.Val /end REF_CHARACTERISTIC /begin REF_MEASUREMENT /end REF_MEASUREMENT /end GROUP
/begin GROUP SysFricLrng.SysFricLrngFricHysHwAgPt.Ary1D "MICROSAR RTE" /begin SUB_GROUP /end SUB_GROUP /begin FUNCTION_LIST /end FUNCTION_LIST /begin REF_CHARACTERISTIC SysFricLrng.SysFricLrngFricHysHwAgPt.Ary1D /end REF_CHARACTERISTIC /begin REF_MEASUREMENT /end REF_MEASUREMENT /end GROUP
/begin GROUP SysFricLrng.SysFricLrngFricOffs.Val "MICROSAR RTE" /begin SUB_GROUP /end SUB_GROUP /begin FUNCTION_LIST /end FUNCTION_LIST /begin REF_CHARACTERISTIC SysFricLrng.SysFricLrngFricOffs.Val /end REF_CHARACTERISTIC /begin REF_MEASUREMENT /end REF_MEASUREMENT /end GROUP
/begin GROUP SysFricLrng.SysFricLrngFricOffsHiLim.Val "MICROSAR RTE" /begin SUB_GROUP /end SUB_GROUP /begin FUNCTION_LIST /end FUNCTION_LIST /begin REF_CHARACTERISTIC SysFricLrng.SysFricLrngFricOffsHiLim.Val /end REF_CHARACTERISTIC /begin REF_MEASUREMENT /end REF_MEASUREMENT /end GROUP
/begin GROUP SysFricLrng.SysFricLrngFricOffsLoLim.Val "MICROSAR RTE" /begin SUB_GROUP /end SUB_GROUP /begin FUNCTION_LIST /end FUNCTION_LIST /begin REF_CHARACTERISTIC SysFricLrng.SysFricLrngFricOffsLoLim.Val /end REF_CHARACTERISTIC /begin REF_MEASUREMENT /end REF_MEASUREMENT /end GROUP
/begin GROUP SysFricLrng.SysFricLrngFricOffsLpFilFrq.Val "MICROSAR RTE" /begin SUB_GROUP /end SUB_GROUP /begin FUNCTION_LIST /end FUNCTION_LIST /begin REF_CHARACTERISTIC SysFricLrng.SysFricLrngFricOffsLpFilFrq.Val /end REF_CHARACTERISTIC /begin REF_MEASUREMENT /end REF_MEASUREMENT /end GROUP
/begin GROUP SysFricLrng.SysFricLrngGain.Val "MICROSAR RTE" /begin SUB_GROUP /end SUB_GROUP /begin FUNCTION_LIST /end FUNCTION_LIST /begin REF_CHARACTERISTIC SysFricLrng.SysFricLrngGain.Val /end REF_CHARACTERISTIC /begin REF_MEASUREMENT /end REF_MEASUREMENT /end GROUP
/begin GROUP SysFricLrng.SysFricLrngHiFricDebStep.Val "MICROSAR RTE" /begin SUB_GROUP /end SUB_GROUP /begin FUNCTION_LIST /end FUNCTION_LIST /begin REF_CHARACTERISTIC SysFricLrng.SysFricLrngHiFricDebStep.Val /end REF_CHARACTERISTIC /begin REF_MEASUREMENT /end REF_MEASUREMENT /end GROUP
/begin GROUP SysFricLrng.SysFricLrngHiFricDiagcThd.Val "MICROSAR RTE" /begin SUB_GROUP /end SUB_GROUP /begin FUNCTION_LIST /end FUNCTION_LIST /begin REF_CHARACTERISTIC SysFricLrng.SysFricLrngHiFricDiagcThd.Val /end REF_CHARACTERISTIC /begin REF_MEASUREMENT /end REF_MEASUREMENT /end GROUP
/begin GROUP SysFricLrng.SysFricLrngHwPosnAuthyThd.Val "MICROSAR RTE" /begin SUB_GROUP /end SUB_GROUP /begin FUNCTION_LIST /end FUNCTION_LIST /begin REF_CHARACTERISTIC SysFricLrng.SysFricLrngHwPosnAuthyThd.Val /end REF_CHARACTERISTIC /begin REF_MEASUREMENT /end REF_MEASUREMENT /end GROUP
/begin GROUP SysFricLrng.SysFricLrngHwVelConstrLim.Val "MICROSAR RTE" /begin SUB_GROUP /end SUB_GROUP /begin FUNCTION_LIST /end FUNCTION_LIST /begin REF_CHARACTERISTIC SysFricLrng.SysFricLrngHwVelConstrLim.Val /end REF_CHARACTERISTIC /begin REF_MEASUREMENT /end REF_MEASUREMENT /end GROUP
/begin GROUP SysFricLrng.SysFricLrngHwVelHiLim.Val "MICROSAR RTE" /begin SUB_GROUP /end SUB_GROUP /begin FUNCTION_LIST /end FUNCTION_LIST /begin REF_CHARACTERISTIC SysFricLrng.SysFricLrngHwVelHiLim.Val /end REF_CHARACTERISTIC /begin REF_MEASUREMENT /end REF_MEASUREMENT /end GROUP
/begin GROUP SysFricLrng.SysFricLrngHwVelLoLim.Val "MICROSAR RTE" /begin SUB_GROUP /end SUB_GROUP /begin FUNCTION_LIST /end FUNCTION_LIST /begin REF_CHARACTERISTIC SysFricLrng.SysFricLrngHwVelLoLim.Val /end REF_CHARACTERISTIC /begin REF_MEASUREMENT /end REF_MEASUREMENT /end GROUP
/begin GROUP SysFricLrng.SysFricLrngIgnCycFricChgLim.Val "MICROSAR RTE" /begin SUB_GROUP /end SUB_GROUP /begin FUNCTION_LIST /end FUNCTION_LIST /begin REF_CHARACTERISTIC SysFricLrng.SysFricLrngIgnCycFricChgLim.Val /end REF_CHARACTERISTIC /begin REF_MEASUREMENT /end REF_MEASUREMENT /end GROUP
/begin GROUP SysFricLrng.SysFricLrngIgnCycFricOffs.Val "MICROSAR RTE" /begin SUB_GROUP /end SUB_GROUP /begin FUNCTION_LIST /end FUNCTION_LIST /begin REF_CHARACTERISTIC SysFricLrng.SysFricLrngIgnCycFricOffs.Val /end REF_CHARACTERISTIC /begin REF_MEASUREMENT /end REF_MEASUREMENT /end GROUP
/begin GROUP SysFricLrng.SysFricLrngIvsTrsmRatX.Ary1D "MICROSAR RTE" /begin SUB_GROUP /end SUB_GROUP /begin FUNCTION_LIST /end FUNCTION_LIST /begin REF_CHARACTERISTIC SysFricLrng.SysFricLrngIvsTrsmRatX.Ary1D /end REF_CHARACTERISTIC /begin REF_MEASUREMENT /end REF_MEASUREMENT /end GROUP
/begin GROUP SysFricLrng.SysFricLrngIvsTrsmRatY.Ary1D "MICROSAR RTE" /begin SUB_GROUP /end SUB_GROUP /begin FUNCTION_LIST /end FUNCTION_LIST /begin REF_CHARACTERISTIC SysFricLrng.SysFricLrngIvsTrsmRatY.Ary1D /end REF_CHARACTERISTIC /begin REF_MEASUREMENT /end REF_MEASUREMENT /end GROUP
/begin GROUP SysFricLrng.SysFricLrngLatAHiLim.Val "MICROSAR RTE" /begin SUB_GROUP /end SUB_GROUP /begin FUNCTION_LIST /end FUNCTION_LIST /begin REF_CHARACTERISTIC SysFricLrng.SysFricLrngLatAHiLim.Val /end REF_CHARACTERISTIC /begin REF_MEASUREMENT /end REF_MEASUREMENT /end GROUP
/begin GROUP SysFricLrng.SysFricLrngLatALoLim.Val "MICROSAR RTE" /begin SUB_GROUP /end SUB_GROUP /begin FUNCTION_LIST /end FUNCTION_LIST /begin REF_CHARACTERISTIC SysFricLrng.SysFricLrngLatALoLim.Val /end REF_CHARACTERISTIC /begin REF_MEASUREMENT /end REF_MEASUREMENT /end GROUP
/begin GROUP SysFricLrng.SysFricLrngMaskVehSpd.Ary1D "MICROSAR RTE" /begin SUB_GROUP /end SUB_GROUP /begin FUNCTION_LIST /end FUNCTION_LIST /begin REF_CHARACTERISTIC SysFricLrng.SysFricLrngMaskVehSpd.Ary1D /end REF_CHARACTERISTIC /begin REF_MEASUREMENT /end REF_MEASUREMENT /end GROUP
/begin GROUP SysFricLrng.SysFricLrngRngCntrThd.Val "MICROSAR RTE" /begin SUB_GROUP /end SUB_GROUP /begin FUNCTION_LIST /end FUNCTION_LIST /begin REF_CHARACTERISTIC SysFricLrng.SysFricLrngRngCntrThd.Val /end REF_CHARACTERISTIC /begin REF_MEASUREMENT /end REF_MEASUREMENT /end GROUP
/begin GROUP SysFricLrng.SysFricLrngTHiLim.Val "MICROSAR RTE" /begin SUB_GROUP /end SUB_GROUP /begin FUNCTION_LIST /end FUNCTION_LIST /begin REF_CHARACTERISTIC SysFricLrng.SysFricLrngTHiLim.Val /end REF_CHARACTERISTIC /begin REF_MEASUREMENT /end REF_MEASUREMENT /end GROUP
/begin GROUP SysFricLrng.SysFricLrngTLoLim.Val "MICROSAR RTE" /begin SUB_GROUP /end SUB_GROUP /begin FUNCTION_LIST /end FUNCTION_LIST /begin REF_CHARACTERISTIC SysFricLrng.SysFricLrngTLoLim.Val /end REF_CHARACTERISTIC /begin REF_MEASUREMENT /end REF_MEASUREMENT /end GROUP
/begin GROUP SysFricLrng.SysFricLrngThd.Val "MICROSAR RTE" /begin SUB_GROUP /end SUB_GROUP /begin FUNCTION_LIST /end FUNCTION_LIST /begin REF_CHARACTERISTIC SysFricLrng.SysFricLrngThd.Val /end REF_CHARACTERISTIC /begin REF_MEASUREMENT /end REF_MEASUREMENT /end GROUP
/begin GROUP SysFricLrng.SysFricLrngVehSpd.Ary2D "MICROSAR RTE" /begin SUB_GROUP /end SUB_GROUP /begin FUNCTION_LIST /end FUNCTION_LIST /begin REF_CHARACTERISTIC SysFricLrng.SysFricLrngVehSpd.Ary2D /end REF_CHARACTERISTIC /begin REF_MEASUREMENT /end REF_MEASUREMENT /end GROUP
/begin GROUP SysFricLrng.SysFricOffs.Val "MICROSAR RTE" /begin SUB_GROUP /end SUB_GROUP /begin FUNCTION_LIST /end FUNCTION_LIST /begin REF_CHARACTERISTIC /end REF_CHARACTERISTIC /begin REF_MEASUREMENT SysFricLrng.SysFricOffs.Val /end REF_MEASUREMENT /end GROUP
/begin GROUP SysFricLrng.SysSatnFricEstimd.Val "MICROSAR RTE" /begin SUB_GROUP /end SUB_GROUP /begin FUNCTION_LIST /end FUNCTION_LIST /begin REF_CHARACTERISTIC /end REF_CHARACTERISTIC /begin REF_MEASUREMENT SysFricLrng.SysSatnFricEstimd.Val /end REF_MEASUREMENT /end GROUP
/begin GROUP SysFricLrng.VehBasLineFric "MICROSAR RTE" /begin SUB_GROUP /end SUB_GROUP /begin FUNCTION_LIST /end FUNCTION_LIST /begin REF_CHARACTERISTIC /end REF_CHARACTERISTIC /begin REF_MEASUREMENT SysFricLrng.VehBasLineFric /end REF_MEASUREMENT /end GROUP
/begin GROUP SysFricLrng.VehLatA.Val "MICROSAR RTE" /begin SUB_GROUP /end SUB_GROUP /begin FUNCTION_LIST /end FUNCTION_LIST /begin REF_CHARACTERISTIC /end REF_CHARACTERISTIC /begin REF_MEASUREMENT SysFricLrng.VehLatA.Val /end REF_MEASUREMENT /end GROUP
/begin GROUP SysFricLrng.VehSpd.Val "MICROSAR RTE" /begin SUB_GROUP /end SUB_GROUP /begin FUNCTION_LIST /end FUNCTION_LIST /begin REF_CHARACTERISTIC /end REF_CHARACTERISTIC /begin REF_MEASUREMENT SysFricLrng.VehSpd.Val /end REF_MEASUREMENT /end GROUP
/begin GROUP SysFricLrng.VehSpdLpFil "MICROSAR RTE" /begin SUB_GROUP /end SUB_GROUP /begin FUNCTION_LIST /end FUNCTION_LIST /begin REF_CHARACTERISTIC /end REF_CHARACTERISTIC
 /begin REF_MEASUREMENT SysFricLrng.VehSpdLpFil.FilGain SysFricLrng.VehSpdLpFil.FilSt /end REF_MEASUREMENT
/end GROUP
/begin GROUP SysFricLrng.VehSpdVld.Logl "MICROSAR RTE" /begin SUB_GROUP /end SUB_GROUP /begin FUNCTION_LIST /end FUNCTION_LIST /begin REF_CHARACTERISTIC /end REF_CHARACTERISTIC /begin REF_MEASUREMENT SysFricLrng.VehSpdVld.Logl /end REF_MEASUREMENT /end GROUP
/begin GROUP SysPrfmncSts "MICROSAR RTE"
 /begin SUB_GROUP SysPrfmncSts.CalibrationPorts SysPrfmncSts.PerInstanceMemories SysPrfmncSts.ReceiverPorts SysPrfmncSts.SenderPorts /end SUB_GROUP
 /begin FUNCTION_LIST /end FUNCTION_LIST
 /begin REF_CHARACTERISTIC /end REF_CHARACTERISTIC
 /begin REF_MEASUREMENT /end REF_MEASUREMENT
/end GROUP
/begin GROUP SysPrfmncSts.BattVltg.Val "MICROSAR RTE" /begin SUB_GROUP /end SUB_GROUP /begin FUNCTION_LIST /end FUNCTION_LIST /begin REF_CHARACTERISTIC /end REF_CHARACTERISTIC /begin REF_MEASUREMENT SysPrfmncSts.BattVltg.Val /end REF_MEASUREMENT /end GROUP
/begin GROUP SysPrfmncSts.BattVltgLpFil "MICROSAR RTE" /begin SUB_GROUP /end SUB_GROUP /begin FUNCTION_LIST /end FUNCTION_LIST /begin REF_CHARACTERISTIC /end REF_CHARACTERISTIC
 /begin REF_MEASUREMENT SysPrfmncSts.BattVltgLpFil.FilGain SysPrfmncSts.BattVltgLpFil.FilSt /end REF_MEASUREMENT
/end GROUP
/begin GROUP SysPrfmncSts.BattVltgSt.Val "MICROSAR RTE" /begin SUB_GROUP /end SUB_GROUP /begin FUNCTION_LIST /end FUNCTION_LIST /begin REF_CHARACTERISTIC /end REF_CHARACTERISTIC /begin REF_MEASUREMENT SysPrfmncSts.BattVltgSt.Val /end REF_MEASUREMENT /end GROUP
/begin GROUP SysPrfmncSts.CalibrationPorts "MICROSAR RTE"
 /begin SUB_GROUP SysPrfmncSts.SysPrfmncStsAbsltCtrlTFltThd.Val SysPrfmncSts.SysPrfmncStsAssiStallLimDecThd.Val SysPrfmncSts.SysPrfmncStsBattDiagcHiCrit.Val SysPrfmncSts.SysPrfmncStsBattDiagcHiWarn.Val SysPrfmncSts.SysPrfmncStsBattDiagcLoCrit.Val SysPrfmncSts.SysPrfmncStsBattDiagcLoWarn.Val SysPrfmncSts.SysPrfmncStsBattVltgFilFrq.Val SysPrfmncSts.SysPrfmncStsDutyCycLvlFltThd.Val SysPrfmncSts.SysPrfmncStsLoadDptLimDecThd.Val SysPrfmncSts.SysPrfmncStsTDptLimThd.Val /end SUB_GROUP
 /begin FUNCTION_LIST /end FUNCTION_LIST
 /begin REF_CHARACTERISTIC /end REF_CHARACTERISTIC
 /begin REF_MEASUREMENT /end REF_MEASUREMENT
/end GROUP
/begin GROUP SysPrfmncSts.DutyCycThermProtnMaxOutp.Val "MICROSAR RTE" /begin SUB_GROUP /end SUB_GROUP /begin FUNCTION_LIST /end FUNCTION_LIST /begin REF_CHARACTERISTIC /end REF_CHARACTERISTIC /begin REF_MEASUREMENT SysPrfmncSts.DutyCycThermProtnMaxOutp.Val /end REF_MEASUREMENT /end GROUP
/begin GROUP SysPrfmncSts.EcuTFild.Val "MICROSAR RTE" /begin SUB_GROUP /end SUB_GROUP /begin FUNCTION_LIST /end FUNCTION_LIST /begin REF_CHARACTERISTIC /end REF_CHARACTERISTIC /begin REF_MEASUREMENT SysPrfmncSts.EcuTFild.Val /end REF_MEASUREMENT /end GROUP
/begin GROUP SysPrfmncSts.LoaSt.Val "MICROSAR RTE" /begin SUB_GROUP /end SUB_GROUP /begin FUNCTION_LIST /end FUNCTION_LIST /begin REF_CHARACTERISTIC /end REF_CHARACTERISTIC /begin REF_MEASUREMENT SysPrfmncSts.LoaSt.Val /end REF_MEASUREMENT /end GROUP
/begin GROUP SysPrfmncSts.PerInstanceMemories "MICROSAR RTE" /begin SUB_GROUP SysPrfmncSts.BattVltgLpFil /end SUB_GROUP /begin FUNCTION_LIST /end FUNCTION_LIST /begin REF_CHARACTERISTIC /end REF_CHARACTERISTIC /begin REF_MEASUREMENT /end REF_MEASUREMENT /end GROUP
/begin GROUP SysPrfmncSts.ReceiverPorts "MICROSAR RTE"
 /begin SUB_GROUP SysPrfmncSts.BattVltg.Val SysPrfmncSts.DutyCycThermProtnMaxOutp.Val SysPrfmncSts.EcuTFild.Val SysPrfmncSts.LoaSt.Val SysPrfmncSts.StallMotTqLim.Val SysPrfmncSts.SysSt.Val SysPrfmncSts.ThermDutyCycProtnLoadDptLim.Val SysPrfmncSts.ThermDutyCycProtnTDptLim.Val SysPrfmncSts.VehSpdVld.Logl /end SUB_GROUP
 /begin FUNCTION_LIST /end FUNCTION_LIST
 /begin REF_CHARACTERISTIC /end REF_CHARACTERISTIC
 /begin REF_MEASUREMENT /end REF_MEASUREMENT
/end GROUP
/begin GROUP SysPrfmncSts.SenderPorts "MICROSAR RTE" /begin SUB_GROUP SysPrfmncSts.BattVltgSt.Val SysPrfmncSts.SysPrfmncSt.Val /end SUB_GROUP /begin FUNCTION_LIST /end FUNCTION_LIST /begin REF_CHARACTERISTIC /end REF_CHARACTERISTIC /begin REF_MEASUREMENT /end REF_MEASUREMENT /end GROUP
/begin GROUP SysPrfmncSts.StallMotTqLim.Val "MICROSAR RTE" /begin SUB_GROUP /end SUB_GROUP /begin FUNCTION_LIST /end FUNCTION_LIST /begin REF_CHARACTERISTIC /end REF_CHARACTERISTIC /begin REF_MEASUREMENT SysPrfmncSts.StallMotTqLim.Val /end REF_MEASUREMENT /end GROUP
/begin GROUP SysPrfmncSts.SysPrfmncSt.Val "MICROSAR RTE" /begin SUB_GROUP /end SUB_GROUP /begin FUNCTION_LIST /end FUNCTION_LIST /begin REF_CHARACTERISTIC /end REF_CHARACTERISTIC /begin REF_MEASUREMENT SysPrfmncSts.SysPrfmncSt.Val /end REF_MEASUREMENT /end GROUP
/begin GROUP SysPrfmncSts.SysPrfmncStsAbsltCtrlTFltThd.Val "MICROSAR RTE" /begin SUB_GROUP /end SUB_GROUP /begin FUNCTION_LIST /end FUNCTION_LIST /begin REF_CHARACTERISTIC SysPrfmncSts.SysPrfmncStsAbsltCtrlTFltThd.Val /end REF_CHARACTERISTIC /begin REF_MEASUREMENT /end REF_MEASUREMENT /end GROUP
/begin GROUP SysPrfmncSts.SysPrfmncStsAssiStallLimDecThd.Val "MICROSAR RTE" /begin SUB_GROUP /end SUB_GROUP /begin FUNCTION_LIST /end FUNCTION_LIST /begin REF_CHARACTERISTIC SysPrfmncSts.SysPrfmncStsAssiStallLimDecThd.Val /end REF_CHARACTERISTIC /begin REF_MEASUREMENT /end REF_MEASUREMENT /end GROUP
/begin GROUP SysPrfmncSts.SysPrfmncStsBattDiagcHiCrit.Val "MICROSAR RTE" /begin SUB_GROUP /end SUB_GROUP /begin FUNCTION_LIST /end FUNCTION_LIST /begin REF_CHARACTERISTIC SysPrfmncSts.SysPrfmncStsBattDiagcHiCrit.Val /end REF_CHARACTERISTIC /begin REF_MEASUREMENT /end REF_MEASUREMENT /end GROUP
/begin GROUP SysPrfmncSts.SysPrfmncStsBattDiagcHiWarn.Val "MICROSAR RTE" /begin SUB_GROUP /end SUB_GROUP /begin FUNCTION_LIST /end FUNCTION_LIST /begin REF_CHARACTERISTIC SysPrfmncSts.SysPrfmncStsBattDiagcHiWarn.Val /end REF_CHARACTERISTIC /begin REF_MEASUREMENT /end REF_MEASUREMENT /end GROUP
/begin GROUP SysPrfmncSts.SysPrfmncStsBattDiagcLoCrit.Val "MICROSAR RTE" /begin SUB_GROUP /end SUB_GROUP /begin FUNCTION_LIST /end FUNCTION_LIST /begin REF_CHARACTERISTIC SysPrfmncSts.SysPrfmncStsBattDiagcLoCrit.Val /end REF_CHARACTERISTIC /begin REF_MEASUREMENT /end REF_MEASUREMENT /end GROUP
/begin GROUP SysPrfmncSts.SysPrfmncStsBattDiagcLoWarn.Val "MICROSAR RTE" /begin SUB_GROUP /end SUB_GROUP /begin FUNCTION_LIST /end FUNCTION_LIST /begin REF_CHARACTERISTIC SysPrfmncSts.SysPrfmncStsBattDiagcLoWarn.Val /end REF_CHARACTERISTIC /begin REF_MEASUREMENT /end REF_MEASUREMENT /end GROUP
/begin GROUP SysPrfmncSts.SysPrfmncStsBattVltgFilFrq.Val "MICROSAR RTE" /begin SUB_GROUP /end SUB_GROUP /begin FUNCTION_LIST /end FUNCTION_LIST /begin REF_CHARACTERISTIC SysPrfmncSts.SysPrfmncStsBattVltgFilFrq.Val /end REF_CHARACTERISTIC /begin REF_MEASUREMENT /end REF_MEASUREMENT /end GROUP
/begin GROUP SysPrfmncSts.SysPrfmncStsDutyCycLvlFltThd.Val "MICROSAR RTE" /begin SUB_GROUP /end SUB_GROUP /begin FUNCTION_LIST /end FUNCTION_LIST /begin REF_CHARACTERISTIC SysPrfmncSts.SysPrfmncStsDutyCycLvlFltThd.Val /end REF_CHARACTERISTIC /begin REF_MEASUREMENT /end REF_MEASUREMENT /end GROUP
/begin GROUP SysPrfmncSts.SysPrfmncStsLoadDptLimDecThd.Val "MICROSAR RTE" /begin SUB_GROUP /end SUB_GROUP /begin FUNCTION_LIST /end FUNCTION_LIST /begin REF_CHARACTERISTIC SysPrfmncSts.SysPrfmncStsLoadDptLimDecThd.Val /end REF_CHARACTERISTIC /begin REF_MEASUREMENT /end REF_MEASUREMENT /end GROUP
/begin GROUP SysPrfmncSts.SysPrfmncStsTDptLimThd.Val "MICROSAR RTE" /begin SUB_GROUP /end SUB_GROUP /begin FUNCTION_LIST /end FUNCTION_LIST /begin REF_CHARACTERISTIC SysPrfmncSts.SysPrfmncStsTDptLimThd.Val /end REF_CHARACTERISTIC /begin REF_MEASUREMENT /end REF_MEASUREMENT /end GROUP
/begin GROUP SysPrfmncSts.SysSt.Val "MICROSAR RTE" /begin SUB_GROUP /end SUB_GROUP /begin FUNCTION_LIST /end FUNCTION_LIST /begin REF_CHARACTERISTIC /end REF_CHARACTERISTIC /begin REF_MEASUREMENT SysPrfmncSts.SysSt.Val /end REF_MEASUREMENT /end GROUP
/begin GROUP SysPrfmncSts.ThermDutyCycProtnLoadDptLim.Val "MICROSAR RTE" /begin SUB_GROUP /end SUB_GROUP /begin FUNCTION_LIST /end FUNCTION_LIST /begin REF_CHARACTERISTIC /end REF_CHARACTERISTIC /begin REF_MEASUREMENT SysPrfmncSts.ThermDutyCycProtnLoadDptLim.Val /end REF_MEASUREMENT /end GROUP
/begin GROUP SysPrfmncSts.ThermDutyCycProtnTDptLim.Val "MICROSAR RTE" /begin SUB_GROUP /end SUB_GROUP /begin FUNCTION_LIST /end FUNCTION_LIST /begin REF_CHARACTERISTIC /end REF_CHARACTERISTIC /begin REF_MEASUREMENT SysPrfmncSts.ThermDutyCycProtnTDptLim.Val /end REF_MEASUREMENT /end GROUP
/begin GROUP SysPrfmncSts.VehSpdVld.Logl "MICROSAR RTE" /begin SUB_GROUP /end SUB_GROUP /begin FUNCTION_LIST /end FUNCTION_LIST /begin REF_CHARACTERISTIC /end REF_CHARACTERISTIC /begin REF_MEASUREMENT SysPrfmncSts.VehSpdVld.Logl /end REF_MEASUREMENT /end GROUP
/begin GROUP SysStMod "MICROSAR RTE"
 /begin SUB_GROUP SysStMod.PerInstanceMemories SysStMod.ReceiverPorts SysStMod.SenderPorts /end SUB_GROUP
 /begin FUNCTION_LIST /end FUNCTION_LIST
 /begin REF_CHARACTERISTIC /end REF_CHARACTERISTIC
 /begin REF_MEASUREMENT /end REF_MEASUREMENT
/end GROUP
/begin GROUP SysStMod.PerInstanceMemories "MICROSAR RTE" /begin SUB_GROUP SysStMod.SysStModPrevSysSt SysStMod.dSysStModTranVect /end SUB_GROUP /begin FUNCTION_LIST /end FUNCTION_LIST /begin REF_CHARACTERISTIC /end REF_CHARACTERISTIC /begin REF_MEASUREMENT /end REF_MEASUREMENT /end GROUP
/begin GROUP SysStMod.PwrSplyEnaReq.Logl "MICROSAR RTE" /begin SUB_GROUP /end SUB_GROUP /begin FUNCTION_LIST /end FUNCTION_LIST /begin REF_CHARACTERISTIC /end REF_CHARACTERISTIC /begin REF_MEASUREMENT SysStMod.PwrSplyEnaReq.Logl /end REF_MEASUREMENT /end GROUP
/begin GROUP SysStMod.ReceiverPorts "MICROSAR RTE"
 /begin SUB_GROUP SysStMod.PwrSplyEnaReq.Logl SysStMod.StrtUpSt.Val SysStMod.SysStFltOutpReqDi.Logl SysStMod.SysStImdtTranReqOff.Logl SysStMod.SysStReqDi.Logl SysStMod.SysStReqEna.Logl SysStMod.SysStWrmIninCmpl.Logl /end SUB_GROUP
 /begin FUNCTION_LIST /end FUNCTION_LIST
 /begin REF_CHARACTERISTIC /end REF_CHARACTERISTIC
 /begin REF_MEASUREMENT /end REF_MEASUREMENT
/end GROUP
/begin GROUP SysStMod.SenderPorts "MICROSAR RTE" /begin SUB_GROUP SysStMod.SysSt.Val /end SUB_GROUP /begin FUNCTION_LIST /end FUNCTION_LIST /begin REF_CHARACTERISTIC /end REF_CHARACTERISTIC /begin REF_MEASUREMENT /end REF_MEASUREMENT /end GROUP
/begin GROUP SysStMod.StrtUpSt.Val "MICROSAR RTE" /begin SUB_GROUP /end SUB_GROUP /begin FUNCTION_LIST /end FUNCTION_LIST /begin REF_CHARACTERISTIC /end REF_CHARACTERISTIC /begin REF_MEASUREMENT SysStMod.StrtUpSt.Val /end REF_MEASUREMENT /end GROUP
/begin GROUP SysStMod.SysSt.Val "MICROSAR RTE" /begin SUB_GROUP /end SUB_GROUP /begin FUNCTION_LIST /end FUNCTION_LIST /begin REF_CHARACTERISTIC /end REF_CHARACTERISTIC /begin REF_MEASUREMENT SysStMod.SysSt.Val /end REF_MEASUREMENT /end GROUP
/begin GROUP SysStMod.SysStFltOutpReqDi.Logl "MICROSAR RTE" /begin SUB_GROUP /end SUB_GROUP /begin FUNCTION_LIST /end FUNCTION_LIST /begin REF_CHARACTERISTIC /end REF_CHARACTERISTIC /begin REF_MEASUREMENT SysStMod.SysStFltOutpReqDi.Logl /end REF_MEASUREMENT /end GROUP
/begin GROUP SysStMod.SysStImdtTranReqOff.Logl "MICROSAR RTE" /begin SUB_GROUP /end SUB_GROUP /begin FUNCTION_LIST /end FUNCTION_LIST /begin REF_CHARACTERISTIC /end REF_CHARACTERISTIC /begin REF_MEASUREMENT SysStMod.SysStImdtTranReqOff.Logl /end REF_MEASUREMENT /end GROUP
/begin GROUP SysStMod.SysStModPrevSysSt "MICROSAR RTE" /begin SUB_GROUP /end SUB_GROUP /begin FUNCTION_LIST /end FUNCTION_LIST /begin REF_CHARACTERISTIC /end REF_CHARACTERISTIC /begin REF_MEASUREMENT SysStMod.SysStModPrevSysSt /end REF_MEASUREMENT /end GROUP
/begin GROUP SysStMod.SysStReqDi.Logl "MICROSAR RTE" /begin SUB_GROUP /end SUB_GROUP /begin FUNCTION_LIST /end FUNCTION_LIST /begin REF_CHARACTERISTIC /end REF_CHARACTERISTIC /begin REF_MEASUREMENT SysStMod.SysStReqDi.Logl /end REF_MEASUREMENT /end GROUP
/**********************************************************************************************************************
* RECORD_LAYOUT
*********************************************************************************************************************/
/begin RECORD_LAYOUT RTE_RL_UBYTE FNC_VALUES 1 UBYTE ROW_DIR DIRECT /end RECORD_LAYOUT
/begin RECORD_LAYOUT RTE_RL_UWORD FNC_VALUES 1 UWORD ROW_DIR DIRECT /end RECORD_LAYOUT
/begin RECORD_LAYOUT RTE_RL_ULONG FNC_VALUES 1 ULONG ROW_DIR DIRECT /end RECORD_LAYOUT
/begin RECORD_LAYOUT RTE_RL_SWORD FNC_VALUES 1 SWORD ROW_DIR DIRECT /end RECORD_LAYOUT
/begin RECORD_LAYOUT RTE_RL_FLOAT32_IEEE FNC_VALUES 1 FLOAT32_IEEE ROW_DIR DIRECT /end RECORD_LAYOUT
/begin RECORD_LAYOUT RTE_RL_BOOLEAN FNC_VALUES 1 UBYTE ROW_DIR DIRECT /end RECORD_LAYOUT
/**********************************************************************************************************************
* COMPU_METHOD / COMPU_VTAB_RANGE
*********************************************************************************************************************/
/begin COMPU_METHOD RTE_CM_BOOLEAN "" TAB_VERB "%3.1" "" COMPU_TAB_REF RTE_CM_BOOLEAN /end COMPU_METHOD
/begin COMPU_VTAB_RANGE RTE_CM_BOOLEAN "" 2 0 0 "false" 1 255 "true" /end COMPU_VTAB_RANGE
/begin COMPU_METHOD RTE_CM_ENUM_SysSt1 "" TAB_VERB "%.1" "" COMPU_TAB_REF RTE_CM_ENUM_SysSt1 /end COMPU_METHOD
/begin COMPU_VTAB_RANGE RTE_CM_ENUM_SysSt1 "" 4 0 0 "SYSST_DI" 1 1 "SYSST_OFF" 2 2 "SYSST_ENA" 3 3 "SYSST_WRMININ" /end COMPU_VTAB_RANGE
/begin COMPU_METHOD RTE_CM_ENUM_LoaSt1 "" TAB_VERB "%.1" "" COMPU_TAB_REF RTE_CM_ENUM_LoaSt1 /end COMPU_METHOD
/begin COMPU_VTAB_RANGE RTE_CM_ENUM_LoaSt1 "" 6 0 0 "LOAST_NORM" 1 1 "LOAST_LIMD" 2 2 "LOAST_SWBASDMTGTN" 3 3 "LOAST_FADEOUT" 4 4 "LOAST_CTRLDSHTDWNREQD" 5 5 "LOAST_IMDTSHTDWNREQD" /end COMPU_VTAB_RANGE
/begin COMPU_METHOD RTE_CM_ENUM_SysFricLrngOperMod1 "" TAB_VERB "%.1" "" COMPU_TAB_REF RTE_CM_ENUM_SysFricLrngOperMod1 /end COMPU_METHOD
/begin COMPU_VTAB_RANGE RTE_CM_ENUM_SysFricLrngOperMod1 "" 5 0 0 "SYSFRICLRNGOPERMOD_CALIBRATION" 1 1 "SYSFRICLRNGOPERMOD_NORMAL" 2 2 "SYSFRICLRNGOPERMOD_CLEAR" 3 3 "SYSFRICLRNGOPERMOD_IDLE" 4 4 "SYSFRICLRNGOPERMOD_BASELINE" /end COMPU_VTAB_RANGE
/begin COMPU_METHOD RTE_CM_ENUM_BattVltgSt1 "" TAB_VERB "%.1" "" COMPU_TAB_REF RTE_CM_ENUM_BattVltgSt1 /end COMPU_METHOD
/begin COMPU_VTAB_RANGE RTE_CM_ENUM_BattVltgSt1 "" 7 0 0 "BATTVLTGST_NORMOPER" 1 1 "BATTVLTGST_HIVLTGWARN" 2 2 "BATTVLTGST_HIVLTGCRIT" 3 3 "BATTVLTGST_HIVLTGOFF" 4 4 "BATTVLTGST_LOVLTGWARN" 5 5 "BATTVLTGST_LOVLTGCRIT" 6 6 "BATTVLTGST_LOVLTGOFF" /end COMPU_VTAB_RANGE
