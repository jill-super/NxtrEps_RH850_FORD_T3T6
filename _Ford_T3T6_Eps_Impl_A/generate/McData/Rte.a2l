/begin CHARACTERISTIC CalRegn01Cmn.VehSigCdngDftYawRate.Val "MICROSAR RTE" VALUE 0x0 RTE_RL_FLOAT32_IEEE 0 NO_COMPU_METHOD -3.402823466e+38 3.402823466e+38 SYMBOL_LINK "Rte_CalprmRom_CalRegn01Cmn_DEFAULT_RTE_CALPRM_GROUP.VehSigCdngDftYawRate_Val" 0 DISPLAY_IDENTIFIER CalRegn01Cmn.CalibrationPorts.VehSigCdngDftYawRate.Val /end CHARACTERISTIC
/begin CHARACTERISTIC CalRegn01Cmn.VehSigCdngLatADifThd.Val "MICROSAR RTE" VALUE 0x0 RTE_RL_FLOAT32_IEEE 0 NO_COMPU_METHOD -3.402823466e+38 3.402823466e+38 SYMBOL_LINK "Rte_CalprmRom_CalRegn01Cmn_DEFAULT_RTE_CALPRM_GROUP.VehSigCdngLatADifThd_Val" 0 DISPLAY_IDENTIFIER CalRegn01Cmn.CalibrationPorts.VehSigCdngLatADifThd.Val /end CHARACTERISTIC
/begin CHARACTERISTIC CalRegn01Cmn.VehSigCdngLatAFilFrq.Val "MICROSAR RTE" VALUE 0x0 RTE_RL_FLOAT32_IEEE 0 NO_COMPU_METHOD -3.402823466e+38 3.402823466e+38 SYMBOL_LINK "Rte_CalprmRom_CalRegn01Cmn_DEFAULT_RTE_CALPRM_GROUP.VehSigCdngLatAFilFrq_Val" 0 DISPLAY_IDENTIFIER CalRegn01Cmn.CalibrationPorts.VehSigCdngLatAFilFrq.Val /end CHARACTERISTIC
/begin CHARACTERISTIC CalRegn01Cmn.VehSigCdngLtgADifThd.Val "MICROSAR RTE" VALUE 0x0 RTE_RL_FLOAT32_IEEE 0 NO_COMPU_METHOD -3.402823466e+38 3.402823466e+38 SYMBOL_LINK "Rte_CalprmRom_CalRegn01Cmn_DEFAULT_RTE_CALPRM_GROUP.VehSigCdngLtgADifThd_Val" 0 DISPLAY_IDENTIFIER CalRegn01Cmn.CalibrationPorts.VehSigCdngLtgADifThd.Val /end CHARACTERISTIC
/begin CHARACTERISTIC CalRegn01Cmn.VehSigCdngVehSpdDifThd.Val "MICROSAR RTE" VALUE 0x0 RTE_RL_FLOAT32_IEEE 0 NO_COMPU_METHOD -3.402823466e+38 3.402823466e+38 SYMBOL_LINK "Rte_CalprmRom_CalRegn01Cmn_DEFAULT_RTE_CALPRM_GROUP.VehSigCdngVehSpdDifThd_Val" 0 DISPLAY_IDENTIFIER CalRegn01Cmn.CalibrationPorts.VehSigCdngVehSpdDifThd.Val /end CHARACTERISTIC
/begin CHARACTERISTIC CalRegn01Cmn.VehSigCdngVehYawSlewRate.Val "MICROSAR RTE" VALUE 0x0 RTE_RL_FLOAT32_IEEE 0 NO_COMPU_METHOD -3.402823466e+38 3.402823466e+38 SYMBOL_LINK "Rte_CalprmRom_CalRegn01Cmn_DEFAULT_RTE_CALPRM_GROUP.VehSigCdngVehYawSlewRate_Val" 0 DISPLAY_IDENTIFIER CalRegn01Cmn.CalibrationPorts.VehSigCdngVehYawSlewRate.Val /end CHARACTERISTIC
/begin CHARACTERISTIC CalRegn01Cmn.VehSigCdngYawRateDifThd.Val "MICROSAR RTE" VALUE 0x0 RTE_RL_FLOAT32_IEEE 0 NO_COMPU_METHOD -3.402823466e+38 3.402823466e+38 SYMBOL_LINK "Rte_CalprmRom_CalRegn01Cmn_DEFAULT_RTE_CALPRM_GROUP.VehSigCdngYawRateDifThd_Val" 0 DISPLAY_IDENTIFIER CalRegn01Cmn.CalibrationPorts.VehSigCdngYawRateDifThd.Val /end CHARACTERISTIC
/begin CHARACTERISTIC CalRegn01Cmn.VehSpdLimrMaxAssiX.Ary1D "MICROSAR RTE" VAL_BLK 0x0 RTE_RL_UWORD 0 NO_COMPU_METHOD 0 65535 MATRIX_DIM 5 1 1 SYMBOL_LINK "Rte_CalprmRom_CalRegn01Cmn_DEFAULT_RTE_CALPRM_GROUP.VehSpdLimrMaxAssiX_Ary1D" 0 DISPLAY_IDENTIFIER CalRegn01Cmn.CalibrationPorts.VehSpdLimrMaxAssiX.Ary1D /end CHARACTERISTIC
/begin CHARACTERISTIC CalRegn01Cmn.VehSpdLimrMaxAssiY.Ary1D "MICROSAR RTE" VAL_BLK 0x0 RTE_RL_UWORD 0 NO_COMPU_METHOD 0 65535 MATRIX_DIM 5 1 1 SYMBOL_LINK "Rte_CalprmRom_CalRegn01Cmn_DEFAULT_RTE_CALPRM_GROUP.VehSpdLimrMaxAssiY_Ary1D" 0 DISPLAY_IDENTIFIER CalRegn01Cmn.CalibrationPorts.VehSpdLimrMaxAssiY.Ary1D /end CHARACTERISTIC
/begin CHARACTERISTIC CalRegn01Cmn.VehSpdLimrPosMaxOffs1.Val "MICROSAR RTE" VALUE 0x0 RTE_RL_FLOAT32_IEEE 0 NO_COMPU_METHOD -3.402823466e+38 3.402823466e+38 SYMBOL_LINK "Rte_CalprmRom_CalRegn01Cmn_DEFAULT_RTE_CALPRM_GROUP.VehSpdLimrPosMaxOffs1_Val" 0 DISPLAY_IDENTIFIER CalRegn01Cmn.CalibrationPorts.VehSpdLimrPosMaxOffs1.Val /end CHARACTERISTIC
/begin CHARACTERISTIC CalRegn01Cmn.VehSpdLimrPosMaxOffs2.Val "MICROSAR RTE" VALUE 0x0 RTE_RL_FLOAT32_IEEE 0 NO_COMPU_METHOD -3.402823466e+38 3.402823466e+38 SYMBOL_LINK "Rte_CalprmRom_CalRegn01Cmn_DEFAULT_RTE_CALPRM_GROUP.VehSpdLimrPosMaxOffs2_Val" 0 DISPLAY_IDENTIFIER CalRegn01Cmn.CalibrationPorts.VehSpdLimrPosMaxOffs2.Val /end CHARACTERISTIC
/begin CHARACTERISTIC CalRegn01CmnGroupA.DampgQuadHwTqBacklsh.Val "MICROSAR RTE" VALUE 0x0 RTE_RL_FLOAT32_IEEE 0 NO_COMPU_METHOD -3.402823466e+38 3.402823466e+38 SYMBOL_LINK "Rte_CalprmRom_CalRegn01CmnGroupA_DEFAULT_RTE_CALPRM_GROUP.DampgQuadHwTqBacklsh_Val" 0 DISPLAY_IDENTIFIER CalRegn01CmnGroupA.CalibrationPorts.DampgQuadHwTqBacklsh.Val /end CHARACTERISTIC
/begin CHARACTERISTIC CalRegn01CmnGroupA.DampgQuadMotVelBacklsh.Val "MICROSAR RTE" VALUE 0x0 RTE_RL_FLOAT32_IEEE 0 NO_COMPU_METHOD -3.402823466e+38 3.402823466e+38 SYMBOL_LINK "Rte_CalprmRom_CalRegn01CmnGroupA_DEFAULT_RTE_CALPRM_GROUP.DampgQuadMotVelBacklsh_Val" 0 DISPLAY_IDENTIFIER CalRegn01CmnGroupA.CalibrationPorts.DampgQuadMotVelBacklsh.Val /end CHARACTERISTIC
/begin CHARACTERISTIC CalRegn01CmnGroupA.ElecPwrCnsPrstcPwrLoss.Val "MICROSAR RTE" VALUE 0x0 RTE_RL_FLOAT32_IEEE 0 NO_COMPU_METHOD -3.402823466e+38 3.402823466e+38 SYMBOL_LINK "Rte_CalprmRom_CalRegn01CmnGroupA_DEFAULT_RTE_CALPRM_GROUP.ElecPwrCnsPrstcPwrLoss_Val" 0 DISPLAY_IDENTIFIER CalRegn01CmnGroupA.CalibrationPorts.ElecPwrCnsPrstcPwrLoss.Val /end CHARACTERISTIC
/begin CHARACTERISTIC CalRegn01CmnGroupA.TunSelnAuthyHwTqY.Ary1D "MICROSAR RTE" VAL_BLK 0x0 RTE_RL_UWORD 0 NO_COMPU_METHOD 0 65535 MATRIX_DIM 6 1 1 SYMBOL_LINK "Rte_CalprmRom_CalRegn01CmnGroupA_DEFAULT_RTE_CALPRM_GROUP.TunSelnAuthyHwTqY_Ary1D" 0 DISPLAY_IDENTIFIER CalRegn01CmnGroupA.CalibrationPorts.TunSelnAuthyHwTqY.Ary1D /end CHARACTERISTIC
/begin CHARACTERISTIC CalRegn01CmnGroupA.TunSelnAuthyHwVelY.Ary1D "MICROSAR RTE" VAL_BLK 0x0 RTE_RL_UWORD 0 NO_COMPU_METHOD 0 65535 MATRIX_DIM 6 1 1 SYMBOL_LINK "Rte_CalprmRom_CalRegn01CmnGroupA_DEFAULT_RTE_CALPRM_GROUP.TunSelnAuthyHwVelY_Ary1D" 0 DISPLAY_IDENTIFIER CalRegn01CmnGroupA.CalibrationPorts.TunSelnAuthyHwVelY.Ary1D /end CHARACTERISTIC
/begin CHARACTERISTIC CalRegn01CmnGroupA.TunSelnAuthyTunSelnRtDiCmd.Logl "MICROSAR RTE" VALUE 0x0 RTE_RL_BOOLEAN 0 RTE_CM_BOOLEAN 0 255 SYMBOL_LINK "Rte_CalprmRom_CalRegn01CmnGroupA_DEFAULT_RTE_CALPRM_GROUP.TunSelnAuthyTunSelnRtDiCmd_Logl" 0 DISPLAY_IDENTIFIER CalRegn01CmnGroupA.CalibrationPorts.TunSelnAuthyTunSelnRtDiCmd.Logl /end CHARACTERISTIC
/begin CHARACTERISTIC CalRegn01Inin00.AssiSumLimBlndCmdSumFrqLimX.Ary1D "MICROSAR RTE" VAL_BLK 0x0 RTE_RL_UWORD 0 NO_COMPU_METHOD 0 65535 MATRIX_DIM 2 1 1 SYMBOL_LINK "Rte_CalprmRom_CalRegn01Inin00_DEFAULT_RTE_CALPRM_GROUP.AssiSumLimBlndCmdSumFrqLimX_Ary1D" 0 DISPLAY_IDENTIFIER CalRegn01Inin00.CalibrationPorts.AssiSumLimBlndCmdSumFrqLimX.Ary1D /end CHARACTERISTIC
/begin CHARACTERISTIC CalRegn01Inin00.AssiSumLimBlndCmdSumFrqLimY.Ary1D "MICROSAR RTE" VAL_BLK 0x0 RTE_RL_UWORD 0 NO_COMPU_METHOD 0 65535 MATRIX_DIM 2 1 1 SYMBOL_LINK "Rte_CalprmRom_CalRegn01Inin00_DEFAULT_RTE_CALPRM_GROUP.AssiSumLimBlndCmdSumFrqLimY_Ary1D" 0 DISPLAY_IDENTIFIER CalRegn01Inin00.CalibrationPorts.AssiSumLimBlndCmdSumFrqLimY.Ary1D /end CHARACTERISTIC
/begin CHARACTERISTIC CalRegn01Inin00.AssiSumLimHiSpdCmdSumFrqLimX.Ary1D "MICROSAR RTE" VAL_BLK 0x0 RTE_RL_UWORD 0 NO_COMPU_METHOD 0 65535 MATRIX_DIM 8 1 1 SYMBOL_LINK "Rte_CalprmRom_CalRegn01Inin00_DEFAULT_RTE_CALPRM_GROUP.AssiSumLimHiSpdCmdSumFrqLimX_Ary1D" 0 DISPLAY_IDENTIFIER CalRegn01Inin00.CalibrationPorts.AssiSumLimHiSpdCmdSumFrqLimX.Ary1D /end CHARACTERISTIC
/begin CHARACTERISTIC CalRegn01Inin00.AssiSumLimHiSpdCmdSumFrqLimY.Ary1D "MICROSAR RTE" VAL_BLK 0x0 RTE_RL_UWORD 0 NO_COMPU_METHOD 0 65535 MATRIX_DIM 8 1 1 SYMBOL_LINK "Rte_CalprmRom_CalRegn01Inin00_DEFAULT_RTE_CALPRM_GROUP.AssiSumLimHiSpdCmdSumFrqLimY_Ary1D" 0 DISPLAY_IDENTIFIER CalRegn01Inin00.CalibrationPorts.AssiSumLimHiSpdCmdSumFrqLimY.Ary1D /end CHARACTERISTIC
/begin CHARACTERISTIC CalRegn01Inin00.AssiSumLimLoSpdCmdSumFrqLimX.Ary1D "MICROSAR RTE" VAL_BLK 0x0 RTE_RL_UWORD 0 NO_COMPU_METHOD 0 65535 MATRIX_DIM 8 1 1 SYMBOL_LINK "Rte_CalprmRom_CalRegn01Inin00_DEFAULT_RTE_CALPRM_GROUP.AssiSumLimLoSpdCmdSumFrqLimX_Ary1D" 0 DISPLAY_IDENTIFIER CalRegn01Inin00.CalibrationPorts.AssiSumLimLoSpdCmdSumFrqLimX.Ary1D /end CHARACTERISTIC
/begin CHARACTERISTIC CalRegn01Inin00.AssiSumLimLoSpdCmdSumFrqLimY.Ary1D "MICROSAR RTE" VAL_BLK 0x0 RTE_RL_UWORD 0 NO_COMPU_METHOD 0 65535 MATRIX_DIM 8 1 1 SYMBOL_LINK "Rte_CalprmRom_CalRegn01Inin00_DEFAULT_RTE_CALPRM_GROUP.AssiSumLimLoSpdCmdSumFrqLimY_Ary1D" 0 DISPLAY_IDENTIFIER CalRegn01Inin00.CalibrationPorts.AssiSumLimLoSpdCmdSumFrqLimY.Ary1D /end CHARACTERISTIC
/begin CHARACTERISTIC CalRegn01Inin00.AssiSumLimMotVelLpFilFrq.Val "MICROSAR RTE" VALUE 0x0 RTE_RL_FLOAT32_IEEE 0 NO_COMPU_METHOD -3.402823466e+38 3.402823466e+38 SYMBOL_LINK "Rte_CalprmRom_CalRegn01Inin00_DEFAULT_RTE_CALPRM_GROUP.AssiSumLimMotVelLpFilFrq_Val" 0 DISPLAY_IDENTIFIER CalRegn01Inin00.CalibrationPorts.AssiSumLimMotVelLpFilFrq.Val /end CHARACTERISTIC
/begin CHARACTERISTIC CalRegn01Inin00.CmplncErrHwAgNonLinCmplncDepTblY.Ary1D "MICROSAR RTE" VAL_BLK 0x0 RTE_RL_UWORD 0 NO_COMPU_METHOD 0 65535 MATRIX_DIM 6 1 1 SYMBOL_LINK "Rte_CalprmRom_CalRegn01Inin00_DEFAULT_RTE_CALPRM_GROUP.CmplncErrHwAgNonLinCmplncDepTblY_Ary1D" 0 DISPLAY_IDENTIFIER CalRegn01Inin00.CalibrationPorts.CmplncErrHwAgNonLinCmplncDepTblY.Ary1D /end CHARACTERISTIC
/begin CHARACTERISTIC CalRegn01Inin00.CmplncErrHwAgNonLinCmplncIndTblX.Ary1D "MICROSAR RTE" VAL_BLK 0x0 RTE_RL_UWORD 0 NO_COMPU_METHOD 0 65535 MATRIX_DIM 6 1 1 SYMBOL_LINK "Rte_CalprmRom_CalRegn01Inin00_DEFAULT_RTE_CALPRM_GROUP.CmplncErrHwAgNonLinCmplncIndTblX_Ary1D" 0 DISPLAY_IDENTIFIER CalRegn01Inin00.CalibrationPorts.CmplncErrHwAgNonLinCmplncIndTblX.Ary1D /end CHARACTERISTIC
/begin CHARACTERISTIC CalRegn01Inin00.CmplncErrMotAgNonLinCmplncDepTblY.Ary1D "MICROSAR RTE" VAL_BLK 0x0 RTE_RL_UWORD 0 NO_COMPU_METHOD 0 65535 MATRIX_DIM 6 1 1 SYMBOL_LINK "Rte_CalprmRom_CalRegn01Inin00_DEFAULT_RTE_CALPRM_GROUP.CmplncErrMotAgNonLinCmplncDepTblY_Ary1D" 0 DISPLAY_IDENTIFIER CalRegn01Inin00.CalibrationPorts.CmplncErrMotAgNonLinCmplncDepTblY.Ary1D /end CHARACTERISTIC
/begin CHARACTERISTIC CalRegn01Inin00.CmplncErrMotAgNonLinCmplncIndTblX.Ary1D "MICROSAR RTE" VAL_BLK 0x0 RTE_RL_UWORD 0 NO_COMPU_METHOD 0 65535 MATRIX_DIM 6 1 1 SYMBOL_LINK "Rte_CalprmRom_CalRegn01Inin00_DEFAULT_RTE_CALPRM_GROUP.CmplncErrMotAgNonLinCmplncIndTblX_Ary1D" 0 DISPLAY_IDENTIFIER CalRegn01Inin00.CalibrationPorts.CmplncErrMotAgNonLinCmplncIndTblX.Ary1D /end CHARACTERISTIC
/begin CHARACTERISTIC CalRegn01Inin00.DualCtrlrOutpMgrConOutpSca.Val "MICROSAR RTE" VALUE 0x0 RTE_RL_FLOAT32_IEEE 0 NO_COMPU_METHOD -3.402823466e+38 3.402823466e+38 SYMBOL_LINK "Rte_CalprmRom_CalRegn01Inin00_DEFAULT_RTE_CALPRM_GROUP.DualCtrlrOutpMgrConOutpSca_Val" 0 DISPLAY_IDENTIFIER CalRegn01Inin00.CalibrationPorts.DualCtrlrOutpMgrConOutpSca.Val /end CHARACTERISTIC
/begin CHARACTERISTIC CalRegn01Inin00.DualCtrlrOutpMgrDiRateTblY.Ary1D "MICROSAR RTE" VAL_BLK 0x0 RTE_RL_UWORD 0 NO_COMPU_METHOD 0 65535 MATRIX_DIM 10 1 1 SYMBOL_LINK "Rte_CalprmRom_CalRegn01Inin00_DEFAULT_RTE_CALPRM_GROUP.DualCtrlrOutpMgrDiRateTblY_Ary1D" 0 DISPLAY_IDENTIFIER CalRegn01Inin00.CalibrationPorts.DualCtrlrOutpMgrDiRateTblY.Ary1D /end CHARACTERISTIC
/begin CHARACTERISTIC CalRegn01Inin00.DualCtrlrOutpMgrEnaRate.Val "MICROSAR RTE" VALUE 0x0 RTE_RL_FLOAT32_IEEE 0 NO_COMPU_METHOD -3.402823466e+38 3.402823466e+38 SYMBOL_LINK "Rte_CalprmRom_CalRegn01Inin00_DEFAULT_RTE_CALPRM_GROUP.DualCtrlrOutpMgrEnaRate_Val" 0 DISPLAY_IDENTIFIER CalRegn01Inin00.CalibrationPorts.DualCtrlrOutpMgrEnaRate.Val /end CHARACTERISTIC
/begin CHARACTERISTIC CalRegn01Inin00.DualCtrlrOutpMgrFltThdTmr.Val "MICROSAR RTE" VALUE 0x0 RTE_RL_UWORD 0 NO_COMPU_METHOD 0 65535 SYMBOL_LINK "Rte_CalprmRom_CalRegn01Inin00_DEFAULT_RTE_CALPRM_GROUP.DualCtrlrOutpMgrFltThdTmr_Val" 0 DISPLAY_IDENTIFIER CalRegn01Inin00.CalibrationPorts.DualCtrlrOutpMgrFltThdTmr.Val /end CHARACTERISTIC
/begin CHARACTERISTIC CalRegn01Inin00.DualCtrlrOutpMgrLimdOutpSca.Val "MICROSAR RTE" VALUE 0x0 RTE_RL_FLOAT32_IEEE 0 NO_COMPU_METHOD -3.402823466e+38 3.402823466e+38 SYMBOL_LINK "Rte_CalprmRom_CalRegn01Inin00_DEFAULT_RTE_CALPRM_GROUP.DualCtrlrOutpMgrLimdOutpSca_Val" 0 DISPLAY_IDENTIFIER CalRegn01Inin00.CalibrationPorts.DualCtrlrOutpMgrLimdOutpSca.Val /end CHARACTERISTIC
/begin CHARACTERISTIC CalRegn01Inin00.DualCtrlrOutpMgrMaxOutpSca.Val "MICROSAR RTE" VALUE 0x0 RTE_RL_FLOAT32_IEEE 0 NO_COMPU_METHOD -3.402823466e+38 3.402823466e+38 SYMBOL_LINK "Rte_CalprmRom_CalRegn01Inin00_DEFAULT_RTE_CALPRM_GROUP.DualCtrlrOutpMgrMaxOutpSca_Val" 0 DISPLAY_IDENTIFIER CalRegn01Inin00.CalibrationPorts.DualCtrlrOutpMgrMaxOutpSca.Val /end CHARACTERISTIC
/begin CHARACTERISTIC CalRegn01Inin00.DualCtrlrOutpMgrMaxOutpTmr.Val "MICROSAR RTE" VALUE 0x0 RTE_RL_UWORD 0 NO_COMPU_METHOD 0 65535 SYMBOL_LINK "Rte_CalprmRom_CalRegn01Inin00_DEFAULT_RTE_CALPRM_GROUP.DualCtrlrOutpMgrMaxOutpTmr_Val" 0 DISPLAY_IDENTIFIER CalRegn01Inin00.CalibrationPorts.DualCtrlrOutpMgrMaxOutpTmr.Val /end CHARACTERISTIC
/begin CHARACTERISTIC CalRegn01Inin00.DualCtrlrOutpMgrMinOutpTmr.Val "MICROSAR RTE" VALUE 0x0 RTE_RL_UWORD 0 NO_COMPU_METHOD 0 65535 SYMBOL_LINK "Rte_CalprmRom_CalRegn01Inin00_DEFAULT_RTE_CALPRM_GROUP.DualCtrlrOutpMgrMinOutpTmr_Val" 0 DISPLAY_IDENTIFIER CalRegn01Inin00.CalibrationPorts.DualCtrlrOutpMgrMinOutpTmr.Val /end CHARACTERISTIC
/begin CHARACTERISTIC CalRegn01Inin00.DualCtrlrOutpMgrNonRecFltThdTmr.Val "MICROSAR RTE" VALUE 0x0 RTE_RL_UWORD 0 NO_COMPU_METHOD 0 65535 SYMBOL_LINK "Rte_CalprmRom_CalRegn01Inin00_DEFAULT_RTE_CALPRM_GROUP.DualCtrlrOutpMgrNonRecFltThdTmr_Val" 0 DISPLAY_IDENTIFIER CalRegn01Inin00.CalibrationPorts.DualCtrlrOutpMgrNonRecFltThdTmr.Val /end CHARACTERISTIC
/begin CHARACTERISTIC CalRegn01Inin00.DualCtrlrOutpMgrThdTmr.Val "MICROSAR RTE" VALUE 0x0 RTE_RL_UWORD 0 NO_COMPU_METHOD 0 65535 SYMBOL_LINK "Rte_CalprmRom_CalRegn01Inin00_DEFAULT_RTE_CALPRM_GROUP.DualCtrlrOutpMgrThdTmr_Val" 0 DISPLAY_IDENTIFIER CalRegn01Inin00.CalibrationPorts.DualCtrlrOutpMgrThdTmr.Val /end CHARACTERISTIC
/begin CHARACTERISTIC CalRegn01Inin00.DualCtrlrOutpMgrVehSpdRefTblX.Ary1D "MICROSAR RTE" VAL_BLK 0x0 RTE_RL_UWORD 0 NO_COMPU_METHOD 0 65535 MATRIX_DIM 10 1 1 SYMBOL_LINK "Rte_CalprmRom_CalRegn01Inin00_DEFAULT_RTE_CALPRM_GROUP.DualCtrlrOutpMgrVehSpdRefTblX_Ary1D" 0 DISPLAY_IDENTIFIER CalRegn01Inin00.CalibrationPorts.DualCtrlrOutpMgrVehSpdRefTblX.Ary1D /end CHARACTERISTIC
/begin CHARACTERISTIC CalRegn01Inin00.DualCtrlrOutpMgrVltgModFltThdTmr.Val "MICROSAR RTE" VALUE 0x0 RTE_RL_UWORD 0 NO_COMPU_METHOD 0 65535 SYMBOL_LINK "Rte_CalprmRom_CalRegn01Inin00_DEFAULT_RTE_CALPRM_GROUP.DualCtrlrOutpMgrVltgModFltThdTmr_Val" 0 DISPLAY_IDENTIFIER CalRegn01Inin00.CalibrationPorts.DualCtrlrOutpMgrVltgModFltThdTmr.Val /end CHARACTERISTIC
/begin CHARACTERISTIC CalRegn01Inin00.HwAg1MeasHwAg1IfFltFailStep.Val "MICROSAR RTE" VALUE 0x0 RTE_RL_UWORD 0 NO_COMPU_METHOD 0 65535 SYMBOL_LINK "Rte_CalprmRom_CalRegn01Inin00_DEFAULT_RTE_CALPRM_GROUP.HwAg1MeasHwAg1IfFltFailStep_Val" 0 DISPLAY_IDENTIFIER CalRegn01Inin00.CalibrationPorts.HwAg1MeasHwAg1IfFltFailStep.Val /end CHARACTERISTIC
/begin CHARACTERISTIC CalRegn01Inin00.HwAg1MeasHwAg1IfFltPassStep.Val "MICROSAR RTE" VALUE 0x0 RTE_RL_UWORD 0 NO_COMPU_METHOD 0 65535 SYMBOL_LINK "Rte_CalprmRom_CalRegn01Inin00_DEFAULT_RTE_CALPRM_GROUP.HwAg1MeasHwAg1IfFltPassStep_Val" 0 DISPLAY_IDENTIFIER CalRegn01Inin00.CalibrationPorts.HwAg1MeasHwAg1IfFltPassStep.Val /end CHARACTERISTIC
/begin CHARACTERISTIC CalRegn01Inin00.HwAg1MeasHwAg1Snsr0PrtclFltFailStep.Val "MICROSAR RTE" VALUE 0x0 RTE_RL_UWORD 0 NO_COMPU_METHOD 0 65535 SYMBOL_LINK "Rte_CalprmRom_CalRegn01Inin00_DEFAULT_RTE_CALPRM_GROUP.HwAg1MeasHwAg1Snsr0PrtclFltFailStep_Val" 0 DISPLAY_IDENTIFIER CalRegn01Inin00.CalibrationPorts.HwAg1MeasHwAg1Snsr0PrtclFltFailStep.Val /end CHARACTERISTIC
/begin CHARACTERISTIC CalRegn01Inin00.HwAg1MeasHwAg1Snsr0PrtclFltPassStep.Val "MICROSAR RTE" VALUE 0x0 RTE_RL_UWORD 0 NO_COMPU_METHOD 0 65535 SYMBOL_LINK "Rte_CalprmRom_CalRegn01Inin00_DEFAULT_RTE_CALPRM_GROUP.HwAg1MeasHwAg1Snsr0PrtclFltPassStep_Val" 0 DISPLAY_IDENTIFIER CalRegn01Inin00.CalibrationPorts.HwAg1MeasHwAg1Snsr0PrtclFltPassStep.Val /end CHARACTERISTIC
/begin CHARACTERISTIC CalRegn01Inin00.HwAg1MeasHwAg1Snsr1PrtclFltFailStep.Val "MICROSAR RTE" VALUE 0x0 RTE_RL_UWORD 0 NO_COMPU_METHOD 0 65535 SYMBOL_LINK "Rte_CalprmRom_CalRegn01Inin00_DEFAULT_RTE_CALPRM_GROUP.HwAg1MeasHwAg1Snsr1PrtclFltFailStep_Val" 0 DISPLAY_IDENTIFIER CalRegn01Inin00.CalibrationPorts.HwAg1MeasHwAg1Snsr1PrtclFltFailStep.Val /end CHARACTERISTIC
/begin CHARACTERISTIC CalRegn01Inin00.HwAg1MeasHwAg1Snsr1PrtclFltPassStep.Val "MICROSAR RTE" VALUE 0x0 RTE_RL_UWORD 0 NO_COMPU_METHOD 0 65535 SYMBOL_LINK "Rte_CalprmRom_CalRegn01Inin00_DEFAULT_RTE_CALPRM_GROUP.HwAg1MeasHwAg1Snsr1PrtclFltPassStep_Val" 0 DISPLAY_IDENTIFIER CalRegn01Inin00.CalibrationPorts.HwAg1MeasHwAg1Snsr1PrtclFltPassStep.Val /end CHARACTERISTIC
/begin CHARACTERISTIC CalRegn01Inin00.HwAg1MeasSnsr0Rev.Ary1D "MICROSAR RTE" VAL_BLK 0x0 RTE_RL_UBYTE 0 NO_COMPU_METHOD 0 255 MATRIX_DIM 22 1 1 SYMBOL_LINK "Rte_CalprmRom_CalRegn01Inin00_DEFAULT_RTE_CALPRM_GROUP.HwAg1MeasSnsr0Rev_Ary1D" 0 DISPLAY_IDENTIFIER CalRegn01Inin00.CalibrationPorts.HwAg1MeasSnsr0Rev.Ary1D /end CHARACTERISTIC
/begin CHARACTERISTIC CalRegn01Inin00.HwAg1MeasSnsr1Rev.Ary1D "MICROSAR RTE" VAL_BLK 0x0 RTE_RL_UBYTE 0 NO_COMPU_METHOD 0 255 MATRIX_DIM 22 1 1 SYMBOL_LINK "Rte_CalprmRom_CalRegn01Inin00_DEFAULT_RTE_CALPRM_GROUP.HwAg1MeasSnsr1Rev_Ary1D" 0 DISPLAY_IDENTIFIER CalRegn01Inin00.CalibrationPorts.HwAg1MeasSnsr1Rev.Ary1D /end CHARACTERISTIC
/begin CHARACTERISTIC CalRegn01Inin00.HwAg1MeasStep.Ary1D "MICROSAR RTE" VAL_BLK 0x0 RTE_RL_SWORD 0 NO_COMPU_METHOD -32768 32767 MATRIX_DIM 22 1 1 SYMBOL_LINK "Rte_CalprmRom_CalRegn01Inin00_DEFAULT_RTE_CALPRM_GROUP.HwAg1MeasStep_Ary1D" 0 DISPLAY_IDENTIFIER CalRegn01Inin00.CalibrationPorts.HwAg1MeasStep.Ary1D /end CHARACTERISTIC
/begin CHARACTERISTIC CalRegn01Inin00.HwAg1MeasVrnrErrThd.Val "MICROSAR RTE" VALUE 0x0 RTE_RL_UBYTE 0 NO_COMPU_METHOD 0 255 SYMBOL_LINK "Rte_CalprmRom_CalRegn01Inin00_DEFAULT_RTE_CALPRM_GROUP.HwAg1MeasVrnrErrThd_Val" 0 DISPLAY_IDENTIFIER CalRegn01Inin00.CalibrationPorts.HwAg1MeasVrnrErrThd.Val /end CHARACTERISTIC
/begin CHARACTERISTIC CalRegn01Inin00.HwAgSnsrlsFeatEna.Logl "MICROSAR RTE" VALUE 0x0 RTE_RL_BOOLEAN 0 RTE_CM_BOOLEAN 0 255 SYMBOL_LINK "Rte_CalprmRom_CalRegn01Inin00_DEFAULT_RTE_CALPRM_GROUP.HwAgSnsrlsFeatEna_Logl" 0 DISPLAY_IDENTIFIER CalRegn01Inin00.CalibrationPorts.HwAgSnsrlsFeatEna.Logl /end CHARACTERISTIC
/begin CHARACTERISTIC CalRegn01Inin00.HwAgSnsrlsVehDynVehSpdThd.Val "MICROSAR RTE" VALUE 0x0 RTE_RL_FLOAT32_IEEE 0 NO_COMPU_METHOD -3.402823466e+38 3.402823466e+38 SYMBOL_LINK "Rte_CalprmRom_CalRegn01Inin00_DEFAULT_RTE_CALPRM_GROUP.HwAgSnsrlsVehDynVehSpdThd_Val" 0 DISPLAY_IDENTIFIER CalRegn01Inin00.CalibrationPorts.HwAgSnsrlsVehDynVehSpdThd.Val /end CHARACTERISTIC
/begin CHARACTERISTIC CalRegn01Inin00.HwAgSnsrlsVehDynYawRateThd.Val "MICROSAR RTE" VALUE 0x0 RTE_RL_FLOAT32_IEEE 0 NO_COMPU_METHOD -3.402823466e+38 3.402823466e+38 SYMBOL_LINK "Rte_CalprmRom_CalRegn01Inin00_DEFAULT_RTE_CALPRM_GROUP.HwAgSnsrlsVehDynYawRateThd_Val" 0 DISPLAY_IDENTIFIER CalRegn01Inin00.CalibrationPorts.HwAgSnsrlsVehDynYawRateThd.Val /end CHARACTERISTIC
/begin CHARACTERISTIC CalRegn01Inin00.HwAgSnsrlsYawRateFilFrq.Val "MICROSAR RTE" VALUE 0x0 RTE_RL_FLOAT32_IEEE 0 NO_COMPU_METHOD -3.402823466e+38 3.402823466e+38 SYMBOL_LINK "Rte_CalprmRom_CalRegn01Inin00_DEFAULT_RTE_CALPRM_GROUP.HwAgSnsrlsYawRateFilFrq_Val" 0 DISPLAY_IDENTIFIER CalRegn01Inin00.CalibrationPorts.HwAgSnsrlsYawRateFilFrq.Val /end CHARACTERISTIC
/begin CHARACTERISTIC CalRegn01Inin00.HwAgSysArbn2PinionPosSnsrAvl.Logl "MICROSAR RTE" VALUE 0x0 RTE_RL_BOOLEAN 0 RTE_CM_BOOLEAN 0 255 SYMBOL_LINK "Rte_CalprmRom_CalRegn01Inin00_DEFAULT_RTE_CALPRM_GROUP.HwAgSysArbn2PinionPosSnsrAvl_Logl" 0 DISPLAY_IDENTIFIER CalRegn01Inin00.CalibrationPorts.HwAgSysArbn2PinionPosSnsrAvl.Logl /end CHARACTERISTIC
/begin CHARACTERISTIC CalRegn01Inin00.HwAgSysArbnTqSnsrVelFilFrq.Val "MICROSAR RTE" VALUE 0x0 RTE_RL_FLOAT32_IEEE 0 NO_COMPU_METHOD -3.402823466e+38 3.402823466e+38 SYMBOL_LINK "Rte_CalprmRom_CalRegn01Inin00_DEFAULT_RTE_CALPRM_GROUP.HwAgSysArbnTqSnsrVelFilFrq_Val" 0 DISPLAY_IDENTIFIER CalRegn01Inin00.CalibrationPorts.HwAgSysArbnTqSnsrVelFilFrq.Val /end CHARACTERISTIC
/begin CHARACTERISTIC CalRegn01Inin00.HwTq1MeasHwTq1PrtclFltFailStep.Val "MICROSAR RTE" VALUE 0x0 RTE_RL_UWORD 0 NO_COMPU_METHOD 0 65535 SYMBOL_LINK "Rte_CalprmRom_CalRegn01Inin00_DEFAULT_RTE_CALPRM_GROUP.HwTq1MeasHwTq1PrtclFltFailStep_Val" 0 DISPLAY_IDENTIFIER CalRegn01Inin00.CalibrationPorts.HwTq1MeasHwTq1PrtclFltFailStep.Val /end CHARACTERISTIC
/begin CHARACTERISTIC CalRegn01Inin00.HwTq1MeasHwTq1PrtclFltPassStep.Val "MICROSAR RTE" VALUE 0x0 RTE_RL_UWORD 0 NO_COMPU_METHOD 0 65535 SYMBOL_LINK "Rte_CalprmRom_CalRegn01Inin00_DEFAULT_RTE_CALPRM_GROUP.HwTq1MeasHwTq1PrtclFltPassStep_Val" 0 DISPLAY_IDENTIFIER CalRegn01Inin00.CalibrationPorts.HwTq1MeasHwTq1PrtclFltPassStep.Val /end CHARACTERISTIC
/begin CHARACTERISTIC CalRegn01Inin00.HwTq8MeasHwTq8PrtclFltFailStep.Val "MICROSAR RTE" VALUE 0x0 RTE_RL_UWORD 0 NO_COMPU_METHOD 0 65535 SYMBOL_LINK "Rte_CalprmRom_CalRegn01Inin00_DEFAULT_RTE_CALPRM_GROUP.HwTq8MeasHwTq8PrtclFltFailStep_Val" 0 DISPLAY_IDENTIFIER CalRegn01Inin00.CalibrationPorts.HwTq8MeasHwTq8PrtclFltFailStep.Val /end CHARACTERISTIC
/begin CHARACTERISTIC CalRegn01Inin00.HwTq8MeasHwTq8PrtclFltPassStep.Val "MICROSAR RTE" VALUE 0x0 RTE_RL_UWORD 0 NO_COMPU_METHOD 0 65535 SYMBOL_LINK "Rte_CalprmRom_CalRegn01Inin00_DEFAULT_RTE_CALPRM_GROUP.HwTq8MeasHwTq8PrtclFltPassStep_Val" 0 DISPLAY_IDENTIFIER CalRegn01Inin00.CalibrationPorts.HwTq8MeasHwTq8PrtclFltPassStep.Val /end CHARACTERISTIC
/begin CHARACTERISTIC CalRegn01Inin00.ImcSigArbnArbnFltTmr.Val "MICROSAR RTE" VALUE 0x0 RTE_RL_FLOAT32_IEEE 0 NO_COMPU_METHOD -3.402823466e+38 3.402823466e+38 SYMBOL_LINK "Rte_CalprmRom_CalRegn01Inin00_DEFAULT_RTE_CALPRM_GROUP.ImcSigArbnArbnFltTmr_Val" 0 DISPLAY_IDENTIFIER CalRegn01Inin00.CalibrationPorts.ImcSigArbnArbnFltTmr.Val /end CHARACTERISTIC
/begin CHARACTERISTIC CalRegn01Inin00.ImcSigArbnHwAgArbnEna.Logl "MICROSAR RTE" VALUE 0x0 RTE_RL_BOOLEAN 0 RTE_CM_BOOLEAN 0 255 SYMBOL_LINK "Rte_CalprmRom_CalRegn01Inin00_DEFAULT_RTE_CALPRM_GROUP.ImcSigArbnHwAgArbnEna_Logl" 0 DISPLAY_IDENTIFIER CalRegn01Inin00.CalibrationPorts.ImcSigArbnHwAgArbnEna.Logl /end CHARACTERISTIC
/begin CHARACTERISTIC CalRegn01Inin00.ImcSigArbnHwAgArbnLpFil.Val "MICROSAR RTE" VALUE 0x0 RTE_RL_FLOAT32_IEEE 0 NO_COMPU_METHOD -3.402823466e+38 3.402823466e+38 SYMBOL_LINK "Rte_CalprmRom_CalRegn01Inin00_DEFAULT_RTE_CALPRM_GROUP.ImcSigArbnHwAgArbnLpFil_Val" 0 DISPLAY_IDENTIFIER CalRegn01Inin00.CalibrationPorts.ImcSigArbnHwAgArbnLpFil.Val /end CHARACTERISTIC
/begin CHARACTERISTIC CalRegn01Inin00.ImcSigArbnHwAgArbnOffsLim.Val "MICROSAR RTE" VALUE 0x0 RTE_RL_FLOAT32_IEEE 0 NO_COMPU_METHOD -3.402823466e+38 3.402823466e+38 SYMBOL_LINK "Rte_CalprmRom_CalRegn01Inin00_DEFAULT_RTE_CALPRM_GROUP.ImcSigArbnHwAgArbnOffsLim_Val" 0 DISPLAY_IDENTIFIER CalRegn01Inin00.CalibrationPorts.ImcSigArbnHwAgArbnOffsLim.Val /end CHARACTERISTIC
/begin CHARACTERISTIC CalRegn01Inin00.ImcSigArbnHwAgTarArbnEna.Logl "MICROSAR RTE" VALUE 0x0 RTE_RL_BOOLEAN 0 RTE_CM_BOOLEAN 0 255 SYMBOL_LINK "Rte_CalprmRom_CalRegn01Inin00_DEFAULT_RTE_CALPRM_GROUP.ImcSigArbnHwAgTarArbnEna_Logl" 0 DISPLAY_IDENTIFIER CalRegn01Inin00.CalibrationPorts.ImcSigArbnHwAgTarArbnEna.Logl /end CHARACTERISTIC
/begin CHARACTERISTIC CalRegn01Inin00.ImcSigArbnHwAgTarArbnLpFil.Val "MICROSAR RTE" VALUE 0x0 RTE_RL_FLOAT32_IEEE 0 NO_COMPU_METHOD -3.402823466e+38 3.402823466e+38 SYMBOL_LINK "Rte_CalprmRom_CalRegn01Inin00_DEFAULT_RTE_CALPRM_GROUP.ImcSigArbnHwAgTarArbnLpFil_Val" 0 DISPLAY_IDENTIFIER CalRegn01Inin00.CalibrationPorts.ImcSigArbnHwAgTarArbnLpFil.Val /end CHARACTERISTIC
/begin CHARACTERISTIC CalRegn01Inin00.ImcSigArbnHwAgTarArbnOffsLim.Val "MICROSAR RTE" VALUE 0x0 RTE_RL_FLOAT32_IEEE 0 NO_COMPU_METHOD -3.402823466e+38 3.402823466e+38 SYMBOL_LINK "Rte_CalprmRom_CalRegn01Inin00_DEFAULT_RTE_CALPRM_GROUP.ImcSigArbnHwAgTarArbnOffsLim_Val" 0 DISPLAY_IDENTIFIER CalRegn01Inin00.CalibrationPorts.ImcSigArbnHwAgTarArbnOffsLim.Val /end CHARACTERISTIC
/begin CHARACTERISTIC CalRegn01Inin00.ImcSigArbnHwTqArbnEna.Logl "MICROSAR RTE" VALUE 0x0 RTE_RL_BOOLEAN 0 RTE_CM_BOOLEAN 0 255 SYMBOL_LINK "Rte_CalprmRom_CalRegn01Inin00_DEFAULT_RTE_CALPRM_GROUP.ImcSigArbnHwTqArbnEna_Logl" 0 DISPLAY_IDENTIFIER CalRegn01Inin00.CalibrationPorts.ImcSigArbnHwTqArbnEna.Logl /end CHARACTERISTIC
/begin CHARACTERISTIC CalRegn01Inin00.ImcSigArbnHwTqArbnLpFil.Val "MICROSAR RTE" VALUE 0x0 RTE_RL_FLOAT32_IEEE 0 NO_COMPU_METHOD -3.402823466e+38 3.402823466e+38 SYMBOL_LINK "Rte_CalprmRom_CalRegn01Inin00_DEFAULT_RTE_CALPRM_GROUP.ImcSigArbnHwTqArbnLpFil_Val" 0 DISPLAY_IDENTIFIER CalRegn01Inin00.CalibrationPorts.ImcSigArbnHwTqArbnLpFil.Val /end CHARACTERISTIC
/begin CHARACTERISTIC CalRegn01Inin00.ImcSigArbnHwTqArbnOffsLim.Val "MICROSAR RTE" VALUE 0x0 RTE_RL_FLOAT32_IEEE 0 NO_COMPU_METHOD -3.402823466e+38 3.402823466e+38 SYMBOL_LINK "Rte_CalprmRom_CalRegn01Inin00_DEFAULT_RTE_CALPRM_GROUP.ImcSigArbnHwTqArbnOffsLim_Val" 0 DISPLAY_IDENTIFIER CalRegn01Inin00.CalibrationPorts.ImcSigArbnHwTqArbnOffsLim.Val /end CHARACTERISTIC
/begin CHARACTERISTIC CalRegn01Inin00.ImcSigArbnMotVelArbnEna.Logl "MICROSAR RTE" VALUE 0x0 RTE_RL_BOOLEAN 0 RTE_CM_BOOLEAN 0 255 SYMBOL_LINK "Rte_CalprmRom_CalRegn01Inin00_DEFAULT_RTE_CALPRM_GROUP.ImcSigArbnMotVelArbnEna_Logl" 0 DISPLAY_IDENTIFIER CalRegn01Inin00.CalibrationPorts.ImcSigArbnMotVelArbnEna.Logl /end CHARACTERISTIC
/begin CHARACTERISTIC CalRegn01Inin00.ImcSigArbnMotVelArbnLpFil.Val "MICROSAR RTE" VALUE 0x0 RTE_RL_FLOAT32_IEEE 0 NO_COMPU_METHOD -3.402823466e+38 3.402823466e+38 SYMBOL_LINK "Rte_CalprmRom_CalRegn01Inin00_DEFAULT_RTE_CALPRM_GROUP.ImcSigArbnMotVelArbnLpFil_Val" 0 DISPLAY_IDENTIFIER CalRegn01Inin00.CalibrationPorts.ImcSigArbnMotVelArbnLpFil.Val /end CHARACTERISTIC
/begin CHARACTERISTIC CalRegn01Inin00.ImcSigArbnMotVelArbnOffsLim.Val "MICROSAR RTE" VALUE 0x0 RTE_RL_FLOAT32_IEEE 0 NO_COMPU_METHOD -3.402823466e+38 3.402823466e+38 SYMBOL_LINK "Rte_CalprmRom_CalRegn01Inin00_DEFAULT_RTE_CALPRM_GROUP.ImcSigArbnMotVelArbnOffsLim_Val" 0 DISPLAY_IDENTIFIER CalRegn01Inin00.CalibrationPorts.ImcSigArbnMotVelArbnOffsLim.Val /end CHARACTERISTIC
/begin CHARACTERISTIC CalRegn01Inin00.ImcSigArbnPosnServoArbnOffsLim.Val "MICROSAR RTE" VALUE 0x0 RTE_RL_FLOAT32_IEEE 0 NO_COMPU_METHOD -3.402823466e+38 3.402823466e+38 SYMBOL_LINK "Rte_CalprmRom_CalRegn01Inin00_DEFAULT_RTE_CALPRM_GROUP.ImcSigArbnPosnServoArbnOffsLim_Val" 0 DISPLAY_IDENTIFIER CalRegn01Inin00.CalibrationPorts.ImcSigArbnPosnServoArbnOffsLim.Val /end CHARACTERISTIC
/begin CHARACTERISTIC CalRegn01Inin00.ImcSigArbnPosnServoIntgtrStArbnEna.Logl "MICROSAR RTE" VALUE 0x0 RTE_RL_BOOLEAN 0 RTE_CM_BOOLEAN 0 255 SYMBOL_LINK "Rte_CalprmRom_CalRegn01Inin00_DEFAULT_RTE_CALPRM_GROUP.ImcSigArbnPosnServoIntgtrStArbnEna_Logl" 0 DISPLAY_IDENTIFIER CalRegn01Inin00.CalibrationPorts.ImcSigArbnPosnServoIntgtrStArbnEna.Logl /end CHARACTERISTIC
/begin CHARACTERISTIC CalRegn01Inin00.ImcSigArbnPosnServoIntgtrStArbnLpFil.Val "MICROSAR RTE" VALUE 0x0 RTE_RL_FLOAT32_IEEE 0 NO_COMPU_METHOD -3.402823466e+38 3.402823466e+38 SYMBOL_LINK "Rte_CalprmRom_CalRegn01Inin00_DEFAULT_RTE_CALPRM_GROUP.ImcSigArbnPosnServoIntgtrStArbnLpFil_Val" 0 DISPLAY_IDENTIFIER CalRegn01Inin00.CalibrationPorts.ImcSigArbnPosnServoIntgtrStArbnLpFil.Val /end CHARACTERISTIC
/begin CHARACTERISTIC CalRegn01Inin00.ImcSigArbnPosnTrakg1ArbnOffsLim.Val "MICROSAR RTE" VALUE 0x0 RTE_RL_FLOAT32_IEEE 0 NO_COMPU_METHOD -3.402823466e+38 3.402823466e+38 SYMBOL_LINK "Rte_CalprmRom_CalRegn01Inin00_DEFAULT_RTE_CALPRM_GROUP.ImcSigArbnPosnTrakg1ArbnOffsLim_Val" 0 DISPLAY_IDENTIFIER CalRegn01Inin00.CalibrationPorts.ImcSigArbnPosnTrakg1ArbnOffsLim.Val /end CHARACTERISTIC
/begin CHARACTERISTIC CalRegn01Inin00.ImcSigArbnPosnTrakg2ArbnOffsLim.Val "MICROSAR RTE" VALUE 0x0 RTE_RL_FLOAT32_IEEE 0 NO_COMPU_METHOD -3.402823466e+38 3.402823466e+38 SYMBOL_LINK "Rte_CalprmRom_CalRegn01Inin00_DEFAULT_RTE_CALPRM_GROUP.ImcSigArbnPosnTrakg2ArbnOffsLim_Val" 0 DISPLAY_IDENTIFIER CalRegn01Inin00.CalibrationPorts.ImcSigArbnPosnTrakg2ArbnOffsLim.Val /end CHARACTERISTIC
/begin CHARACTERISTIC CalRegn01Inin00.ImcSigArbnPullCmpLongTermIntgtrStArbnEna.Logl "MICROSAR RTE" VALUE 0x0 RTE_RL_BOOLEAN 0 RTE_CM_BOOLEAN 0 255 SYMBOL_LINK "Rte_CalprmRom_CalRegn01Inin00_DEFAULT_RTE_CALPRM_GROUP.ImcSigArbnPullCmpLongTermIntgtrStArbnEna_Logl" 0 DISPLAY_IDENTIFIER CalRegn01Inin00.CalibrationPorts.ImcSigArbnPullCmpLongTermIntgtrStArbnEna.Logl /end CHARACTERISTIC
/begin CHARACTERISTIC CalRegn01Inin00.ImcSigArbnPullCmpLongTermIntgtrStArbnLpFil.Val "MICROSAR RTE" VALUE 0x0 RTE_RL_FLOAT32_IEEE 0 NO_COMPU_METHOD -3.402823466e+38 3.402823466e+38 SYMBOL_LINK "Rte_CalprmRom_CalRegn01Inin00_DEFAULT_RTE_CALPRM_GROUP.ImcSigArbnPullCmpLongTermIntgtrStArbnLpFil_Val" 0 DISPLAY_IDENTIFIER CalRegn01Inin00.CalibrationPorts.ImcSigArbnPullCmpLongTermIntgtrStArbnLpFil.Val /end CHARACTERISTIC
/begin CHARACTERISTIC CalRegn01Inin00.ImcSigArbnPullCmpShoTermIntgtrStArbnEna.Logl "MICROSAR RTE" VALUE 0x0 RTE_RL_BOOLEAN 0 RTE_CM_BOOLEAN 0 255 SYMBOL_LINK "Rte_CalprmRom_CalRegn01Inin00_DEFAULT_RTE_CALPRM_GROUP.ImcSigArbnPullCmpShoTermIntgtrStArbnEna_Logl" 0 DISPLAY_IDENTIFIER CalRegn01Inin00.CalibrationPorts.ImcSigArbnPullCmpShoTermIntgtrStArbnEna.Logl /end CHARACTERISTIC
/begin CHARACTERISTIC CalRegn01Inin00.ImcSigArbnPullCmpShoTermIntgtrStArbnLpFil.Val "MICROSAR RTE" VALUE 0x0 RTE_RL_FLOAT32_IEEE 0 NO_COMPU_METHOD -3.402823466e+38 3.402823466e+38 SYMBOL_LINK "Rte_CalprmRom_CalRegn01Inin00_DEFAULT_RTE_CALPRM_GROUP.ImcSigArbnPullCmpShoTermIntgtrStArbnLpFil_Val" 0 DISPLAY_IDENTIFIER CalRegn01Inin00.CalibrationPorts.ImcSigArbnPullCmpShoTermIntgtrStArbnLpFil.Val /end CHARACTERISTIC
/begin CHARACTERISTIC CalRegn01Inin00.ImcSigArbnSysStTmr.Val "MICROSAR RTE" VALUE 0x0 RTE_RL_FLOAT32_IEEE 0 NO_COMPU_METHOD -3.402823466e+38 3.402823466e+38 SYMBOL_LINK "Rte_CalprmRom_CalRegn01Inin00_DEFAULT_RTE_CALPRM_GROUP.ImcSigArbnSysStTmr_Val" 0 DISPLAY_IDENTIFIER CalRegn01Inin00.CalibrationPorts.ImcSigArbnSysStTmr.Val /end CHARACTERISTIC
/begin CHARACTERISTIC CalRegn01Inin00.ImcSigArbnTrakgIntgtrSt1ArbnEna.Logl "MICROSAR RTE" VALUE 0x0 RTE_RL_BOOLEAN 0 RTE_CM_BOOLEAN 0 255 SYMBOL_LINK "Rte_CalprmRom_CalRegn01Inin00_DEFAULT_RTE_CALPRM_GROUP.ImcSigArbnTrakgIntgtrSt1ArbnEna_Logl" 0 DISPLAY_IDENTIFIER CalRegn01Inin00.CalibrationPorts.ImcSigArbnTrakgIntgtrSt1ArbnEna.Logl /end CHARACTERISTIC
/begin CHARACTERISTIC CalRegn01Inin00.ImcSigArbnTrakgIntgtrSt1ArbnLpFil.Val "MICROSAR RTE" VALUE 0x0 RTE_RL_FLOAT32_IEEE 0 NO_COMPU_METHOD -3.402823466e+38 3.402823466e+38 SYMBOL_LINK "Rte_CalprmRom_CalRegn01Inin00_DEFAULT_RTE_CALPRM_GROUP.ImcSigArbnTrakgIntgtrSt1ArbnLpFil_Val" 0 DISPLAY_IDENTIFIER CalRegn01Inin00.CalibrationPorts.ImcSigArbnTrakgIntgtrSt1ArbnLpFil.Val /end CHARACTERISTIC
/begin CHARACTERISTIC CalRegn01Inin00.ImcSigArbnTrakgIntgtrSt2ArbnEna.Logl "MICROSAR RTE" VALUE 0x0 RTE_RL_BOOLEAN 0 RTE_CM_BOOLEAN 0 255 SYMBOL_LINK "Rte_CalprmRom_CalRegn01Inin00_DEFAULT_RTE_CALPRM_GROUP.ImcSigArbnTrakgIntgtrSt2ArbnEna_Logl" 0 DISPLAY_IDENTIFIER CalRegn01Inin00.CalibrationPorts.ImcSigArbnTrakgIntgtrSt2ArbnEna.Logl /end CHARACTERISTIC
/begin CHARACTERISTIC CalRegn01Inin00.ImcSigArbnTrakgIntgtrSt2ArbnLpFil.Val "MICROSAR RTE" VALUE 0x0 RTE_RL_FLOAT32_IEEE 0 NO_COMPU_METHOD -3.402823466e+38 3.402823466e+38 SYMBOL_LINK "Rte_CalprmRom_CalRegn01Inin00_DEFAULT_RTE_CALPRM_GROUP.ImcSigArbnTrakgIntgtrSt2ArbnLpFil_Val" 0 DISPLAY_IDENTIFIER CalRegn01Inin00.CalibrationPorts.ImcSigArbnTrakgIntgtrSt2ArbnLpFil.Val /end CHARACTERISTIC
/begin CHARACTERISTIC CalRegn01Inin00.ImcSigArbnVehSpdArbnEna.Logl "MICROSAR RTE" VALUE 0x0 RTE_RL_BOOLEAN 0 RTE_CM_BOOLEAN 0 255 SYMBOL_LINK "Rte_CalprmRom_CalRegn01Inin00_DEFAULT_RTE_CALPRM_GROUP.ImcSigArbnVehSpdArbnEna_Logl" 0 DISPLAY_IDENTIFIER CalRegn01Inin00.CalibrationPorts.ImcSigArbnVehSpdArbnEna.Logl /end CHARACTERISTIC
/begin CHARACTERISTIC CalRegn01Inin00.ImcSigArbnVehSpdArbnLpFil.Val "MICROSAR RTE" VALUE 0x0 RTE_RL_FLOAT32_IEEE 0 NO_COMPU_METHOD -3.402823466e+38 3.402823466e+38 SYMBOL_LINK "Rte_CalprmRom_CalRegn01Inin00_DEFAULT_RTE_CALPRM_GROUP.ImcSigArbnVehSpdArbnLpFil_Val" 0 DISPLAY_IDENTIFIER CalRegn01Inin00.CalibrationPorts.ImcSigArbnVehSpdArbnLpFil.Val /end CHARACTERISTIC
/begin CHARACTERISTIC CalRegn01Inin00.ImcSigArbnVehSpdArbnOffsLim.Val "MICROSAR RTE" VALUE 0x0 RTE_RL_FLOAT32_IEEE 0 NO_COMPU_METHOD -3.402823466e+38 3.402823466e+38 SYMBOL_LINK "Rte_CalprmRom_CalRegn01Inin00_DEFAULT_RTE_CALPRM_GROUP.ImcSigArbnVehSpdArbnOffsLim_Val" 0 DISPLAY_IDENTIFIER CalRegn01Inin00.CalibrationPorts.ImcSigArbnVehSpdArbnOffsLim.Val /end CHARACTERISTIC
/begin CHARACTERISTIC CalRegn01Inin00.LimrCdngGainDecSlew.Val "MICROSAR RTE" VALUE 0x0 RTE_RL_FLOAT32_IEEE 0 NO_COMPU_METHOD -3.402823466e+38 3.402823466e+38 SYMBOL_LINK "Rte_CalprmRom_CalRegn01Inin00_DEFAULT_RTE_CALPRM_GROUP.LimrCdngGainDecSlew_Val" 0 DISPLAY_IDENTIFIER CalRegn01Inin00.CalibrationPorts.LimrCdngGainDecSlew.Val /end CHARACTERISTIC
/begin CHARACTERISTIC CalRegn01Inin00.LimrCdngGainIncSlewX.Ary1D "MICROSAR RTE" VAL_BLK 0x0 RTE_RL_UWORD 0 NO_COMPU_METHOD 0 65535 MATRIX_DIM 2 1 1 SYMBOL_LINK "Rte_CalprmRom_CalRegn01Inin00_DEFAULT_RTE_CALPRM_GROUP.LimrCdngGainIncSlewX_Ary1D" 0 DISPLAY_IDENTIFIER CalRegn01Inin00.CalibrationPorts.LimrCdngGainIncSlewX.Ary1D /end CHARACTERISTIC
/begin CHARACTERISTIC CalRegn01Inin00.LimrCdngGainIncSlewY.Ary1D "MICROSAR RTE" VAL_BLK 0x0 RTE_RL_UWORD 0 NO_COMPU_METHOD 0 65535 MATRIX_DIM 2 1 1 SYMBOL_LINK "Rte_CalprmRom_CalRegn01Inin00_DEFAULT_RTE_CALPRM_GROUP.LimrCdngGainIncSlewY_Ary1D" 0 DISPLAY_IDENTIFIER CalRegn01Inin00.CalibrationPorts.LimrCdngGainIncSlewY.Ary1D /end CHARACTERISTIC
/begin CHARACTERISTIC CalRegn01Inin00.LimrCdngTqDecSlew.Val "MICROSAR RTE" VALUE 0x0 RTE_RL_FLOAT32_IEEE 0 NO_COMPU_METHOD -3.402823466e+38 3.402823466e+38 SYMBOL_LINK "Rte_CalprmRom_CalRegn01Inin00_DEFAULT_RTE_CALPRM_GROUP.LimrCdngTqDecSlew_Val" 0 DISPLAY_IDENTIFIER CalRegn01Inin00.CalibrationPorts.LimrCdngTqDecSlew.Val /end CHARACTERISTIC
/begin CHARACTERISTIC CalRegn01Inin00.LimrCdngTqIncSlewX.Ary1D "MICROSAR RTE" VAL_BLK 0x0 RTE_RL_UWORD 0 NO_COMPU_METHOD 0 65535 MATRIX_DIM 2 1 1 SYMBOL_LINK "Rte_CalprmRom_CalRegn01Inin00_DEFAULT_RTE_CALPRM_GROUP.LimrCdngTqIncSlewX_Ary1D" 0 DISPLAY_IDENTIFIER CalRegn01Inin00.CalibrationPorts.LimrCdngTqIncSlewX.Ary1D /end CHARACTERISTIC
/begin CHARACTERISTIC CalRegn01Inin00.LimrCdngTqIncSlewY.Ary1D "MICROSAR RTE" VAL_BLK 0x0 RTE_RL_UWORD 0 NO_COMPU_METHOD 0 65535 MATRIX_DIM 2 1 1 SYMBOL_LINK "Rte_CalprmRom_CalRegn01Inin00_DEFAULT_RTE_CALPRM_GROUP.LimrCdngTqIncSlewY_Ary1D" 0 DISPLAY_IDENTIFIER CalRegn01Inin00.CalibrationPorts.LimrCdngTqIncSlewY.Ary1D /end CHARACTERISTIC
/begin CHARACTERISTIC CalRegn01Inin00.McuDiagc2MilliSecCntrCompThd.Val "MICROSAR RTE" VALUE 0x0 RTE_RL_UWORD 0 NO_COMPU_METHOD 0 65535 SYMBOL_LINK "Rte_CalprmRom_CalRegn01Inin00_DEFAULT_RTE_CALPRM_GROUP.McuDiagc2MilliSecCntrCompThd_Val" 0 DISPLAY_IDENTIFIER CalRegn01Inin00.CalibrationPorts.McuDiagc2MilliSecCntrCompThd.Val /end CHARACTERISTIC
/begin CHARACTERISTIC CalRegn01Inin00.McuDiagcFltFailStep.Val "MICROSAR RTE" VALUE 0x0 RTE_RL_UWORD 0 NO_COMPU_METHOD 0 65535 SYMBOL_LINK "Rte_CalprmRom_CalRegn01Inin00_DEFAULT_RTE_CALPRM_GROUP.McuDiagcFltFailStep_Val" 0 DISPLAY_IDENTIFIER CalRegn01Inin00.CalibrationPorts.McuDiagcFltFailStep.Val /end CHARACTERISTIC
/begin CHARACTERISTIC CalRegn01Inin00.McuDiagcFltPassStep.Val "MICROSAR RTE" VALUE 0x0 RTE_RL_UWORD 0 NO_COMPU_METHOD 0 65535 SYMBOL_LINK "Rte_CalprmRom_CalRegn01Inin00_DEFAULT_RTE_CALPRM_GROUP.McuDiagcFltPassStep_Val" 0 DISPLAY_IDENTIFIER CalRegn01Inin00.CalibrationPorts.McuDiagcFltPassStep.Val /end CHARACTERISTIC
/begin CHARACTERISTIC CalRegn01Inin00.MotTqCmdScaMax.Val "MICROSAR RTE" VALUE 0x0 RTE_RL_FLOAT32_IEEE 0 NO_COMPU_METHOD -3.402823466e+38 3.402823466e+38 SYMBOL_LINK "Rte_CalprmRom_CalRegn01Inin00_DEFAULT_RTE_CALPRM_GROUP.MotTqCmdScaMax_Val" 0 DISPLAY_IDENTIFIER CalRegn01Inin00.CalibrationPorts.MotTqCmdScaMax.Val /end CHARACTERISTIC
/begin CHARACTERISTIC CalRegn01Inin00.MotTqCmdScaMin.Val "MICROSAR RTE" VALUE 0x0 RTE_RL_FLOAT32_IEEE 0 NO_COMPU_METHOD -3.402823466e+38 3.402823466e+38 SYMBOL_LINK "Rte_CalprmRom_CalRegn01Inin00_DEFAULT_RTE_CALPRM_GROUP.MotTqCmdScaMin_Val" 0 DISPLAY_IDENTIFIER CalRegn01Inin00.CalibrationPorts.MotTqCmdScaMin.Val /end CHARACTERISTIC
/begin CHARACTERISTIC CalRegn01Inin00.MotTqTranlDampgCmdLim.Val "MICROSAR RTE" VALUE 0x0 RTE_RL_FLOAT32_IEEE 0 NO_COMPU_METHOD -3.402823466e+38 3.402823466e+38 SYMBOL_LINK "Rte_CalprmRom_CalRegn01Inin00_DEFAULT_RTE_CALPRM_GROUP.MotTqTranlDampgCmdLim_Val" 0 DISPLAY_IDENTIFIER CalRegn01Inin00.CalibrationPorts.MotTqTranlDampgCmdLim.Val /end CHARACTERISTIC
/begin CHARACTERISTIC CalRegn01Inin00.MotTqTranlDampgDampgCoeff.Val "MICROSAR RTE" VALUE 0x0 RTE_RL_FLOAT32_IEEE 0 NO_COMPU_METHOD -3.402823466e+38 3.402823466e+38 SYMBOL_LINK "Rte_CalprmRom_CalRegn01Inin00_DEFAULT_RTE_CALPRM_GROUP.MotTqTranlDampgDampgCoeff_Val" 0 DISPLAY_IDENTIFIER CalRegn01Inin00.CalibrationPorts.MotTqTranlDampgDampgCoeff.Val /end CHARACTERISTIC
/begin CHARACTERISTIC CalRegn01Inin00.MotTqTranlDampgRampEnd.Val "MICROSAR RTE" VALUE 0x0 RTE_RL_UWORD 0 NO_COMPU_METHOD 0 65535 SYMBOL_LINK "Rte_CalprmRom_CalRegn01Inin00_DEFAULT_RTE_CALPRM_GROUP.MotTqTranlDampgRampEnd_Val" 0 DISPLAY_IDENTIFIER CalRegn01Inin00.CalibrationPorts.MotTqTranlDampgRampEnd.Val /end CHARACTERISTIC
/begin CHARACTERISTIC CalRegn01Inin00.MotTqTranlDampgTmrPt1.Val "MICROSAR RTE" VALUE 0x0 RTE_RL_FLOAT32_IEEE 0 NO_COMPU_METHOD -3.402823466e+38 3.402823466e+38 SYMBOL_LINK "Rte_CalprmRom_CalRegn01Inin00_DEFAULT_RTE_CALPRM_GROUP.MotTqTranlDampgTmrPt1_Val" 0 DISPLAY_IDENTIFIER CalRegn01Inin00.CalibrationPorts.MotTqTranlDampgTmrPt1.Val /end CHARACTERISTIC
/begin CHARACTERISTIC CalRegn01Inin00.MotTqTranlDampgTmrPt2.Val "MICROSAR RTE" VALUE 0x0 RTE_RL_FLOAT32_IEEE 0 NO_COMPU_METHOD -3.402823466e+38 3.402823466e+38 SYMBOL_LINK "Rte_CalprmRom_CalRegn01Inin00_DEFAULT_RTE_CALPRM_GROUP.MotTqTranlDampgTmrPt2_Val" 0 DISPLAY_IDENTIFIER CalRegn01Inin00.CalibrationPorts.MotTqTranlDampgTmrPt2.Val /end CHARACTERISTIC
/begin CHARACTERISTIC CalRegn01Inin00.MotTqTranlDampgVehSpdBlndX.Ary1D "MICROSAR RTE" VAL_BLK 0x0 RTE_RL_UWORD 0 NO_COMPU_METHOD 0 65535 MATRIX_DIM 4 1 1 SYMBOL_LINK "Rte_CalprmRom_CalRegn01Inin00_DEFAULT_RTE_CALPRM_GROUP.MotTqTranlDampgVehSpdBlndX_Ary1D" 0 DISPLAY_IDENTIFIER CalRegn01Inin00.CalibrationPorts.MotTqTranlDampgVehSpdBlndX.Ary1D /end CHARACTERISTIC
/begin CHARACTERISTIC CalRegn01Inin00.MotTqTranlDampgVelThd.Val "MICROSAR RTE" VALUE 0x0 RTE_RL_FLOAT32_IEEE 0 NO_COMPU_METHOD -3.402823466e+38 3.402823466e+38 SYMBOL_LINK "Rte_CalprmRom_CalRegn01Inin00_DEFAULT_RTE_CALPRM_GROUP.MotTqTranlDampgVelThd_Val" 0 DISPLAY_IDENTIFIER CalRegn01Inin00.CalibrationPorts.MotTqTranlDampgVelThd.Val /end CHARACTERISTIC
/begin CHARACTERISTIC CalRegn01Inin00.PwrDiscnctBattVltgExtdNormThd.Val "MICROSAR RTE" VALUE 0x0 RTE_RL_FLOAT32_IEEE 0 NO_COMPU_METHOD -3.402823466e+38 3.402823466e+38 SYMBOL_LINK "Rte_CalprmRom_CalRegn01Inin00_DEFAULT_RTE_CALPRM_GROUP.PwrDiscnctBattVltgExtdNormThd_Val" 0 DISPLAY_IDENTIFIER CalRegn01Inin00.CalibrationPorts.PwrDiscnctBattVltgExtdNormThd.Val /end CHARACTERISTIC
/begin CHARACTERISTIC CalRegn01Inin00.PwrDiscnctBattVltgNonExtdThd.Val "MICROSAR RTE" VALUE 0x0 RTE_RL_FLOAT32_IEEE 0 NO_COMPU_METHOD -3.402823466e+38 3.402823466e+38 SYMBOL_LINK "Rte_CalprmRom_CalRegn01Inin00_DEFAULT_RTE_CALPRM_GROUP.PwrDiscnctBattVltgNonExtdThd_Val" 0 DISPLAY_IDENTIFIER CalRegn01Inin00.CalibrationPorts.PwrDiscnctBattVltgNonExtdThd.Val /end CHARACTERISTIC
/begin CHARACTERISTIC CalRegn01Inin00.PwrDiscnctChrgMinDeltaExtOper.Val "MICROSAR RTE" VALUE 0x0 RTE_RL_FLOAT32_IEEE 0 NO_COMPU_METHOD -3.402823466e+38 3.402823466e+38 SYMBOL_LINK "Rte_CalprmRom_CalRegn01Inin00_DEFAULT_RTE_CALPRM_GROUP.PwrDiscnctChrgMinDeltaExtOper_Val" 0 DISPLAY_IDENTIFIER CalRegn01Inin00.CalibrationPorts.PwrDiscnctChrgMinDeltaExtOper.Val /end CHARACTERISTIC
/begin CHARACTERISTIC CalRegn01Inin00.PwrDiscnctChrgMinDeltaNonOper.Val "MICROSAR RTE" VALUE 0x0 RTE_RL_FLOAT32_IEEE 0 NO_COMPU_METHOD -3.402823466e+38 3.402823466e+38 SYMBOL_LINK "Rte_CalprmRom_CalRegn01Inin00_DEFAULT_RTE_CALPRM_GROUP.PwrDiscnctChrgMinDeltaNonOper_Val" 0 DISPLAY_IDENTIFIER CalRegn01Inin00.CalibrationPorts.PwrDiscnctChrgMinDeltaNonOper.Val /end CHARACTERISTIC
/begin CHARACTERISTIC CalRegn01Inin00.PwrDiscnctChrgMinDeltaNormOper.Val "MICROSAR RTE" VALUE 0x0 RTE_RL_FLOAT32_IEEE 0 NO_COMPU_METHOD -3.402823466e+38 3.402823466e+38 SYMBOL_LINK "Rte_CalprmRom_CalRegn01Inin00_DEFAULT_RTE_CALPRM_GROUP.PwrDiscnctChrgMinDeltaNormOper_Val" 0 DISPLAY_IDENTIFIER CalRegn01Inin00.CalibrationPorts.PwrDiscnctChrgMinDeltaNormOper.Val /end CHARACTERISTIC
/begin CHARACTERISTIC CalRegn01Inin00.PwrDiscnctChrgPmpDiagOpenThd.Val "MICROSAR RTE" VALUE 0x0 RTE_RL_FLOAT32_IEEE 0 NO_COMPU_METHOD -3.402823466e+38 3.402823466e+38 SYMBOL_LINK "Rte_CalprmRom_CalRegn01Inin00_DEFAULT_RTE_CALPRM_GROUP.PwrDiscnctChrgPmpDiagOpenThd_Val" 0 DISPLAY_IDENTIFIER CalRegn01Inin00.CalibrationPorts.PwrDiscnctChrgPmpDiagOpenThd.Val /end CHARACTERISTIC
/begin CHARACTERISTIC CalRegn01Inin00.PwrDiscnctDeltaSwtClsThd.Val "MICROSAR RTE" VALUE 0x0 RTE_RL_FLOAT32_IEEE 0 NO_COMPU_METHOD -3.402823466e+38 3.402823466e+38 SYMBOL_LINK "Rte_CalprmRom_CalRegn01Inin00_DEFAULT_RTE_CALPRM_GROUP.PwrDiscnctDeltaSwtClsThd_Val" 0 DISPLAY_IDENTIFIER CalRegn01Inin00.CalibrationPorts.PwrDiscnctDeltaSwtClsThd.Val /end CHARACTERISTIC
/begin CHARACTERISTIC CalRegn01Inin00.PwrDiscnctDeltaVltgClsThd.Val "MICROSAR RTE" VALUE 0x0 RTE_RL_FLOAT32_IEEE 0 NO_COMPU_METHOD -3.402823466e+38 3.402823466e+38 SYMBOL_LINK "Rte_CalprmRom_CalRegn01Inin00_DEFAULT_RTE_CALPRM_GROUP.PwrDiscnctDeltaVltgClsThd_Val" 0 DISPLAY_IDENTIFIER CalRegn01Inin00.CalibrationPorts.PwrDiscnctDeltaVltgClsThd.Val /end CHARACTERISTIC
/begin CHARACTERISTIC CalRegn01Inin00.PwrDiscnctDeltaVltgOpenThd.Val "MICROSAR RTE" VALUE 0x0 RTE_RL_FLOAT32_IEEE 0 NO_COMPU_METHOD -3.402823466e+38 3.402823466e+38 SYMBOL_LINK "Rte_CalprmRom_CalRegn01Inin00_DEFAULT_RTE_CALPRM_GROUP.PwrDiscnctDeltaVltgOpenThd_Val" 0 DISPLAY_IDENTIFIER CalRegn01Inin00.CalibrationPorts.PwrDiscnctDeltaVltgOpenThd.Val /end CHARACTERISTIC
/begin CHARACTERISTIC CalRegn01Inin00.PwrDiscnctFltFailStep.Val "MICROSAR RTE" VALUE 0x0 RTE_RL_UWORD 0 NO_COMPU_METHOD 0 65535 SYMBOL_LINK "Rte_CalprmRom_CalRegn01Inin00_DEFAULT_RTE_CALPRM_GROUP.PwrDiscnctFltFailStep_Val" 0 DISPLAY_IDENTIFIER CalRegn01Inin00.CalibrationPorts.PwrDiscnctFltFailStep.Val /end CHARACTERISTIC
/begin CHARACTERISTIC CalRegn01Inin00.PwrDiscnctFltPassStep.Val "MICROSAR RTE" VALUE 0x0 RTE_RL_UWORD 0 NO_COMPU_METHOD 0 65535 SYMBOL_LINK "Rte_CalprmRom_CalRegn01Inin00_DEFAULT_RTE_CALPRM_GROUP.PwrDiscnctFltPassStep_Val" 0 DISPLAY_IDENTIFIER CalRegn01Inin00.CalibrationPorts.PwrDiscnctFltPassStep.Val /end CHARACTERISTIC
/begin CHARACTERISTIC CalRegn01Inin00.PwrDiscnctFltThd.Val "MICROSAR RTE" VALUE 0x0 RTE_RL_UWORD 0 NO_COMPU_METHOD 0 65535 SYMBOL_LINK "Rte_CalprmRom_CalRegn01Inin00_DEFAULT_RTE_CALPRM_GROUP.PwrDiscnctFltThd_Val" 0 DISPLAY_IDENTIFIER CalRegn01Inin00.CalibrationPorts.PwrDiscnctFltThd.Val /end CHARACTERISTIC
/begin CHARACTERISTIC CalRegn01Inin00.PwrDiscnctMtrMtnThd.Val "MICROSAR RTE" VALUE 0x0 RTE_RL_FLOAT32_IEEE 0 NO_COMPU_METHOD -3.402823466e+38 3.402823466e+38 SYMBOL_LINK "Rte_CalprmRom_CalRegn01Inin00_DEFAULT_RTE_CALPRM_GROUP.PwrDiscnctMtrMtnThd_Val" 0 DISPLAY_IDENTIFIER CalRegn01Inin00.CalibrationPorts.PwrDiscnctMtrMtnThd.Val /end CHARACTERISTIC
/begin CHARACTERISTIC CalRegn01Inin00.PwrDiscnctPwrDiscnctRtFltFailStep.Val "MICROSAR RTE" VALUE 0x0 RTE_RL_UWORD 0 NO_COMPU_METHOD 0 65535 SYMBOL_LINK "Rte_CalprmRom_CalRegn01Inin00_DEFAULT_RTE_CALPRM_GROUP.PwrDiscnctPwrDiscnctRtFltFailStep_Val" 0 DISPLAY_IDENTIFIER CalRegn01Inin00.CalibrationPorts.PwrDiscnctPwrDiscnctRtFltFailStep.Val /end CHARACTERISTIC
/begin CHARACTERISTIC CalRegn01Inin00.PwrDiscnctPwrDiscnctRtFltPassStep.Val "MICROSAR RTE" VALUE 0x0 RTE_RL_UWORD 0 NO_COMPU_METHOD 0 65535 SYMBOL_LINK "Rte_CalprmRom_CalRegn01Inin00_DEFAULT_RTE_CALPRM_GROUP.PwrDiscnctPwrDiscnctRtFltPassStep_Val" 0 DISPLAY_IDENTIFIER CalRegn01Inin00.CalibrationPorts.PwrDiscnctPwrDiscnctRtFltPassStep.Val /end CHARACTERISTIC
/begin CHARACTERISTIC CalRegn01Inin00.PwrDiscnctSwtDiagOpenThd.Val "MICROSAR RTE" VALUE 0x0 RTE_RL_FLOAT32_IEEE 0 NO_COMPU_METHOD -3.402823466e+38 3.402823466e+38 SYMBOL_LINK "Rte_CalprmRom_CalRegn01Inin00_DEFAULT_RTE_CALPRM_GROUP.PwrDiscnctSwtDiagOpenThd_Val" 0 DISPLAY_IDENTIFIER CalRegn01Inin00.CalibrationPorts.PwrDiscnctSwtDiagOpenThd.Val /end CHARACTERISTIC
/begin CHARACTERISTIC CalRegn01Inin00.SysFricLrngAvrgFricFrq.Val "MICROSAR RTE" VALUE 0x0 RTE_RL_FLOAT32_IEEE 0 NO_COMPU_METHOD -3.402823466e+38 3.402823466e+38 SYMBOL_LINK "Rte_CalprmRom_CalRegn01Inin00_DEFAULT_RTE_CALPRM_GROUP.SysFricLrngAvrgFricFrq_Val" 0 DISPLAY_IDENTIFIER CalRegn01Inin00.CalibrationPorts.SysFricLrngAvrgFricFrq.Val /end CHARACTERISTIC
/begin CHARACTERISTIC CalRegn01Inin00.SysFricLrngBasLineEolFric.Val "MICROSAR RTE" VALUE 0x0 RTE_RL_FLOAT32_IEEE 0 NO_COMPU_METHOD -3.402823466e+38 3.402823466e+38 SYMBOL_LINK "Rte_CalprmRom_CalRegn01Inin00_DEFAULT_RTE_CALPRM_GROUP.SysFricLrngBasLineEolFric_Val" 0 DISPLAY_IDENTIFIER CalRegn01Inin00.CalibrationPorts.SysFricLrngBasLineEolFric.Val /end CHARACTERISTIC
/begin CHARACTERISTIC CalRegn01Inin00.SysFricLrngBasLineFric.Ary1D "MICROSAR RTE" VAL_BLK 0x0 RTE_RL_FLOAT32_IEEE 0 NO_COMPU_METHOD -3.402823466e+38 3.402823466e+38 MATRIX_DIM 4 1 1 SYMBOL_LINK "Rte_CalprmRom_CalRegn01Inin00_DEFAULT_RTE_CALPRM_GROUP.SysFricLrngBasLineFric_Ary1D" 0 DISPLAY_IDENTIFIER CalRegn01Inin00.CalibrationPorts.SysFricLrngBasLineFric.Ary1D /end CHARACTERISTIC
/begin CHARACTERISTIC CalRegn01Inin00.SysFricLrngBasLineHys.Ary2D "MICROSAR RTE" VAL_BLK 0x0 RTE_RL_FLOAT32_IEEE 0 NO_COMPU_METHOD -3.402823466e+38 3.402823466e+38 MATRIX_DIM 4 8 1 SYMBOL_LINK "Rte_CalprmRom_CalRegn01Inin00_DEFAULT_RTE_CALPRM_GROUP.SysFricLrngBasLineHys_Ary2D" 0 DISPLAY_IDENTIFIER CalRegn01Inin00.CalibrationPorts.SysFricLrngBasLineHys.Ary2D /end CHARACTERISTIC
/begin CHARACTERISTIC CalRegn01Inin00.SysFricLrngBasLineRngCntr.Ary2D "MICROSAR RTE" VAL_BLK 0x0 RTE_RL_UWORD 0 NO_COMPU_METHOD 0 65535 MATRIX_DIM 3 8 1 SYMBOL_LINK "Rte_CalprmRom_CalRegn01Inin00_DEFAULT_RTE_CALPRM_GROUP.SysFricLrngBasLineRngCntr_Ary2D" 0 DISPLAY_IDENTIFIER CalRegn01Inin00.CalibrationPorts.SysFricLrngBasLineRngCntr.Ary2D /end CHARACTERISTIC
/begin CHARACTERISTIC CalRegn01Inin00.SysFricLrngDataPrepLpFilFrq.Val "MICROSAR RTE" VALUE 0x0 RTE_RL_FLOAT32_IEEE 0 NO_COMPU_METHOD -3.402823466e+38 3.402823466e+38 SYMBOL_LINK "Rte_CalprmRom_CalRegn01Inin00_DEFAULT_RTE_CALPRM_GROUP.SysFricLrngDataPrepLpFilFrq_Val" 0 DISPLAY_IDENTIFIER CalRegn01Inin00.CalibrationPorts.SysFricLrngDataPrepLpFilFrq.Val /end CHARACTERISTIC
/begin CHARACTERISTIC CalRegn01Inin00.SysFricLrngDebStep.Val "MICROSAR RTE" VALUE 0x0 RTE_RL_UWORD 0 NO_COMPU_METHOD 0 65535 SYMBOL_LINK "Rte_CalprmRom_CalRegn01Inin00_DEFAULT_RTE_CALPRM_GROUP.SysFricLrngDebStep_Val" 0 DISPLAY_IDENTIFIER CalRegn01Inin00.CalibrationPorts.SysFricLrngDebStep.Val /end CHARACTERISTIC
/begin CHARACTERISTIC CalRegn01Inin00.SysFricLrngEolFricDifHiLim.Val "MICROSAR RTE" VALUE 0x0 RTE_RL_FLOAT32_IEEE 0 NO_COMPU_METHOD -3.402823466e+38 3.402823466e+38 SYMBOL_LINK "Rte_CalprmRom_CalRegn01Inin00_DEFAULT_RTE_CALPRM_GROUP.SysFricLrngEolFricDifHiLim_Val" 0 DISPLAY_IDENTIFIER CalRegn01Inin00.CalibrationPorts.SysFricLrngEolFricDifHiLim.Val /end CHARACTERISTIC
/begin CHARACTERISTIC CalRegn01Inin00.SysFricLrngEolFricDifLoLim.Val "MICROSAR RTE" VALUE 0x0 RTE_RL_FLOAT32_IEEE 0 NO_COMPU_METHOD -3.402823466e+38 3.402823466e+38 SYMBOL_LINK "Rte_CalprmRom_CalRegn01Inin00_DEFAULT_RTE_CALPRM_GROUP.SysFricLrngEolFricDifLoLim_Val" 0 DISPLAY_IDENTIFIER CalRegn01Inin00.CalibrationPorts.SysFricLrngEolFricDifLoLim.Val /end CHARACTERISTIC
/begin CHARACTERISTIC CalRegn01Inin00.SysFricLrngEolFricDifScagFac.Val "MICROSAR RTE" VALUE 0x0 RTE_RL_FLOAT32_IEEE 0 NO_COMPU_METHOD -3.402823466e+38 3.402823466e+38 SYMBOL_LINK "Rte_CalprmRom_CalRegn01Inin00_DEFAULT_RTE_CALPRM_GROUP.SysFricLrngEolFricDifScagFac_Val" 0 DISPLAY_IDENTIFIER CalRegn01Inin00.CalibrationPorts.SysFricLrngEolFricDifScagFac.Val /end CHARACTERISTIC
/begin CHARACTERISTIC CalRegn01Inin00.SysFricLrngFricChgWght.Ary1D "MICROSAR RTE" VAL_BLK 0x0 RTE_RL_FLOAT32_IEEE 0 NO_COMPU_METHOD -3.402823466e+38 3.402823466e+38 MATRIX_DIM 4 1 1 SYMBOL_LINK "Rte_CalprmRom_CalRegn01Inin00_DEFAULT_RTE_CALPRM_GROUP.SysFricLrngFricChgWght_Ary1D" 0 DISPLAY_IDENTIFIER CalRegn01Inin00.CalibrationPorts.SysFricLrngFricChgWght.Ary1D /end CHARACTERISTIC
/begin CHARACTERISTIC CalRegn01Inin00.SysFricLrngFricDiagcThd.Val "MICROSAR RTE" VALUE 0x0 RTE_RL_FLOAT32_IEEE 0 NO_COMPU_METHOD -3.402823466e+38 3.402823466e+38 SYMBOL_LINK "Rte_CalprmRom_CalRegn01Inin00_DEFAULT_RTE_CALPRM_GROUP.SysFricLrngFricDiagcThd_Val" 0 DISPLAY_IDENTIFIER CalRegn01Inin00.CalibrationPorts.SysFricLrngFricDiagcThd.Val /end CHARACTERISTIC
/begin CHARACTERISTIC CalRegn01Inin00.SysFricLrngFricHysHwAgPt.Ary1D "MICROSAR RTE" VAL_BLK 0x0 RTE_RL_FLOAT32_IEEE 0 NO_COMPU_METHOD -3.402823466e+38 3.402823466e+38 MATRIX_DIM 4 1 1 SYMBOL_LINK "Rte_CalprmRom_CalRegn01Inin00_DEFAULT_RTE_CALPRM_GROUP.SysFricLrngFricHysHwAgPt_Ary1D" 0 DISPLAY_IDENTIFIER CalRegn01Inin00.CalibrationPorts.SysFricLrngFricHysHwAgPt.Ary1D /end CHARACTERISTIC
/begin CHARACTERISTIC CalRegn01Inin00.SysFricLrngFricOffs.Val "MICROSAR RTE" VALUE 0x0 RTE_RL_FLOAT32_IEEE 0 NO_COMPU_METHOD -3.402823466e+38 3.402823466e+38 SYMBOL_LINK "Rte_CalprmRom_CalRegn01Inin00_DEFAULT_RTE_CALPRM_GROUP.SysFricLrngFricOffs_Val" 0 DISPLAY_IDENTIFIER CalRegn01Inin00.CalibrationPorts.SysFricLrngFricOffs.Val /end CHARACTERISTIC
/begin CHARACTERISTIC CalRegn01Inin00.SysFricLrngFricOffsHiLim.Val "MICROSAR RTE" VALUE 0x0 RTE_RL_FLOAT32_IEEE 0 NO_COMPU_METHOD -3.402823466e+38 3.402823466e+38 SYMBOL_LINK "Rte_CalprmRom_CalRegn01Inin00_DEFAULT_RTE_CALPRM_GROUP.SysFricLrngFricOffsHiLim_Val" 0 DISPLAY_IDENTIFIER CalRegn01Inin00.CalibrationPorts.SysFricLrngFricOffsHiLim.Val /end CHARACTERISTIC
/begin CHARACTERISTIC CalRegn01Inin00.SysFricLrngFricOffsLoLim.Val "MICROSAR RTE" VALUE 0x0 RTE_RL_FLOAT32_IEEE 0 NO_COMPU_METHOD -3.402823466e+38 3.402823466e+38 SYMBOL_LINK "Rte_CalprmRom_CalRegn01Inin00_DEFAULT_RTE_CALPRM_GROUP.SysFricLrngFricOffsLoLim_Val" 0 DISPLAY_IDENTIFIER CalRegn01Inin00.CalibrationPorts.SysFricLrngFricOffsLoLim.Val /end CHARACTERISTIC
/begin CHARACTERISTIC CalRegn01Inin00.SysFricLrngFricOffsLpFilFrq.Val "MICROSAR RTE" VALUE 0x0 RTE_RL_FLOAT32_IEEE 0 NO_COMPU_METHOD -3.402823466e+38 3.402823466e+38 SYMBOL_LINK "Rte_CalprmRom_CalRegn01Inin00_DEFAULT_RTE_CALPRM_GROUP.SysFricLrngFricOffsLpFilFrq_Val" 0 DISPLAY_IDENTIFIER CalRegn01Inin00.CalibrationPorts.SysFricLrngFricOffsLpFilFrq.Val /end CHARACTERISTIC
/begin CHARACTERISTIC CalRegn01Inin00.SysFricLrngGain.Val "MICROSAR RTE" VALUE 0x0 RTE_RL_FLOAT32_IEEE 0 NO_COMPU_METHOD -3.402823466e+38 3.402823466e+38 SYMBOL_LINK "Rte_CalprmRom_CalRegn01Inin00_DEFAULT_RTE_CALPRM_GROUP.SysFricLrngGain_Val" 0 DISPLAY_IDENTIFIER CalRegn01Inin00.CalibrationPorts.SysFricLrngGain.Val /end CHARACTERISTIC
/begin CHARACTERISTIC CalRegn01Inin00.SysFricLrngHiFricDebStep.Val "MICROSAR RTE" VALUE 0x0 RTE_RL_UWORD 0 NO_COMPU_METHOD 0 65535 SYMBOL_LINK "Rte_CalprmRom_CalRegn01Inin00_DEFAULT_RTE_CALPRM_GROUP.SysFricLrngHiFricDebStep_Val" 0 DISPLAY_IDENTIFIER CalRegn01Inin00.CalibrationPorts.SysFricLrngHiFricDebStep.Val /end CHARACTERISTIC
/begin CHARACTERISTIC CalRegn01Inin00.SysFricLrngHiFricDiagcThd.Val "MICROSAR RTE" VALUE 0x0 RTE_RL_FLOAT32_IEEE 0 NO_COMPU_METHOD -3.402823466e+38 3.402823466e+38 SYMBOL_LINK "Rte_CalprmRom_CalRegn01Inin00_DEFAULT_RTE_CALPRM_GROUP.SysFricLrngHiFricDiagcThd_Val" 0 DISPLAY_IDENTIFIER CalRegn01Inin00.CalibrationPorts.SysFricLrngHiFricDiagcThd.Val /end CHARACTERISTIC
/begin CHARACTERISTIC CalRegn01Inin00.SysFricLrngHwPosnAuthyThd.Val "MICROSAR RTE" VALUE 0x0 RTE_RL_FLOAT32_IEEE 0 NO_COMPU_METHOD -3.402823466e+38 3.402823466e+38 SYMBOL_LINK "Rte_CalprmRom_CalRegn01Inin00_DEFAULT_RTE_CALPRM_GROUP.SysFricLrngHwPosnAuthyThd_Val" 0 DISPLAY_IDENTIFIER CalRegn01Inin00.CalibrationPorts.SysFricLrngHwPosnAuthyThd.Val /end CHARACTERISTIC
/begin CHARACTERISTIC CalRegn01Inin00.SysFricLrngHwVelConstrLim.Val "MICROSAR RTE" VALUE 0x0 RTE_RL_FLOAT32_IEEE 0 NO_COMPU_METHOD -3.402823466e+38 3.402823466e+38 SYMBOL_LINK "Rte_CalprmRom_CalRegn01Inin00_DEFAULT_RTE_CALPRM_GROUP.SysFricLrngHwVelConstrLim_Val" 0 DISPLAY_IDENTIFIER CalRegn01Inin00.CalibrationPorts.SysFricLrngHwVelConstrLim.Val /end CHARACTERISTIC
/begin CHARACTERISTIC CalRegn01Inin00.SysFricLrngHwVelHiLim.Val "MICROSAR RTE" VALUE 0x0 RTE_RL_FLOAT32_IEEE 0 NO_COMPU_METHOD -3.402823466e+38 3.402823466e+38 SYMBOL_LINK "Rte_CalprmRom_CalRegn01Inin00_DEFAULT_RTE_CALPRM_GROUP.SysFricLrngHwVelHiLim_Val" 0 DISPLAY_IDENTIFIER CalRegn01Inin00.CalibrationPorts.SysFricLrngHwVelHiLim.Val /end CHARACTERISTIC
/begin CHARACTERISTIC CalRegn01Inin00.SysFricLrngHwVelLoLim.Val "MICROSAR RTE" VALUE 0x0 RTE_RL_FLOAT32_IEEE 0 NO_COMPU_METHOD -3.402823466e+38 3.402823466e+38 SYMBOL_LINK "Rte_CalprmRom_CalRegn01Inin00_DEFAULT_RTE_CALPRM_GROUP.SysFricLrngHwVelLoLim_Val" 0 DISPLAY_IDENTIFIER CalRegn01Inin00.CalibrationPorts.SysFricLrngHwVelLoLim.Val /end CHARACTERISTIC
/begin CHARACTERISTIC CalRegn01Inin00.SysFricLrngIgnCycFricChgLim.Val "MICROSAR RTE" VALUE 0x0 RTE_RL_FLOAT32_IEEE 0 NO_COMPU_METHOD -3.402823466e+38 3.402823466e+38 SYMBOL_LINK "Rte_CalprmRom_CalRegn01Inin00_DEFAULT_RTE_CALPRM_GROUP.SysFricLrngIgnCycFricChgLim_Val" 0 DISPLAY_IDENTIFIER CalRegn01Inin00.CalibrationPorts.SysFricLrngIgnCycFricChgLim.Val /end CHARACTERISTIC
/begin CHARACTERISTIC CalRegn01Inin00.SysFricLrngIgnCycFricOffs.Val "MICROSAR RTE" VALUE 0x0 RTE_RL_FLOAT32_IEEE 0 NO_COMPU_METHOD -3.402823466e+38 3.402823466e+38 SYMBOL_LINK "Rte_CalprmRom_CalRegn01Inin00_DEFAULT_RTE_CALPRM_GROUP.SysFricLrngIgnCycFricOffs_Val" 0 DISPLAY_IDENTIFIER CalRegn01Inin00.CalibrationPorts.SysFricLrngIgnCycFricOffs.Val /end CHARACTERISTIC
/begin CHARACTERISTIC CalRegn01Inin00.SysFricLrngIvsTrsmRatX.Ary1D "MICROSAR RTE" VAL_BLK 0x0 RTE_RL_UWORD 0 NO_COMPU_METHOD 0 65535 MATRIX_DIM 10 1 1 SYMBOL_LINK "Rte_CalprmRom_CalRegn01Inin00_DEFAULT_RTE_CALPRM_GROUP.SysFricLrngIvsTrsmRatX_Ary1D" 0 DISPLAY_IDENTIFIER CalRegn01Inin00.CalibrationPorts.SysFricLrngIvsTrsmRatX.Ary1D /end CHARACTERISTIC
/begin CHARACTERISTIC CalRegn01Inin00.SysFricLrngIvsTrsmRatY.Ary1D "MICROSAR RTE" VAL_BLK 0x0 RTE_RL_UWORD 0 NO_COMPU_METHOD 0 65535 MATRIX_DIM 10 1 1 SYMBOL_LINK "Rte_CalprmRom_CalRegn01Inin00_DEFAULT_RTE_CALPRM_GROUP.SysFricLrngIvsTrsmRatY_Ary1D" 0 DISPLAY_IDENTIFIER CalRegn01Inin00.CalibrationPorts.SysFricLrngIvsTrsmRatY.Ary1D /end CHARACTERISTIC
/begin CHARACTERISTIC CalRegn01Inin00.SysFricLrngLatAHiLim.Val "MICROSAR RTE" VALUE 0x0 RTE_RL_FLOAT32_IEEE 0 NO_COMPU_METHOD -3.402823466e+38 3.402823466e+38 SYMBOL_LINK "Rte_CalprmRom_CalRegn01Inin00_DEFAULT_RTE_CALPRM_GROUP.SysFricLrngLatAHiLim_Val" 0 DISPLAY_IDENTIFIER CalRegn01Inin00.CalibrationPorts.SysFricLrngLatAHiLim.Val /end CHARACTERISTIC
/begin CHARACTERISTIC CalRegn01Inin00.SysFricLrngLatALoLim.Val "MICROSAR RTE" VALUE 0x0 RTE_RL_FLOAT32_IEEE 0 NO_COMPU_METHOD -3.402823466e+38 3.402823466e+38 SYMBOL_LINK "Rte_CalprmRom_CalRegn01Inin00_DEFAULT_RTE_CALPRM_GROUP.SysFricLrngLatALoLim_Val" 0 DISPLAY_IDENTIFIER CalRegn01Inin00.CalibrationPorts.SysFricLrngLatALoLim.Val /end CHARACTERISTIC
/begin CHARACTERISTIC CalRegn01Inin00.SysFricLrngMaskVehSpd.Ary1D "MICROSAR RTE" VAL_BLK 0x0 RTE_RL_BOOLEAN 0 RTE_CM_BOOLEAN 0 255 MATRIX_DIM 4 1 1 SYMBOL_LINK "Rte_CalprmRom_CalRegn01Inin00_DEFAULT_RTE_CALPRM_GROUP.SysFricLrngMaskVehSpd_Ary1D" 0 DISPLAY_IDENTIFIER CalRegn01Inin00.CalibrationPorts.SysFricLrngMaskVehSpd.Ary1D /end CHARACTERISTIC
/begin CHARACTERISTIC CalRegn01Inin00.SysFricLrngRngCntrThd.Val "MICROSAR RTE" VALUE 0x0 RTE_RL_UWORD 0 NO_COMPU_METHOD 0 65535 SYMBOL_LINK "Rte_CalprmRom_CalRegn01Inin00_DEFAULT_RTE_CALPRM_GROUP.SysFricLrngRngCntrThd_Val" 0 DISPLAY_IDENTIFIER CalRegn01Inin00.CalibrationPorts.SysFricLrngRngCntrThd.Val /end CHARACTERISTIC
/begin CHARACTERISTIC CalRegn01Inin00.SysFricLrngTHiLim.Val "MICROSAR RTE" VALUE 0x0 RTE_RL_FLOAT32_IEEE 0 NO_COMPU_METHOD -3.402823466e+38 3.402823466e+38 SYMBOL_LINK "Rte_CalprmRom_CalRegn01Inin00_DEFAULT_RTE_CALPRM_GROUP.SysFricLrngTHiLim_Val" 0 DISPLAY_IDENTIFIER CalRegn01Inin00.CalibrationPorts.SysFricLrngTHiLim.Val /end CHARACTERISTIC
/begin CHARACTERISTIC CalRegn01Inin00.SysFricLrngTLoLim.Val "MICROSAR RTE" VALUE 0x0 RTE_RL_FLOAT32_IEEE 0 NO_COMPU_METHOD -3.402823466e+38 3.402823466e+38 SYMBOL_LINK "Rte_CalprmRom_CalRegn01Inin00_DEFAULT_RTE_CALPRM_GROUP.SysFricLrngTLoLim_Val" 0 DISPLAY_IDENTIFIER CalRegn01Inin00.CalibrationPorts.SysFricLrngTLoLim.Val /end CHARACTERISTIC
/begin CHARACTERISTIC CalRegn01Inin00.SysFricLrngThd.Val "MICROSAR RTE" VALUE 0x0 RTE_RL_ULONG 0 NO_COMPU_METHOD 0 4294967295 SYMBOL_LINK "Rte_CalprmRom_CalRegn01Inin00_DEFAULT_RTE_CALPRM_GROUP.SysFricLrngThd_Val" 0 DISPLAY_IDENTIFIER CalRegn01Inin00.CalibrationPorts.SysFricLrngThd.Val /end CHARACTERISTIC
/begin CHARACTERISTIC CalRegn01Inin00.SysFricLrngVehSpd.Ary2D "MICROSAR RTE" VAL_BLK 0x0 RTE_RL_FLOAT32_IEEE 0 NO_COMPU_METHOD -3.402823466e+38 3.402823466e+38 MATRIX_DIM 2 4 1 SYMBOL_LINK "Rte_CalprmRom_CalRegn01Inin00_DEFAULT_RTE_CALPRM_GROUP.SysFricLrngVehSpd_Ary2D" 0 DISPLAY_IDENTIFIER CalRegn01Inin00.CalibrationPorts.SysFricLrngVehSpd.Ary2D /end CHARACTERISTIC
/begin CHARACTERISTIC CalRegn01Inin00.SysGlbPrmMotPoleCnt.Val "MICROSAR RTE" VALUE 0x0 RTE_RL_UBYTE 0 NO_COMPU_METHOD 0 255 SYMBOL_LINK "Rte_CalprmRom_CalRegn01Inin00_DEFAULT_RTE_CALPRM_GROUP.SysGlbPrmMotPoleCnt_Val" 0 DISPLAY_IDENTIFIER CalRegn01Inin00.CalibrationPorts.SysGlbPrmMotPoleCnt.Val /end CHARACTERISTIC
/begin CHARACTERISTIC CalRegn01Inin00.SysGlbPrmSysTqRat.Val "MICROSAR RTE" VALUE 0x0 RTE_RL_FLOAT32_IEEE 0 NO_COMPU_METHOD -3.402823466e+38 3.402823466e+38 SYMBOL_LINK "Rte_CalprmRom_CalRegn01Inin00_DEFAULT_RTE_CALPRM_GROUP.SysGlbPrmSysTqRat_Val" 0 DISPLAY_IDENTIFIER CalRegn01Inin00.CalibrationPorts.SysGlbPrmSysTqRat.Val /end CHARACTERISTIC
/begin CHARACTERISTIC CalRegn01Inin00.SysGlbPrmTorsBarStfn.Val "MICROSAR RTE" VALUE 0x0 RTE_RL_FLOAT32_IEEE 0 NO_COMPU_METHOD -3.402823466e+38 3.402823466e+38 SYMBOL_LINK "Rte_CalprmRom_CalRegn01Inin00_DEFAULT_RTE_CALPRM_GROUP.SysGlbPrmTorsBarStfn_Val" 0 DISPLAY_IDENTIFIER CalRegn01Inin00.CalibrationPorts.SysGlbPrmTorsBarStfn.Val /end CHARACTERISTIC
/begin CHARACTERISTIC CalRegn01Inin00.SysGlbPrmVehSpdBilnrSeln.Ary1D "MICROSAR RTE" VAL_BLK 0x0 RTE_RL_UWORD 0 NO_COMPU_METHOD 0 65535 MATRIX_DIM 12 1 1 SYMBOL_LINK "Rte_CalprmRom_CalRegn01Inin00_DEFAULT_RTE_CALPRM_GROUP.SysGlbPrmVehSpdBilnrSeln_Ary1D" 0 DISPLAY_IDENTIFIER CalRegn01Inin00.CalibrationPorts.SysGlbPrmVehSpdBilnrSeln.Ary1D /end CHARACTERISTIC
/begin CHARACTERISTIC CalRegn01Inin00.TEstimnAmbPwrMplr.Ary1D "MICROSAR RTE" VAL_BLK 0x0 RTE_RL_FLOAT32_IEEE 0 NO_COMPU_METHOD -3.402823466e+38 3.402823466e+38 MATRIX_DIM 3 1 1 SYMBOL_LINK "Rte_CalprmRom_CalRegn01Inin00_DEFAULT_RTE_CALPRM_GROUP.TEstimnAmbPwrMplr_Ary1D" 0 DISPLAY_IDENTIFIER CalRegn01Inin00.CalibrationPorts.TEstimnAmbPwrMplr.Ary1D /end CHARACTERISTIC
/begin CHARACTERISTIC CalRegn01Inin00.TEstimnAmbTSca.Ary1D "MICROSAR RTE" VAL_BLK 0x0 RTE_RL_FLOAT32_IEEE 0 NO_COMPU_METHOD -3.402823466e+38 3.402823466e+38 MATRIX_DIM 3 1 1 SYMBOL_LINK "Rte_CalprmRom_CalRegn01Inin00_DEFAULT_RTE_CALPRM_GROUP.TEstimnAmbTSca_Ary1D" 0 DISPLAY_IDENTIFIER CalRegn01Inin00.CalibrationPorts.TEstimnAmbTSca.Ary1D /end CHARACTERISTIC
/begin CHARACTERISTIC CalRegn01Inin00.TEstimnAssiMechAmbLpFilFrq.Val "MICROSAR RTE" VALUE 0x0 RTE_RL_FLOAT32_IEEE 0 NO_COMPU_METHOD -3.402823466e+38 3.402823466e+38 SYMBOL_LINK "Rte_CalprmRom_CalRegn01Inin00_DEFAULT_RTE_CALPRM_GROUP.TEstimnAssiMechAmbLpFilFrq_Val" 0 DISPLAY_IDENTIFIER CalRegn01Inin00.CalibrationPorts.TEstimnAssiMechAmbLpFilFrq.Val /end CHARACTERISTIC
/begin CHARACTERISTIC CalRegn01Inin00.TEstimnAssiMechAmbLpFilFrqDualEcuFltMtgtn.Val "MICROSAR RTE" VALUE 0x0 RTE_RL_FLOAT32_IEEE 0 NO_COMPU_METHOD -3.402823466e+38 3.402823466e+38 SYMBOL_LINK "Rte_CalprmRom_CalRegn01Inin00_DEFAULT_RTE_CALPRM_GROUP.TEstimnAssiMechAmbLpFilFrqDualEcuFltMtgtn_Val" 0 DISPLAY_IDENTIFIER CalRegn01Inin00.CalibrationPorts.TEstimnAssiMechAmbLpFilFrqDualEcuFltMtgtn.Val /end CHARACTERISTIC
/begin CHARACTERISTIC CalRegn01Inin00.TEstimnAssiMechAmbLpFilFrqFetMtgtnEna.Val "MICROSAR RTE" VALUE 0x0 RTE_RL_FLOAT32_IEEE 0 NO_COMPU_METHOD -3.402823466e+38 3.402823466e+38 SYMBOL_LINK "Rte_CalprmRom_CalRegn01Inin00_DEFAULT_RTE_CALPRM_GROUP.TEstimnAssiMechAmbLpFilFrqFetMtgtnEna_Val" 0 DISPLAY_IDENTIFIER CalRegn01Inin00.CalibrationPorts.TEstimnAssiMechAmbLpFilFrqFetMtgtnEna.Val /end CHARACTERISTIC
/begin CHARACTERISTIC CalRegn01Inin00.TEstimnAssiMechAmbMplr.Ary1D "MICROSAR RTE" VAL_BLK 0x0 RTE_RL_FLOAT32_IEEE 0 NO_COMPU_METHOD -3.402823466e+38 3.402823466e+38 MATRIX_DIM 3 1 1 SYMBOL_LINK "Rte_CalprmRom_CalRegn01Inin00_DEFAULT_RTE_CALPRM_GROUP.TEstimnAssiMechAmbMplr_Ary1D" 0 DISPLAY_IDENTIFIER CalRegn01Inin00.CalibrationPorts.TEstimnAssiMechAmbMplr.Ary1D /end CHARACTERISTIC
/begin CHARACTERISTIC CalRegn01Inin00.TEstimnAssiMechCorrLim.Ary1D "MICROSAR RTE" VAL_BLK 0x0 RTE_RL_FLOAT32_IEEE 0 NO_COMPU_METHOD -3.402823466e+38 3.402823466e+38 MATRIX_DIM 3 1 1 SYMBOL_LINK "Rte_CalprmRom_CalRegn01Inin00_DEFAULT_RTE_CALPRM_GROUP.TEstimnAssiMechCorrLim_Ary1D" 0 DISPLAY_IDENTIFIER CalRegn01Inin00.CalibrationPorts.TEstimnAssiMechCorrLim.Ary1D /end CHARACTERISTIC
/begin CHARACTERISTIC CalRegn01Inin00.TEstimnAssiMechDampgSca.Ary1D "MICROSAR RTE" VAL_BLK 0x0 RTE_RL_FLOAT32_IEEE 0 NO_COMPU_METHOD -3.402823466e+38 3.402823466e+38 MATRIX_DIM 3 1 1 SYMBOL_LINK "Rte_CalprmRom_CalRegn01Inin00_DEFAULT_RTE_CALPRM_GROUP.TEstimnAssiMechDampgSca_Ary1D" 0 DISPLAY_IDENTIFIER CalRegn01Inin00.CalibrationPorts.TEstimnAssiMechDampgSca.Ary1D /end CHARACTERISTIC
/begin CHARACTERISTIC CalRegn01Inin00.TEstimnAssiMechDftT.Ary1D "MICROSAR RTE" VAL_BLK 0x0 RTE_RL_FLOAT32_IEEE 0 NO_COMPU_METHOD -3.402823466e+38 3.402823466e+38 MATRIX_DIM 3 1 1 SYMBOL_LINK "Rte_CalprmRom_CalRegn01Inin00_DEFAULT_RTE_CALPRM_GROUP.TEstimnAssiMechDftT_Ary1D" 0 DISPLAY_IDENTIFIER CalRegn01Inin00.CalibrationPorts.TEstimnAssiMechDftT.Ary1D /end CHARACTERISTIC
/begin CHARACTERISTIC CalRegn01Inin00.TEstimnAssiMechLLFilCoeffA1.Ary1D "MICROSAR RTE" VAL_BLK 0x0 RTE_RL_FLOAT32_IEEE 0 NO_COMPU_METHOD -3.402823466e+38 3.402823466e+38 MATRIX_DIM 3 1 1 SYMBOL_LINK "Rte_CalprmRom_CalRegn01Inin00_DEFAULT_RTE_CALPRM_GROUP.TEstimnAssiMechLLFilCoeffA1_Ary1D" 0 DISPLAY_IDENTIFIER CalRegn01Inin00.CalibrationPorts.TEstimnAssiMechLLFilCoeffA1.Ary1D /end CHARACTERISTIC
/begin CHARACTERISTIC CalRegn01Inin00.TEstimnAssiMechLLFilCoeffB0.Ary1D "MICROSAR RTE" VAL_BLK 0x0 RTE_RL_FLOAT32_IEEE 0 NO_COMPU_METHOD -3.402823466e+38 3.402823466e+38 MATRIX_DIM 3 1 1 SYMBOL_LINK "Rte_CalprmRom_CalRegn01Inin00_DEFAULT_RTE_CALPRM_GROUP.TEstimnAssiMechLLFilCoeffB0_Ary1D" 0 DISPLAY_IDENTIFIER CalRegn01Inin00.CalibrationPorts.TEstimnAssiMechLLFilCoeffB0.Ary1D /end CHARACTERISTIC
/begin CHARACTERISTIC CalRegn01Inin00.TEstimnAssiMechLLFilCoeffB1.Ary1D "MICROSAR RTE" VAL_BLK 0x0 RTE_RL_FLOAT32_IEEE 0 NO_COMPU_METHOD -3.402823466e+38 3.402823466e+38 MATRIX_DIM 3 1 1 SYMBOL_LINK "Rte_CalprmRom_CalRegn01Inin00_DEFAULT_RTE_CALPRM_GROUP.TEstimnAssiMechLLFilCoeffB1_Ary1D" 0 DISPLAY_IDENTIFIER CalRegn01Inin00.CalibrationPorts.TEstimnAssiMechLLFilCoeffB1.Ary1D /end CHARACTERISTIC
/begin CHARACTERISTIC CalRegn01Inin00.TEstimnAssiMechSlew.Ary1D "MICROSAR RTE" VAL_BLK 0x0 RTE_RL_FLOAT32_IEEE 0 NO_COMPU_METHOD -3.402823466e+38 3.402823466e+38 MATRIX_DIM 3 1 1 SYMBOL_LINK "Rte_CalprmRom_CalRegn01Inin00_DEFAULT_RTE_CALPRM_GROUP.TEstimnAssiMechSlew_Ary1D" 0 DISPLAY_IDENTIFIER CalRegn01Inin00.CalibrationPorts.TEstimnAssiMechSlew.Ary1D /end CHARACTERISTIC
/begin CHARACTERISTIC CalRegn01Inin00.TEstimnCorrnTAssiMech.Ary1D "MICROSAR RTE" VAL_BLK 0x0 RTE_RL_FLOAT32_IEEE 0 NO_COMPU_METHOD -3.402823466e+38 3.402823466e+38 MATRIX_DIM 3 1 1 SYMBOL_LINK "Rte_CalprmRom_CalRegn01Inin00_DEFAULT_RTE_CALPRM_GROUP.TEstimnCorrnTAssiMech_Ary1D" 0 DISPLAY_IDENTIFIER CalRegn01Inin00.CalibrationPorts.TEstimnCorrnTAssiMech.Ary1D /end CHARACTERISTIC
/begin CHARACTERISTIC CalRegn01Inin00.TEstimnCorrnTCu.Ary1D "MICROSAR RTE" VAL_BLK 0x0 RTE_RL_FLOAT32_IEEE 0 NO_COMPU_METHOD -3.402823466e+38 3.402823466e+38 MATRIX_DIM 3 1 1 SYMBOL_LINK "Rte_CalprmRom_CalRegn01Inin00_DEFAULT_RTE_CALPRM_GROUP.TEstimnCorrnTCu_Ary1D" 0 DISPLAY_IDENTIFIER CalRegn01Inin00.CalibrationPorts.TEstimnCorrnTCu.Ary1D /end CHARACTERISTIC
/begin CHARACTERISTIC CalRegn01Inin00.TEstimnCorrnTMag.Ary1D "MICROSAR RTE" VAL_BLK 0x0 RTE_RL_FLOAT32_IEEE 0 NO_COMPU_METHOD -3.402823466e+38 3.402823466e+38 MATRIX_DIM 3 1 1 SYMBOL_LINK "Rte_CalprmRom_CalRegn01Inin00_DEFAULT_RTE_CALPRM_GROUP.TEstimnCorrnTMag_Ary1D" 0 DISPLAY_IDENTIFIER CalRegn01Inin00.CalibrationPorts.TEstimnCorrnTMag.Ary1D /end CHARACTERISTIC
/begin CHARACTERISTIC CalRegn01Inin00.TEstimnCorrnTSi.Ary1D "MICROSAR RTE" VAL_BLK 0x0 RTE_RL_FLOAT32_IEEE 0 NO_COMPU_METHOD -3.402823466e+38 3.402823466e+38 MATRIX_DIM 3 1 1 SYMBOL_LINK "Rte_CalprmRom_CalRegn01Inin00_DEFAULT_RTE_CALPRM_GROUP.TEstimnCorrnTSi_Ary1D" 0 DISPLAY_IDENTIFIER CalRegn01Inin00.CalibrationPorts.TEstimnCorrnTSi.Ary1D /end CHARACTERISTIC
/begin CHARACTERISTIC CalRegn01Inin00.TEstimnCuAmbLpFilFrq.Val "MICROSAR RTE" VALUE 0x0 RTE_RL_FLOAT32_IEEE 0 NO_COMPU_METHOD -3.402823466e+38 3.402823466e+38 SYMBOL_LINK "Rte_CalprmRom_CalRegn01Inin00_DEFAULT_RTE_CALPRM_GROUP.TEstimnCuAmbLpFilFrq_Val" 0 DISPLAY_IDENTIFIER CalRegn01Inin00.CalibrationPorts.TEstimnCuAmbLpFilFrq.Val /end CHARACTERISTIC
/begin CHARACTERISTIC CalRegn01Inin00.TEstimnCuAmbLpFilFrqDualEcuFltMtgtn.Val "MICROSAR RTE" VALUE 0x0 RTE_RL_FLOAT32_IEEE 0 NO_COMPU_METHOD -3.402823466e+38 3.402823466e+38 SYMBOL_LINK "Rte_CalprmRom_CalRegn01Inin00_DEFAULT_RTE_CALPRM_GROUP.TEstimnCuAmbLpFilFrqDualEcuFltMtgtn_Val" 0 DISPLAY_IDENTIFIER CalRegn01Inin00.CalibrationPorts.TEstimnCuAmbLpFilFrqDualEcuFltMtgtn.Val /end CHARACTERISTIC
/begin CHARACTERISTIC CalRegn01Inin00.TEstimnCuAmbLpFilFrqFetMtgtnEna.Val "MICROSAR RTE" VALUE 0x0 RTE_RL_FLOAT32_IEEE 0 NO_COMPU_METHOD -3.402823466e+38 3.402823466e+38 SYMBOL_LINK "Rte_CalprmRom_CalRegn01Inin00_DEFAULT_RTE_CALPRM_GROUP.TEstimnCuAmbLpFilFrqFetMtgtnEna_Val" 0 DISPLAY_IDENTIFIER CalRegn01Inin00.CalibrationPorts.TEstimnCuAmbLpFilFrqFetMtgtnEna.Val /end CHARACTERISTIC
/begin CHARACTERISTIC CalRegn01Inin00.TEstimnCuAmbMplr.Ary1D "MICROSAR RTE" VAL_BLK 0x0 RTE_RL_FLOAT32_IEEE 0 NO_COMPU_METHOD -3.402823466e+38 3.402823466e+38 MATRIX_DIM 3 1 1 SYMBOL_LINK "Rte_CalprmRom_CalRegn01Inin00_DEFAULT_RTE_CALPRM_GROUP.TEstimnCuAmbMplr_Ary1D" 0 DISPLAY_IDENTIFIER CalRegn01Inin00.CalibrationPorts.TEstimnCuAmbMplr.Ary1D /end CHARACTERISTIC
/begin CHARACTERISTIC CalRegn01Inin00.TEstimnCuCorrnLim.Ary1D "MICROSAR RTE" VAL_BLK 0x0 RTE_RL_FLOAT32_IEEE 0 NO_COMPU_METHOD -3.402823466e+38 3.402823466e+38 MATRIX_DIM 3 1 1 SYMBOL_LINK "Rte_CalprmRom_CalRegn01Inin00_DEFAULT_RTE_CALPRM_GROUP.TEstimnCuCorrnLim_Ary1D" 0 DISPLAY_IDENTIFIER CalRegn01Inin00.CalibrationPorts.TEstimnCuCorrnLim.Ary1D /end CHARACTERISTIC
/begin CHARACTERISTIC CalRegn01Inin00.TEstimnCuLLFilCoeffA1.Ary1D "MICROSAR RTE" VAL_BLK 0x0 RTE_RL_FLOAT32_IEEE 0 NO_COMPU_METHOD -3.402823466e+38 3.402823466e+38 MATRIX_DIM 3 1 1 SYMBOL_LINK "Rte_CalprmRom_CalRegn01Inin00_DEFAULT_RTE_CALPRM_GROUP.TEstimnCuLLFilCoeffA1_Ary1D" 0 DISPLAY_IDENTIFIER CalRegn01Inin00.CalibrationPorts.TEstimnCuLLFilCoeffA1.Ary1D /end CHARACTERISTIC
/begin CHARACTERISTIC CalRegn01Inin00.TEstimnCuLLFilCoeffB0.Ary1D "MICROSAR RTE" VAL_BLK 0x0 RTE_RL_FLOAT32_IEEE 0 NO_COMPU_METHOD -3.402823466e+38 3.402823466e+38 MATRIX_DIM 3 1 1 SYMBOL_LINK "Rte_CalprmRom_CalRegn01Inin00_DEFAULT_RTE_CALPRM_GROUP.TEstimnCuLLFilCoeffB0_Ary1D" 0 DISPLAY_IDENTIFIER CalRegn01Inin00.CalibrationPorts.TEstimnCuLLFilCoeffB0.Ary1D /end CHARACTERISTIC
/begin CHARACTERISTIC CalRegn01Inin00.TEstimnCuLLFilCoeffB1.Ary1D "MICROSAR RTE" VAL_BLK 0x0 RTE_RL_FLOAT32_IEEE 0 NO_COMPU_METHOD -3.402823466e+38 3.402823466e+38 MATRIX_DIM 3 1 1 SYMBOL_LINK "Rte_CalprmRom_CalRegn01Inin00_DEFAULT_RTE_CALPRM_GROUP.TEstimnCuLLFilCoeffB1_Ary1D" 0 DISPLAY_IDENTIFIER CalRegn01Inin00.CalibrationPorts.TEstimnCuLLFilCoeffB1.Ary1D /end CHARACTERISTIC
/begin CHARACTERISTIC CalRegn01Inin00.TEstimnEngTSca.Ary1D "MICROSAR RTE" VAL_BLK 0x0 RTE_RL_FLOAT32_IEEE 0 NO_COMPU_METHOD -3.402823466e+38 3.402823466e+38 MATRIX_DIM 3 1 1 SYMBOL_LINK "Rte_CalprmRom_CalRegn01Inin00_DEFAULT_RTE_CALPRM_GROUP.TEstimnEngTSca_Ary1D" 0 DISPLAY_IDENTIFIER CalRegn01Inin00.CalibrationPorts.TEstimnEngTSca.Ary1D /end CHARACTERISTIC
/begin CHARACTERISTIC CalRegn01Inin00.TEstimnMagAmbLpFilFrq.Val "MICROSAR RTE" VALUE 0x0 RTE_RL_FLOAT32_IEEE 0 NO_COMPU_METHOD -3.402823466e+38 3.402823466e+38 SYMBOL_LINK "Rte_CalprmRom_CalRegn01Inin00_DEFAULT_RTE_CALPRM_GROUP.TEstimnMagAmbLpFilFrq_Val" 0 DISPLAY_IDENTIFIER CalRegn01Inin00.CalibrationPorts.TEstimnMagAmbLpFilFrq.Val /end CHARACTERISTIC
/begin CHARACTERISTIC CalRegn01Inin00.TEstimnMagAmbLpFilFrqDualEcuFltMtgtn.Val "MICROSAR RTE" VALUE 0x0 RTE_RL_FLOAT32_IEEE 0 NO_COMPU_METHOD -3.402823466e+38 3.402823466e+38 SYMBOL_LINK "Rte_CalprmRom_CalRegn01Inin00_DEFAULT_RTE_CALPRM_GROUP.TEstimnMagAmbLpFilFrqDualEcuFltMtgtn_Val" 0 DISPLAY_IDENTIFIER CalRegn01Inin00.CalibrationPorts.TEstimnMagAmbLpFilFrqDualEcuFltMtgtn.Val /end CHARACTERISTIC
/begin CHARACTERISTIC CalRegn01Inin00.TEstimnMagAmbLpFilFrqFetMtgtnEna.Val "MICROSAR RTE" VALUE 0x0 RTE_RL_FLOAT32_IEEE 0 NO_COMPU_METHOD -3.402823466e+38 3.402823466e+38 SYMBOL_LINK "Rte_CalprmRom_CalRegn01Inin00_DEFAULT_RTE_CALPRM_GROUP.TEstimnMagAmbLpFilFrqFetMtgtnEna_Val" 0 DISPLAY_IDENTIFIER CalRegn01Inin00.CalibrationPorts.TEstimnMagAmbLpFilFrqFetMtgtnEna.Val /end CHARACTERISTIC
/begin CHARACTERISTIC CalRegn01Inin00.TEstimnMagCorrnLim.Ary1D "MICROSAR RTE" VAL_BLK 0x0 RTE_RL_FLOAT32_IEEE 0 NO_COMPU_METHOD -3.402823466e+38 3.402823466e+38 MATRIX_DIM 3 1 1 SYMBOL_LINK "Rte_CalprmRom_CalRegn01Inin00_DEFAULT_RTE_CALPRM_GROUP.TEstimnMagCorrnLim_Ary1D" 0 DISPLAY_IDENTIFIER CalRegn01Inin00.CalibrationPorts.TEstimnMagCorrnLim.Ary1D /end CHARACTERISTIC
/begin CHARACTERISTIC CalRegn01Inin00.TEstimnMagLLFilCoeffA1.Ary1D "MICROSAR RTE" VAL_BLK 0x0 RTE_RL_FLOAT32_IEEE 0 NO_COMPU_METHOD -3.402823466e+38 3.402823466e+38 MATRIX_DIM 3 1 1 SYMBOL_LINK "Rte_CalprmRom_CalRegn01Inin00_DEFAULT_RTE_CALPRM_GROUP.TEstimnMagLLFilCoeffA1_Ary1D" 0 DISPLAY_IDENTIFIER CalRegn01Inin00.CalibrationPorts.TEstimnMagLLFilCoeffA1.Ary1D /end CHARACTERISTIC
/begin CHARACTERISTIC CalRegn01Inin00.TEstimnMagLLFilCoeffB0.Ary1D "MICROSAR RTE" VAL_BLK 0x0 RTE_RL_FLOAT32_IEEE 0 NO_COMPU_METHOD -3.402823466e+38 3.402823466e+38 MATRIX_DIM 3 1 1 SYMBOL_LINK "Rte_CalprmRom_CalRegn01Inin00_DEFAULT_RTE_CALPRM_GROUP.TEstimnMagLLFilCoeffB0_Ary1D" 0 DISPLAY_IDENTIFIER CalRegn01Inin00.CalibrationPorts.TEstimnMagLLFilCoeffB0.Ary1D /end CHARACTERISTIC
/begin CHARACTERISTIC CalRegn01Inin00.TEstimnMagLLFilCoeffB1.Ary1D "MICROSAR RTE" VAL_BLK 0x0 RTE_RL_FLOAT32_IEEE 0 NO_COMPU_METHOD -3.402823466e+38 3.402823466e+38 MATRIX_DIM 3 1 1 SYMBOL_LINK "Rte_CalprmRom_CalRegn01Inin00_DEFAULT_RTE_CALPRM_GROUP.TEstimnMagLLFilCoeffB1_Ary1D" 0 DISPLAY_IDENTIFIER CalRegn01Inin00.CalibrationPorts.TEstimnMagLLFilCoeffB1.Ary1D /end CHARACTERISTIC
/begin CHARACTERISTIC CalRegn01Inin00.TEstimnSiAmbLpFilFrq.Val "MICROSAR RTE" VALUE 0x0 RTE_RL_FLOAT32_IEEE 0 NO_COMPU_METHOD -3.402823466e+38 3.402823466e+38 SYMBOL_LINK "Rte_CalprmRom_CalRegn01Inin00_DEFAULT_RTE_CALPRM_GROUP.TEstimnSiAmbLpFilFrq_Val" 0 DISPLAY_IDENTIFIER CalRegn01Inin00.CalibrationPorts.TEstimnSiAmbLpFilFrq.Val /end CHARACTERISTIC
/begin CHARACTERISTIC CalRegn01Inin00.TEstimnSiAmbLpFilFrqDualEcuFltMtgtn.Val "MICROSAR RTE" VALUE 0x0 RTE_RL_FLOAT32_IEEE 0 NO_COMPU_METHOD -3.402823466e+38 3.402823466e+38 SYMBOL_LINK "Rte_CalprmRom_CalRegn01Inin00_DEFAULT_RTE_CALPRM_GROUP.TEstimnSiAmbLpFilFrqDualEcuFltMtgtn_Val" 0 DISPLAY_IDENTIFIER CalRegn01Inin00.CalibrationPorts.TEstimnSiAmbLpFilFrqDualEcuFltMtgtn.Val /end CHARACTERISTIC
/begin CHARACTERISTIC CalRegn01Inin00.TEstimnSiAmbLpFilFrqFetMtgtnEna.Val "MICROSAR RTE" VALUE 0x0 RTE_RL_FLOAT32_IEEE 0 NO_COMPU_METHOD -3.402823466e+38 3.402823466e+38 SYMBOL_LINK "Rte_CalprmRom_CalRegn01Inin00_DEFAULT_RTE_CALPRM_GROUP.TEstimnSiAmbLpFilFrqFetMtgtnEna_Val" 0 DISPLAY_IDENTIFIER CalRegn01Inin00.CalibrationPorts.TEstimnSiAmbLpFilFrqFetMtgtnEna.Val /end CHARACTERISTIC
/begin CHARACTERISTIC CalRegn01Inin00.TEstimnSiAmbMplr.Ary1D "MICROSAR RTE" VAL_BLK 0x0 RTE_RL_FLOAT32_IEEE 0 NO_COMPU_METHOD -3.402823466e+38 3.402823466e+38 MATRIX_DIM 3 1 1 SYMBOL_LINK "Rte_CalprmRom_CalRegn01Inin00_DEFAULT_RTE_CALPRM_GROUP.TEstimnSiAmbMplr_Ary1D" 0 DISPLAY_IDENTIFIER CalRegn01Inin00.CalibrationPorts.TEstimnSiAmbMplr.Ary1D /end CHARACTERISTIC
/begin CHARACTERISTIC CalRegn01Inin00.TEstimnSiCorrnLim.Ary1D "MICROSAR RTE" VAL_BLK 0x0 RTE_RL_FLOAT32_IEEE 0 NO_COMPU_METHOD -3.402823466e+38 3.402823466e+38 MATRIX_DIM 3 1 1 SYMBOL_LINK "Rte_CalprmRom_CalRegn01Inin00_DEFAULT_RTE_CALPRM_GROUP.TEstimnSiCorrnLim_Ary1D" 0 DISPLAY_IDENTIFIER CalRegn01Inin00.CalibrationPorts.TEstimnSiCorrnLim.Ary1D /end CHARACTERISTIC
/begin CHARACTERISTIC CalRegn01Inin00.TEstimnSiLLFilCoeffA1.Ary1D "MICROSAR RTE" VAL_BLK 0x0 RTE_RL_FLOAT32_IEEE 0 NO_COMPU_METHOD -3.402823466e+38 3.402823466e+38 MATRIX_DIM 3 1 1 SYMBOL_LINK "Rte_CalprmRom_CalRegn01Inin00_DEFAULT_RTE_CALPRM_GROUP.TEstimnSiLLFilCoeffA1_Ary1D" 0 DISPLAY_IDENTIFIER CalRegn01Inin00.CalibrationPorts.TEstimnSiLLFilCoeffA1.Ary1D /end CHARACTERISTIC
/begin CHARACTERISTIC CalRegn01Inin00.TEstimnSiLLFilCoeffB0.Ary1D "MICROSAR RTE" VAL_BLK 0x0 RTE_RL_FLOAT32_IEEE 0 NO_COMPU_METHOD -3.402823466e+38 3.402823466e+38 MATRIX_DIM 3 1 1 SYMBOL_LINK "Rte_CalprmRom_CalRegn01Inin00_DEFAULT_RTE_CALPRM_GROUP.TEstimnSiLLFilCoeffB0_Ary1D" 0 DISPLAY_IDENTIFIER CalRegn01Inin00.CalibrationPorts.TEstimnSiLLFilCoeffB0.Ary1D /end CHARACTERISTIC
/begin CHARACTERISTIC CalRegn01Inin00.TEstimnSiLLFilCoeffB1.Ary1D "MICROSAR RTE" VAL_BLK 0x0 RTE_RL_FLOAT32_IEEE 0 NO_COMPU_METHOD -3.402823466e+38 3.402823466e+38 MATRIX_DIM 3 1 1 SYMBOL_LINK "Rte_CalprmRom_CalRegn01Inin00_DEFAULT_RTE_CALPRM_GROUP.TEstimnSiLLFilCoeffB1_Ary1D" 0 DISPLAY_IDENTIFIER CalRegn01Inin00.CalibrationPorts.TEstimnSiLLFilCoeffB1.Ary1D /end CHARACTERISTIC
/begin CHARACTERISTIC CalRegn01Inin00.TEstimnTauAssiMech.Ary1D "MICROSAR RTE" VAL_BLK 0x0 RTE_RL_FLOAT32_IEEE 0 NO_COMPU_METHOD -3.402823466e+38 3.402823466e+38 MATRIX_DIM 3 1 1 SYMBOL_LINK "Rte_CalprmRom_CalRegn01Inin00_DEFAULT_RTE_CALPRM_GROUP.TEstimnTauAssiMech_Ary1D" 0 DISPLAY_IDENTIFIER CalRegn01Inin00.CalibrationPorts.TEstimnTauAssiMech.Ary1D /end CHARACTERISTIC
/begin CHARACTERISTIC CalRegn01Inin00.TEstimnTauCu.Ary1D "MICROSAR RTE" VAL_BLK 0x0 RTE_RL_FLOAT32_IEEE 0 NO_COMPU_METHOD -3.402823466e+38 3.402823466e+38 MATRIX_DIM 3 1 1 SYMBOL_LINK "Rte_CalprmRom_CalRegn01Inin00_DEFAULT_RTE_CALPRM_GROUP.TEstimnTauCu_Ary1D" 0 DISPLAY_IDENTIFIER CalRegn01Inin00.CalibrationPorts.TEstimnTauCu.Ary1D /end CHARACTERISTIC
/begin CHARACTERISTIC CalRegn01Inin00.TEstimnTauMag.Ary1D "MICROSAR RTE" VAL_BLK 0x0 RTE_RL_FLOAT32_IEEE 0 NO_COMPU_METHOD -3.402823466e+38 3.402823466e+38 MATRIX_DIM 3 1 1 SYMBOL_LINK "Rte_CalprmRom_CalRegn01Inin00_DEFAULT_RTE_CALPRM_GROUP.TEstimnTauMag_Ary1D" 0 DISPLAY_IDENTIFIER CalRegn01Inin00.CalibrationPorts.TEstimnTauMag.Ary1D /end CHARACTERISTIC
/begin CHARACTERISTIC CalRegn01Inin00.TEstimnTauSi.Ary1D "MICROSAR RTE" VAL_BLK 0x0 RTE_RL_FLOAT32_IEEE 0 NO_COMPU_METHOD -3.402823466e+38 3.402823466e+38 MATRIX_DIM 3 1 1 SYMBOL_LINK "Rte_CalprmRom_CalRegn01Inin00_DEFAULT_RTE_CALPRM_GROUP.TEstimnTauSi_Ary1D" 0 DISPLAY_IDENTIFIER CalRegn01Inin00.CalibrationPorts.TEstimnTauSi.Ary1D /end CHARACTERISTIC
/begin CHARACTERISTIC CalRegn01Inin00.TEstimnWghtAvrgTDi.Ary1D "MICROSAR RTE" VAL_BLK 0x0 RTE_RL_BOOLEAN 0 RTE_CM_BOOLEAN 0 255 MATRIX_DIM 3 1 1 SYMBOL_LINK "Rte_CalprmRom_CalRegn01Inin00_DEFAULT_RTE_CALPRM_GROUP.TEstimnWghtAvrgTDi_Ary1D" 0 DISPLAY_IDENTIFIER CalRegn01Inin00.CalibrationPorts.TEstimnWghtAvrgTDi.Ary1D /end CHARACTERISTIC
/begin CHARACTERISTIC CalRegn01Inin00.VehSigCdngLatASlewRate.Val "MICROSAR RTE" VALUE 0x0 RTE_RL_FLOAT32_IEEE 0 NO_COMPU_METHOD -3.402823466e+38 3.402823466e+38 SYMBOL_LINK "Rte_CalprmRom_CalRegn01Inin00_DEFAULT_RTE_CALPRM_GROUP.VehSigCdngLatASlewRate_Val" 0 DISPLAY_IDENTIFIER CalRegn01Inin00.CalibrationPorts.VehSigCdngLatASlewRate.Val /end CHARACTERISTIC
/begin CHARACTERISTIC CalRegn01Inin00.VehSigCdngLtgASlewRate.Val "MICROSAR RTE" VALUE 0x0 RTE_RL_FLOAT32_IEEE 0 NO_COMPU_METHOD -3.402823466e+38 3.402823466e+38 SYMBOL_LINK "Rte_CalprmRom_CalRegn01Inin00_DEFAULT_RTE_CALPRM_GROUP.VehSigCdngLtgASlewRate_Val" 0 DISPLAY_IDENTIFIER CalRegn01Inin00.CalibrationPorts.VehSigCdngLtgASlewRate.Val /end CHARACTERISTIC
/begin CHARACTERISTIC CalRegn01Inin00GroupA.AssiPahSumHysCmpLim.Val "MICROSAR RTE" VALUE 0x0 RTE_RL_FLOAT32_IEEE 0 NO_COMPU_METHOD -3.402823466e+38 3.402823466e+38 SYMBOL_LINK "Rte_CalprmRom_CalRegn01Inin00GroupA_DEFAULT_RTE_CALPRM_GROUP.AssiPahSumHysCmpLim_Val" 0 DISPLAY_IDENTIFIER CalRegn01Inin00GroupA.CalibrationPorts.AssiPahSumHysCmpLim.Val /end CHARACTERISTIC
/begin CHARACTERISTIC CalRegn01Inin00GroupA.DampgHydBasCoeff1.Val "MICROSAR RTE" VALUE 0x0 RTE_RL_FLOAT32_IEEE 0 NO_COMPU_METHOD -3.402823466e+38 3.402823466e+38 SYMBOL_LINK "Rte_CalprmRom_CalRegn01Inin00GroupA_DEFAULT_RTE_CALPRM_GROUP.DampgHydBasCoeff1_Val" 0 DISPLAY_IDENTIFIER CalRegn01Inin00GroupA.CalibrationPorts.DampgHydBasCoeff1.Val /end CHARACTERISTIC
/begin CHARACTERISTIC CalRegn01Inin00GroupA.DampgHydBasCoeff2.Val "MICROSAR RTE" VALUE 0x0 RTE_RL_FLOAT32_IEEE 0 NO_COMPU_METHOD -3.402823466e+38 3.402823466e+38 SYMBOL_LINK "Rte_CalprmRom_CalRegn01Inin00GroupA_DEFAULT_RTE_CALPRM_GROUP.DampgHydBasCoeff2_Val" 0 DISPLAY_IDENTIFIER CalRegn01Inin00GroupA.CalibrationPorts.DampgHydBasCoeff2.Val /end CHARACTERISTIC
/begin CHARACTERISTIC CalRegn01Inin00GroupA.DampgHydBasCoeff3.Val "MICROSAR RTE" VALUE 0x0 RTE_RL_FLOAT32_IEEE 0 NO_COMPU_METHOD -3.402823466e+38 3.402823466e+38 SYMBOL_LINK "Rte_CalprmRom_CalRegn01Inin00GroupA_DEFAULT_RTE_CALPRM_GROUP.DampgHydBasCoeff3_Val" 0 DISPLAY_IDENTIFIER CalRegn01Inin00GroupA.CalibrationPorts.DampgHydBasCoeff3.Val /end CHARACTERISTIC
/begin CHARACTERISTIC CalRegn01Inin00GroupA.DampgHydBasCoeff4.Val "MICROSAR RTE" VALUE 0x0 RTE_RL_FLOAT32_IEEE 0 NO_COMPU_METHOD -3.402823466e+38 3.402823466e+38 SYMBOL_LINK "Rte_CalprmRom_CalRegn01Inin00GroupA_DEFAULT_RTE_CALPRM_GROUP.DampgHydBasCoeff4_Val" 0 DISPLAY_IDENTIFIER CalRegn01Inin00GroupA.CalibrationPorts.DampgHydBasCoeff4.Val /end CHARACTERISTIC
/begin CHARACTERISTIC CalRegn01Inin00GroupA.DampgHydOutpLim.Val "MICROSAR RTE" VALUE 0x0 RTE_RL_FLOAT32_IEEE 0 NO_COMPU_METHOD -3.402823466e+38 3.402823466e+38 SYMBOL_LINK "Rte_CalprmRom_CalRegn01Inin00GroupA_DEFAULT_RTE_CALPRM_GROUP.DampgHydOutpLim_Val" 0 DISPLAY_IDENTIFIER CalRegn01Inin00GroupA.CalibrationPorts.DampgHydOutpLim.Val /end CHARACTERISTIC
/begin CHARACTERISTIC CalRegn01Inin00GroupA.DampgMotVelLpFilFrq.Val "MICROSAR RTE" VALUE 0x0 RTE_RL_FLOAT32_IEEE 0 NO_COMPU_METHOD -3.402823466e+38 3.402823466e+38 SYMBOL_LINK "Rte_CalprmRom_CalRegn01Inin00GroupA_DEFAULT_RTE_CALPRM_GROUP.DampgMotVelLpFilFrq_Val" 0 DISPLAY_IDENTIFIER CalRegn01Inin00GroupA.CalibrationPorts.DampgMotVelLpFilFrq.Val /end CHARACTERISTIC
/begin CHARACTERISTIC CalRegn01Inin00GroupA.DampgQuad13Mplr.Val "MICROSAR RTE" VALUE 0x0 RTE_RL_FLOAT32_IEEE 0 NO_COMPU_METHOD -3.402823466e+38 3.402823466e+38 SYMBOL_LINK "Rte_CalprmRom_CalRegn01Inin00GroupA_DEFAULT_RTE_CALPRM_GROUP.DampgQuad13Mplr_Val" 0 DISPLAY_IDENTIFIER CalRegn01Inin00GroupA.CalibrationPorts.DampgQuad13Mplr.Val /end CHARACTERISTIC
/begin CHARACTERISTIC CalRegn01Inin00GroupA.DampgQuad24Mplr.Val "MICROSAR RTE" VALUE 0x0 RTE_RL_FLOAT32_IEEE 0 NO_COMPU_METHOD -3.402823466e+38 3.402823466e+38 SYMBOL_LINK "Rte_CalprmRom_CalRegn01Inin00GroupA_DEFAULT_RTE_CALPRM_GROUP.DampgQuad24Mplr_Val" 0 DISPLAY_IDENTIFIER CalRegn01Inin00GroupA.CalibrationPorts.DampgQuad24Mplr.Val /end CHARACTERISTIC
/begin CHARACTERISTIC CalRegn01Inin00GroupA.DampgQuadHwTqLpFilFrq.Val "MICROSAR RTE" VALUE 0x0 RTE_RL_FLOAT32_IEEE 0 NO_COMPU_METHOD -3.402823466e+38 3.402823466e+38 SYMBOL_LINK "Rte_CalprmRom_CalRegn01Inin00GroupA_DEFAULT_RTE_CALPRM_GROUP.DampgQuadHwTqLpFilFrq_Val" 0 DISPLAY_IDENTIFIER CalRegn01Inin00GroupA.CalibrationPorts.DampgQuadHwTqLpFilFrq.Val /end CHARACTERISTIC
/begin CHARACTERISTIC CalRegn01Inin00GroupA.DampgQuadMotVelLpFilFrq.Val "MICROSAR RTE" VALUE 0x0 RTE_RL_FLOAT32_IEEE 0 NO_COMPU_METHOD -3.402823466e+38 3.402823466e+38 SYMBOL_LINK "Rte_CalprmRom_CalRegn01Inin00GroupA_DEFAULT_RTE_CALPRM_GROUP.DampgQuadMotVelLpFilFrq_Val" 0 DISPLAY_IDENTIFIER CalRegn01Inin00GroupA.CalibrationPorts.DampgQuadMotVelLpFilFrq.Val /end CHARACTERISTIC
/begin CHARACTERISTIC CalRegn01Inin00GroupA.DampgQuadScaLpFilFrq.Val "MICROSAR RTE" VALUE 0x0 RTE_RL_FLOAT32_IEEE 0 NO_COMPU_METHOD -3.402823466e+38 3.402823466e+38 SYMBOL_LINK "Rte_CalprmRom_CalRegn01Inin00GroupA_DEFAULT_RTE_CALPRM_GROUP.DampgQuadScaLpFilFrq_Val" 0 DISPLAY_IDENTIFIER CalRegn01Inin00GroupA.CalibrationPorts.DampgQuadScaLpFilFrq.Val /end CHARACTERISTIC
/begin CHARACTERISTIC CalRegn01Inin00GroupA.DampgTScaX.Ary1D "MICROSAR RTE" VAL_BLK 0x0 RTE_RL_SWORD 0 NO_COMPU_METHOD -32768 32767 MATRIX_DIM 14 1 1 SYMBOL_LINK "Rte_CalprmRom_CalRegn01Inin00GroupA_DEFAULT_RTE_CALPRM_GROUP.DampgTScaX_Ary1D" 0 DISPLAY_IDENTIFIER CalRegn01Inin00GroupA.CalibrationPorts.DampgTScaX.Ary1D /end CHARACTERISTIC
/begin CHARACTERISTIC CalRegn01Inin00GroupA.DampgTScaY.Ary1D "MICROSAR RTE" VAL_BLK 0x0 RTE_RL_UWORD 0 NO_COMPU_METHOD 0 65535 MATRIX_DIM 14 1 1 SYMBOL_LINK "Rte_CalprmRom_CalRegn01Inin00GroupA_DEFAULT_RTE_CALPRM_GROUP.DampgTScaY_Ary1D" 0 DISPLAY_IDENTIFIER CalRegn01Inin00GroupA.CalibrationPorts.DampgTScaY.Ary1D /end CHARACTERISTIC
/begin CHARACTERISTIC CalRegn01Inin00GroupA.ImcSigArbnPullCmpLongTermArbnOffsLim.Val "MICROSAR RTE" VALUE 0x0 RTE_RL_FLOAT32_IEEE 0 NO_COMPU_METHOD -3.402823466e+38 3.402823466e+38 SYMBOL_LINK "Rte_CalprmRom_CalRegn01Inin00GroupA_DEFAULT_RTE_CALPRM_GROUP.ImcSigArbnPullCmpLongTermArbnOffsLim_Val" 0 DISPLAY_IDENTIFIER CalRegn01Inin00GroupA.CalibrationPorts.ImcSigArbnPullCmpLongTermArbnOffsLim.Val /end CHARACTERISTIC
/begin CHARACTERISTIC CalRegn01Inin00GroupA.ImcSigArbnPullCmpShoTermArbnOffsLim.Val "MICROSAR RTE" VALUE 0x0 RTE_RL_FLOAT32_IEEE 0 NO_COMPU_METHOD -3.402823466e+38 3.402823466e+38 SYMBOL_LINK "Rte_CalprmRom_CalRegn01Inin00GroupA_DEFAULT_RTE_CALPRM_GROUP.ImcSigArbnPullCmpShoTermArbnOffsLim_Val" 0 DISPLAY_IDENTIFIER CalRegn01Inin00GroupA.CalibrationPorts.ImcSigArbnPullCmpShoTermArbnOffsLim.Val /end CHARACTERISTIC
/begin CHARACTERISTIC CalRegn01Inin00GroupA.TunSelnAuthyVehSpdX.Ary1D "MICROSAR RTE" VAL_BLK 0x0 RTE_RL_UWORD 0 NO_COMPU_METHOD 0 65535 MATRIX_DIM 6 1 1 SYMBOL_LINK "Rte_CalprmRom_CalRegn01Inin00GroupA_DEFAULT_RTE_CALPRM_GROUP.TunSelnAuthyVehSpdX_Ary1D" 0 DISPLAY_IDENTIFIER CalRegn01Inin00GroupA.CalibrationPorts.TunSelnAuthyVehSpdX.Ary1D /end CHARACTERISTIC
/begin CHARACTERISTIC CalRegn01Inin00GroupB.PosnTrakgServoArbnFltMtgtnLpFilCutOffFrq.Val "MICROSAR RTE" VALUE 0x0 RTE_RL_FLOAT32_IEEE 0 NO_COMPU_METHOD -3.402823466e+38 3.402823466e+38 SYMBOL_LINK "Rte_CalprmRom_CalRegn01Inin00GroupB_DEFAULT_RTE_CALPRM_GROUP.PosnTrakgServoArbnFltMtgtnLpFilCutOffFrq_Val" 0 DISPLAY_IDENTIFIER CalRegn01Inin00GroupB.CalibrationPorts.PosnTrakgServoArbnFltMtgtnLpFilCutOffFrq.Val /end CHARACTERISTIC
/begin CHARACTERISTIC CalRegn01Inin00GroupB.PosnTrakgServoEnaBlndFacTblX.Ary1D "MICROSAR RTE" VAL_BLK 0x0 RTE_RL_UWORD 0 NO_COMPU_METHOD 0 65535 MATRIX_DIM 10 1 1 SYMBOL_LINK "Rte_CalprmRom_CalRegn01Inin00GroupB_DEFAULT_RTE_CALPRM_GROUP.PosnTrakgServoEnaBlndFacTblX_Ary1D" 0 DISPLAY_IDENTIFIER CalRegn01Inin00GroupB.CalibrationPorts.PosnTrakgServoEnaBlndFacTblX.Ary1D /end CHARACTERISTIC
/begin CHARACTERISTIC CalRegn01Inin00GroupB.PosnTrakgServoEnaBlndFacTblY.Ary1D "MICROSAR RTE" VAL_BLK 0x0 RTE_RL_UWORD 0 NO_COMPU_METHOD 0 65535 MATRIX_DIM 10 1 1 SYMBOL_LINK "Rte_CalprmRom_CalRegn01Inin00GroupB_DEFAULT_RTE_CALPRM_GROUP.PosnTrakgServoEnaBlndFacTblY_Ary1D" 0 DISPLAY_IDENTIFIER CalRegn01Inin00GroupB.CalibrationPorts.PosnTrakgServoEnaBlndFacTblY.Ary1D /end CHARACTERISTIC
/begin CHARACTERISTIC CalRegn01Inin00GroupB.PosnTrakgServoFfGain.Ary1D "MICROSAR RTE" VAL_BLK 0x0 RTE_RL_UWORD 0 NO_COMPU_METHOD 0 65535 MATRIX_DIM 12 1 1 SYMBOL_LINK "Rte_CalprmRom_CalRegn01Inin00GroupB_DEFAULT_RTE_CALPRM_GROUP.PosnTrakgServoFfGain_Ary1D" 0 DISPLAY_IDENTIFIER CalRegn01Inin00GroupB.CalibrationPorts.PosnTrakgServoFfGain.Ary1D /end CHARACTERISTIC
/begin CHARACTERISTIC CalRegn01Inin00GroupB.PosnTrakgServoFfVelGain.Ary1D "MICROSAR RTE" VAL_BLK 0x0 RTE_RL_UWORD 0 NO_COMPU_METHOD 0 65535 MATRIX_DIM 12 1 1 SYMBOL_LINK "Rte_CalprmRom_CalRegn01Inin00GroupB_DEFAULT_RTE_CALPRM_GROUP.PosnTrakgServoFfVelGain_Ary1D" 0 DISPLAY_IDENTIFIER CalRegn01Inin00GroupB.CalibrationPorts.PosnTrakgServoFfVelGain.Ary1D /end CHARACTERISTIC
/begin CHARACTERISTIC CalRegn01Inin00GroupB.PosnTrakgServoGain1.Ary1D "MICROSAR RTE" VAL_BLK 0x0 RTE_RL_UWORD 0 NO_COMPU_METHOD 0 65535 MATRIX_DIM 12 1 1 SYMBOL_LINK "Rte_CalprmRom_CalRegn01Inin00GroupB_DEFAULT_RTE_CALPRM_GROUP.PosnTrakgServoGain1_Ary1D" 0 DISPLAY_IDENTIFIER CalRegn01Inin00GroupB.CalibrationPorts.PosnTrakgServoGain1.Ary1D /end CHARACTERISTIC
/begin CHARACTERISTIC CalRegn01Inin00GroupB.PosnTrakgServoGain2.Ary1D "MICROSAR RTE" VAL_BLK 0x0 RTE_RL_UWORD 0 NO_COMPU_METHOD 0 65535 MATRIX_DIM 12 1 1 SYMBOL_LINK "Rte_CalprmRom_CalRegn01Inin00GroupB_DEFAULT_RTE_CALPRM_GROUP.PosnTrakgServoGain2_Ary1D" 0 DISPLAY_IDENTIFIER CalRegn01Inin00GroupB.CalibrationPorts.PosnTrakgServoGain2.Ary1D /end CHARACTERISTIC
/begin CHARACTERISTIC CalRegn01Inin00GroupB.PosnTrakgServoGain3.Ary1D "MICROSAR RTE" VAL_BLK 0x0 RTE_RL_SWORD 0 NO_COMPU_METHOD -32768 32767 MATRIX_DIM 12 1 1 SYMBOL_LINK "Rte_CalprmRom_CalRegn01Inin00GroupB_DEFAULT_RTE_CALPRM_GROUP.PosnTrakgServoGain3_Ary1D" 0 DISPLAY_IDENTIFIER CalRegn01Inin00GroupB.CalibrationPorts.PosnTrakgServoGain3.Ary1D /end CHARACTERISTIC
/begin CHARACTERISTIC CalRegn01Inin00GroupB.PosnTrakgServoGain4.Ary1D "MICROSAR RTE" VAL_BLK 0x0 RTE_RL_SWORD 0 NO_COMPU_METHOD -32768 32767 MATRIX_DIM 12 1 1 SYMBOL_LINK "Rte_CalprmRom_CalRegn01Inin00GroupB_DEFAULT_RTE_CALPRM_GROUP.PosnTrakgServoGain4_Ary1D" 0 DISPLAY_IDENTIFIER CalRegn01Inin00GroupB.CalibrationPorts.PosnTrakgServoGain4.Ary1D /end CHARACTERISTIC
/begin CHARACTERISTIC CalRegn01Inin00GroupB.PosnTrakgServoGainArbnFltMtgtn.Ary1D "MICROSAR RTE" VAL_BLK 0x0 RTE_RL_UWORD 0 NO_COMPU_METHOD 0 65535 MATRIX_DIM 12 1 1 SYMBOL_LINK "Rte_CalprmRom_CalRegn01Inin00GroupB_DEFAULT_RTE_CALPRM_GROUP.PosnTrakgServoGainArbnFltMtgtn_Ary1D" 0 DISPLAY_IDENTIFIER CalRegn01Inin00GroupB.CalibrationPorts.PosnTrakgServoGainArbnFltMtgtn.Ary1D /end CHARACTERISTIC
/begin CHARACTERISTIC CalRegn01Inin00GroupB.PosnTrakgServoHwAgTarMgnLimTblY.Ary1D "MICROSAR RTE" VAL_BLK 0x0 RTE_RL_UWORD 0 NO_COMPU_METHOD 0 65535 MATRIX_DIM 12 1 1 SYMBOL_LINK "Rte_CalprmRom_CalRegn01Inin00GroupB_DEFAULT_RTE_CALPRM_GROUP.PosnTrakgServoHwAgTarMgnLimTblY_Ary1D" 0 DISPLAY_IDENTIFIER CalRegn01Inin00GroupB.CalibrationPorts.PosnTrakgServoHwAgTarMgnLimTblY.Ary1D /end CHARACTERISTIC
/begin CHARACTERISTIC CalRegn01Inin00GroupB.PosnTrakgServoHwAgTarRateLimTblY.Ary1D "MICROSAR RTE" VAL_BLK 0x0 RTE_RL_UWORD 0 NO_COMPU_METHOD 0 65535 MATRIX_DIM 12 1 1 SYMBOL_LINK "Rte_CalprmRom_CalRegn01Inin00GroupB_DEFAULT_RTE_CALPRM_GROUP.PosnTrakgServoHwAgTarRateLimTblY_Ary1D" 0 DISPLAY_IDENTIFIER CalRegn01Inin00GroupB.CalibrationPorts.PosnTrakgServoHwAgTarRateLimTblY.Ary1D /end CHARACTERISTIC
/begin CHARACTERISTIC CalRegn01Inin00GroupB.PosnTrakgServoHwVelTarRateLimTblY.Ary1D "MICROSAR RTE" VAL_BLK 0x0 RTE_RL_UWORD 0 NO_COMPU_METHOD 0 65535 MATRIX_DIM 12 1 1 SYMBOL_LINK "Rte_CalprmRom_CalRegn01Inin00GroupB_DEFAULT_RTE_CALPRM_GROUP.PosnTrakgServoHwVelTarRateLimTblY_Ary1D" 0 DISPLAY_IDENTIFIER CalRegn01Inin00GroupB.CalibrationPorts.PosnTrakgServoHwVelTarRateLimTblY.Ary1D /end CHARACTERISTIC
/begin CHARACTERISTIC CalRegn01Inin00GroupB.PosnTrakgServoIntglGain.Ary1D "MICROSAR RTE" VAL_BLK 0x0 RTE_RL_UWORD 0 NO_COMPU_METHOD 0 65535 MATRIX_DIM 12 1 1 SYMBOL_LINK "Rte_CalprmRom_CalRegn01Inin00GroupB_DEFAULT_RTE_CALPRM_GROUP.PosnTrakgServoIntglGain_Ary1D" 0 DISPLAY_IDENTIFIER CalRegn01Inin00GroupB.CalibrationPorts.PosnTrakgServoIntglGain.Ary1D /end CHARACTERISTIC
/begin CHARACTERISTIC CalRegn01Inin00GroupB.PosnTrakgServoIntglLim.Ary1D "MICROSAR RTE" VAL_BLK 0x0 RTE_RL_UWORD 0 NO_COMPU_METHOD 0 65535 MATRIX_DIM 12 1 1 SYMBOL_LINK "Rte_CalprmRom_CalRegn01Inin00GroupB_DEFAULT_RTE_CALPRM_GROUP.PosnTrakgServoIntglLim_Ary1D" 0 DISPLAY_IDENTIFIER CalRegn01Inin00GroupB.CalibrationPorts.PosnTrakgServoIntglLim.Ary1D /end CHARACTERISTIC
/begin CHARACTERISTIC CalRegn01Inin00GroupB.PosnTrakgServoIntgtrAntiWdupGain.Val "MICROSAR RTE" VALUE 0x0 RTE_RL_FLOAT32_IEEE 0 NO_COMPU_METHOD -3.402823466e+38 3.402823466e+38 SYMBOL_LINK "Rte_CalprmRom_CalRegn01Inin00GroupB_DEFAULT_RTE_CALPRM_GROUP.PosnTrakgServoIntgtrAntiWdupGain_Val" 0 DISPLAY_IDENTIFIER CalRegn01Inin00GroupB.CalibrationPorts.PosnTrakgServoIntgtrAntiWdupGain.Val /end CHARACTERISTIC
/begin CHARACTERISTIC CalRegn01Inin00GroupB.PosnTrakgServoIntgtrStCorrnGain.Val "MICROSAR RTE" VALUE 0x0 RTE_RL_FLOAT32_IEEE 0 NO_COMPU_METHOD -3.402823466e+38 3.402823466e+38 SYMBOL_LINK "Rte_CalprmRom_CalRegn01Inin00GroupB_DEFAULT_RTE_CALPRM_GROUP.PosnTrakgServoIntgtrStCorrnGain_Val" 0 DISPLAY_IDENTIFIER CalRegn01Inin00GroupB.CalibrationPorts.PosnTrakgServoIntgtrStCorrnGain.Val /end CHARACTERISTIC
/begin CHARACTERISTIC CalRegn01Inin00GroupB.PosnTrakgServoLpFilCutOffFrq.Val "MICROSAR RTE" VALUE 0x0 RTE_RL_FLOAT32_IEEE 0 NO_COMPU_METHOD -3.402823466e+38 3.402823466e+38 SYMBOL_LINK "Rte_CalprmRom_CalRegn01Inin00GroupB_DEFAULT_RTE_CALPRM_GROUP.PosnTrakgServoLpFilCutOffFrq_Val" 0 DISPLAY_IDENTIFIER CalRegn01Inin00GroupB.CalibrationPorts.PosnTrakgServoLpFilCutOffFrq.Val /end CHARACTERISTIC
/begin CHARACTERISTIC CalRegn01Inin00GroupB.PosnTrakgServoOutpAntiWdupGain.Val "MICROSAR RTE" VALUE 0x0 RTE_RL_FLOAT32_IEEE 0 NO_COMPU_METHOD -3.402823466e+38 3.402823466e+38 SYMBOL_LINK "Rte_CalprmRom_CalRegn01Inin00GroupB_DEFAULT_RTE_CALPRM_GROUP.PosnTrakgServoOutpAntiWdupGain_Val" 0 DISPLAY_IDENTIFIER CalRegn01Inin00GroupB.CalibrationPorts.PosnTrakgServoOutpAntiWdupGain.Val /end CHARACTERISTIC
/begin CHARACTERISTIC CalRegn01Inin00GroupB.PosnTrakgServoOutpLim.Ary1D "MICROSAR RTE" VAL_BLK 0x0 RTE_RL_UWORD 0 NO_COMPU_METHOD 0 65535 MATRIX_DIM 12 1 1 SYMBOL_LINK "Rte_CalprmRom_CalRegn01Inin00GroupB_DEFAULT_RTE_CALPRM_GROUP.PosnTrakgServoOutpLim_Ary1D" 0 DISPLAY_IDENTIFIER CalRegn01Inin00GroupB.CalibrationPorts.PosnTrakgServoOutpLim.Ary1D /end CHARACTERISTIC
/begin CHARACTERISTIC CalRegn01Inin00GroupB.PosnTrakgServoVehSpdTbl.Ary1D "MICROSAR RTE" VAL_BLK 0x0 RTE_RL_UWORD 0 NO_COMPU_METHOD 0 65535 MATRIX_DIM 12 1 1 SYMBOL_LINK "Rte_CalprmRom_CalRegn01Inin00GroupB_DEFAULT_RTE_CALPRM_GROUP.PosnTrakgServoVehSpdTbl_Ary1D" 0 DISPLAY_IDENTIFIER CalRegn01Inin00GroupB.CalibrationPorts.PosnTrakgServoVehSpdTbl.Ary1D /end CHARACTERISTIC
/begin CHARACTERISTIC CalRegn01Inin00GroupD.StabyCmpAssiScaBlndX.Ary1D "MICROSAR RTE" VAL_BLK 0x0 RTE_RL_UWORD 0 NO_COMPU_METHOD 0 65535 MATRIX_DIM 2 1 1 SYMBOL_LINK "Rte_CalprmRom_CalRegn01Inin00GroupD_DEFAULT_RTE_CALPRM_GROUP.StabyCmpAssiScaBlndX_Ary1D" 0 DISPLAY_IDENTIFIER CalRegn01Inin00GroupD.CalibrationPorts.StabyCmpAssiScaBlndX.Ary1D /end CHARACTERISTIC
/begin CHARACTERISTIC CalRegn01Inin00GroupD.StabyCmpAssiScaBlndY.Ary1D "MICROSAR RTE" VAL_BLK 0x0 RTE_RL_UWORD 0 NO_COMPU_METHOD 0 65535 MATRIX_DIM 2 1 1 SYMBOL_LINK "Rte_CalprmRom_CalRegn01Inin00GroupD_DEFAULT_RTE_CALPRM_GROUP.StabyCmpAssiScaBlndY_Ary1D" 0 DISPLAY_IDENTIFIER CalRegn01Inin00GroupD.CalibrationPorts.StabyCmpAssiScaBlndY.Ary1D /end CHARACTERISTIC
/begin CHARACTERISTIC CalRegn01Inin00GroupD.StabyCmpHwTqLpFilFrq.Val "MICROSAR RTE" VALUE 0x0 RTE_RL_FLOAT32_IEEE 0 NO_COMPU_METHOD -3.402823466e+38 3.402823466e+38 SYMBOL_LINK "Rte_CalprmRom_CalRegn01Inin00GroupD_DEFAULT_RTE_CALPRM_GROUP.StabyCmpHwTqLpFilFrq_Val" 0 DISPLAY_IDENTIFIER CalRegn01Inin00GroupD.CalibrationPorts.StabyCmpHwTqLpFilFrq.Val /end CHARACTERISTIC
/begin GROUP CalRegn01Cmn.VehSigCdngDftYawRate.Val "MICROSAR RTE" /begin SUB_GROUP /end SUB_GROUP /begin FUNCTION_LIST /end FUNCTION_LIST /begin REF_CHARACTERISTIC CalRegn01Cmn.VehSigCdngDftYawRate.Val /end REF_CHARACTERISTIC /begin REF_MEASUREMENT /end REF_MEASUREMENT /end GROUP
/begin GROUP CalRegn01Cmn.VehSigCdngLatADifThd.Val "MICROSAR RTE" /begin SUB_GROUP /end SUB_GROUP /begin FUNCTION_LIST /end FUNCTION_LIST /begin REF_CHARACTERISTIC CalRegn01Cmn.VehSigCdngLatADifThd.Val /end REF_CHARACTERISTIC /begin REF_MEASUREMENT /end REF_MEASUREMENT /end GROUP
/begin GROUP CalRegn01Cmn.VehSigCdngLatAFilFrq.Val "MICROSAR RTE" /begin SUB_GROUP /end SUB_GROUP /begin FUNCTION_LIST /end FUNCTION_LIST /begin REF_CHARACTERISTIC CalRegn01Cmn.VehSigCdngLatAFilFrq.Val /end REF_CHARACTERISTIC /begin REF_MEASUREMENT /end REF_MEASUREMENT /end GROUP
/begin GROUP CalRegn01Cmn.VehSigCdngLtgADifThd.Val "MICROSAR RTE" /begin SUB_GROUP /end SUB_GROUP /begin FUNCTION_LIST /end FUNCTION_LIST /begin REF_CHARACTERISTIC CalRegn01Cmn.VehSigCdngLtgADifThd.Val /end REF_CHARACTERISTIC /begin REF_MEASUREMENT /end REF_MEASUREMENT /end GROUP
/begin GROUP CalRegn01Cmn.VehSigCdngVehSpdDifThd.Val "MICROSAR RTE" /begin SUB_GROUP /end SUB_GROUP /begin FUNCTION_LIST /end FUNCTION_LIST /begin REF_CHARACTERISTIC CalRegn01Cmn.VehSigCdngVehSpdDifThd.Val /end REF_CHARACTERISTIC /begin REF_MEASUREMENT /end REF_MEASUREMENT /end GROUP
/begin GROUP CalRegn01Cmn.VehSigCdngVehYawSlewRate.Val "MICROSAR RTE" /begin SUB_GROUP /end SUB_GROUP /begin FUNCTION_LIST /end FUNCTION_LIST /begin REF_CHARACTERISTIC CalRegn01Cmn.VehSigCdngVehYawSlewRate.Val /end REF_CHARACTERISTIC /begin REF_MEASUREMENT /end REF_MEASUREMENT /end GROUP
/begin GROUP CalRegn01Cmn.VehSigCdngYawRateDifThd.Val "MICROSAR RTE" /begin SUB_GROUP /end SUB_GROUP /begin FUNCTION_LIST /end FUNCTION_LIST /begin REF_CHARACTERISTIC CalRegn01Cmn.VehSigCdngYawRateDifThd.Val /end REF_CHARACTERISTIC /begin REF_MEASUREMENT /end REF_MEASUREMENT /end GROUP
/begin GROUP CalRegn01Cmn.VehSpdLimrMaxAssiX.Ary1D "MICROSAR RTE" /begin SUB_GROUP /end SUB_GROUP /begin FUNCTION_LIST /end FUNCTION_LIST /begin REF_CHARACTERISTIC CalRegn01Cmn.VehSpdLimrMaxAssiX.Ary1D /end REF_CHARACTERISTIC /begin REF_MEASUREMENT /end REF_MEASUREMENT /end GROUP
/begin GROUP CalRegn01Cmn.VehSpdLimrMaxAssiY.Ary1D "MICROSAR RTE" /begin SUB_GROUP /end SUB_GROUP /begin FUNCTION_LIST /end FUNCTION_LIST /begin REF_CHARACTERISTIC CalRegn01Cmn.VehSpdLimrMaxAssiY.Ary1D /end REF_CHARACTERISTIC /begin REF_MEASUREMENT /end REF_MEASUREMENT /end GROUP
/begin GROUP CalRegn01Cmn.VehSpdLimrPosMaxOffs1.Val "MICROSAR RTE" /begin SUB_GROUP /end SUB_GROUP /begin FUNCTION_LIST /end FUNCTION_LIST /begin REF_CHARACTERISTIC CalRegn01Cmn.VehSpdLimrPosMaxOffs1.Val /end REF_CHARACTERISTIC /begin REF_MEASUREMENT /end REF_MEASUREMENT /end GROUP
/begin GROUP CalRegn01Cmn.VehSpdLimrPosMaxOffs2.Val "MICROSAR RTE" /begin SUB_GROUP /end SUB_GROUP /begin FUNCTION_LIST /end FUNCTION_LIST /begin REF_CHARACTERISTIC CalRegn01Cmn.VehSpdLimrPosMaxOffs2.Val /end REF_CHARACTERISTIC /begin REF_MEASUREMENT /end REF_MEASUREMENT /end GROUP
/begin GROUP CalRegn01CmnGroupA "MICROSAR RTE" /begin SUB_GROUP CalRegn01CmnGroupA.CalibrationPorts /end SUB_GROUP /begin FUNCTION_LIST /end FUNCTION_LIST /begin REF_CHARACTERISTIC /end REF_CHARACTERISTIC /begin REF_MEASUREMENT /end REF_MEASUREMENT /end GROUP
/begin GROUP CalRegn01CmnGroupA.CalibrationPorts "MICROSAR RTE"
 /begin SUB_GROUP CalRegn01CmnGroupA.DampgQuadHwTqBacklsh.Val CalRegn01CmnGroupA.DampgQuadMotVelBacklsh.Val CalRegn01CmnGroupA.ElecPwrCnsPrstcPwrLoss.Val CalRegn01CmnGroupA.TunSelnAuthyHwTqY.Ary1D CalRegn01CmnGroupA.TunSelnAuthyHwVelY.Ary1D CalRegn01CmnGroupA.TunSelnAuthyTunSelnRtDiCmd.Logl /end SUB_GROUP
 /begin FUNCTION_LIST /end FUNCTION_LIST
 /begin REF_CHARACTERISTIC /end REF_CHARACTERISTIC
 /begin REF_MEASUREMENT /end REF_MEASUREMENT
/end GROUP
/begin GROUP CalRegn01CmnGroupA.DampgQuadHwTqBacklsh.Val "MICROSAR RTE" /begin SUB_GROUP /end SUB_GROUP /begin FUNCTION_LIST /end FUNCTION_LIST /begin REF_CHARACTERISTIC CalRegn01CmnGroupA.DampgQuadHwTqBacklsh.Val /end REF_CHARACTERISTIC /begin REF_MEASUREMENT /end REF_MEASUREMENT /end GROUP
/begin GROUP CalRegn01CmnGroupA.DampgQuadMotVelBacklsh.Val "MICROSAR RTE" /begin SUB_GROUP /end SUB_GROUP /begin FUNCTION_LIST /end FUNCTION_LIST /begin REF_CHARACTERISTIC CalRegn01CmnGroupA.DampgQuadMotVelBacklsh.Val /end REF_CHARACTERISTIC /begin REF_MEASUREMENT /end REF_MEASUREMENT /end GROUP
/begin GROUP CalRegn01CmnGroupA.ElecPwrCnsPrstcPwrLoss.Val "MICROSAR RTE" /begin SUB_GROUP /end SUB_GROUP /begin FUNCTION_LIST /end FUNCTION_LIST /begin REF_CHARACTERISTIC CalRegn01CmnGroupA.ElecPwrCnsPrstcPwrLoss.Val /end REF_CHARACTERISTIC /begin REF_MEASUREMENT /end REF_MEASUREMENT /end GROUP
/begin GROUP CalRegn01CmnGroupA.TunSelnAuthyHwTqY.Ary1D "MICROSAR RTE" /begin SUB_GROUP /end SUB_GROUP /begin FUNCTION_LIST /end FUNCTION_LIST /begin REF_CHARACTERISTIC CalRegn01CmnGroupA.TunSelnAuthyHwTqY.Ary1D /end REF_CHARACTERISTIC /begin REF_MEASUREMENT /end REF_MEASUREMENT /end GROUP
/begin GROUP CalRegn01CmnGroupA.TunSelnAuthyHwVelY.Ary1D "MICROSAR RTE" /begin SUB_GROUP /end SUB_GROUP /begin FUNCTION_LIST /end FUNCTION_LIST /begin REF_CHARACTERISTIC CalRegn01CmnGroupA.TunSelnAuthyHwVelY.Ary1D /end REF_CHARACTERISTIC /begin REF_MEASUREMENT /end REF_MEASUREMENT /end GROUP
/begin GROUP CalRegn01CmnGroupA.TunSelnAuthyTunSelnRtDiCmd.Logl "MICROSAR RTE" /begin SUB_GROUP /end SUB_GROUP /begin FUNCTION_LIST /end FUNCTION_LIST /begin REF_CHARACTERISTIC CalRegn01CmnGroupA.TunSelnAuthyTunSelnRtDiCmd.Logl /end REF_CHARACTERISTIC /begin REF_MEASUREMENT /end REF_MEASUREMENT /end GROUP
/begin GROUP CalRegn01Inin00 "MICROSAR RTE" /begin SUB_GROUP CalRegn01Inin00.CalibrationPorts /end SUB_GROUP /begin FUNCTION_LIST /end FUNCTION_LIST /begin REF_CHARACTERISTIC /end REF_CHARACTERISTIC /begin REF_MEASUREMENT /end REF_MEASUREMENT /end GROUP
/begin GROUP CalRegn01Inin00.AssiSumLimBlndCmdSumFrqLimX.Ary1D "MICROSAR RTE" /begin SUB_GROUP /end SUB_GROUP /begin FUNCTION_LIST /end FUNCTION_LIST /begin REF_CHARACTERISTIC CalRegn01Inin00.AssiSumLimBlndCmdSumFrqLimX.Ary1D /end REF_CHARACTERISTIC /begin REF_MEASUREMENT /end REF_MEASUREMENT /end GROUP
/begin GROUP CalRegn01Inin00.AssiSumLimBlndCmdSumFrqLimY.Ary1D "MICROSAR RTE" /begin SUB_GROUP /end SUB_GROUP /begin FUNCTION_LIST /end FUNCTION_LIST /begin REF_CHARACTERISTIC CalRegn01Inin00.AssiSumLimBlndCmdSumFrqLimY.Ary1D /end REF_CHARACTERISTIC /begin REF_MEASUREMENT /end REF_MEASUREMENT /end GROUP
/begin GROUP CalRegn01Inin00.AssiSumLimHiSpdCmdSumFrqLimX.Ary1D "MICROSAR RTE" /begin SUB_GROUP /end SUB_GROUP /begin FUNCTION_LIST /end FUNCTION_LIST /begin REF_CHARACTERISTIC CalRegn01Inin00.AssiSumLimHiSpdCmdSumFrqLimX.Ary1D /end REF_CHARACTERISTIC /begin REF_MEASUREMENT /end REF_MEASUREMENT /end GROUP
/begin GROUP CalRegn01Inin00.AssiSumLimHiSpdCmdSumFrqLimY.Ary1D "MICROSAR RTE" /begin SUB_GROUP /end SUB_GROUP /begin FUNCTION_LIST /end FUNCTION_LIST /begin REF_CHARACTERISTIC CalRegn01Inin00.AssiSumLimHiSpdCmdSumFrqLimY.Ary1D /end REF_CHARACTERISTIC /begin REF_MEASUREMENT /end REF_MEASUREMENT /end GROUP
/begin GROUP CalRegn01Inin00.AssiSumLimLoSpdCmdSumFrqLimX.Ary1D "MICROSAR RTE" /begin SUB_GROUP /end SUB_GROUP /begin FUNCTION_LIST /end FUNCTION_LIST /begin REF_CHARACTERISTIC CalRegn01Inin00.AssiSumLimLoSpdCmdSumFrqLimX.Ary1D /end REF_CHARACTERISTIC /begin REF_MEASUREMENT /end REF_MEASUREMENT /end GROUP
/begin GROUP CalRegn01Inin00.AssiSumLimLoSpdCmdSumFrqLimY.Ary1D "MICROSAR RTE" /begin SUB_GROUP /end SUB_GROUP /begin FUNCTION_LIST /end FUNCTION_LIST /begin REF_CHARACTERISTIC CalRegn01Inin00.AssiSumLimLoSpdCmdSumFrqLimY.Ary1D /end REF_CHARACTERISTIC /begin REF_MEASUREMENT /end REF_MEASUREMENT /end GROUP
/begin GROUP CalRegn01Inin00.AssiSumLimMotVelLpFilFrq.Val "MICROSAR RTE" /begin SUB_GROUP /end SUB_GROUP /begin FUNCTION_LIST /end FUNCTION_LIST /begin REF_CHARACTERISTIC CalRegn01Inin00.AssiSumLimMotVelLpFilFrq.Val /end REF_CHARACTERISTIC /begin REF_MEASUREMENT /end REF_MEASUREMENT /end GROUP
/begin GROUP CalRegn01Inin00.CalibrationPorts "MICROSAR RTE"
 /begin SUB_GROUP CalRegn01Inin00.AssiSumLimBlndCmdSumFrqLimX.Ary1D CalRegn01Inin00.AssiSumLimBlndCmdSumFrqLimY.Ary1D CalRegn01Inin00.AssiSumLimHiSpdCmdSumFrqLimX.Ary1D CalRegn01Inin00.AssiSumLimHiSpdCmdSumFrqLimY.Ary1D CalRegn01Inin00.AssiSumLimLoSpdCmdSumFrqLimX.Ary1D CalRegn01Inin00.AssiSumLimLoSpdCmdSumFrqLimY.Ary1D CalRegn01Inin00.AssiSumLimMotVelLpFilFrq.Val CalRegn01Inin00.CmplncErrHwAgNonLinCmplncDepTblY.Ary1D CalRegn01Inin00.CmplncErrHwAgNonLinCmplncIndTblX.Ary1D CalRegn01Inin00.CmplncErrMotAgNonLinCmplncDepTblY.Ary1D CalRegn01Inin00.CmplncErrMotAgNonLinCmplncIndTblX.Ary1D CalRegn01Inin00.DualCtrlrOutpMgrConOutpSca.Val CalRegn01Inin00.DualCtrlrOutpMgrDiRateTblY.Ary1D CalRegn01Inin00.DualCtrlrOutpMgrEnaRate.Val CalRegn01Inin00.DualCtrlrOutpMgrFltThdTmr.Val CalRegn01Inin00.DualCtrlrOutpMgrLimdOutpSca.Val CalRegn01Inin00.DualCtrlrOutpMgrMaxOutpSca.Val CalRegn01Inin00.DualCtrlrOutpMgrMaxOutpTmr.Val CalRegn01Inin00.DualCtrlrOutpMgrMinOutpTmr.Val CalRegn01Inin00.DualCtrlrOutpMgrNonRecFltThdTmr.Val CalRegn01Inin00.DualCtrlrOutpMgrThdTmr.Val CalRegn01Inin00.DualCtrlrOutpMgrVehSpdRefTblX.Ary1D CalRegn01Inin00.DualCtrlrOutpMgrVltgModFltThdTmr.Val CalRegn01Inin00.HwAg1MeasHwAg1IfFltFailStep.Val CalRegn01Inin00.HwAg1MeasHwAg1IfFltPassStep.Val CalRegn01Inin00.HwAg1MeasHwAg1Snsr0PrtclFltFailStep.Val CalRegn01Inin00.HwAg1MeasHwAg1Snsr0PrtclFltPassStep.Val CalRegn01Inin00.HwAg1MeasHwAg1Snsr1PrtclFltFailStep.Val CalRegn01Inin00.HwAg1MeasHwAg1Snsr1PrtclFltPassStep.Val CalRegn01Inin00.HwAg1MeasSnsr0Rev.Ary1D CalRegn01Inin00.HwAg1MeasSnsr1Rev.Ary1D CalRegn01Inin00.HwAg1MeasStep.Ary1D CalRegn01Inin00.HwAg1MeasVrnrErrThd.Val CalRegn01Inin00.HwAgSnsrlsFeatEna.Logl CalRegn01Inin00.HwAgSnsrlsVehDynVehSpdThd.Val CalRegn01Inin00.HwAgSnsrlsVehDynYawRateThd.Val CalRegn01Inin00.HwAgSnsrlsYawRateFilFrq.Val CalRegn01Inin00.HwAgSysArbn2PinionPosSnsrAvl.Logl CalRegn01Inin00.HwAgSysArbnTqSnsrVelFilFrq.Val CalRegn01Inin00.HwTq1MeasHwTq1PrtclFltFailStep.Val CalRegn01Inin00.HwTq1MeasHwTq1PrtclFltPassStep.Val CalRegn01Inin00.HwTq8MeasHwTq8PrtclFltFailStep.Val CalRegn01Inin00.HwTq8MeasHwTq8PrtclFltPassStep.Val CalRegn01Inin00.ImcSigArbnArbnFltTmr.Val CalRegn01Inin00.ImcSigArbnHwAgArbnEna.Logl CalRegn01Inin00.ImcSigArbnHwAgArbnLpFil.Val CalRegn01Inin00.ImcSigArbnHwAgArbnOffsLim.Val CalRegn01Inin00.ImcSigArbnHwAgTarArbnEna.Logl CalRegn01Inin00.ImcSigArbnHwAgTarArbnLpFil.Val CalRegn01Inin00.ImcSigArbnHwAgTarArbnOffsLim.Val CalRegn01Inin00.ImcSigArbnHwTqArbnEna.Logl CalRegn01Inin00.ImcSigArbnHwTqArbnLpFil.Val CalRegn01Inin00.ImcSigArbnHwTqArbnOffsLim.Val CalRegn01Inin00.ImcSigArbnMotVelArbnEna.Logl CalRegn01Inin00.ImcSigArbnMotVelArbnLpFil.Val CalRegn01Inin00.ImcSigArbnMotVelArbnOffsLim.Val CalRegn01Inin00.ImcSigArbnPosnServoArbnOffsLim.Val CalRegn01Inin00.ImcSigArbnPosnServoIntgtrStArbnEna.Logl CalRegn01Inin00.ImcSigArbnPosnServoIntgtrStArbnLpFil.Val CalRegn01Inin00.ImcSigArbnPosnTrakg1ArbnOffsLim.Val CalRegn01Inin00.ImcSigArbnPosnTrakg2ArbnOffsLim.Val CalRegn01Inin00.ImcSigArbnPullCmpLongTermIntgtrStArbnEna.Logl CalRegn01Inin00.ImcSigArbnPullCmpLongTermIntgtrStArbnLpFil.Val CalRegn01Inin00.ImcSigArbnPullCmpShoTermIntgtrStArbnEna.Logl CalRegn01Inin00.ImcSigArbnPullCmpShoTermIntgtrStArbnLpFil.Val CalRegn01Inin00.ImcSigArbnSysStTmr.Val CalRegn01Inin00.ImcSigArbnTrakgIntgtrSt1ArbnEna.Logl CalRegn01Inin00.ImcSigArbnTrakgIntgtrSt1ArbnLpFil.Val CalRegn01Inin00.ImcSigArbnTrakgIntgtrSt2ArbnEna.Logl CalRegn01Inin00.ImcSigArbnTrakgIntgtrSt2ArbnLpFil.Val CalRegn01Inin00.ImcSigArbnVehSpdArbnEna.Logl CalRegn01Inin00.ImcSigArbnVehSpdArbnLpFil.Val CalRegn01Inin00.ImcSigArbnVehSpdArbnOffsLim.Val CalRegn01Inin00.LimrCdngGainDecSlew.Val CalRegn01Inin00.LimrCdngGainIncSlewX.Ary1D CalRegn01Inin00.LimrCdngGainIncSlewY.Ary1D CalRegn01Inin00.LimrCdngTqDecSlew.Val CalRegn01Inin00.LimrCdngTqIncSlewX.Ary1D CalRegn01Inin00.LimrCdngTqIncSlewY.Ary1D CalRegn01Inin00.McuDiagc2MilliSecCntrCompThd.Val CalRegn01Inin00.McuDiagcFltFailStep.Val CalRegn01Inin00.McuDiagcFltPassStep.Val CalRegn01Inin00.MotTqCmdScaMax.Val CalRegn01Inin00.MotTqCmdScaMin.Val CalRegn01Inin00.MotTqTranlDampgCmdLim.Val CalRegn01Inin00.MotTqTranlDampgDampgCoeff.Val CalRegn01Inin00.MotTqTranlDampgRampEnd.Val CalRegn01Inin00.MotTqTranlDampgTmrPt1.Val CalRegn01Inin00.MotTqTranlDampgTmrPt2.Val CalRegn01Inin00.MotTqTranlDampgVehSpdBlndX.Ary1D CalRegn01Inin00.MotTqTranlDampgVelThd.Val CalRegn01Inin00.PwrDiscnctBattVltgExtdNormThd.Val CalRegn01Inin00.PwrDiscnctBattVltgNonExtdThd.Val CalRegn01Inin00.PwrDiscnctChrgMinDeltaExtOper.Val CalRegn01Inin00.PwrDiscnctChrgMinDeltaNonOper.Val CalRegn01Inin00.PwrDiscnctChrgMinDeltaNormOper.Val CalRegn01Inin00.PwrDiscnctChrgPmpDiagOpenThd.Val CalRegn01Inin00.PwrDiscnctDeltaSwtClsThd.Val CalRegn01Inin00.PwrDiscnctDeltaVltgClsThd.Val CalRegn01Inin00.PwrDiscnctDeltaVltgOpenThd.Val CalRegn01Inin00.PwrDiscnctFltFailStep.Val CalRegn01Inin00.PwrDiscnctFltPassStep.Val CalRegn01Inin00.PwrDiscnctFltThd.Val CalRegn01Inin00.PwrDiscnctMtrMtnThd.Val CalRegn01Inin00.PwrDiscnctPwrDiscnctRtFltFailStep.Val CalRegn01Inin00.PwrDiscnctPwrDiscnctRtFltPassStep.Val CalRegn01Inin00.PwrDiscnctSwtDiagOpenThd.Val CalRegn01Inin00.SysFricLrngAvrgFricFrq.Val CalRegn01Inin00.SysFricLrngBasLineEolFric.Val CalRegn01Inin00.SysFricLrngBasLineFric.Ary1D CalRegn01Inin00.SysFricLrngBasLineHys.Ary2D CalRegn01Inin00.SysFricLrngBasLineRngCntr.Ary2D CalRegn01Inin00.SysFricLrngDataPrepLpFilFrq.Val CalRegn01Inin00.SysFricLrngDebStep.Val CalRegn01Inin00.SysFricLrngEolFricDifHiLim.Val CalRegn01Inin00.SysFricLrngEolFricDifLoLim.Val CalRegn01Inin00.SysFricLrngEolFricDifScagFac.Val CalRegn01Inin00.SysFricLrngFricChgWght.Ary1D CalRegn01Inin00.SysFricLrngFricDiagcThd.Val CalRegn01Inin00.SysFricLrngFricHysHwAgPt.Ary1D CalRegn01Inin00.SysFricLrngFricOffs.Val CalRegn01Inin00.SysFricLrngFricOffsHiLim.Val CalRegn01Inin00.SysFricLrngFricOffsLoLim.Val CalRegn01Inin00.SysFricLrngFricOffsLpFilFrq.Val CalRegn01Inin00.SysFricLrngGain.Val CalRegn01Inin00.SysFricLrngHiFricDebStep.Val CalRegn01Inin00.SysFricLrngHiFricDiagcThd.Val CalRegn01Inin00.SysFricLrngHwPosnAuthyThd.Val CalRegn01Inin00.SysFricLrngHwVelConstrLim.Val CalRegn01Inin00.SysFricLrngHwVelHiLim.Val CalRegn01Inin00.SysFricLrngHwVelLoLim.Val CalRegn01Inin00.SysFricLrngIgnCycFricChgLim.Val CalRegn01Inin00.SysFricLrngIgnCycFricOffs.Val CalRegn01Inin00.SysFricLrngIvsTrsmRatX.Ary1D CalRegn01Inin00.SysFricLrngIvsTrsmRatY.Ary1D CalRegn01Inin00.SysFricLrngLatAHiLim.Val CalRegn01Inin00.SysFricLrngLatALoLim.Val CalRegn01Inin00.SysFricLrngMaskVehSpd.Ary1D CalRegn01Inin00.SysFricLrngRngCntrThd.Val CalRegn01Inin00.SysFricLrngTHiLim.Val CalRegn01Inin00.SysFricLrngTLoLim.Val CalRegn01Inin00.SysFricLrngThd.Val CalRegn01Inin00.SysFricLrngVehSpd.Ary2D CalRegn01Inin00.SysGlbPrmMotPoleCnt.Val CalRegn01Inin00.SysGlbPrmSysTqRat.Val CalRegn01Inin00.SysGlbPrmTorsBarStfn.Val CalRegn01Inin00.SysGlbPrmVehSpdBilnrSeln.Ary1D CalRegn01Inin00.TEstimnAmbPwrMplr.Ary1D CalRegn01Inin00.TEstimnAmbTSca.Ary1D CalRegn01Inin00.TEstimnAssiMechAmbLpFilFrq.Val CalRegn01Inin00.TEstimnAssiMechAmbLpFilFrqDualEcuFltMtgtn.Val CalRegn01Inin00.TEstimnAssiMechAmbLpFilFrqFetMtgtnEna.Val CalRegn01Inin00.TEstimnAssiMechAmbMplr.Ary1D CalRegn01Inin00.TEstimnAssiMechCorrLim.Ary1D CalRegn01Inin00.TEstimnAssiMechDampgSca.Ary1D CalRegn01Inin00.TEstimnAssiMechDftT.Ary1D CalRegn01Inin00.TEstimnAssiMechLLFilCoeffA1.Ary1D CalRegn01Inin00.TEstimnAssiMechLLFilCoeffB0.Ary1D CalRegn01Inin00.TEstimnAssiMechLLFilCoeffB1.Ary1D CalRegn01Inin00.TEstimnAssiMechSlew.Ary1D CalRegn01Inin00.TEstimnCorrnTAssiMech.Ary1D CalRegn01Inin00.TEstimnCorrnTCu.Ary1D CalRegn01Inin00.TEstimnCorrnTMag.Ary1D CalRegn01Inin00.TEstimnCorrnTSi.Ary1D CalRegn01Inin00.TEstimnCuAmbLpFilFrq.Val CalRegn01Inin00.TEstimnCuAmbLpFilFrqDualEcuFltMtgtn.Val CalRegn01Inin00.TEstimnCuAmbLpFilFrqFetMtgtnEna.Val CalRegn01Inin00.TEstimnCuAmbMplr.Ary1D CalRegn01Inin00.TEstimnCuCorrnLim.Ary1D CalRegn01Inin00.TEstimnCuLLFilCoeffA1.Ary1D CalRegn01Inin00.TEstimnCuLLFilCoeffB0.Ary1D CalRegn01Inin00.TEstimnCuLLFilCoeffB1.Ary1D CalRegn01Inin00.TEstimnEngTSca.Ary1D CalRegn01Inin00.TEstimnMagAmbLpFilFrq.Val CalRegn01Inin00.TEstimnMagAmbLpFilFrqDualEcuFltMtgtn.Val CalRegn01Inin00.TEstimnMagAmbLpFilFrqFetMtgtnEna.Val CalRegn01Inin00.TEstimnMagCorrnLim.Ary1D CalRegn01Inin00.TEstimnMagLLFilCoeffA1.Ary1D CalRegn01Inin00.TEstimnMagLLFilCoeffB0.Ary1D CalRegn01Inin00.TEstimnMagLLFilCoeffB1.Ary1D CalRegn01Inin00.TEstimnSiAmbLpFilFrq.Val CalRegn01Inin00.TEstimnSiAmbLpFilFrqDualEcuFltMtgtn.Val CalRegn01Inin00.TEstimnSiAmbLpFilFrqFetMtgtnEna.Val CalRegn01Inin00.TEstimnSiAmbMplr.Ary1D CalRegn01Inin00.TEstimnSiCorrnLim.Ary1D CalRegn01Inin00.TEstimnSiLLFilCoeffA1.Ary1D CalRegn01Inin00.TEstimnSiLLFilCoeffB0.Ary1D CalRegn01Inin00.TEstimnSiLLFilCoeffB1.Ary1D CalRegn01Inin00.TEstimnTauAssiMech.Ary1D CalRegn01Inin00.TEstimnTauCu.Ary1D CalRegn01Inin00.TEstimnTauMag.Ary1D CalRegn01Inin00.TEstimnTauSi.Ary1D CalRegn01Inin00.TEstimnWghtAvrgTDi.Ary1D CalRegn01Inin00.VehSigCdngLatASlewRate.Val CalRegn01Inin00.VehSigCdngLtgASlewRate.Val /end SUB_GROUP
 /begin FUNCTION_LIST /end FUNCTION_LIST
 /begin REF_CHARACTERISTIC /end REF_CHARACTERISTIC
 /begin REF_MEASUREMENT /end REF_MEASUREMENT
/end GROUP
/begin GROUP CalRegn01Inin00.CmplncErrHwAgNonLinCmplncDepTblY.Ary1D "MICROSAR RTE" /begin SUB_GROUP /end SUB_GROUP /begin FUNCTION_LIST /end FUNCTION_LIST /begin REF_CHARACTERISTIC CalRegn01Inin00.CmplncErrHwAgNonLinCmplncDepTblY.Ary1D /end REF_CHARACTERISTIC /begin REF_MEASUREMENT /end REF_MEASUREMENT /end GROUP
/begin GROUP CalRegn01Inin00.CmplncErrHwAgNonLinCmplncIndTblX.Ary1D "MICROSAR RTE" /begin SUB_GROUP /end SUB_GROUP /begin FUNCTION_LIST /end FUNCTION_LIST /begin REF_CHARACTERISTIC CalRegn01Inin00.CmplncErrHwAgNonLinCmplncIndTblX.Ary1D /end REF_CHARACTERISTIC /begin REF_MEASUREMENT /end REF_MEASUREMENT /end GROUP
/begin GROUP CalRegn01Inin00.CmplncErrMotAgNonLinCmplncDepTblY.Ary1D "MICROSAR RTE" /begin SUB_GROUP /end SUB_GROUP /begin FUNCTION_LIST /end FUNCTION_LIST /begin REF_CHARACTERISTIC CalRegn01Inin00.CmplncErrMotAgNonLinCmplncDepTblY.Ary1D /end REF_CHARACTERISTIC /begin REF_MEASUREMENT /end REF_MEASUREMENT /end GROUP
/begin GROUP CalRegn01Inin00.CmplncErrMotAgNonLinCmplncIndTblX.Ary1D "MICROSAR RTE" /begin SUB_GROUP /end SUB_GROUP /begin FUNCTION_LIST /end FUNCTION_LIST /begin REF_CHARACTERISTIC CalRegn01Inin00.CmplncErrMotAgNonLinCmplncIndTblX.Ary1D /end REF_CHARACTERISTIC /begin REF_MEASUREMENT /end REF_MEASUREMENT /end GROUP
/begin GROUP CalRegn01Inin00.DualCtrlrOutpMgrConOutpSca.Val "MICROSAR RTE" /begin SUB_GROUP /end SUB_GROUP /begin FUNCTION_LIST /end FUNCTION_LIST /begin REF_CHARACTERISTIC CalRegn01Inin00.DualCtrlrOutpMgrConOutpSca.Val /end REF_CHARACTERISTIC /begin REF_MEASUREMENT /end REF_MEASUREMENT /end GROUP
/begin GROUP CalRegn01Inin00.DualCtrlrOutpMgrDiRateTblY.Ary1D "MICROSAR RTE" /begin SUB_GROUP /end SUB_GROUP /begin FUNCTION_LIST /end FUNCTION_LIST /begin REF_CHARACTERISTIC CalRegn01Inin00.DualCtrlrOutpMgrDiRateTblY.Ary1D /end REF_CHARACTERISTIC /begin REF_MEASUREMENT /end REF_MEASUREMENT /end GROUP
/begin GROUP CalRegn01Inin00.DualCtrlrOutpMgrEnaRate.Val "MICROSAR RTE" /begin SUB_GROUP /end SUB_GROUP /begin FUNCTION_LIST /end FUNCTION_LIST /begin REF_CHARACTERISTIC CalRegn01Inin00.DualCtrlrOutpMgrEnaRate.Val /end REF_CHARACTERISTIC /begin REF_MEASUREMENT /end REF_MEASUREMENT /end GROUP
/begin GROUP CalRegn01Inin00.DualCtrlrOutpMgrFltThdTmr.Val "MICROSAR RTE" /begin SUB_GROUP /end SUB_GROUP /begin FUNCTION_LIST /end FUNCTION_LIST /begin REF_CHARACTERISTIC CalRegn01Inin00.DualCtrlrOutpMgrFltThdTmr.Val /end REF_CHARACTERISTIC /begin REF_MEASUREMENT /end REF_MEASUREMENT /end GROUP
/begin GROUP CalRegn01Inin00.DualCtrlrOutpMgrLimdOutpSca.Val "MICROSAR RTE" /begin SUB_GROUP /end SUB_GROUP /begin FUNCTION_LIST /end FUNCTION_LIST /begin REF_CHARACTERISTIC CalRegn01Inin00.DualCtrlrOutpMgrLimdOutpSca.Val /end REF_CHARACTERISTIC /begin REF_MEASUREMENT /end REF_MEASUREMENT /end GROUP
/begin GROUP CalRegn01Inin00.DualCtrlrOutpMgrMaxOutpSca.Val "MICROSAR RTE" /begin SUB_GROUP /end SUB_GROUP /begin FUNCTION_LIST /end FUNCTION_LIST /begin REF_CHARACTERISTIC CalRegn01Inin00.DualCtrlrOutpMgrMaxOutpSca.Val /end REF_CHARACTERISTIC /begin REF_MEASUREMENT /end REF_MEASUREMENT /end GROUP
/begin GROUP CalRegn01Inin00.DualCtrlrOutpMgrMaxOutpTmr.Val "MICROSAR RTE" /begin SUB_GROUP /end SUB_GROUP /begin FUNCTION_LIST /end FUNCTION_LIST /begin REF_CHARACTERISTIC CalRegn01Inin00.DualCtrlrOutpMgrMaxOutpTmr.Val /end REF_CHARACTERISTIC /begin REF_MEASUREMENT /end REF_MEASUREMENT /end GROUP
/begin GROUP CalRegn01Inin00.DualCtrlrOutpMgrMinOutpTmr.Val "MICROSAR RTE" /begin SUB_GROUP /end SUB_GROUP /begin FUNCTION_LIST /end FUNCTION_LIST /begin REF_CHARACTERISTIC CalRegn01Inin00.DualCtrlrOutpMgrMinOutpTmr.Val /end REF_CHARACTERISTIC /begin REF_MEASUREMENT /end REF_MEASUREMENT /end GROUP
/begin GROUP CalRegn01Inin00.DualCtrlrOutpMgrNonRecFltThdTmr.Val "MICROSAR RTE" /begin SUB_GROUP /end SUB_GROUP /begin FUNCTION_LIST /end FUNCTION_LIST /begin REF_CHARACTERISTIC CalRegn01Inin00.DualCtrlrOutpMgrNonRecFltThdTmr.Val /end REF_CHARACTERISTIC /begin REF_MEASUREMENT /end REF_MEASUREMENT /end GROUP
/begin GROUP CalRegn01Inin00.DualCtrlrOutpMgrThdTmr.Val "MICROSAR RTE" /begin SUB_GROUP /end SUB_GROUP /begin FUNCTION_LIST /end FUNCTION_LIST /begin REF_CHARACTERISTIC CalRegn01Inin00.DualCtrlrOutpMgrThdTmr.Val /end REF_CHARACTERISTIC /begin REF_MEASUREMENT /end REF_MEASUREMENT /end GROUP
/begin GROUP CalRegn01Inin00.DualCtrlrOutpMgrVehSpdRefTblX.Ary1D "MICROSAR RTE" /begin SUB_GROUP /end SUB_GROUP /begin FUNCTION_LIST /end FUNCTION_LIST /begin REF_CHARACTERISTIC CalRegn01Inin00.DualCtrlrOutpMgrVehSpdRefTblX.Ary1D /end REF_CHARACTERISTIC /begin REF_MEASUREMENT /end REF_MEASUREMENT /end GROUP
/begin GROUP CalRegn01Inin00.DualCtrlrOutpMgrVltgModFltThdTmr.Val "MICROSAR RTE" /begin SUB_GROUP /end SUB_GROUP /begin FUNCTION_LIST /end FUNCTION_LIST /begin REF_CHARACTERISTIC CalRegn01Inin00.DualCtrlrOutpMgrVltgModFltThdTmr.Val /end REF_CHARACTERISTIC /begin REF_MEASUREMENT /end REF_MEASUREMENT /end GROUP
/begin GROUP CalRegn01Inin00.HwAg1MeasHwAg1IfFltFailStep.Val "MICROSAR RTE" /begin SUB_GROUP /end SUB_GROUP /begin FUNCTION_LIST /end FUNCTION_LIST /begin REF_CHARACTERISTIC CalRegn01Inin00.HwAg1MeasHwAg1IfFltFailStep.Val /end REF_CHARACTERISTIC /begin REF_MEASUREMENT /end REF_MEASUREMENT /end GROUP
/begin GROUP CalRegn01Inin00.HwAg1MeasHwAg1IfFltPassStep.Val "MICROSAR RTE" /begin SUB_GROUP /end SUB_GROUP /begin FUNCTION_LIST /end FUNCTION_LIST /begin REF_CHARACTERISTIC CalRegn01Inin00.HwAg1MeasHwAg1IfFltPassStep.Val /end REF_CHARACTERISTIC /begin REF_MEASUREMENT /end REF_MEASUREMENT /end GROUP
/begin GROUP CalRegn01Inin00.HwAg1MeasHwAg1Snsr0PrtclFltFailStep.Val "MICROSAR RTE" /begin SUB_GROUP /end SUB_GROUP /begin FUNCTION_LIST /end FUNCTION_LIST /begin REF_CHARACTERISTIC CalRegn01Inin00.HwAg1MeasHwAg1Snsr0PrtclFltFailStep.Val /end REF_CHARACTERISTIC /begin REF_MEASUREMENT /end REF_MEASUREMENT /end GROUP
/begin GROUP CalRegn01Inin00.HwAg1MeasHwAg1Snsr0PrtclFltPassStep.Val "MICROSAR RTE" /begin SUB_GROUP /end SUB_GROUP /begin FUNCTION_LIST /end FUNCTION_LIST /begin REF_CHARACTERISTIC CalRegn01Inin00.HwAg1MeasHwAg1Snsr0PrtclFltPassStep.Val /end REF_CHARACTERISTIC /begin REF_MEASUREMENT /end REF_MEASUREMENT /end GROUP
/begin GROUP CalRegn01Inin00.HwAg1MeasHwAg1Snsr1PrtclFltFailStep.Val "MICROSAR RTE" /begin SUB_GROUP /end SUB_GROUP /begin FUNCTION_LIST /end FUNCTION_LIST /begin REF_CHARACTERISTIC CalRegn01Inin00.HwAg1MeasHwAg1Snsr1PrtclFltFailStep.Val /end REF_CHARACTERISTIC /begin REF_MEASUREMENT /end REF_MEASUREMENT /end GROUP
/begin GROUP CalRegn01Inin00.HwAg1MeasHwAg1Snsr1PrtclFltPassStep.Val "MICROSAR RTE" /begin SUB_GROUP /end SUB_GROUP /begin FUNCTION_LIST /end FUNCTION_LIST /begin REF_CHARACTERISTIC CalRegn01Inin00.HwAg1MeasHwAg1Snsr1PrtclFltPassStep.Val /end REF_CHARACTERISTIC /begin REF_MEASUREMENT /end REF_MEASUREMENT /end GROUP
/begin GROUP CalRegn01Inin00.HwAg1MeasSnsr0Rev.Ary1D "MICROSAR RTE" /begin SUB_GROUP /end SUB_GROUP /begin FUNCTION_LIST /end FUNCTION_LIST /begin REF_CHARACTERISTIC CalRegn01Inin00.HwAg1MeasSnsr0Rev.Ary1D /end REF_CHARACTERISTIC /begin REF_MEASUREMENT /end REF_MEASUREMENT /end GROUP
/begin GROUP CalRegn01Inin00.HwAg1MeasSnsr1Rev.Ary1D "MICROSAR RTE" /begin SUB_GROUP /end SUB_GROUP /begin FUNCTION_LIST /end FUNCTION_LIST /begin REF_CHARACTERISTIC CalRegn01Inin00.HwAg1MeasSnsr1Rev.Ary1D /end REF_CHARACTERISTIC /begin REF_MEASUREMENT /end REF_MEASUREMENT /end GROUP
/begin GROUP CalRegn01Inin00.HwAg1MeasStep.Ary1D "MICROSAR RTE" /begin SUB_GROUP /end SUB_GROUP /begin FUNCTION_LIST /end FUNCTION_LIST /begin REF_CHARACTERISTIC CalRegn01Inin00.HwAg1MeasStep.Ary1D /end REF_CHARACTERISTIC /begin REF_MEASUREMENT /end REF_MEASUREMENT /end GROUP
/begin GROUP CalRegn01Inin00.HwAg1MeasVrnrErrThd.Val "MICROSAR RTE" /begin SUB_GROUP /end SUB_GROUP /begin FUNCTION_LIST /end FUNCTION_LIST /begin REF_CHARACTERISTIC CalRegn01Inin00.HwAg1MeasVrnrErrThd.Val /end REF_CHARACTERISTIC /begin REF_MEASUREMENT /end REF_MEASUREMENT /end GROUP
/begin GROUP CalRegn01Inin00.HwAgSnsrlsFeatEna.Logl "MICROSAR RTE" /begin SUB_GROUP /end SUB_GROUP /begin FUNCTION_LIST /end FUNCTION_LIST /begin REF_CHARACTERISTIC CalRegn01Inin00.HwAgSnsrlsFeatEna.Logl /end REF_CHARACTERISTIC /begin REF_MEASUREMENT /end REF_MEASUREMENT /end GROUP
/begin GROUP CalRegn01Inin00.HwAgSnsrlsVehDynVehSpdThd.Val "MICROSAR RTE" /begin SUB_GROUP /end SUB_GROUP /begin FUNCTION_LIST /end FUNCTION_LIST /begin REF_CHARACTERISTIC CalRegn01Inin00.HwAgSnsrlsVehDynVehSpdThd.Val /end REF_CHARACTERISTIC /begin REF_MEASUREMENT /end REF_MEASUREMENT /end GROUP
/begin GROUP CalRegn01Inin00.HwAgSnsrlsVehDynYawRateThd.Val "MICROSAR RTE" /begin SUB_GROUP /end SUB_GROUP /begin FUNCTION_LIST /end FUNCTION_LIST /begin REF_CHARACTERISTIC CalRegn01Inin00.HwAgSnsrlsVehDynYawRateThd.Val /end REF_CHARACTERISTIC /begin REF_MEASUREMENT /end REF_MEASUREMENT /end GROUP
/begin GROUP CalRegn01Inin00.HwAgSnsrlsYawRateFilFrq.Val "MICROSAR RTE" /begin SUB_GROUP /end SUB_GROUP /begin FUNCTION_LIST /end FUNCTION_LIST /begin REF_CHARACTERISTIC CalRegn01Inin00.HwAgSnsrlsYawRateFilFrq.Val /end REF_CHARACTERISTIC /begin REF_MEASUREMENT /end REF_MEASUREMENT /end GROUP
/begin GROUP CalRegn01Inin00.HwAgSysArbn2PinionPosSnsrAvl.Logl "MICROSAR RTE" /begin SUB_GROUP /end SUB_GROUP /begin FUNCTION_LIST /end FUNCTION_LIST /begin REF_CHARACTERISTIC CalRegn01Inin00.HwAgSysArbn2PinionPosSnsrAvl.Logl /end REF_CHARACTERISTIC /begin REF_MEASUREMENT /end REF_MEASUREMENT /end GROUP
/begin GROUP CalRegn01Inin00.HwAgSysArbnTqSnsrVelFilFrq.Val "MICROSAR RTE" /begin SUB_GROUP /end SUB_GROUP /begin FUNCTION_LIST /end FUNCTION_LIST /begin REF_CHARACTERISTIC CalRegn01Inin00.HwAgSysArbnTqSnsrVelFilFrq.Val /end REF_CHARACTERISTIC /begin REF_MEASUREMENT /end REF_MEASUREMENT /end GROUP
/begin GROUP CalRegn01Inin00.HwTq1MeasHwTq1PrtclFltFailStep.Val "MICROSAR RTE" /begin SUB_GROUP /end SUB_GROUP /begin FUNCTION_LIST /end FUNCTION_LIST /begin REF_CHARACTERISTIC CalRegn01Inin00.HwTq1MeasHwTq1PrtclFltFailStep.Val /end REF_CHARACTERISTIC /begin REF_MEASUREMENT /end REF_MEASUREMENT /end GROUP
/begin GROUP CalRegn01Inin00.HwTq1MeasHwTq1PrtclFltPassStep.Val "MICROSAR RTE" /begin SUB_GROUP /end SUB_GROUP /begin FUNCTION_LIST /end FUNCTION_LIST /begin REF_CHARACTERISTIC CalRegn01Inin00.HwTq1MeasHwTq1PrtclFltPassStep.Val /end REF_CHARACTERISTIC /begin REF_MEASUREMENT /end REF_MEASUREMENT /end GROUP
/begin GROUP CalRegn01Inin00.HwTq8MeasHwTq8PrtclFltFailStep.Val "MICROSAR RTE" /begin SUB_GROUP /end SUB_GROUP /begin FUNCTION_LIST /end FUNCTION_LIST /begin REF_CHARACTERISTIC CalRegn01Inin00.HwTq8MeasHwTq8PrtclFltFailStep.Val /end REF_CHARACTERISTIC /begin REF_MEASUREMENT /end REF_MEASUREMENT /end GROUP
/begin GROUP CalRegn01Inin00.HwTq8MeasHwTq8PrtclFltPassStep.Val "MICROSAR RTE" /begin SUB_GROUP /end SUB_GROUP /begin FUNCTION_LIST /end FUNCTION_LIST /begin REF_CHARACTERISTIC CalRegn01Inin00.HwTq8MeasHwTq8PrtclFltPassStep.Val /end REF_CHARACTERISTIC /begin REF_MEASUREMENT /end REF_MEASUREMENT /end GROUP
/begin GROUP CalRegn01Inin00.ImcSigArbnArbnFltTmr.Val "MICROSAR RTE" /begin SUB_GROUP /end SUB_GROUP /begin FUNCTION_LIST /end FUNCTION_LIST /begin REF_CHARACTERISTIC CalRegn01Inin00.ImcSigArbnArbnFltTmr.Val /end REF_CHARACTERISTIC /begin REF_MEASUREMENT /end REF_MEASUREMENT /end GROUP
/begin GROUP CalRegn01Inin00.ImcSigArbnHwAgArbnEna.Logl "MICROSAR RTE" /begin SUB_GROUP /end SUB_GROUP /begin FUNCTION_LIST /end FUNCTION_LIST /begin REF_CHARACTERISTIC CalRegn01Inin00.ImcSigArbnHwAgArbnEna.Logl /end REF_CHARACTERISTIC /begin REF_MEASUREMENT /end REF_MEASUREMENT /end GROUP
/begin GROUP CalRegn01Inin00.ImcSigArbnHwAgArbnLpFil.Val "MICROSAR RTE" /begin SUB_GROUP /end SUB_GROUP /begin FUNCTION_LIST /end FUNCTION_LIST /begin REF_CHARACTERISTIC CalRegn01Inin00.ImcSigArbnHwAgArbnLpFil.Val /end REF_CHARACTERISTIC /begin REF_MEASUREMENT /end REF_MEASUREMENT /end GROUP
/begin GROUP CalRegn01Inin00.ImcSigArbnHwAgArbnOffsLim.Val "MICROSAR RTE" /begin SUB_GROUP /end SUB_GROUP /begin FUNCTION_LIST /end FUNCTION_LIST /begin REF_CHARACTERISTIC CalRegn01Inin00.ImcSigArbnHwAgArbnOffsLim.Val /end REF_CHARACTERISTIC /begin REF_MEASUREMENT /end REF_MEASUREMENT /end GROUP
/begin GROUP CalRegn01Inin00.ImcSigArbnHwAgTarArbnEna.Logl "MICROSAR RTE" /begin SUB_GROUP /end SUB_GROUP /begin FUNCTION_LIST /end FUNCTION_LIST /begin REF_CHARACTERISTIC CalRegn01Inin00.ImcSigArbnHwAgTarArbnEna.Logl /end REF_CHARACTERISTIC /begin REF_MEASUREMENT /end REF_MEASUREMENT /end GROUP
/begin GROUP CalRegn01Inin00.ImcSigArbnHwAgTarArbnLpFil.Val "MICROSAR RTE" /begin SUB_GROUP /end SUB_GROUP /begin FUNCTION_LIST /end FUNCTION_LIST /begin REF_CHARACTERISTIC CalRegn01Inin00.ImcSigArbnHwAgTarArbnLpFil.Val /end REF_CHARACTERISTIC /begin REF_MEASUREMENT /end REF_MEASUREMENT /end GROUP
/begin GROUP CalRegn01Inin00.ImcSigArbnHwAgTarArbnOffsLim.Val "MICROSAR RTE" /begin SUB_GROUP /end SUB_GROUP /begin FUNCTION_LIST /end FUNCTION_LIST /begin REF_CHARACTERISTIC CalRegn01Inin00.ImcSigArbnHwAgTarArbnOffsLim.Val /end REF_CHARACTERISTIC /begin REF_MEASUREMENT /end REF_MEASUREMENT /end GROUP
/begin GROUP CalRegn01Inin00.ImcSigArbnHwTqArbnEna.Logl "MICROSAR RTE" /begin SUB_GROUP /end SUB_GROUP /begin FUNCTION_LIST /end FUNCTION_LIST /begin REF_CHARACTERISTIC CalRegn01Inin00.ImcSigArbnHwTqArbnEna.Logl /end REF_CHARACTERISTIC /begin REF_MEASUREMENT /end REF_MEASUREMENT /end GROUP
/begin GROUP CalRegn01Inin00.ImcSigArbnHwTqArbnLpFil.Val "MICROSAR RTE" /begin SUB_GROUP /end SUB_GROUP /begin FUNCTION_LIST /end FUNCTION_LIST /begin REF_CHARACTERISTIC CalRegn01Inin00.ImcSigArbnHwTqArbnLpFil.Val /end REF_CHARACTERISTIC /begin REF_MEASUREMENT /end REF_MEASUREMENT /end GROUP
/begin GROUP CalRegn01Inin00.ImcSigArbnHwTqArbnOffsLim.Val "MICROSAR RTE" /begin SUB_GROUP /end SUB_GROUP /begin FUNCTION_LIST /end FUNCTION_LIST /begin REF_CHARACTERISTIC CalRegn01Inin00.ImcSigArbnHwTqArbnOffsLim.Val /end REF_CHARACTERISTIC /begin REF_MEASUREMENT /end REF_MEASUREMENT /end GROUP
/begin GROUP CalRegn01Inin00.ImcSigArbnMotVelArbnEna.Logl "MICROSAR RTE" /begin SUB_GROUP /end SUB_GROUP /begin FUNCTION_LIST /end FUNCTION_LIST /begin REF_CHARACTERISTIC CalRegn01Inin00.ImcSigArbnMotVelArbnEna.Logl /end REF_CHARACTERISTIC /begin REF_MEASUREMENT /end REF_MEASUREMENT /end GROUP
/begin GROUP CalRegn01Inin00.ImcSigArbnMotVelArbnLpFil.Val "MICROSAR RTE" /begin SUB_GROUP /end SUB_GROUP /begin FUNCTION_LIST /end FUNCTION_LIST /begin REF_CHARACTERISTIC CalRegn01Inin00.ImcSigArbnMotVelArbnLpFil.Val /end REF_CHARACTERISTIC /begin REF_MEASUREMENT /end REF_MEASUREMENT /end GROUP
/begin GROUP CalRegn01Inin00.ImcSigArbnMotVelArbnOffsLim.Val "MICROSAR RTE" /begin SUB_GROUP /end SUB_GROUP /begin FUNCTION_LIST /end FUNCTION_LIST /begin REF_CHARACTERISTIC CalRegn01Inin00.ImcSigArbnMotVelArbnOffsLim.Val /end REF_CHARACTERISTIC /begin REF_MEASUREMENT /end REF_MEASUREMENT /end GROUP
/begin GROUP CalRegn01Inin00.ImcSigArbnPosnServoArbnOffsLim.Val "MICROSAR RTE" /begin SUB_GROUP /end SUB_GROUP /begin FUNCTION_LIST /end FUNCTION_LIST /begin REF_CHARACTERISTIC CalRegn01Inin00.ImcSigArbnPosnServoArbnOffsLim.Val /end REF_CHARACTERISTIC /begin REF_MEASUREMENT /end REF_MEASUREMENT /end GROUP
/begin GROUP CalRegn01Inin00.ImcSigArbnPosnServoIntgtrStArbnEna.Logl "MICROSAR RTE" /begin SUB_GROUP /end SUB_GROUP /begin FUNCTION_LIST /end FUNCTION_LIST /begin REF_CHARACTERISTIC CalRegn01Inin00.ImcSigArbnPosnServoIntgtrStArbnEna.Logl /end REF_CHARACTERISTIC /begin REF_MEASUREMENT /end REF_MEASUREMENT /end GROUP
/begin GROUP CalRegn01Inin00.ImcSigArbnPosnServoIntgtrStArbnLpFil.Val "MICROSAR RTE" /begin SUB_GROUP /end SUB_GROUP /begin FUNCTION_LIST /end FUNCTION_LIST /begin REF_CHARACTERISTIC CalRegn01Inin00.ImcSigArbnPosnServoIntgtrStArbnLpFil.Val /end REF_CHARACTERISTIC /begin REF_MEASUREMENT /end REF_MEASUREMENT /end GROUP
/begin GROUP CalRegn01Inin00.ImcSigArbnPosnTrakg1ArbnOffsLim.Val "MICROSAR RTE" /begin SUB_GROUP /end SUB_GROUP /begin FUNCTION_LIST /end FUNCTION_LIST /begin REF_CHARACTERISTIC CalRegn01Inin00.ImcSigArbnPosnTrakg1ArbnOffsLim.Val /end REF_CHARACTERISTIC /begin REF_MEASUREMENT /end REF_MEASUREMENT /end GROUP
/begin GROUP CalRegn01Inin00.ImcSigArbnPosnTrakg2ArbnOffsLim.Val "MICROSAR RTE" /begin SUB_GROUP /end SUB_GROUP /begin FUNCTION_LIST /end FUNCTION_LIST /begin REF_CHARACTERISTIC CalRegn01Inin00.ImcSigArbnPosnTrakg2ArbnOffsLim.Val /end REF_CHARACTERISTIC /begin REF_MEASUREMENT /end REF_MEASUREMENT /end GROUP
/begin GROUP CalRegn01Inin00.ImcSigArbnPullCmpLongTermIntgtrStArbnEna.Logl "MICROSAR RTE" /begin SUB_GROUP /end SUB_GROUP /begin FUNCTION_LIST /end FUNCTION_LIST
 /begin REF_CHARACTERISTIC CalRegn01Inin00.ImcSigArbnPullCmpLongTermIntgtrStArbnEna.Logl /end REF_CHARACTERISTIC
 /begin REF_MEASUREMENT /end REF_MEASUREMENT
/end GROUP
/begin GROUP CalRegn01Inin00.ImcSigArbnPullCmpLongTermIntgtrStArbnLpFil.Val "MICROSAR RTE" /begin SUB_GROUP /end SUB_GROUP /begin FUNCTION_LIST /end FUNCTION_LIST
 /begin REF_CHARACTERISTIC CalRegn01Inin00.ImcSigArbnPullCmpLongTermIntgtrStArbnLpFil.Val /end REF_CHARACTERISTIC
 /begin REF_MEASUREMENT /end REF_MEASUREMENT
/end GROUP
/begin GROUP CalRegn01Inin00.ImcSigArbnPullCmpShoTermIntgtrStArbnEna.Logl "MICROSAR RTE" /begin SUB_GROUP /end SUB_GROUP /begin FUNCTION_LIST /end FUNCTION_LIST
 /begin REF_CHARACTERISTIC CalRegn01Inin00.ImcSigArbnPullCmpShoTermIntgtrStArbnEna.Logl /end REF_CHARACTERISTIC
 /begin REF_MEASUREMENT /end REF_MEASUREMENT
/end GROUP
/begin GROUP CalRegn01Inin00.ImcSigArbnPullCmpShoTermIntgtrStArbnLpFil.Val "MICROSAR RTE" /begin SUB_GROUP /end SUB_GROUP /begin FUNCTION_LIST /end FUNCTION_LIST
 /begin REF_CHARACTERISTIC CalRegn01Inin00.ImcSigArbnPullCmpShoTermIntgtrStArbnLpFil.Val /end REF_CHARACTERISTIC
 /begin REF_MEASUREMENT /end REF_MEASUREMENT
/end GROUP
/begin GROUP CalRegn01Inin00.ImcSigArbnSysStTmr.Val "MICROSAR RTE" /begin SUB_GROUP /end SUB_GROUP /begin FUNCTION_LIST /end FUNCTION_LIST /begin REF_CHARACTERISTIC CalRegn01Inin00.ImcSigArbnSysStTmr.Val /end REF_CHARACTERISTIC /begin REF_MEASUREMENT /end REF_MEASUREMENT /end GROUP
/begin GROUP CalRegn01Inin00.ImcSigArbnTrakgIntgtrSt1ArbnEna.Logl "MICROSAR RTE" /begin SUB_GROUP /end SUB_GROUP /begin FUNCTION_LIST /end FUNCTION_LIST /begin REF_CHARACTERISTIC CalRegn01Inin00.ImcSigArbnTrakgIntgtrSt1ArbnEna.Logl /end REF_CHARACTERISTIC /begin REF_MEASUREMENT /end REF_MEASUREMENT /end GROUP
/begin GROUP CalRegn01Inin00.ImcSigArbnTrakgIntgtrSt1ArbnLpFil.Val "MICROSAR RTE" /begin SUB_GROUP /end SUB_GROUP /begin FUNCTION_LIST /end FUNCTION_LIST /begin REF_CHARACTERISTIC CalRegn01Inin00.ImcSigArbnTrakgIntgtrSt1ArbnLpFil.Val /end REF_CHARACTERISTIC /begin REF_MEASUREMENT /end REF_MEASUREMENT /end GROUP
/begin GROUP CalRegn01Inin00.ImcSigArbnTrakgIntgtrSt2ArbnEna.Logl "MICROSAR RTE" /begin SUB_GROUP /end SUB_GROUP /begin FUNCTION_LIST /end FUNCTION_LIST /begin REF_CHARACTERISTIC CalRegn01Inin00.ImcSigArbnTrakgIntgtrSt2ArbnEna.Logl /end REF_CHARACTERISTIC /begin REF_MEASUREMENT /end REF_MEASUREMENT /end GROUP
/begin GROUP CalRegn01Inin00.ImcSigArbnTrakgIntgtrSt2ArbnLpFil.Val "MICROSAR RTE" /begin SUB_GROUP /end SUB_GROUP /begin FUNCTION_LIST /end FUNCTION_LIST /begin REF_CHARACTERISTIC CalRegn01Inin00.ImcSigArbnTrakgIntgtrSt2ArbnLpFil.Val /end REF_CHARACTERISTIC /begin REF_MEASUREMENT /end REF_MEASUREMENT /end GROUP
/begin GROUP CalRegn01Inin00.ImcSigArbnVehSpdArbnEna.Logl "MICROSAR RTE" /begin SUB_GROUP /end SUB_GROUP /begin FUNCTION_LIST /end FUNCTION_LIST /begin REF_CHARACTERISTIC CalRegn01Inin00.ImcSigArbnVehSpdArbnEna.Logl /end REF_CHARACTERISTIC /begin REF_MEASUREMENT /end REF_MEASUREMENT /end GROUP
/begin GROUP CalRegn01Inin00.ImcSigArbnVehSpdArbnLpFil.Val "MICROSAR RTE" /begin SUB_GROUP /end SUB_GROUP /begin FUNCTION_LIST /end FUNCTION_LIST /begin REF_CHARACTERISTIC CalRegn01Inin00.ImcSigArbnVehSpdArbnLpFil.Val /end REF_CHARACTERISTIC /begin REF_MEASUREMENT /end REF_MEASUREMENT /end GROUP
/begin GROUP CalRegn01Inin00.ImcSigArbnVehSpdArbnOffsLim.Val "MICROSAR RTE" /begin SUB_GROUP /end SUB_GROUP /begin FUNCTION_LIST /end FUNCTION_LIST /begin REF_CHARACTERISTIC CalRegn01Inin00.ImcSigArbnVehSpdArbnOffsLim.Val /end REF_CHARACTERISTIC /begin REF_MEASUREMENT /end REF_MEASUREMENT /end GROUP
/begin GROUP CalRegn01Inin00.LimrCdngGainDecSlew.Val "MICROSAR RTE" /begin SUB_GROUP /end SUB_GROUP /begin FUNCTION_LIST /end FUNCTION_LIST /begin REF_CHARACTERISTIC CalRegn01Inin00.LimrCdngGainDecSlew.Val /end REF_CHARACTERISTIC /begin REF_MEASUREMENT /end REF_MEASUREMENT /end GROUP
/begin GROUP CalRegn01Inin00.LimrCdngGainIncSlewX.Ary1D "MICROSAR RTE" /begin SUB_GROUP /end SUB_GROUP /begin FUNCTION_LIST /end FUNCTION_LIST /begin REF_CHARACTERISTIC CalRegn01Inin00.LimrCdngGainIncSlewX.Ary1D /end REF_CHARACTERISTIC /begin REF_MEASUREMENT /end REF_MEASUREMENT /end GROUP
/begin GROUP CalRegn01Inin00.LimrCdngGainIncSlewY.Ary1D "MICROSAR RTE" /begin SUB_GROUP /end SUB_GROUP /begin FUNCTION_LIST /end FUNCTION_LIST /begin REF_CHARACTERISTIC CalRegn01Inin00.LimrCdngGainIncSlewY.Ary1D /end REF_CHARACTERISTIC /begin REF_MEASUREMENT /end REF_MEASUREMENT /end GROUP
/begin GROUP CalRegn01Inin00.LimrCdngTqDecSlew.Val "MICROSAR RTE" /begin SUB_GROUP /end SUB_GROUP /begin FUNCTION_LIST /end FUNCTION_LIST /begin REF_CHARACTERISTIC CalRegn01Inin00.LimrCdngTqDecSlew.Val /end REF_CHARACTERISTIC /begin REF_MEASUREMENT /end REF_MEASUREMENT /end GROUP
/begin GROUP CalRegn01Inin00.LimrCdngTqIncSlewX.Ary1D "MICROSAR RTE" /begin SUB_GROUP /end SUB_GROUP /begin FUNCTION_LIST /end FUNCTION_LIST /begin REF_CHARACTERISTIC CalRegn01Inin00.LimrCdngTqIncSlewX.Ary1D /end REF_CHARACTERISTIC /begin REF_MEASUREMENT /end REF_MEASUREMENT /end GROUP
/begin GROUP CalRegn01Inin00.LimrCdngTqIncSlewY.Ary1D "MICROSAR RTE" /begin SUB_GROUP /end SUB_GROUP /begin FUNCTION_LIST /end FUNCTION_LIST /begin REF_CHARACTERISTIC CalRegn01Inin00.LimrCdngTqIncSlewY.Ary1D /end REF_CHARACTERISTIC /begin REF_MEASUREMENT /end REF_MEASUREMENT /end GROUP
/begin GROUP CalRegn01Inin00.McuDiagc2MilliSecCntrCompThd.Val "MICROSAR RTE" /begin SUB_GROUP /end SUB_GROUP /begin FUNCTION_LIST /end FUNCTION_LIST /begin REF_CHARACTERISTIC CalRegn01Inin00.McuDiagc2MilliSecCntrCompThd.Val /end REF_CHARACTERISTIC /begin REF_MEASUREMENT /end REF_MEASUREMENT /end GROUP
/begin GROUP CalRegn01Inin00.McuDiagcFltFailStep.Val "MICROSAR RTE" /begin SUB_GROUP /end SUB_GROUP /begin FUNCTION_LIST /end FUNCTION_LIST /begin REF_CHARACTERISTIC CalRegn01Inin00.McuDiagcFltFailStep.Val /end REF_CHARACTERISTIC /begin REF_MEASUREMENT /end REF_MEASUREMENT /end GROUP
/begin GROUP CalRegn01Inin00.McuDiagcFltPassStep.Val "MICROSAR RTE" /begin SUB_GROUP /end SUB_GROUP /begin FUNCTION_LIST /end FUNCTION_LIST /begin REF_CHARACTERISTIC CalRegn01Inin00.McuDiagcFltPassStep.Val /end REF_CHARACTERISTIC /begin REF_MEASUREMENT /end REF_MEASUREMENT /end GROUP
/begin GROUP CalRegn01Inin00.MotTqCmdScaMax.Val "MICROSAR RTE" /begin SUB_GROUP /end SUB_GROUP /begin FUNCTION_LIST /end FUNCTION_LIST /begin REF_CHARACTERISTIC CalRegn01Inin00.MotTqCmdScaMax.Val /end REF_CHARACTERISTIC /begin REF_MEASUREMENT /end REF_MEASUREMENT /end GROUP
/begin GROUP CalRegn01Inin00.MotTqCmdScaMin.Val "MICROSAR RTE" /begin SUB_GROUP /end SUB_GROUP /begin FUNCTION_LIST /end FUNCTION_LIST /begin REF_CHARACTERISTIC CalRegn01Inin00.MotTqCmdScaMin.Val /end REF_CHARACTERISTIC /begin REF_MEASUREMENT /end REF_MEASUREMENT /end GROUP
/begin GROUP CalRegn01Inin00.MotTqTranlDampgCmdLim.Val "MICROSAR RTE" /begin SUB_GROUP /end SUB_GROUP /begin FUNCTION_LIST /end FUNCTION_LIST /begin REF_CHARACTERISTIC CalRegn01Inin00.MotTqTranlDampgCmdLim.Val /end REF_CHARACTERISTIC /begin REF_MEASUREMENT /end REF_MEASUREMENT /end GROUP
/begin GROUP CalRegn01Inin00.MotTqTranlDampgDampgCoeff.Val "MICROSAR RTE" /begin SUB_GROUP /end SUB_GROUP /begin FUNCTION_LIST /end FUNCTION_LIST /begin REF_CHARACTERISTIC CalRegn01Inin00.MotTqTranlDampgDampgCoeff.Val /end REF_CHARACTERISTIC /begin REF_MEASUREMENT /end REF_MEASUREMENT /end GROUP
/begin GROUP CalRegn01Inin00.MotTqTranlDampgRampEnd.Val "MICROSAR RTE" /begin SUB_GROUP /end SUB_GROUP /begin FUNCTION_LIST /end FUNCTION_LIST /begin REF_CHARACTERISTIC CalRegn01Inin00.MotTqTranlDampgRampEnd.Val /end REF_CHARACTERISTIC /begin REF_MEASUREMENT /end REF_MEASUREMENT /end GROUP
/begin GROUP CalRegn01Inin00.MotTqTranlDampgTmrPt1.Val "MICROSAR RTE" /begin SUB_GROUP /end SUB_GROUP /begin FUNCTION_LIST /end FUNCTION_LIST /begin REF_CHARACTERISTIC CalRegn01Inin00.MotTqTranlDampgTmrPt1.Val /end REF_CHARACTERISTIC /begin REF_MEASUREMENT /end REF_MEASUREMENT /end GROUP
/begin GROUP CalRegn01Inin00.MotTqTranlDampgTmrPt2.Val "MICROSAR RTE" /begin SUB_GROUP /end SUB_GROUP /begin FUNCTION_LIST /end FUNCTION_LIST /begin REF_CHARACTERISTIC CalRegn01Inin00.MotTqTranlDampgTmrPt2.Val /end REF_CHARACTERISTIC /begin REF_MEASUREMENT /end REF_MEASUREMENT /end GROUP
/begin GROUP CalRegn01Inin00.MotTqTranlDampgVehSpdBlndX.Ary1D "MICROSAR RTE" /begin SUB_GROUP /end SUB_GROUP /begin FUNCTION_LIST /end FUNCTION_LIST /begin REF_CHARACTERISTIC CalRegn01Inin00.MotTqTranlDampgVehSpdBlndX.Ary1D /end REF_CHARACTERISTIC /begin REF_MEASUREMENT /end REF_MEASUREMENT /end GROUP
/begin GROUP CalRegn01Inin00.MotTqTranlDampgVelThd.Val "MICROSAR RTE" /begin SUB_GROUP /end SUB_GROUP /begin FUNCTION_LIST /end FUNCTION_LIST /begin REF_CHARACTERISTIC CalRegn01Inin00.MotTqTranlDampgVelThd.Val /end REF_CHARACTERISTIC /begin REF_MEASUREMENT /end REF_MEASUREMENT /end GROUP
/begin GROUP CalRegn01Inin00.PwrDiscnctBattVltgExtdNormThd.Val "MICROSAR RTE" /begin SUB_GROUP /end SUB_GROUP /begin FUNCTION_LIST /end FUNCTION_LIST /begin REF_CHARACTERISTIC CalRegn01Inin00.PwrDiscnctBattVltgExtdNormThd.Val /end REF_CHARACTERISTIC /begin REF_MEASUREMENT /end REF_MEASUREMENT /end GROUP
/begin GROUP CalRegn01Inin00.PwrDiscnctBattVltgNonExtdThd.Val "MICROSAR RTE" /begin SUB_GROUP /end SUB_GROUP /begin FUNCTION_LIST /end FUNCTION_LIST /begin REF_CHARACTERISTIC CalRegn01Inin00.PwrDiscnctBattVltgNonExtdThd.Val /end REF_CHARACTERISTIC /begin REF_MEASUREMENT /end REF_MEASUREMENT /end GROUP
/begin GROUP CalRegn01Inin00.PwrDiscnctChrgMinDeltaExtOper.Val "MICROSAR RTE" /begin SUB_GROUP /end SUB_GROUP /begin FUNCTION_LIST /end FUNCTION_LIST /begin REF_CHARACTERISTIC CalRegn01Inin00.PwrDiscnctChrgMinDeltaExtOper.Val /end REF_CHARACTERISTIC /begin REF_MEASUREMENT /end REF_MEASUREMENT /end GROUP
/begin GROUP CalRegn01Inin00.PwrDiscnctChrgMinDeltaNonOper.Val "MICROSAR RTE" /begin SUB_GROUP /end SUB_GROUP /begin FUNCTION_LIST /end FUNCTION_LIST /begin REF_CHARACTERISTIC CalRegn01Inin00.PwrDiscnctChrgMinDeltaNonOper.Val /end REF_CHARACTERISTIC /begin REF_MEASUREMENT /end REF_MEASUREMENT /end GROUP
/begin GROUP CalRegn01Inin00.PwrDiscnctChrgMinDeltaNormOper.Val "MICROSAR RTE" /begin SUB_GROUP /end SUB_GROUP /begin FUNCTION_LIST /end FUNCTION_LIST /begin REF_CHARACTERISTIC CalRegn01Inin00.PwrDiscnctChrgMinDeltaNormOper.Val /end REF_CHARACTERISTIC /begin REF_MEASUREMENT /end REF_MEASUREMENT /end GROUP
/begin GROUP CalRegn01Inin00.PwrDiscnctChrgPmpDiagOpenThd.Val "MICROSAR RTE" /begin SUB_GROUP /end SUB_GROUP /begin FUNCTION_LIST /end FUNCTION_LIST /begin REF_CHARACTERISTIC CalRegn01Inin00.PwrDiscnctChrgPmpDiagOpenThd.Val /end REF_CHARACTERISTIC /begin REF_MEASUREMENT /end REF_MEASUREMENT /end GROUP
/begin GROUP CalRegn01Inin00.PwrDiscnctDeltaSwtClsThd.Val "MICROSAR RTE" /begin SUB_GROUP /end SUB_GROUP /begin FUNCTION_LIST /end FUNCTION_LIST /begin REF_CHARACTERISTIC CalRegn01Inin00.PwrDiscnctDeltaSwtClsThd.Val /end REF_CHARACTERISTIC /begin REF_MEASUREMENT /end REF_MEASUREMENT /end GROUP
/begin GROUP CalRegn01Inin00.PwrDiscnctDeltaVltgClsThd.Val "MICROSAR RTE" /begin SUB_GROUP /end SUB_GROUP /begin FUNCTION_LIST /end FUNCTION_LIST /begin REF_CHARACTERISTIC CalRegn01Inin00.PwrDiscnctDeltaVltgClsThd.Val /end REF_CHARACTERISTIC /begin REF_MEASUREMENT /end REF_MEASUREMENT /end GROUP
/begin GROUP CalRegn01Inin00.PwrDiscnctDeltaVltgOpenThd.Val "MICROSAR RTE" /begin SUB_GROUP /end SUB_GROUP /begin FUNCTION_LIST /end FUNCTION_LIST /begin REF_CHARACTERISTIC CalRegn01Inin00.PwrDiscnctDeltaVltgOpenThd.Val /end REF_CHARACTERISTIC /begin REF_MEASUREMENT /end REF_MEASUREMENT /end GROUP
/begin GROUP CalRegn01Inin00.PwrDiscnctFltFailStep.Val "MICROSAR RTE" /begin SUB_GROUP /end SUB_GROUP /begin FUNCTION_LIST /end FUNCTION_LIST /begin REF_CHARACTERISTIC CalRegn01Inin00.PwrDiscnctFltFailStep.Val /end REF_CHARACTERISTIC /begin REF_MEASUREMENT /end REF_MEASUREMENT /end GROUP
/begin GROUP CalRegn01Inin00.PwrDiscnctFltPassStep.Val "MICROSAR RTE" /begin SUB_GROUP /end SUB_GROUP /begin FUNCTION_LIST /end FUNCTION_LIST /begin REF_CHARACTERISTIC CalRegn01Inin00.PwrDiscnctFltPassStep.Val /end REF_CHARACTERISTIC /begin REF_MEASUREMENT /end REF_MEASUREMENT /end GROUP
/begin GROUP CalRegn01Inin00.PwrDiscnctFltThd.Val "MICROSAR RTE" /begin SUB_GROUP /end SUB_GROUP /begin FUNCTION_LIST /end FUNCTION_LIST /begin REF_CHARACTERISTIC CalRegn01Inin00.PwrDiscnctFltThd.Val /end REF_CHARACTERISTIC /begin REF_MEASUREMENT /end REF_MEASUREMENT /end GROUP
/begin GROUP CalRegn01Inin00.PwrDiscnctMtrMtnThd.Val "MICROSAR RTE" /begin SUB_GROUP /end SUB_GROUP /begin FUNCTION_LIST /end FUNCTION_LIST /begin REF_CHARACTERISTIC CalRegn01Inin00.PwrDiscnctMtrMtnThd.Val /end REF_CHARACTERISTIC /begin REF_MEASUREMENT /end REF_MEASUREMENT /end GROUP
/begin GROUP CalRegn01Inin00.PwrDiscnctPwrDiscnctRtFltFailStep.Val "MICROSAR RTE" /begin SUB_GROUP /end SUB_GROUP /begin FUNCTION_LIST /end FUNCTION_LIST /begin REF_CHARACTERISTIC CalRegn01Inin00.PwrDiscnctPwrDiscnctRtFltFailStep.Val /end REF_CHARACTERISTIC /begin REF_MEASUREMENT /end REF_MEASUREMENT /end GROUP
/begin GROUP CalRegn01Inin00.PwrDiscnctPwrDiscnctRtFltPassStep.Val "MICROSAR RTE" /begin SUB_GROUP /end SUB_GROUP /begin FUNCTION_LIST /end FUNCTION_LIST /begin REF_CHARACTERISTIC CalRegn01Inin00.PwrDiscnctPwrDiscnctRtFltPassStep.Val /end REF_CHARACTERISTIC /begin REF_MEASUREMENT /end REF_MEASUREMENT /end GROUP
/begin GROUP CalRegn01Inin00.PwrDiscnctSwtDiagOpenThd.Val "MICROSAR RTE" /begin SUB_GROUP /end SUB_GROUP /begin FUNCTION_LIST /end FUNCTION_LIST /begin REF_CHARACTERISTIC CalRegn01Inin00.PwrDiscnctSwtDiagOpenThd.Val /end REF_CHARACTERISTIC /begin REF_MEASUREMENT /end REF_MEASUREMENT /end GROUP
/begin GROUP CalRegn01Inin00.SysFricLrngAvrgFricFrq.Val "MICROSAR RTE" /begin SUB_GROUP /end SUB_GROUP /begin FUNCTION_LIST /end FUNCTION_LIST /begin REF_CHARACTERISTIC CalRegn01Inin00.SysFricLrngAvrgFricFrq.Val /end REF_CHARACTERISTIC /begin REF_MEASUREMENT /end REF_MEASUREMENT /end GROUP
/begin GROUP CalRegn01Inin00.SysFricLrngBasLineEolFric.Val "MICROSAR RTE" /begin SUB_GROUP /end SUB_GROUP /begin FUNCTION_LIST /end FUNCTION_LIST /begin REF_CHARACTERISTIC CalRegn01Inin00.SysFricLrngBasLineEolFric.Val /end REF_CHARACTERISTIC /begin REF_MEASUREMENT /end REF_MEASUREMENT /end GROUP
/begin GROUP CalRegn01Inin00.SysFricLrngBasLineFric.Ary1D "MICROSAR RTE" /begin SUB_GROUP /end SUB_GROUP /begin FUNCTION_LIST /end FUNCTION_LIST /begin REF_CHARACTERISTIC CalRegn01Inin00.SysFricLrngBasLineFric.Ary1D /end REF_CHARACTERISTIC /begin REF_MEASUREMENT /end REF_MEASUREMENT /end GROUP
/begin GROUP CalRegn01Inin00.SysFricLrngBasLineHys.Ary2D "MICROSAR RTE" /begin SUB_GROUP /end SUB_GROUP /begin FUNCTION_LIST /end FUNCTION_LIST /begin REF_CHARACTERISTIC CalRegn01Inin00.SysFricLrngBasLineHys.Ary2D /end REF_CHARACTERISTIC /begin REF_MEASUREMENT /end REF_MEASUREMENT /end GROUP
/begin GROUP CalRegn01Inin00.SysFricLrngBasLineRngCntr.Ary2D "MICROSAR RTE" /begin SUB_GROUP /end SUB_GROUP /begin FUNCTION_LIST /end FUNCTION_LIST /begin REF_CHARACTERISTIC CalRegn01Inin00.SysFricLrngBasLineRngCntr.Ary2D /end REF_CHARACTERISTIC /begin REF_MEASUREMENT /end REF_MEASUREMENT /end GROUP
/begin GROUP CalRegn01Inin00.SysFricLrngDataPrepLpFilFrq.Val "MICROSAR RTE" /begin SUB_GROUP /end SUB_GROUP /begin FUNCTION_LIST /end FUNCTION_LIST /begin REF_CHARACTERISTIC CalRegn01Inin00.SysFricLrngDataPrepLpFilFrq.Val /end REF_CHARACTERISTIC /begin REF_MEASUREMENT /end REF_MEASUREMENT /end GROUP
/begin GROUP CalRegn01Inin00.SysFricLrngDebStep.Val "MICROSAR RTE" /begin SUB_GROUP /end SUB_GROUP /begin FUNCTION_LIST /end FUNCTION_LIST /begin REF_CHARACTERISTIC CalRegn01Inin00.SysFricLrngDebStep.Val /end REF_CHARACTERISTIC /begin REF_MEASUREMENT /end REF_MEASUREMENT /end GROUP
/begin GROUP CalRegn01Inin00.SysFricLrngEolFricDifHiLim.Val "MICROSAR RTE" /begin SUB_GROUP /end SUB_GROUP /begin FUNCTION_LIST /end FUNCTION_LIST /begin REF_CHARACTERISTIC CalRegn01Inin00.SysFricLrngEolFricDifHiLim.Val /end REF_CHARACTERISTIC /begin REF_MEASUREMENT /end REF_MEASUREMENT /end GROUP
/begin GROUP CalRegn01Inin00.SysFricLrngEolFricDifLoLim.Val "MICROSAR RTE" /begin SUB_GROUP /end SUB_GROUP /begin FUNCTION_LIST /end FUNCTION_LIST /begin REF_CHARACTERISTIC CalRegn01Inin00.SysFricLrngEolFricDifLoLim.Val /end REF_CHARACTERISTIC /begin REF_MEASUREMENT /end REF_MEASUREMENT /end GROUP
/begin GROUP CalRegn01Inin00.SysFricLrngEolFricDifScagFac.Val "MICROSAR RTE" /begin SUB_GROUP /end SUB_GROUP /begin FUNCTION_LIST /end FUNCTION_LIST /begin REF_CHARACTERISTIC CalRegn01Inin00.SysFricLrngEolFricDifScagFac.Val /end REF_CHARACTERISTIC /begin REF_MEASUREMENT /end REF_MEASUREMENT /end GROUP
/begin GROUP CalRegn01Inin00.SysFricLrngFricChgWght.Ary1D "MICROSAR RTE" /begin SUB_GROUP /end SUB_GROUP /begin FUNCTION_LIST /end FUNCTION_LIST /begin REF_CHARACTERISTIC CalRegn01Inin00.SysFricLrngFricChgWght.Ary1D /end REF_CHARACTERISTIC /begin REF_MEASUREMENT /end REF_MEASUREMENT /end GROUP
/begin GROUP CalRegn01Inin00.SysFricLrngFricDiagcThd.Val "MICROSAR RTE" /begin SUB_GROUP /end SUB_GROUP /begin FUNCTION_LIST /end FUNCTION_LIST /begin REF_CHARACTERISTIC CalRegn01Inin00.SysFricLrngFricDiagcThd.Val /end REF_CHARACTERISTIC /begin REF_MEASUREMENT /end REF_MEASUREMENT /end GROUP
/begin GROUP CalRegn01Inin00.SysFricLrngFricHysHwAgPt.Ary1D "MICROSAR RTE" /begin SUB_GROUP /end SUB_GROUP /begin FUNCTION_LIST /end FUNCTION_LIST /begin REF_CHARACTERISTIC CalRegn01Inin00.SysFricLrngFricHysHwAgPt.Ary1D /end REF_CHARACTERISTIC /begin REF_MEASUREMENT /end REF_MEASUREMENT /end GROUP
/begin GROUP CalRegn01Inin00.SysFricLrngFricOffs.Val "MICROSAR RTE" /begin SUB_GROUP /end SUB_GROUP /begin FUNCTION_LIST /end FUNCTION_LIST /begin REF_CHARACTERISTIC CalRegn01Inin00.SysFricLrngFricOffs.Val /end REF_CHARACTERISTIC /begin REF_MEASUREMENT /end REF_MEASUREMENT /end GROUP
/begin GROUP CalRegn01Inin00.SysFricLrngFricOffsHiLim.Val "MICROSAR RTE" /begin SUB_GROUP /end SUB_GROUP /begin FUNCTION_LIST /end FUNCTION_LIST /begin REF_CHARACTERISTIC CalRegn01Inin00.SysFricLrngFricOffsHiLim.Val /end REF_CHARACTERISTIC /begin REF_MEASUREMENT /end REF_MEASUREMENT /end GROUP
/begin GROUP CalRegn01Inin00.SysFricLrngFricOffsLoLim.Val "MICROSAR RTE" /begin SUB_GROUP /end SUB_GROUP /begin FUNCTION_LIST /end FUNCTION_LIST /begin REF_CHARACTERISTIC CalRegn01Inin00.SysFricLrngFricOffsLoLim.Val /end REF_CHARACTERISTIC /begin REF_MEASUREMENT /end REF_MEASUREMENT /end GROUP
/begin GROUP CalRegn01Inin00.SysFricLrngFricOffsLpFilFrq.Val "MICROSAR RTE" /begin SUB_GROUP /end SUB_GROUP /begin FUNCTION_LIST /end FUNCTION_LIST /begin REF_CHARACTERISTIC CalRegn01Inin00.SysFricLrngFricOffsLpFilFrq.Val /end REF_CHARACTERISTIC /begin REF_MEASUREMENT /end REF_MEASUREMENT /end GROUP
/begin GROUP CalRegn01Inin00.SysFricLrngGain.Val "MICROSAR RTE" /begin SUB_GROUP /end SUB_GROUP /begin FUNCTION_LIST /end FUNCTION_LIST /begin REF_CHARACTERISTIC CalRegn01Inin00.SysFricLrngGain.Val /end REF_CHARACTERISTIC /begin REF_MEASUREMENT /end REF_MEASUREMENT /end GROUP
/begin GROUP CalRegn01Inin00.SysFricLrngHiFricDebStep.Val "MICROSAR RTE" /begin SUB_GROUP /end SUB_GROUP /begin FUNCTION_LIST /end FUNCTION_LIST /begin REF_CHARACTERISTIC CalRegn01Inin00.SysFricLrngHiFricDebStep.Val /end REF_CHARACTERISTIC /begin REF_MEASUREMENT /end REF_MEASUREMENT /end GROUP
/begin GROUP CalRegn01Inin00.SysFricLrngHiFricDiagcThd.Val "MICROSAR RTE" /begin SUB_GROUP /end SUB_GROUP /begin FUNCTION_LIST /end FUNCTION_LIST /begin REF_CHARACTERISTIC CalRegn01Inin00.SysFricLrngHiFricDiagcThd.Val /end REF_CHARACTERISTIC /begin REF_MEASUREMENT /end REF_MEASUREMENT /end GROUP
/begin GROUP CalRegn01Inin00.SysFricLrngHwPosnAuthyThd.Val "MICROSAR RTE" /begin SUB_GROUP /end SUB_GROUP /begin FUNCTION_LIST /end FUNCTION_LIST /begin REF_CHARACTERISTIC CalRegn01Inin00.SysFricLrngHwPosnAuthyThd.Val /end REF_CHARACTERISTIC /begin REF_MEASUREMENT /end REF_MEASUREMENT /end GROUP
/begin GROUP CalRegn01Inin00.SysFricLrngHwVelConstrLim.Val "MICROSAR RTE" /begin SUB_GROUP /end SUB_GROUP /begin FUNCTION_LIST /end FUNCTION_LIST /begin REF_CHARACTERISTIC CalRegn01Inin00.SysFricLrngHwVelConstrLim.Val /end REF_CHARACTERISTIC /begin REF_MEASUREMENT /end REF_MEASUREMENT /end GROUP
/begin GROUP CalRegn01Inin00.SysFricLrngHwVelHiLim.Val "MICROSAR RTE" /begin SUB_GROUP /end SUB_GROUP /begin FUNCTION_LIST /end FUNCTION_LIST /begin REF_CHARACTERISTIC CalRegn01Inin00.SysFricLrngHwVelHiLim.Val /end REF_CHARACTERISTIC /begin REF_MEASUREMENT /end REF_MEASUREMENT /end GROUP
/begin GROUP CalRegn01Inin00.SysFricLrngHwVelLoLim.Val "MICROSAR RTE" /begin SUB_GROUP /end SUB_GROUP /begin FUNCTION_LIST /end FUNCTION_LIST /begin REF_CHARACTERISTIC CalRegn01Inin00.SysFricLrngHwVelLoLim.Val /end REF_CHARACTERISTIC /begin REF_MEASUREMENT /end REF_MEASUREMENT /end GROUP
/begin GROUP CalRegn01Inin00.SysFricLrngIgnCycFricChgLim.Val "MICROSAR RTE" /begin SUB_GROUP /end SUB_GROUP /begin FUNCTION_LIST /end FUNCTION_LIST /begin REF_CHARACTERISTIC CalRegn01Inin00.SysFricLrngIgnCycFricChgLim.Val /end REF_CHARACTERISTIC /begin REF_MEASUREMENT /end REF_MEASUREMENT /end GROUP
/begin GROUP CalRegn01Inin00.SysFricLrngIgnCycFricOffs.Val "MICROSAR RTE" /begin SUB_GROUP /end SUB_GROUP /begin FUNCTION_LIST /end FUNCTION_LIST /begin REF_CHARACTERISTIC CalRegn01Inin00.SysFricLrngIgnCycFricOffs.Val /end REF_CHARACTERISTIC /begin REF_MEASUREMENT /end REF_MEASUREMENT /end GROUP
/begin GROUP CalRegn01Inin00.SysFricLrngIvsTrsmRatX.Ary1D "MICROSAR RTE" /begin SUB_GROUP /end SUB_GROUP /begin FUNCTION_LIST /end FUNCTION_LIST /begin REF_CHARACTERISTIC CalRegn01Inin00.SysFricLrngIvsTrsmRatX.Ary1D /end REF_CHARACTERISTIC /begin REF_MEASUREMENT /end REF_MEASUREMENT /end GROUP
/begin GROUP CalRegn01Inin00.SysFricLrngIvsTrsmRatY.Ary1D "MICROSAR RTE" /begin SUB_GROUP /end SUB_GROUP /begin FUNCTION_LIST /end FUNCTION_LIST /begin REF_CHARACTERISTIC CalRegn01Inin00.SysFricLrngIvsTrsmRatY.Ary1D /end REF_CHARACTERISTIC /begin REF_MEASUREMENT /end REF_MEASUREMENT /end GROUP
/begin GROUP CalRegn01Inin00.SysFricLrngLatAHiLim.Val "MICROSAR RTE" /begin SUB_GROUP /end SUB_GROUP /begin FUNCTION_LIST /end FUNCTION_LIST /begin REF_CHARACTERISTIC CalRegn01Inin00.SysFricLrngLatAHiLim.Val /end REF_CHARACTERISTIC /begin REF_MEASUREMENT /end REF_MEASUREMENT /end GROUP
/begin GROUP CalRegn01Inin00.SysFricLrngLatALoLim.Val "MICROSAR RTE" /begin SUB_GROUP /end SUB_GROUP /begin FUNCTION_LIST /end FUNCTION_LIST /begin REF_CHARACTERISTIC CalRegn01Inin00.SysFricLrngLatALoLim.Val /end REF_CHARACTERISTIC /begin REF_MEASUREMENT /end REF_MEASUREMENT /end GROUP
/begin GROUP CalRegn01Inin00.SysFricLrngMaskVehSpd.Ary1D "MICROSAR RTE" /begin SUB_GROUP /end SUB_GROUP /begin FUNCTION_LIST /end FUNCTION_LIST /begin REF_CHARACTERISTIC CalRegn01Inin00.SysFricLrngMaskVehSpd.Ary1D /end REF_CHARACTERISTIC /begin REF_MEASUREMENT /end REF_MEASUREMENT /end GROUP
/begin GROUP CalRegn01Inin00.SysFricLrngRngCntrThd.Val "MICROSAR RTE" /begin SUB_GROUP /end SUB_GROUP /begin FUNCTION_LIST /end FUNCTION_LIST /begin REF_CHARACTERISTIC CalRegn01Inin00.SysFricLrngRngCntrThd.Val /end REF_CHARACTERISTIC /begin REF_MEASUREMENT /end REF_MEASUREMENT /end GROUP
/begin GROUP CalRegn01Inin00.SysFricLrngTHiLim.Val "MICROSAR RTE" /begin SUB_GROUP /end SUB_GROUP /begin FUNCTION_LIST /end FUNCTION_LIST /begin REF_CHARACTERISTIC CalRegn01Inin00.SysFricLrngTHiLim.Val /end REF_CHARACTERISTIC /begin REF_MEASUREMENT /end REF_MEASUREMENT /end GROUP
/begin GROUP CalRegn01Inin00.SysFricLrngTLoLim.Val "MICROSAR RTE" /begin SUB_GROUP /end SUB_GROUP /begin FUNCTION_LIST /end FUNCTION_LIST /begin REF_CHARACTERISTIC CalRegn01Inin00.SysFricLrngTLoLim.Val /end REF_CHARACTERISTIC /begin REF_MEASUREMENT /end REF_MEASUREMENT /end GROUP
/begin GROUP CalRegn01Inin00.SysFricLrngThd.Val "MICROSAR RTE" /begin SUB_GROUP /end SUB_GROUP /begin FUNCTION_LIST /end FUNCTION_LIST /begin REF_CHARACTERISTIC CalRegn01Inin00.SysFricLrngThd.Val /end REF_CHARACTERISTIC /begin REF_MEASUREMENT /end REF_MEASUREMENT /end GROUP
/begin GROUP CalRegn01Inin00.SysFricLrngVehSpd.Ary2D "MICROSAR RTE" /begin SUB_GROUP /end SUB_GROUP /begin FUNCTION_LIST /end FUNCTION_LIST /begin REF_CHARACTERISTIC CalRegn01Inin00.SysFricLrngVehSpd.Ary2D /end REF_CHARACTERISTIC /begin REF_MEASUREMENT /end REF_MEASUREMENT /end GROUP
/begin GROUP CalRegn01Inin00.SysGlbPrmMotPoleCnt.Val "MICROSAR RTE" /begin SUB_GROUP /end SUB_GROUP /begin FUNCTION_LIST /end FUNCTION_LIST /begin REF_CHARACTERISTIC CalRegn01Inin00.SysGlbPrmMotPoleCnt.Val /end REF_CHARACTERISTIC /begin REF_MEASUREMENT /end REF_MEASUREMENT /end GROUP
/begin GROUP CalRegn01Inin00.SysGlbPrmSysTqRat.Val "MICROSAR RTE" /begin SUB_GROUP /end SUB_GROUP /begin FUNCTION_LIST /end FUNCTION_LIST /begin REF_CHARACTERISTIC CalRegn01Inin00.SysGlbPrmSysTqRat.Val /end REF_CHARACTERISTIC /begin REF_MEASUREMENT /end REF_MEASUREMENT /end GROUP
/begin GROUP CalRegn01Inin00.SysGlbPrmTorsBarStfn.Val "MICROSAR RTE" /begin SUB_GROUP /end SUB_GROUP /begin FUNCTION_LIST /end FUNCTION_LIST /begin REF_CHARACTERISTIC CalRegn01Inin00.SysGlbPrmTorsBarStfn.Val /end REF_CHARACTERISTIC /begin REF_MEASUREMENT /end REF_MEASUREMENT /end GROUP
/begin GROUP CalRegn01Inin00.SysGlbPrmVehSpdBilnrSeln.Ary1D "MICROSAR RTE" /begin SUB_GROUP /end SUB_GROUP /begin FUNCTION_LIST /end FUNCTION_LIST /begin REF_CHARACTERISTIC CalRegn01Inin00.SysGlbPrmVehSpdBilnrSeln.Ary1D /end REF_CHARACTERISTIC /begin REF_MEASUREMENT /end REF_MEASUREMENT /end GROUP
/begin GROUP CalRegn01Inin00.TEstimnAmbPwrMplr.Ary1D "MICROSAR RTE" /begin SUB_GROUP /end SUB_GROUP /begin FUNCTION_LIST /end FUNCTION_LIST /begin REF_CHARACTERISTIC CalRegn01Inin00.TEstimnAmbPwrMplr.Ary1D /end REF_CHARACTERISTIC /begin REF_MEASUREMENT /end REF_MEASUREMENT /end GROUP
/begin GROUP CalRegn01Inin00.TEstimnAmbTSca.Ary1D "MICROSAR RTE" /begin SUB_GROUP /end SUB_GROUP /begin FUNCTION_LIST /end FUNCTION_LIST /begin REF_CHARACTERISTIC CalRegn01Inin00.TEstimnAmbTSca.Ary1D /end REF_CHARACTERISTIC /begin REF_MEASUREMENT /end REF_MEASUREMENT /end GROUP
/begin GROUP CalRegn01Inin00.TEstimnAssiMechAmbLpFilFrq.Val "MICROSAR RTE" /begin SUB_GROUP /end SUB_GROUP /begin FUNCTION_LIST /end FUNCTION_LIST /begin REF_CHARACTERISTIC CalRegn01Inin00.TEstimnAssiMechAmbLpFilFrq.Val /end REF_CHARACTERISTIC /begin REF_MEASUREMENT /end REF_MEASUREMENT /end GROUP
/begin GROUP CalRegn01Inin00.TEstimnAssiMechAmbLpFilFrqDualEcuFltMtgtn.Val "MICROSAR RTE" /begin SUB_GROUP /end SUB_GROUP /begin FUNCTION_LIST /end FUNCTION_LIST
 /begin REF_CHARACTERISTIC CalRegn01Inin00.TEstimnAssiMechAmbLpFilFrqDualEcuFltMtgtn.Val /end REF_CHARACTERISTIC
 /begin REF_MEASUREMENT /end REF_MEASUREMENT
/end GROUP
/begin GROUP CalRegn01Inin00.TEstimnAssiMechAmbLpFilFrqFetMtgtnEna.Val "MICROSAR RTE" /begin SUB_GROUP /end SUB_GROUP /begin FUNCTION_LIST /end FUNCTION_LIST /begin REF_CHARACTERISTIC CalRegn01Inin00.TEstimnAssiMechAmbLpFilFrqFetMtgtnEna.Val /end REF_CHARACTERISTIC /begin REF_MEASUREMENT /end REF_MEASUREMENT /end GROUP
/begin GROUP CalRegn01Inin00.TEstimnAssiMechAmbMplr.Ary1D "MICROSAR RTE" /begin SUB_GROUP /end SUB_GROUP /begin FUNCTION_LIST /end FUNCTION_LIST /begin REF_CHARACTERISTIC CalRegn01Inin00.TEstimnAssiMechAmbMplr.Ary1D /end REF_CHARACTERISTIC /begin REF_MEASUREMENT /end REF_MEASUREMENT /end GROUP
/begin GROUP CalRegn01Inin00.TEstimnAssiMechCorrLim.Ary1D "MICROSAR RTE" /begin SUB_GROUP /end SUB_GROUP /begin FUNCTION_LIST /end FUNCTION_LIST /begin REF_CHARACTERISTIC CalRegn01Inin00.TEstimnAssiMechCorrLim.Ary1D /end REF_CHARACTERISTIC /begin REF_MEASUREMENT /end REF_MEASUREMENT /end GROUP
/begin GROUP CalRegn01Inin00.TEstimnAssiMechDampgSca.Ary1D "MICROSAR RTE" /begin SUB_GROUP /end SUB_GROUP /begin FUNCTION_LIST /end FUNCTION_LIST /begin REF_CHARACTERISTIC CalRegn01Inin00.TEstimnAssiMechDampgSca.Ary1D /end REF_CHARACTERISTIC /begin REF_MEASUREMENT /end REF_MEASUREMENT /end GROUP
/begin GROUP CalRegn01Inin00.TEstimnAssiMechDftT.Ary1D "MICROSAR RTE" /begin SUB_GROUP /end SUB_GROUP /begin FUNCTION_LIST /end FUNCTION_LIST /begin REF_CHARACTERISTIC CalRegn01Inin00.TEstimnAssiMechDftT.Ary1D /end REF_CHARACTERISTIC /begin REF_MEASUREMENT /end REF_MEASUREMENT /end GROUP
/begin GROUP CalRegn01Inin00.TEstimnAssiMechLLFilCoeffA1.Ary1D "MICROSAR RTE" /begin SUB_GROUP /end SUB_GROUP /begin FUNCTION_LIST /end FUNCTION_LIST /begin REF_CHARACTERISTIC CalRegn01Inin00.TEstimnAssiMechLLFilCoeffA1.Ary1D /end REF_CHARACTERISTIC /begin REF_MEASUREMENT /end REF_MEASUREMENT /end GROUP
/begin GROUP CalRegn01Inin00.TEstimnAssiMechLLFilCoeffB0.Ary1D "MICROSAR RTE" /begin SUB_GROUP /end SUB_GROUP /begin FUNCTION_LIST /end FUNCTION_LIST /begin REF_CHARACTERISTIC CalRegn01Inin00.TEstimnAssiMechLLFilCoeffB0.Ary1D /end REF_CHARACTERISTIC /begin REF_MEASUREMENT /end REF_MEASUREMENT /end GROUP
/begin GROUP CalRegn01Inin00.TEstimnAssiMechLLFilCoeffB1.Ary1D "MICROSAR RTE" /begin SUB_GROUP /end SUB_GROUP /begin FUNCTION_LIST /end FUNCTION_LIST /begin REF_CHARACTERISTIC CalRegn01Inin00.TEstimnAssiMechLLFilCoeffB1.Ary1D /end REF_CHARACTERISTIC /begin REF_MEASUREMENT /end REF_MEASUREMENT /end GROUP
/begin GROUP CalRegn01Inin00.TEstimnAssiMechSlew.Ary1D "MICROSAR RTE" /begin SUB_GROUP /end SUB_GROUP /begin FUNCTION_LIST /end FUNCTION_LIST /begin REF_CHARACTERISTIC CalRegn01Inin00.TEstimnAssiMechSlew.Ary1D /end REF_CHARACTERISTIC /begin REF_MEASUREMENT /end REF_MEASUREMENT /end GROUP
/begin GROUP CalRegn01Inin00.TEstimnCorrnTAssiMech.Ary1D "MICROSAR RTE" /begin SUB_GROUP /end SUB_GROUP /begin FUNCTION_LIST /end FUNCTION_LIST /begin REF_CHARACTERISTIC CalRegn01Inin00.TEstimnCorrnTAssiMech.Ary1D /end REF_CHARACTERISTIC /begin REF_MEASUREMENT /end REF_MEASUREMENT /end GROUP
/begin GROUP CalRegn01Inin00.TEstimnCorrnTCu.Ary1D "MICROSAR RTE" /begin SUB_GROUP /end SUB_GROUP /begin FUNCTION_LIST /end FUNCTION_LIST /begin REF_CHARACTERISTIC CalRegn01Inin00.TEstimnCorrnTCu.Ary1D /end REF_CHARACTERISTIC /begin REF_MEASUREMENT /end REF_MEASUREMENT /end GROUP
/begin GROUP CalRegn01Inin00.TEstimnCorrnTMag.Ary1D "MICROSAR RTE" /begin SUB_GROUP /end SUB_GROUP /begin FUNCTION_LIST /end FUNCTION_LIST /begin REF_CHARACTERISTIC CalRegn01Inin00.TEstimnCorrnTMag.Ary1D /end REF_CHARACTERISTIC /begin REF_MEASUREMENT /end REF_MEASUREMENT /end GROUP
/begin GROUP CalRegn01Inin00.TEstimnCorrnTSi.Ary1D "MICROSAR RTE" /begin SUB_GROUP /end SUB_GROUP /begin FUNCTION_LIST /end FUNCTION_LIST /begin REF_CHARACTERISTIC CalRegn01Inin00.TEstimnCorrnTSi.Ary1D /end REF_CHARACTERISTIC /begin REF_MEASUREMENT /end REF_MEASUREMENT /end GROUP
/begin GROUP CalRegn01Inin00.TEstimnCuAmbLpFilFrq.Val "MICROSAR RTE" /begin SUB_GROUP /end SUB_GROUP /begin FUNCTION_LIST /end FUNCTION_LIST /begin REF_CHARACTERISTIC CalRegn01Inin00.TEstimnCuAmbLpFilFrq.Val /end REF_CHARACTERISTIC /begin REF_MEASUREMENT /end REF_MEASUREMENT /end GROUP
/begin GROUP CalRegn01Inin00.TEstimnCuAmbLpFilFrqDualEcuFltMtgtn.Val "MICROSAR RTE" /begin SUB_GROUP /end SUB_GROUP /begin FUNCTION_LIST /end FUNCTION_LIST /begin REF_CHARACTERISTIC CalRegn01Inin00.TEstimnCuAmbLpFilFrqDualEcuFltMtgtn.Val /end REF_CHARACTERISTIC /begin REF_MEASUREMENT /end REF_MEASUREMENT /end GROUP
/begin GROUP CalRegn01Inin00.TEstimnCuAmbLpFilFrqFetMtgtnEna.Val "MICROSAR RTE" /begin SUB_GROUP /end SUB_GROUP /begin FUNCTION_LIST /end FUNCTION_LIST /begin REF_CHARACTERISTIC CalRegn01Inin00.TEstimnCuAmbLpFilFrqFetMtgtnEna.Val /end REF_CHARACTERISTIC /begin REF_MEASUREMENT /end REF_MEASUREMENT /end GROUP
/begin GROUP CalRegn01Inin00.TEstimnCuAmbMplr.Ary1D "MICROSAR RTE" /begin SUB_GROUP /end SUB_GROUP /begin FUNCTION_LIST /end FUNCTION_LIST /begin REF_CHARACTERISTIC CalRegn01Inin00.TEstimnCuAmbMplr.Ary1D /end REF_CHARACTERISTIC /begin REF_MEASUREMENT /end REF_MEASUREMENT /end GROUP
/begin GROUP CalRegn01Inin00.TEstimnCuCorrnLim.Ary1D "MICROSAR RTE" /begin SUB_GROUP /end SUB_GROUP /begin FUNCTION_LIST /end FUNCTION_LIST /begin REF_CHARACTERISTIC CalRegn01Inin00.TEstimnCuCorrnLim.Ary1D /end REF_CHARACTERISTIC /begin REF_MEASUREMENT /end REF_MEASUREMENT /end GROUP
/begin GROUP CalRegn01Inin00.TEstimnCuLLFilCoeffA1.Ary1D "MICROSAR RTE" /begin SUB_GROUP /end SUB_GROUP /begin FUNCTION_LIST /end FUNCTION_LIST /begin REF_CHARACTERISTIC CalRegn01Inin00.TEstimnCuLLFilCoeffA1.Ary1D /end REF_CHARACTERISTIC /begin REF_MEASUREMENT /end REF_MEASUREMENT /end GROUP
/begin GROUP CalRegn01Inin00.TEstimnCuLLFilCoeffB0.Ary1D "MICROSAR RTE" /begin SUB_GROUP /end SUB_GROUP /begin FUNCTION_LIST /end FUNCTION_LIST /begin REF_CHARACTERISTIC CalRegn01Inin00.TEstimnCuLLFilCoeffB0.Ary1D /end REF_CHARACTERISTIC /begin REF_MEASUREMENT /end REF_MEASUREMENT /end GROUP
/begin GROUP CalRegn01Inin00.TEstimnCuLLFilCoeffB1.Ary1D "MICROSAR RTE" /begin SUB_GROUP /end SUB_GROUP /begin FUNCTION_LIST /end FUNCTION_LIST /begin REF_CHARACTERISTIC CalRegn01Inin00.TEstimnCuLLFilCoeffB1.Ary1D /end REF_CHARACTERISTIC /begin REF_MEASUREMENT /end REF_MEASUREMENT /end GROUP
/begin GROUP CalRegn01Inin00.TEstimnEngTSca.Ary1D "MICROSAR RTE" /begin SUB_GROUP /end SUB_GROUP /begin FUNCTION_LIST /end FUNCTION_LIST /begin REF_CHARACTERISTIC CalRegn01Inin00.TEstimnEngTSca.Ary1D /end REF_CHARACTERISTIC /begin REF_MEASUREMENT /end REF_MEASUREMENT /end GROUP
/begin GROUP CalRegn01Inin00.TEstimnMagAmbLpFilFrq.Val "MICROSAR RTE" /begin SUB_GROUP /end SUB_GROUP /begin FUNCTION_LIST /end FUNCTION_LIST /begin REF_CHARACTERISTIC CalRegn01Inin00.TEstimnMagAmbLpFilFrq.Val /end REF_CHARACTERISTIC /begin REF_MEASUREMENT /end REF_MEASUREMENT /end GROUP
/begin GROUP CalRegn01Inin00.TEstimnMagAmbLpFilFrqDualEcuFltMtgtn.Val "MICROSAR RTE" /begin SUB_GROUP /end SUB_GROUP /begin FUNCTION_LIST /end FUNCTION_LIST /begin REF_CHARACTERISTIC CalRegn01Inin00.TEstimnMagAmbLpFilFrqDualEcuFltMtgtn.Val /end REF_CHARACTERISTIC /begin REF_MEASUREMENT /end REF_MEASUREMENT /end GROUP
/begin GROUP CalRegn01Inin00.TEstimnMagAmbLpFilFrqFetMtgtnEna.Val "MICROSAR RTE" /begin SUB_GROUP /end SUB_GROUP /begin FUNCTION_LIST /end FUNCTION_LIST /begin REF_CHARACTERISTIC CalRegn01Inin00.TEstimnMagAmbLpFilFrqFetMtgtnEna.Val /end REF_CHARACTERISTIC /begin REF_MEASUREMENT /end REF_MEASUREMENT /end GROUP
/begin GROUP CalRegn01Inin00.TEstimnMagCorrnLim.Ary1D "MICROSAR RTE" /begin SUB_GROUP /end SUB_GROUP /begin FUNCTION_LIST /end FUNCTION_LIST /begin REF_CHARACTERISTIC CalRegn01Inin00.TEstimnMagCorrnLim.Ary1D /end REF_CHARACTERISTIC /begin REF_MEASUREMENT /end REF_MEASUREMENT /end GROUP
/begin GROUP CalRegn01Inin00.TEstimnMagLLFilCoeffA1.Ary1D "MICROSAR RTE" /begin SUB_GROUP /end SUB_GROUP /begin FUNCTION_LIST /end FUNCTION_LIST /begin REF_CHARACTERISTIC CalRegn01Inin00.TEstimnMagLLFilCoeffA1.Ary1D /end REF_CHARACTERISTIC /begin REF_MEASUREMENT /end REF_MEASUREMENT /end GROUP
/begin GROUP CalRegn01Inin00.TEstimnMagLLFilCoeffB0.Ary1D "MICROSAR RTE" /begin SUB_GROUP /end SUB_GROUP /begin FUNCTION_LIST /end FUNCTION_LIST /begin REF_CHARACTERISTIC CalRegn01Inin00.TEstimnMagLLFilCoeffB0.Ary1D /end REF_CHARACTERISTIC /begin REF_MEASUREMENT /end REF_MEASUREMENT /end GROUP
/begin GROUP CalRegn01Inin00.TEstimnMagLLFilCoeffB1.Ary1D "MICROSAR RTE" /begin SUB_GROUP /end SUB_GROUP /begin FUNCTION_LIST /end FUNCTION_LIST /begin REF_CHARACTERISTIC CalRegn01Inin00.TEstimnMagLLFilCoeffB1.Ary1D /end REF_CHARACTERISTIC /begin REF_MEASUREMENT /end REF_MEASUREMENT /end GROUP
/begin GROUP CalRegn01Inin00.TEstimnSiAmbLpFilFrq.Val "MICROSAR RTE" /begin SUB_GROUP /end SUB_GROUP /begin FUNCTION_LIST /end FUNCTION_LIST /begin REF_CHARACTERISTIC CalRegn01Inin00.TEstimnSiAmbLpFilFrq.Val /end REF_CHARACTERISTIC /begin REF_MEASUREMENT /end REF_MEASUREMENT /end GROUP
/begin GROUP CalRegn01Inin00.TEstimnSiAmbLpFilFrqDualEcuFltMtgtn.Val "MICROSAR RTE" /begin SUB_GROUP /end SUB_GROUP /begin FUNCTION_LIST /end FUNCTION_LIST /begin REF_CHARACTERISTIC CalRegn01Inin00.TEstimnSiAmbLpFilFrqDualEcuFltMtgtn.Val /end REF_CHARACTERISTIC /begin REF_MEASUREMENT /end REF_MEASUREMENT /end GROUP
/begin GROUP CalRegn01Inin00.TEstimnSiAmbLpFilFrqFetMtgtnEna.Val "MICROSAR RTE" /begin SUB_GROUP /end SUB_GROUP /begin FUNCTION_LIST /end FUNCTION_LIST /begin REF_CHARACTERISTIC CalRegn01Inin00.TEstimnSiAmbLpFilFrqFetMtgtnEna.Val /end REF_CHARACTERISTIC /begin REF_MEASUREMENT /end REF_MEASUREMENT /end GROUP
/begin GROUP CalRegn01Inin00.TEstimnSiAmbMplr.Ary1D "MICROSAR RTE" /begin SUB_GROUP /end SUB_GROUP /begin FUNCTION_LIST /end FUNCTION_LIST /begin REF_CHARACTERISTIC CalRegn01Inin00.TEstimnSiAmbMplr.Ary1D /end REF_CHARACTERISTIC /begin REF_MEASUREMENT /end REF_MEASUREMENT /end GROUP
/begin GROUP CalRegn01Inin00.TEstimnSiCorrnLim.Ary1D "MICROSAR RTE" /begin SUB_GROUP /end SUB_GROUP /begin FUNCTION_LIST /end FUNCTION_LIST /begin REF_CHARACTERISTIC CalRegn01Inin00.TEstimnSiCorrnLim.Ary1D /end REF_CHARACTERISTIC /begin REF_MEASUREMENT /end REF_MEASUREMENT /end GROUP
/begin GROUP CalRegn01Inin00.TEstimnSiLLFilCoeffA1.Ary1D "MICROSAR RTE" /begin SUB_GROUP /end SUB_GROUP /begin FUNCTION_LIST /end FUNCTION_LIST /begin REF_CHARACTERISTIC CalRegn01Inin00.TEstimnSiLLFilCoeffA1.Ary1D /end REF_CHARACTERISTIC /begin REF_MEASUREMENT /end REF_MEASUREMENT /end GROUP
/begin GROUP CalRegn01Inin00.TEstimnSiLLFilCoeffB0.Ary1D "MICROSAR RTE" /begin SUB_GROUP /end SUB_GROUP /begin FUNCTION_LIST /end FUNCTION_LIST /begin REF_CHARACTERISTIC CalRegn01Inin00.TEstimnSiLLFilCoeffB0.Ary1D /end REF_CHARACTERISTIC /begin REF_MEASUREMENT /end REF_MEASUREMENT /end GROUP
/begin GROUP CalRegn01Inin00.TEstimnSiLLFilCoeffB1.Ary1D "MICROSAR RTE" /begin SUB_GROUP /end SUB_GROUP /begin FUNCTION_LIST /end FUNCTION_LIST /begin REF_CHARACTERISTIC CalRegn01Inin00.TEstimnSiLLFilCoeffB1.Ary1D /end REF_CHARACTERISTIC /begin REF_MEASUREMENT /end REF_MEASUREMENT /end GROUP
/begin GROUP CalRegn01Inin00.TEstimnTauAssiMech.Ary1D "MICROSAR RTE" /begin SUB_GROUP /end SUB_GROUP /begin FUNCTION_LIST /end FUNCTION_LIST /begin REF_CHARACTERISTIC CalRegn01Inin00.TEstimnTauAssiMech.Ary1D /end REF_CHARACTERISTIC /begin REF_MEASUREMENT /end REF_MEASUREMENT /end GROUP
/begin GROUP CalRegn01Inin00.TEstimnTauCu.Ary1D "MICROSAR RTE" /begin SUB_GROUP /end SUB_GROUP /begin FUNCTION_LIST /end FUNCTION_LIST /begin REF_CHARACTERISTIC CalRegn01Inin00.TEstimnTauCu.Ary1D /end REF_CHARACTERISTIC /begin REF_MEASUREMENT /end REF_MEASUREMENT /end GROUP
/begin GROUP CalRegn01Inin00.TEstimnTauMag.Ary1D "MICROSAR RTE" /begin SUB_GROUP /end SUB_GROUP /begin FUNCTION_LIST /end FUNCTION_LIST /begin REF_CHARACTERISTIC CalRegn01Inin00.TEstimnTauMag.Ary1D /end REF_CHARACTERISTIC /begin REF_MEASUREMENT /end REF_MEASUREMENT /end GROUP
/begin GROUP CalRegn01Inin00.TEstimnTauSi.Ary1D "MICROSAR RTE" /begin SUB_GROUP /end SUB_GROUP /begin FUNCTION_LIST /end FUNCTION_LIST /begin REF_CHARACTERISTIC CalRegn01Inin00.TEstimnTauSi.Ary1D /end REF_CHARACTERISTIC /begin REF_MEASUREMENT /end REF_MEASUREMENT /end GROUP
/begin GROUP CalRegn01Inin00.TEstimnWghtAvrgTDi.Ary1D "MICROSAR RTE" /begin SUB_GROUP /end SUB_GROUP /begin FUNCTION_LIST /end FUNCTION_LIST /begin REF_CHARACTERISTIC CalRegn01Inin00.TEstimnWghtAvrgTDi.Ary1D /end REF_CHARACTERISTIC /begin REF_MEASUREMENT /end REF_MEASUREMENT /end GROUP
/begin GROUP CalRegn01Inin00.VehSigCdngLatASlewRate.Val "MICROSAR RTE" /begin SUB_GROUP /end SUB_GROUP /begin FUNCTION_LIST /end FUNCTION_LIST /begin REF_CHARACTERISTIC CalRegn01Inin00.VehSigCdngLatASlewRate.Val /end REF_CHARACTERISTIC /begin REF_MEASUREMENT /end REF_MEASUREMENT /end GROUP
/begin GROUP CalRegn01Inin00.VehSigCdngLtgASlewRate.Val "MICROSAR RTE" /begin SUB_GROUP /end SUB_GROUP /begin FUNCTION_LIST /end FUNCTION_LIST /begin REF_CHARACTERISTIC CalRegn01Inin00.VehSigCdngLtgASlewRate.Val /end REF_CHARACTERISTIC /begin REF_MEASUREMENT /end REF_MEASUREMENT /end GROUP
/begin GROUP CalRegn01Inin00GroupA "MICROSAR RTE" /begin SUB_GROUP CalRegn01Inin00GroupA.CalibrationPorts /end SUB_GROUP /begin FUNCTION_LIST /end FUNCTION_LIST /begin REF_CHARACTERISTIC /end REF_CHARACTERISTIC /begin REF_MEASUREMENT /end REF_MEASUREMENT /end GROUP
/begin GROUP CalRegn01Inin00GroupA.AssiPahSumHysCmpLim.Val "MICROSAR RTE" /begin SUB_GROUP /end SUB_GROUP /begin FUNCTION_LIST /end FUNCTION_LIST /begin REF_CHARACTERISTIC CalRegn01Inin00GroupA.AssiPahSumHysCmpLim.Val /end REF_CHARACTERISTIC /begin REF_MEASUREMENT /end REF_MEASUREMENT /end GROUP
/begin GROUP CalRegn01Inin00GroupA.CalibrationPorts "MICROSAR RTE"
 /begin SUB_GROUP CalRegn01Inin00GroupA.AssiPahSumHysCmpLim.Val CalRegn01Inin00GroupA.DampgHydBasCoeff1.Val CalRegn01Inin00GroupA.DampgHydBasCoeff2.Val CalRegn01Inin00GroupA.DampgHydBasCoeff3.Val CalRegn01Inin00GroupA.DampgHydBasCoeff4.Val CalRegn01Inin00GroupA.DampgHydOutpLim.Val CalRegn01Inin00GroupA.DampgMotVelLpFilFrq.Val CalRegn01Inin00GroupA.DampgQuad13Mplr.Val CalRegn01Inin00GroupA.DampgQuad24Mplr.Val CalRegn01Inin00GroupA.DampgQuadHwTqLpFilFrq.Val CalRegn01Inin00GroupA.DampgQuadMotVelLpFilFrq.Val CalRegn01Inin00GroupA.DampgQuadScaLpFilFrq.Val CalRegn01Inin00GroupA.DampgTScaX.Ary1D CalRegn01Inin00GroupA.DampgTScaY.Ary1D CalRegn01Inin00GroupA.ImcSigArbnPullCmpLongTermArbnOffsLim.Val CalRegn01Inin00GroupA.ImcSigArbnPullCmpShoTermArbnOffsLim.Val CalRegn01Inin00GroupA.TunSelnAuthyVehSpdX.Ary1D /end SUB_GROUP
 /begin FUNCTION_LIST /end FUNCTION_LIST
 /begin REF_CHARACTERISTIC /end REF_CHARACTERISTIC
 /begin REF_MEASUREMENT /end REF_MEASUREMENT
/end GROUP
/begin GROUP CalRegn01Inin00GroupA.DampgHydBasCoeff1.Val "MICROSAR RTE" /begin SUB_GROUP /end SUB_GROUP /begin FUNCTION_LIST /end FUNCTION_LIST /begin REF_CHARACTERISTIC CalRegn01Inin00GroupA.DampgHydBasCoeff1.Val /end REF_CHARACTERISTIC /begin REF_MEASUREMENT /end REF_MEASUREMENT /end GROUP
/begin GROUP CalRegn01Inin00GroupA.DampgHydBasCoeff2.Val "MICROSAR RTE" /begin SUB_GROUP /end SUB_GROUP /begin FUNCTION_LIST /end FUNCTION_LIST /begin REF_CHARACTERISTIC CalRegn01Inin00GroupA.DampgHydBasCoeff2.Val /end REF_CHARACTERISTIC /begin REF_MEASUREMENT /end REF_MEASUREMENT /end GROUP
/begin GROUP CalRegn01Inin00GroupA.DampgHydBasCoeff3.Val "MICROSAR RTE" /begin SUB_GROUP /end SUB_GROUP /begin FUNCTION_LIST /end FUNCTION_LIST /begin REF_CHARACTERISTIC CalRegn01Inin00GroupA.DampgHydBasCoeff3.Val /end REF_CHARACTERISTIC /begin REF_MEASUREMENT /end REF_MEASUREMENT /end GROUP
/begin GROUP CalRegn01Inin00GroupA.DampgHydBasCoeff4.Val "MICROSAR RTE" /begin SUB_GROUP /end SUB_GROUP /begin FUNCTION_LIST /end FUNCTION_LIST /begin REF_CHARACTERISTIC CalRegn01Inin00GroupA.DampgHydBasCoeff4.Val /end REF_CHARACTERISTIC /begin REF_MEASUREMENT /end REF_MEASUREMENT /end GROUP
/begin GROUP CalRegn01Inin00GroupA.DampgHydOutpLim.Val "MICROSAR RTE" /begin SUB_GROUP /end SUB_GROUP /begin FUNCTION_LIST /end FUNCTION_LIST /begin REF_CHARACTERISTIC CalRegn01Inin00GroupA.DampgHydOutpLim.Val /end REF_CHARACTERISTIC /begin REF_MEASUREMENT /end REF_MEASUREMENT /end GROUP
/begin GROUP CalRegn01Inin00GroupA.DampgMotVelLpFilFrq.Val "MICROSAR RTE" /begin SUB_GROUP /end SUB_GROUP /begin FUNCTION_LIST /end FUNCTION_LIST /begin REF_CHARACTERISTIC CalRegn01Inin00GroupA.DampgMotVelLpFilFrq.Val /end REF_CHARACTERISTIC /begin REF_MEASUREMENT /end REF_MEASUREMENT /end GROUP
/begin GROUP CalRegn01Inin00GroupA.DampgQuad13Mplr.Val "MICROSAR RTE" /begin SUB_GROUP /end SUB_GROUP /begin FUNCTION_LIST /end FUNCTION_LIST /begin REF_CHARACTERISTIC CalRegn01Inin00GroupA.DampgQuad13Mplr.Val /end REF_CHARACTERISTIC /begin REF_MEASUREMENT /end REF_MEASUREMENT /end GROUP
/begin GROUP CalRegn01Inin00GroupA.DampgQuad24Mplr.Val "MICROSAR RTE" /begin SUB_GROUP /end SUB_GROUP /begin FUNCTION_LIST /end FUNCTION_LIST /begin REF_CHARACTERISTIC CalRegn01Inin00GroupA.DampgQuad24Mplr.Val /end REF_CHARACTERISTIC /begin REF_MEASUREMENT /end REF_MEASUREMENT /end GROUP
/begin GROUP CalRegn01Inin00GroupA.DampgQuadHwTqLpFilFrq.Val "MICROSAR RTE" /begin SUB_GROUP /end SUB_GROUP /begin FUNCTION_LIST /end FUNCTION_LIST /begin REF_CHARACTERISTIC CalRegn01Inin00GroupA.DampgQuadHwTqLpFilFrq.Val /end REF_CHARACTERISTIC /begin REF_MEASUREMENT /end REF_MEASUREMENT /end GROUP
/begin GROUP CalRegn01Inin00GroupA.DampgQuadMotVelLpFilFrq.Val "MICROSAR RTE" /begin SUB_GROUP /end SUB_GROUP /begin FUNCTION_LIST /end FUNCTION_LIST /begin REF_CHARACTERISTIC CalRegn01Inin00GroupA.DampgQuadMotVelLpFilFrq.Val /end REF_CHARACTERISTIC /begin REF_MEASUREMENT /end REF_MEASUREMENT /end GROUP
/begin GROUP CalRegn01Inin00GroupA.DampgQuadScaLpFilFrq.Val "MICROSAR RTE" /begin SUB_GROUP /end SUB_GROUP /begin FUNCTION_LIST /end FUNCTION_LIST /begin REF_CHARACTERISTIC CalRegn01Inin00GroupA.DampgQuadScaLpFilFrq.Val /end REF_CHARACTERISTIC /begin REF_MEASUREMENT /end REF_MEASUREMENT /end GROUP
/begin GROUP CalRegn01Inin00GroupA.DampgTScaX.Ary1D "MICROSAR RTE" /begin SUB_GROUP /end SUB_GROUP /begin FUNCTION_LIST /end FUNCTION_LIST /begin REF_CHARACTERISTIC CalRegn01Inin00GroupA.DampgTScaX.Ary1D /end REF_CHARACTERISTIC /begin REF_MEASUREMENT /end REF_MEASUREMENT /end GROUP
/begin GROUP CalRegn01Inin00GroupA.DampgTScaY.Ary1D "MICROSAR RTE" /begin SUB_GROUP /end SUB_GROUP /begin FUNCTION_LIST /end FUNCTION_LIST /begin REF_CHARACTERISTIC CalRegn01Inin00GroupA.DampgTScaY.Ary1D /end REF_CHARACTERISTIC /begin REF_MEASUREMENT /end REF_MEASUREMENT /end GROUP
/begin GROUP CalRegn01Inin00GroupA.ImcSigArbnPullCmpLongTermArbnOffsLim.Val "MICROSAR RTE" /begin SUB_GROUP /end SUB_GROUP /begin FUNCTION_LIST /end FUNCTION_LIST
 /begin REF_CHARACTERISTIC CalRegn01Inin00GroupA.ImcSigArbnPullCmpLongTermArbnOffsLim.Val /end REF_CHARACTERISTIC
 /begin REF_MEASUREMENT /end REF_MEASUREMENT
/end GROUP
/begin GROUP CalRegn01Inin00GroupA.ImcSigArbnPullCmpShoTermArbnOffsLim.Val "MICROSAR RTE" /begin SUB_GROUP /end SUB_GROUP /begin FUNCTION_LIST /end FUNCTION_LIST
 /begin REF_CHARACTERISTIC CalRegn01Inin00GroupA.ImcSigArbnPullCmpShoTermArbnOffsLim.Val /end REF_CHARACTERISTIC
 /begin REF_MEASUREMENT /end REF_MEASUREMENT
/end GROUP
/begin GROUP CalRegn01Inin00GroupA.TunSelnAuthyVehSpdX.Ary1D "MICROSAR RTE" /begin SUB_GROUP /end SUB_GROUP /begin FUNCTION_LIST /end FUNCTION_LIST /begin REF_CHARACTERISTIC CalRegn01Inin00GroupA.TunSelnAuthyVehSpdX.Ary1D /end REF_CHARACTERISTIC /begin REF_MEASUREMENT /end REF_MEASUREMENT /end GROUP
/begin GROUP CalRegn01Inin00GroupB "MICROSAR RTE" /begin SUB_GROUP CalRegn01Inin00GroupB.CalibrationPorts /end SUB_GROUP /begin FUNCTION_LIST /end FUNCTION_LIST /begin REF_CHARACTERISTIC /end REF_CHARACTERISTIC /begin REF_MEASUREMENT /end REF_MEASUREMENT /end GROUP
/begin GROUP CalRegn01Inin00GroupB.CalibrationPorts "MICROSAR RTE"
 /begin SUB_GROUP CalRegn01Inin00GroupB.PosnTrakgServoArbnFltMtgtnLpFilCutOffFrq.Val CalRegn01Inin00GroupB.PosnTrakgServoEnaBlndFacTblX.Ary1D CalRegn01Inin00GroupB.PosnTrakgServoEnaBlndFacTblY.Ary1D CalRegn01Inin00GroupB.PosnTrakgServoFfGain.Ary1D CalRegn01Inin00GroupB.PosnTrakgServoFfVelGain.Ary1D CalRegn01Inin00GroupB.PosnTrakgServoGain1.Ary1D CalRegn01Inin00GroupB.PosnTrakgServoGain2.Ary1D CalRegn01Inin00GroupB.PosnTrakgServoGain3.Ary1D CalRegn01Inin00GroupB.PosnTrakgServoGain4.Ary1D CalRegn01Inin00GroupB.PosnTrakgServoGainArbnFltMtgtn.Ary1D CalRegn01Inin00GroupB.PosnTrakgServoHwAgTarMgnLimTblY.Ary1D CalRegn01Inin00GroupB.PosnTrakgServoHwAgTarRateLimTblY.Ary1D CalRegn01Inin00GroupB.PosnTrakgServoHwVelTarRateLimTblY.Ary1D CalRegn01Inin00GroupB.PosnTrakgServoIntglGain.Ary1D CalRegn01Inin00GroupB.PosnTrakgServoIntglLim.Ary1D CalRegn01Inin00GroupB.PosnTrakgServoIntgtrAntiWdupGain.Val CalRegn01Inin00GroupB.PosnTrakgServoIntgtrStCorrnGain.Val CalRegn01Inin00GroupB.PosnTrakgServoLpFilCutOffFrq.Val CalRegn01Inin00GroupB.PosnTrakgServoOutpAntiWdupGain.Val CalRegn01Inin00GroupB.PosnTrakgServoOutpLim.Ary1D CalRegn01Inin00GroupB.PosnTrakgServoVehSpdTbl.Ary1D /end SUB_GROUP
 /begin FUNCTION_LIST /end FUNCTION_LIST
 /begin REF_CHARACTERISTIC /end REF_CHARACTERISTIC
 /begin REF_MEASUREMENT /end REF_MEASUREMENT
/end GROUP
/begin GROUP CalRegn01Inin00GroupB.PosnTrakgServoArbnFltMtgtnLpFilCutOffFrq.Val "MICROSAR RTE" /begin SUB_GROUP /end SUB_GROUP /begin FUNCTION_LIST /end FUNCTION_LIST
 /begin REF_CHARACTERISTIC CalRegn01Inin00GroupB.PosnTrakgServoArbnFltMtgtnLpFilCutOffFrq.Val /end REF_CHARACTERISTIC
 /begin REF_MEASUREMENT /end REF_MEASUREMENT
/end GROUP
/begin GROUP CalRegn01Inin00GroupB.PosnTrakgServoEnaBlndFacTblX.Ary1D "MICROSAR RTE" /begin SUB_GROUP /end SUB_GROUP /begin FUNCTION_LIST /end FUNCTION_LIST /begin REF_CHARACTERISTIC CalRegn01Inin00GroupB.PosnTrakgServoEnaBlndFacTblX.Ary1D /end REF_CHARACTERISTIC /begin REF_MEASUREMENT /end REF_MEASUREMENT /end GROUP
/begin GROUP CalRegn01Inin00GroupB.PosnTrakgServoEnaBlndFacTblY.Ary1D "MICROSAR RTE" /begin SUB_GROUP /end SUB_GROUP /begin FUNCTION_LIST /end FUNCTION_LIST /begin REF_CHARACTERISTIC CalRegn01Inin00GroupB.PosnTrakgServoEnaBlndFacTblY.Ary1D /end REF_CHARACTERISTIC /begin REF_MEASUREMENT /end REF_MEASUREMENT /end GROUP
/begin GROUP CalRegn01Inin00GroupB.PosnTrakgServoFfGain.Ary1D "MICROSAR RTE" /begin SUB_GROUP /end SUB_GROUP /begin FUNCTION_LIST /end FUNCTION_LIST /begin REF_CHARACTERISTIC CalRegn01Inin00GroupB.PosnTrakgServoFfGain.Ary1D /end REF_CHARACTERISTIC /begin REF_MEASUREMENT /end REF_MEASUREMENT /end GROUP
/begin GROUP CalRegn01Inin00GroupB.PosnTrakgServoFfVelGain.Ary1D "MICROSAR RTE" /begin SUB_GROUP /end SUB_GROUP /begin FUNCTION_LIST /end FUNCTION_LIST /begin REF_CHARACTERISTIC CalRegn01Inin00GroupB.PosnTrakgServoFfVelGain.Ary1D /end REF_CHARACTERISTIC /begin REF_MEASUREMENT /end REF_MEASUREMENT /end GROUP
/begin GROUP CalRegn01Inin00GroupB.PosnTrakgServoGain1.Ary1D "MICROSAR RTE" /begin SUB_GROUP /end SUB_GROUP /begin FUNCTION_LIST /end FUNCTION_LIST /begin REF_CHARACTERISTIC CalRegn01Inin00GroupB.PosnTrakgServoGain1.Ary1D /end REF_CHARACTERISTIC /begin REF_MEASUREMENT /end REF_MEASUREMENT /end GROUP
/begin GROUP CalRegn01Inin00GroupB.PosnTrakgServoGain2.Ary1D "MICROSAR RTE" /begin SUB_GROUP /end SUB_GROUP /begin FUNCTION_LIST /end FUNCTION_LIST /begin REF_CHARACTERISTIC CalRegn01Inin00GroupB.PosnTrakgServoGain2.Ary1D /end REF_CHARACTERISTIC /begin REF_MEASUREMENT /end REF_MEASUREMENT /end GROUP
/begin GROUP CalRegn01Inin00GroupB.PosnTrakgServoGain3.Ary1D "MICROSAR RTE" /begin SUB_GROUP /end SUB_GROUP /begin FUNCTION_LIST /end FUNCTION_LIST /begin REF_CHARACTERISTIC CalRegn01Inin00GroupB.PosnTrakgServoGain3.Ary1D /end REF_CHARACTERISTIC /begin REF_MEASUREMENT /end REF_MEASUREMENT /end GROUP
/begin GROUP CalRegn01Inin00GroupB.PosnTrakgServoGain4.Ary1D "MICROSAR RTE" /begin SUB_GROUP /end SUB_GROUP /begin FUNCTION_LIST /end FUNCTION_LIST /begin REF_CHARACTERISTIC CalRegn01Inin00GroupB.PosnTrakgServoGain4.Ary1D /end REF_CHARACTERISTIC /begin REF_MEASUREMENT /end REF_MEASUREMENT /end GROUP
/begin GROUP CalRegn01Inin00GroupB.PosnTrakgServoGainArbnFltMtgtn.Ary1D "MICROSAR RTE" /begin SUB_GROUP /end SUB_GROUP /begin FUNCTION_LIST /end FUNCTION_LIST /begin REF_CHARACTERISTIC CalRegn01Inin00GroupB.PosnTrakgServoGainArbnFltMtgtn.Ary1D /end REF_CHARACTERISTIC /begin REF_MEASUREMENT /end REF_MEASUREMENT /end GROUP
/begin GROUP CalRegn01Inin00GroupB.PosnTrakgServoHwAgTarMgnLimTblY.Ary1D "MICROSAR RTE" /begin SUB_GROUP /end SUB_GROUP /begin FUNCTION_LIST /end FUNCTION_LIST
 /begin REF_CHARACTERISTIC CalRegn01Inin00GroupB.PosnTrakgServoHwAgTarMgnLimTblY.Ary1D /end REF_CHARACTERISTIC
 /begin REF_MEASUREMENT /end REF_MEASUREMENT
/end GROUP
/begin GROUP CalRegn01Inin00GroupB.PosnTrakgServoHwAgTarRateLimTblY.Ary1D "MICROSAR RTE" /begin SUB_GROUP /end SUB_GROUP /begin FUNCTION_LIST /end FUNCTION_LIST
 /begin REF_CHARACTERISTIC CalRegn01Inin00GroupB.PosnTrakgServoHwAgTarRateLimTblY.Ary1D /end REF_CHARACTERISTIC
 /begin REF_MEASUREMENT /end REF_MEASUREMENT
/end GROUP
/begin GROUP CalRegn01Inin00GroupB.PosnTrakgServoHwVelTarRateLimTblY.Ary1D "MICROSAR RTE" /begin SUB_GROUP /end SUB_GROUP /begin FUNCTION_LIST /end FUNCTION_LIST
 /begin REF_CHARACTERISTIC CalRegn01Inin00GroupB.PosnTrakgServoHwVelTarRateLimTblY.Ary1D /end REF_CHARACTERISTIC
 /begin REF_MEASUREMENT /end REF_MEASUREMENT
/end GROUP
/begin GROUP CalRegn01Inin00GroupB.PosnTrakgServoIntglGain.Ary1D "MICROSAR RTE" /begin SUB_GROUP /end SUB_GROUP /begin FUNCTION_LIST /end FUNCTION_LIST /begin REF_CHARACTERISTIC CalRegn01Inin00GroupB.PosnTrakgServoIntglGain.Ary1D /end REF_CHARACTERISTIC /begin REF_MEASUREMENT /end REF_MEASUREMENT /end GROUP
/begin GROUP CalRegn01Inin00GroupB.PosnTrakgServoIntglLim.Ary1D "MICROSAR RTE" /begin SUB_GROUP /end SUB_GROUP /begin FUNCTION_LIST /end FUNCTION_LIST /begin REF_CHARACTERISTIC CalRegn01Inin00GroupB.PosnTrakgServoIntglLim.Ary1D /end REF_CHARACTERISTIC /begin REF_MEASUREMENT /end REF_MEASUREMENT /end GROUP
/begin GROUP CalRegn01Inin00GroupB.PosnTrakgServoIntgtrAntiWdupGain.Val "MICROSAR RTE" /begin SUB_GROUP /end SUB_GROUP /begin FUNCTION_LIST /end FUNCTION_LIST /begin REF_CHARACTERISTIC CalRegn01Inin00GroupB.PosnTrakgServoIntgtrAntiWdupGain.Val /end REF_CHARACTERISTIC /begin REF_MEASUREMENT /end REF_MEASUREMENT /end GROUP
/begin GROUP CalRegn01Inin00GroupB.PosnTrakgServoIntgtrStCorrnGain.Val "MICROSAR RTE" /begin SUB_GROUP /end SUB_GROUP /begin FUNCTION_LIST /end FUNCTION_LIST /begin REF_CHARACTERISTIC CalRegn01Inin00GroupB.PosnTrakgServoIntgtrStCorrnGain.Val /end REF_CHARACTERISTIC /begin REF_MEASUREMENT /end REF_MEASUREMENT /end GROUP
/begin GROUP CalRegn01Inin00GroupB.PosnTrakgServoLpFilCutOffFrq.Val "MICROSAR RTE" /begin SUB_GROUP /end SUB_GROUP /begin FUNCTION_LIST /end FUNCTION_LIST /begin REF_CHARACTERISTIC CalRegn01Inin00GroupB.PosnTrakgServoLpFilCutOffFrq.Val /end REF_CHARACTERISTIC /begin REF_MEASUREMENT /end REF_MEASUREMENT /end GROUP
/begin GROUP CalRegn01Inin00GroupB.PosnTrakgServoOutpAntiWdupGain.Val "MICROSAR RTE" /begin SUB_GROUP /end SUB_GROUP /begin FUNCTION_LIST /end FUNCTION_LIST /begin REF_CHARACTERISTIC CalRegn01Inin00GroupB.PosnTrakgServoOutpAntiWdupGain.Val /end REF_CHARACTERISTIC /begin REF_MEASUREMENT /end REF_MEASUREMENT /end GROUP
/begin GROUP CalRegn01Inin00GroupB.PosnTrakgServoOutpLim.Ary1D "MICROSAR RTE" /begin SUB_GROUP /end SUB_GROUP /begin FUNCTION_LIST /end FUNCTION_LIST /begin REF_CHARACTERISTIC CalRegn01Inin00GroupB.PosnTrakgServoOutpLim.Ary1D /end REF_CHARACTERISTIC /begin REF_MEASUREMENT /end REF_MEASUREMENT /end GROUP
/begin GROUP CalRegn01Inin00GroupB.PosnTrakgServoVehSpdTbl.Ary1D "MICROSAR RTE" /begin SUB_GROUP /end SUB_GROUP /begin FUNCTION_LIST /end FUNCTION_LIST /begin REF_CHARACTERISTIC CalRegn01Inin00GroupB.PosnTrakgServoVehSpdTbl.Ary1D /end REF_CHARACTERISTIC /begin REF_MEASUREMENT /end REF_MEASUREMENT /end GROUP
/begin GROUP CalRegn01Inin00GroupD "MICROSAR RTE" /begin SUB_GROUP CalRegn01Inin00GroupD.CalibrationPorts /end SUB_GROUP /begin FUNCTION_LIST /end FUNCTION_LIST /begin REF_CHARACTERISTIC /end REF_CHARACTERISTIC /begin REF_MEASUREMENT /end REF_MEASUREMENT /end GROUP
/begin GROUP CalRegn01Inin00GroupD.CalibrationPorts "MICROSAR RTE"
 /begin SUB_GROUP CalRegn01Inin00GroupD.StabyCmpAssiScaBlndX.Ary1D CalRegn01Inin00GroupD.StabyCmpAssiScaBlndY.Ary1D CalRegn01Inin00GroupD.StabyCmpHwTqLpFilFrq.Val CalRegn01Inin00GroupD.StabyCmpNotchFil1Struct.Rec CalRegn01Inin00GroupD.StabyCmpNotchFil2Struct.Rec CalRegn01Inin00GroupD.StabyCmpNotchFil3Struct.Rec CalRegn01Inin00GroupD.StabyCmpNotchFil4Struct.Rec CalRegn01Inin00GroupD.StabyCmpNotchFilBilnrBlndVehSpd.Ary1D CalRegn01Inin00GroupD.StabyCmpNotchFilBlnd02Y.Ary2D CalRegn01Inin00GroupD.StabyCmpNotchFilBlnd04Y.Ary2D CalRegn01Inin00GroupD.StabyCmpNotchFilBlnd12TqX.Ary2D CalRegn01Inin00GroupD.StabyCmpNotchFilBlnd12Y.Ary2D CalRegn01Inin00GroupD.StabyCmpNotchFilBlnd34TqX.Ary2D CalRegn01Inin00GroupD.StabyCmpNotchFilBlnd34Y.Ary2D /end SUB_GROUP
 /begin FUNCTION_LIST /end FUNCTION_LIST
 /begin REF_CHARACTERISTIC /end REF_CHARACTERISTIC
 /begin REF_MEASUREMENT /end REF_MEASUREMENT
/end GROUP
/begin GROUP CalRegn01Inin00GroupD.StabyCmpAssiScaBlndX.Ary1D "MICROSAR RTE" /begin SUB_GROUP /end SUB_GROUP /begin FUNCTION_LIST /end FUNCTION_LIST /begin REF_CHARACTERISTIC CalRegn01Inin00GroupD.StabyCmpAssiScaBlndX.Ary1D /end REF_CHARACTERISTIC /begin REF_MEASUREMENT /end REF_MEASUREMENT /end GROUP
/begin GROUP CalRegn01Inin00GroupD.StabyCmpAssiScaBlndY.Ary1D "MICROSAR RTE" /begin SUB_GROUP /end SUB_GROUP /begin FUNCTION_LIST /end FUNCTION_LIST /begin REF_CHARACTERISTIC CalRegn01Inin00GroupD.StabyCmpAssiScaBlndY.Ary1D /end REF_CHARACTERISTIC /begin REF_MEASUREMENT /end REF_MEASUREMENT /end GROUP
/begin GROUP CalRegn01Inin00GroupD.StabyCmpHwTqLpFilFrq.Val "MICROSAR RTE" /begin SUB_GROUP /end SUB_GROUP /begin FUNCTION_LIST /end FUNCTION_LIST /begin REF_CHARACTERISTIC CalRegn01Inin00GroupD.StabyCmpHwTqLpFilFrq.Val /end REF_CHARACTERISTIC /begin REF_MEASUREMENT /end REF_MEASUREMENT /end GROUP
/**********************************************************************************************************************
* RECORD_LAYOUT
*********************************************************************************************************************/
/begin RECORD_LAYOUT RTE_RL_UBYTE FNC_VALUES 1 UBYTE ROW_DIR DIRECT /end RECORD_LAYOUT
/begin RECORD_LAYOUT RTE_RL_UWORD FNC_VALUES 1 UWORD ROW_DIR DIRECT /end RECORD_LAYOUT
/begin RECORD_LAYOUT RTE_RL_ULONG FNC_VALUES 1 ULONG ROW_DIR DIRECT /end RECORD_LAYOUT
/begin RECORD_LAYOUT RTE_RL_SBYTE FNC_VALUES 1 SBYTE ROW_DIR DIRECT /end RECORD_LAYOUT
/begin RECORD_LAYOUT RTE_RL_SWORD FNC_VALUES 1 SWORD ROW_DIR DIRECT /end RECORD_LAYOUT
/begin RECORD_LAYOUT RTE_RL_FLOAT32_IEEE FNC_VALUES 1 FLOAT32_IEEE ROW_DIR DIRECT /end RECORD_LAYOUT
/begin RECORD_LAYOUT RTE_RL_BOOLEAN FNC_VALUES 1 UBYTE ROW_DIR DIRECT /end RECORD_LAYOUT
/**********************************************************************************************************************
* COMPU_METHOD / COMPU_VTAB_RANGE
*********************************************************************************************************************/
/begin COMPU_METHOD RTE_CM_BOOLEAN "" TAB_VERB "%3.1" "" COMPU_TAB_REF RTE_CM_BOOLEAN /end COMPU_METHOD
/begin COMPU_VTAB_RANGE RTE_CM_BOOLEAN "" 2 0 0 "false" 1 255 "true" /end COMPU_VTAB_RANGE
