/begin CHARACTERISTIC LoaMgr.LoaMgrCurrMeasIdptSig0Resp.Val "MICROSAR RTE" VALUE 0x0 RTE_RL_UBYTE 0 NO_COMPU_METHOD 0 255 SYMBOL_LINK "Rte_CalprmRom_CalRegn01Cmn_DEFAULT_RTE_CALPRM_GROUP.LoaMgrCurrMeasIdptSig0Resp_Val" 0 DISPLAY_IDENTIFIER LoaMgr.CalibrationPorts.LoaMgrCurrMeasIdptSig0Resp.Val /end CHARACTERISTIC
/begin CHARACTERISTIC LoaMgr.LoaMgrCurrMeasIdptSig1Resp.Val "MICROSAR RTE" VALUE 0x0 RTE_RL_UBYTE 0 NO_COMPU_METHOD 0 255 SYMBOL_LINK "Rte_CalprmRom_CalRegn01Cmn_DEFAULT_RTE_CALPRM_GROUP.LoaMgrCurrMeasIdptSig1Resp_Val" 0 DISPLAY_IDENTIFIER LoaMgr.CalibrationPorts.LoaMgrCurrMeasIdptSig1Resp.Val /end CHARACTERISTIC
/begin CHARACTERISTIC LoaMgr.LoaMgrCurrMeasIdptSig2Resp.Val "MICROSAR RTE" VALUE 0x0 RTE_RL_UBYTE 0 NO_COMPU_METHOD 0 255 SYMBOL_LINK "Rte_CalprmRom_CalRegn01Cmn_DEFAULT_RTE_CALPRM_GROUP.LoaMgrCurrMeasIdptSig2Resp_Val" 0 DISPLAY_IDENTIFIER LoaMgr.CalibrationPorts.LoaMgrCurrMeasIdptSig2Resp.Val /end CHARACTERISTIC
/begin CHARACTERISTIC LoaMgr.LoaMgrCurrMeasIdptSigFltThd.Val "MICROSAR RTE" VALUE 0x0 RTE_RL_UBYTE 0 NO_COMPU_METHOD 0 255 SYMBOL_LINK "Rte_CalprmRom_CalRegn01Cmn_DEFAULT_RTE_CALPRM_GROUP.LoaMgrCurrMeasIdptSigFltThd_Val" 0 DISPLAY_IDENTIFIER LoaMgr.CalibrationPorts.LoaMgrCurrMeasIdptSigFltThd.Val /end CHARACTERISTIC
/begin CHARACTERISTIC LoaMgr.LoaMgrCurrMeasMtgtnRate.Val "MICROSAR RTE" VALUE 0x0 RTE_RL_FLOAT32_IEEE 0 NO_COMPU_METHOD -3.402823466e+38 3.402823466e+38 SYMBOL_LINK "Rte_CalprmRom_CalRegn02Cmn_DEFAULT_RTE_CALPRM_GROUP.LoaMgrCurrMeasMtgtnRate_Val" 0 DISPLAY_IDENTIFIER LoaMgr.CalibrationPorts.LoaMgrCurrMeasMtgtnRate.Val /end CHARACTERISTIC
/begin CHARACTERISTIC LoaMgr.LoaMgrCurrMeasMtgtnSca.Val "MICROSAR RTE" VALUE 0x0 RTE_RL_FLOAT32_IEEE 0 NO_COMPU_METHOD -3.402823466e+38 3.402823466e+38 SYMBOL_LINK "Rte_CalprmRom_CalRegn02Cmn_DEFAULT_RTE_CALPRM_GROUP.LoaMgrCurrMeasMtgtnSca_Val" 0 DISPLAY_IDENTIFIER LoaMgr.CalibrationPorts.LoaMgrCurrMeasMtgtnSca.Val /end CHARACTERISTIC
/begin CHARACTERISTIC LoaMgr.LoaMgrCurrMeasMtgtnScaZeroEna.Logl "MICROSAR RTE" VALUE 0x0 RTE_RL_BOOLEAN 0 RTE_CM_BOOLEAN 0 255 SYMBOL_LINK "Rte_CalprmRom_CalRegn01Cmn_DEFAULT_RTE_CALPRM_GROUP.LoaMgrCurrMeasMtgtnScaZeroEna_Logl" 0 DISPLAY_IDENTIFIER LoaMgr.CalibrationPorts.LoaMgrCurrMeasMtgtnScaZeroEna.Logl /end CHARACTERISTIC
/begin CHARACTERISTIC LoaMgr.LoaMgrFadeOutStRate.Val "MICROSAR RTE" VALUE 0x0 RTE_RL_FLOAT32_IEEE 0 NO_COMPU_METHOD -3.402823466e+38 3.402823466e+38 SYMBOL_LINK "Rte_CalprmRom_CalRegn01Cmn_DEFAULT_RTE_CALPRM_GROUP.LoaMgrFadeOutStRate_Val" 0 DISPLAY_IDENTIFIER LoaMgr.CalibrationPorts.LoaMgrFadeOutStRate.Val /end CHARACTERISTIC
/begin CHARACTERISTIC LoaMgr.LoaMgrHwTqIdptSig0NoTqLoaResp.Val "MICROSAR RTE" VALUE 0x0 RTE_RL_UBYTE 0 NO_COMPU_METHOD 0 255 SYMBOL_LINK "Rte_CalprmRom_CalRegn01Cmn_DEFAULT_RTE_CALPRM_GROUP.LoaMgrHwTqIdptSig0NoTqLoaResp_Val" 0 DISPLAY_IDENTIFIER LoaMgr.CalibrationPorts.LoaMgrHwTqIdptSig0NoTqLoaResp.Val /end CHARACTERISTIC
/begin CHARACTERISTIC LoaMgr.LoaMgrHwTqIdptSig1NoTqLoaResp.Val "MICROSAR RTE" VALUE 0x0 RTE_RL_UBYTE 0 NO_COMPU_METHOD 0 255 SYMBOL_LINK "Rte_CalprmRom_CalRegn01Cmn_DEFAULT_RTE_CALPRM_GROUP.LoaMgrHwTqIdptSig1NoTqLoaResp_Val" 0 DISPLAY_IDENTIFIER LoaMgr.CalibrationPorts.LoaMgrHwTqIdptSig1NoTqLoaResp.Val /end CHARACTERISTIC
/begin CHARACTERISTIC LoaMgr.LoaMgrHwTqIdptSig2Resp.Val "MICROSAR RTE" VALUE 0x0 RTE_RL_UBYTE 0 NO_COMPU_METHOD 0 255 SYMBOL_LINK "Rte_CalprmRom_CalRegn01Cmn_DEFAULT_RTE_CALPRM_GROUP.LoaMgrHwTqIdptSig2Resp_Val" 0 DISPLAY_IDENTIFIER LoaMgr.CalibrationPorts.LoaMgrHwTqIdptSig2Resp.Val /end CHARACTERISTIC
/begin CHARACTERISTIC LoaMgr.LoaMgrHwTqIdptSig3Resp.Val "MICROSAR RTE" VALUE 0x0 RTE_RL_UBYTE 0 NO_COMPU_METHOD 0 255 SYMBOL_LINK "Rte_CalprmRom_CalRegn01Cmn_DEFAULT_RTE_CALPRM_GROUP.LoaMgrHwTqIdptSig3Resp_Val" 0 DISPLAY_IDENTIFIER LoaMgr.CalibrationPorts.LoaMgrHwTqIdptSig3Resp.Val /end CHARACTERISTIC
/begin CHARACTERISTIC LoaMgr.LoaMgrHwTqIdptSig4Resp.Val "MICROSAR RTE" VALUE 0x0 RTE_RL_UBYTE 0 NO_COMPU_METHOD 0 255 SYMBOL_LINK "Rte_CalprmRom_CalRegn01Cmn_DEFAULT_RTE_CALPRM_GROUP.LoaMgrHwTqIdptSig4Resp_Val" 0 DISPLAY_IDENTIFIER LoaMgr.CalibrationPorts.LoaMgrHwTqIdptSig4Resp.Val /end CHARACTERISTIC
/begin CHARACTERISTIC LoaMgr.LoaMgrHwTqIdptSigFltThd.Val "MICROSAR RTE" VALUE 0x0 RTE_RL_UBYTE 0 NO_COMPU_METHOD 0 255 SYMBOL_LINK "Rte_CalprmRom_CalRegn01Cmn_DEFAULT_RTE_CALPRM_GROUP.LoaMgrHwTqIdptSigFltThd_Val" 0 DISPLAY_IDENTIFIER LoaMgr.CalibrationPorts.LoaMgrHwTqIdptSigFltThd.Val /end CHARACTERISTIC
/begin CHARACTERISTIC LoaMgr.LoaMgrHwTqLoaAvlResp.Val "MICROSAR RTE" VALUE 0x0 RTE_RL_UBYTE 0 NO_COMPU_METHOD 0 255 SYMBOL_LINK "Rte_CalprmRom_CalRegn01Cmn_DEFAULT_RTE_CALPRM_GROUP.LoaMgrHwTqLoaAvlResp_Val" 0 DISPLAY_IDENTIFIER LoaMgr.CalibrationPorts.LoaMgrHwTqLoaAvlResp.Val /end CHARACTERISTIC
/begin CHARACTERISTIC LoaMgr.LoaMgrIvtrIdptSig0Resp.Val "MICROSAR RTE" VALUE 0x0 RTE_RL_UBYTE 0 NO_COMPU_METHOD 0 255 SYMBOL_LINK "Rte_CalprmRom_CalRegn01Cmn_DEFAULT_RTE_CALPRM_GROUP.LoaMgrIvtrIdptSig0Resp_Val" 0 DISPLAY_IDENTIFIER LoaMgr.CalibrationPorts.LoaMgrIvtrIdptSig0Resp.Val /end CHARACTERISTIC
/begin CHARACTERISTIC LoaMgr.LoaMgrIvtrIdptSig1Resp.Val "MICROSAR RTE" VALUE 0x0 RTE_RL_UBYTE 0 NO_COMPU_METHOD 0 255 SYMBOL_LINK "Rte_CalprmRom_CalRegn01Cmn_DEFAULT_RTE_CALPRM_GROUP.LoaMgrIvtrIdptSig1Resp_Val" 0 DISPLAY_IDENTIFIER LoaMgr.CalibrationPorts.LoaMgrIvtrIdptSig1Resp.Val /end CHARACTERISTIC
/begin CHARACTERISTIC LoaMgr.LoaMgrIvtrIdptSig2Resp.Val "MICROSAR RTE" VALUE 0x0 RTE_RL_UBYTE 0 NO_COMPU_METHOD 0 255 SYMBOL_LINK "Rte_CalprmRom_CalRegn01Cmn_DEFAULT_RTE_CALPRM_GROUP.LoaMgrIvtrIdptSig2Resp_Val" 0 DISPLAY_IDENTIFIER LoaMgr.CalibrationPorts.LoaMgrIvtrIdptSig2Resp.Val /end CHARACTERISTIC
/begin CHARACTERISTIC LoaMgr.LoaMgrIvtrIdptSigFltThd.Val "MICROSAR RTE" VALUE 0x0 RTE_RL_UBYTE 0 NO_COMPU_METHOD 0 255 SYMBOL_LINK "Rte_CalprmRom_CalRegn01Cmn_DEFAULT_RTE_CALPRM_GROUP.LoaMgrIvtrIdptSigFltThd_Val" 0 DISPLAY_IDENTIFIER LoaMgr.CalibrationPorts.LoaMgrIvtrIdptSigFltThd.Val /end CHARACTERISTIC
/begin CHARACTERISTIC LoaMgr.LoaMgrIvtrMtgtnRate.Val "MICROSAR RTE" VALUE 0x0 RTE_RL_FLOAT32_IEEE 0 NO_COMPU_METHOD -3.402823466e+38 3.402823466e+38 SYMBOL_LINK "Rte_CalprmRom_CalRegn02Cmn_DEFAULT_RTE_CALPRM_GROUP.LoaMgrIvtrMtgtnRate_Val" 0 DISPLAY_IDENTIFIER LoaMgr.CalibrationPorts.LoaMgrIvtrMtgtnRate.Val /end CHARACTERISTIC
/begin CHARACTERISTIC LoaMgr.LoaMgrIvtrMtgtnSca.Val "MICROSAR RTE" VALUE 0x0 RTE_RL_FLOAT32_IEEE 0 NO_COMPU_METHOD -3.402823466e+38 3.402823466e+38 SYMBOL_LINK "Rte_CalprmRom_CalRegn02Cmn_DEFAULT_RTE_CALPRM_GROUP.LoaMgrIvtrMtgtnSca_Val" 0 DISPLAY_IDENTIFIER LoaMgr.CalibrationPorts.LoaMgrIvtrMtgtnSca.Val /end CHARACTERISTIC
/begin CHARACTERISTIC LoaMgr.LoaMgrIvtrMtgtnScaZeroEna.Logl "MICROSAR RTE" VALUE 0x0 RTE_RL_BOOLEAN 0 RTE_CM_BOOLEAN 0 255 SYMBOL_LINK "Rte_CalprmRom_CalRegn01Cmn_DEFAULT_RTE_CALPRM_GROUP.LoaMgrIvtrMtgtnScaZeroEna_Logl" 0 DISPLAY_IDENTIFIER LoaMgr.CalibrationPorts.LoaMgrIvtrMtgtnScaZeroEna.Logl /end CHARACTERISTIC
/begin CHARACTERISTIC LoaMgr.LoaMgrLimdStRate.Val "MICROSAR RTE" VALUE 0x0 RTE_RL_FLOAT32_IEEE 0 NO_COMPU_METHOD -3.402823466e+38 3.402823466e+38 SYMBOL_LINK "Rte_CalprmRom_CalRegn02Cmn_DEFAULT_RTE_CALPRM_GROUP.LoaMgrLimdStRate_Val" 0 DISPLAY_IDENTIFIER LoaMgr.CalibrationPorts.LoaMgrLimdStRate.Val /end CHARACTERISTIC
/begin CHARACTERISTIC LoaMgr.LoaMgrLimdStSca.Val "MICROSAR RTE" VALUE 0x0 RTE_RL_FLOAT32_IEEE 0 NO_COMPU_METHOD -3.402823466e+38 3.402823466e+38 SYMBOL_LINK "Rte_CalprmRom_CalRegn02Cmn_DEFAULT_RTE_CALPRM_GROUP.LoaMgrLimdStSca_Val" 0 DISPLAY_IDENTIFIER LoaMgr.CalibrationPorts.LoaMgrLimdStSca.Val /end CHARACTERISTIC
/begin CHARACTERISTIC LoaMgr.LoaMgrMotAgAvlSnsrlsResp.Val "MICROSAR RTE" VALUE 0x0 RTE_RL_UBYTE 0 NO_COMPU_METHOD 0 255 SYMBOL_LINK "Rte_CalprmRom_CalRegn01Cmn_DEFAULT_RTE_CALPRM_GROUP.LoaMgrMotAgAvlSnsrlsResp_Val" 0 DISPLAY_IDENTIFIER LoaMgr.CalibrationPorts.LoaMgrMotAgAvlSnsrlsResp.Val /end CHARACTERISTIC
/begin CHARACTERISTIC LoaMgr.LoaMgrMotAgIdptSig0NoSnsrlsResp.Val "MICROSAR RTE" VALUE 0x0 RTE_RL_UBYTE 0 NO_COMPU_METHOD 0 255 SYMBOL_LINK "Rte_CalprmRom_CalRegn01Cmn_DEFAULT_RTE_CALPRM_GROUP.LoaMgrMotAgIdptSig0NoSnsrlsResp_Val" 0 DISPLAY_IDENTIFIER LoaMgr.CalibrationPorts.LoaMgrMotAgIdptSig0NoSnsrlsResp.Val /end CHARACTERISTIC
/begin CHARACTERISTIC LoaMgr.LoaMgrMotAgIdptSig1NoSnsrlsResp.Val "MICROSAR RTE" VALUE 0x0 RTE_RL_UBYTE 0 NO_COMPU_METHOD 0 255 SYMBOL_LINK "Rte_CalprmRom_CalRegn01Cmn_DEFAULT_RTE_CALPRM_GROUP.LoaMgrMotAgIdptSig1NoSnsrlsResp_Val" 0 DISPLAY_IDENTIFIER LoaMgr.CalibrationPorts.LoaMgrMotAgIdptSig1NoSnsrlsResp.Val /end CHARACTERISTIC
/begin CHARACTERISTIC LoaMgr.LoaMgrMotAgIdptSig2Resp.Val "MICROSAR RTE" VALUE 0x0 RTE_RL_UBYTE 0 NO_COMPU_METHOD 0 255 SYMBOL_LINK "Rte_CalprmRom_CalRegn01Cmn_DEFAULT_RTE_CALPRM_GROUP.LoaMgrMotAgIdptSig2Resp_Val" 0 DISPLAY_IDENTIFIER LoaMgr.CalibrationPorts.LoaMgrMotAgIdptSig2Resp.Val /end CHARACTERISTIC
/begin CHARACTERISTIC LoaMgr.LoaMgrMotAgIdptSig3Resp.Val "MICROSAR RTE" VALUE 0x0 RTE_RL_UBYTE 0 NO_COMPU_METHOD 0 255 SYMBOL_LINK "Rte_CalprmRom_CalRegn01Cmn_DEFAULT_RTE_CALPRM_GROUP.LoaMgrMotAgIdptSig3Resp_Val" 0 DISPLAY_IDENTIFIER LoaMgr.CalibrationPorts.LoaMgrMotAgIdptSig3Resp.Val /end CHARACTERISTIC
/begin CHARACTERISTIC LoaMgr.LoaMgrMotAgIdptSigFltThd.Val "MICROSAR RTE" VALUE 0x0 RTE_RL_UBYTE 0 NO_COMPU_METHOD 0 255 SYMBOL_LINK "Rte_CalprmRom_CalRegn01Cmn_DEFAULT_RTE_CALPRM_GROUP.LoaMgrMotAgIdptSigFltThd_Val" 0 DISPLAY_IDENTIFIER LoaMgr.CalibrationPorts.LoaMgrMotAgIdptSigFltThd.Val /end CHARACTERISTIC
/begin CHARACTERISTIC LoaMgr.LoaMgrMotAgMtgtnRate.Val "MICROSAR RTE" VALUE 0x0 RTE_RL_FLOAT32_IEEE 0 NO_COMPU_METHOD -3.402823466e+38 3.402823466e+38 SYMBOL_LINK "Rte_CalprmRom_CalRegn02Cmn_DEFAULT_RTE_CALPRM_GROUP.LoaMgrMotAgMtgtnRate_Val" 0 DISPLAY_IDENTIFIER LoaMgr.CalibrationPorts.LoaMgrMotAgMtgtnRate.Val /end CHARACTERISTIC
/begin CHARACTERISTIC LoaMgr.LoaMgrMotAgMtgtnSca.Val "MICROSAR RTE" VALUE 0x0 RTE_RL_FLOAT32_IEEE 0 NO_COMPU_METHOD -3.402823466e+38 3.402823466e+38 SYMBOL_LINK "Rte_CalprmRom_CalRegn02Cmn_DEFAULT_RTE_CALPRM_GROUP.LoaMgrMotAgMtgtnSca_Val" 0 DISPLAY_IDENTIFIER LoaMgr.CalibrationPorts.LoaMgrMotAgMtgtnSca.Val /end CHARACTERISTIC
/begin CHARACTERISTIC LoaMgr.LoaMgrMotAgMtgtnScaZeroEna.Logl "MICROSAR RTE" VALUE 0x0 RTE_RL_BOOLEAN 0 RTE_CM_BOOLEAN 0 255 SYMBOL_LINK "Rte_CalprmRom_CalRegn01Cmn_DEFAULT_RTE_CALPRM_GROUP.LoaMgrMotAgMtgtnScaZeroEna_Logl" 0 DISPLAY_IDENTIFIER LoaMgr.CalibrationPorts.LoaMgrMotAgMtgtnScaZeroEna.Logl /end CHARACTERISTIC
/begin CHARACTERISTIC MotAg2Meas.MotAg2EolPrmDft.CosAmpRecpr "MICROSAR RTE" VALUE 0x0 RTE_RL_FLOAT32_IEEE 0 NO_COMPU_METHOD -3.402823466e+38 3.402823466e+38 SYMBOL_LINK "Rte_CalprmRom_MotAg2Meas_DEFAULT_RTE_CDATA_GROUP.MotAg2EolPrmDft.CosAmpRecpr" 0 DISPLAY_IDENTIFIER MotAg2Meas.CalibrationParameters.MotAg2EolPrmDft.CosAmpRecpr /end CHARACTERISTIC
/begin CHARACTERISTIC MotAg2Meas.MotAg2EolPrmDft.CosOffs "MICROSAR RTE" VALUE 0x0 RTE_RL_FLOAT32_IEEE 0 NO_COMPU_METHOD -3.402823466e+38 3.402823466e+38 SYMBOL_LINK "Rte_CalprmRom_MotAg2Meas_DEFAULT_RTE_CDATA_GROUP.MotAg2EolPrmDft.CosOffs" 0 DISPLAY_IDENTIFIER MotAg2Meas.CalibrationParameters.MotAg2EolPrmDft.CosOffs /end CHARACTERISTIC
/begin CHARACTERISTIC MotAg2Meas.MotAg2EolPrmDft.SinAmpRecpr "MICROSAR RTE" VALUE 0x0 RTE_RL_FLOAT32_IEEE 0 NO_COMPU_METHOD -3.402823466e+38 3.402823466e+38 SYMBOL_LINK "Rte_CalprmRom_MotAg2Meas_DEFAULT_RTE_CDATA_GROUP.MotAg2EolPrmDft.SinAmpRecpr" 0 DISPLAY_IDENTIFIER MotAg2Meas.CalibrationParameters.MotAg2EolPrmDft.SinAmpRecpr /end CHARACTERISTIC
/begin CHARACTERISTIC MotAg2Meas.MotAg2EolPrmDft.SinDelta "MICROSAR RTE" VALUE 0x0 RTE_RL_FLOAT32_IEEE 0 NO_COMPU_METHOD -3.402823466e+38 3.402823466e+38 SYMBOL_LINK "Rte_CalprmRom_MotAg2Meas_DEFAULT_RTE_CDATA_GROUP.MotAg2EolPrmDft.SinDelta" 0 DISPLAY_IDENTIFIER MotAg2Meas.CalibrationParameters.MotAg2EolPrmDft.SinDelta /end CHARACTERISTIC
/begin CHARACTERISTIC MotAg2Meas.MotAg2EolPrmDft.SinOffs "MICROSAR RTE" VALUE 0x0 RTE_RL_FLOAT32_IEEE 0 NO_COMPU_METHOD -3.402823466e+38 3.402823466e+38 SYMBOL_LINK "Rte_CalprmRom_MotAg2Meas_DEFAULT_RTE_CDATA_GROUP.MotAg2EolPrmDft.SinOffs" 0 DISPLAY_IDENTIFIER MotAg2Meas.CalibrationParameters.MotAg2EolPrmDft.SinOffs /end CHARACTERISTIC
/begin CHARACTERISTIC MotAg2Meas.MotAg2MeasOffs.Val "MICROSAR RTE" VALUE 0x0 RTE_RL_FLOAT32_IEEE 0 NO_COMPU_METHOD -3.402823466e+38 3.402823466e+38 SYMBOL_LINK "Rte_CalprmRom_CalRegn01Cmn_DEFAULT_RTE_CALPRM_GROUP.MotAg2MeasOffs_Val" 0 DISPLAY_IDENTIFIER MotAg2Meas.CalibrationPorts.MotAg2MeasOffs.Val /end CHARACTERISTIC
/begin CHARACTERISTIC MotAgCorrln.SysGlbPrmMotPoleCnt.Val "MICROSAR RTE" VALUE 0x0 RTE_RL_UBYTE 0 NO_COMPU_METHOD 2 12 SYMBOL_LINK "Rte_CalprmRom_CalRegn01Inin00_DEFAULT_RTE_CALPRM_GROUP.SysGlbPrmMotPoleCnt_Val" 0 DISPLAY_IDENTIFIER MotAgCorrln.CalibrationPorts.SysGlbPrmMotPoleCnt.Val /end CHARACTERISTIC
/begin CHARACTERISTIC MotCtrlPrmEstimn.MotCtrlPrmEstimnFetRNom.Val "MICROSAR RTE" VALUE 0x0 RTE_RL_FLOAT32_IEEE 0 NO_COMPU_METHOD 0.0 0.1 SYMBOL_LINK "Rte_CalprmRom_CalRegn01Cmn_DEFAULT_RTE_CALPRM_GROUP.MotCtrlPrmEstimnFetRNom_Val" 0 DISPLAY_IDENTIFIER MotCtrlPrmEstimn.CalibrationPorts.MotCtrlPrmEstimnFetRNom.Val /end CHARACTERISTIC
/begin CHARACTERISTIC MotCtrlPrmEstimn.MotCtrlPrmEstimnFetThermCoeff.Val "MICROSAR RTE" VALUE 0x0 RTE_RL_FLOAT32_IEEE 0 NO_COMPU_METHOD 0.0 0.006 SYMBOL_LINK "Rte_CalprmRom_CalRegn01Cmn_DEFAULT_RTE_CALPRM_GROUP.MotCtrlPrmEstimnFetThermCoeff_Val" 0 DISPLAY_IDENTIFIER MotCtrlPrmEstimn.CalibrationPorts.MotCtrlPrmEstimnFetThermCoeff.Val /end CHARACTERISTIC
/begin CHARACTERISTIC MotCtrlPrmEstimn.MotCtrlPrmEstimnMagThermCoeff.Val "MICROSAR RTE" VALUE 0x0 RTE_RL_FLOAT32_IEEE 0 NO_COMPU_METHOD -0.0015 0.0 SYMBOL_LINK "Rte_CalprmRom_CalRegn01Cmn_DEFAULT_RTE_CALPRM_GROUP.MotCtrlPrmEstimnMagThermCoeff_Val" 0 DISPLAY_IDENTIFIER MotCtrlPrmEstimn.CalibrationPorts.MotCtrlPrmEstimnMagThermCoeff.Val /end CHARACTERISTIC
/begin CHARACTERISTIC MotCtrlPrmEstimn.MotCtrlPrmEstimnMotBackEmfConHiLim.Val "MICROSAR RTE" VALUE 0x0 RTE_RL_FLOAT32_IEEE 0 NO_COMPU_METHOD 0.025 0.075 SYMBOL_LINK "Rte_CalprmRom_CalRegn01Cmn_DEFAULT_RTE_CALPRM_GROUP.MotCtrlPrmEstimnMotBackEmfConHiLim_Val" 0 DISPLAY_IDENTIFIER MotCtrlPrmEstimn.CalibrationPorts.MotCtrlPrmEstimnMotBackEmfConHiLim.Val /end CHARACTERISTIC
/begin CHARACTERISTIC MotCtrlPrmEstimn.MotCtrlPrmEstimnMotBackEmfConLoLim.Val "MICROSAR RTE" VALUE 0x0 RTE_RL_FLOAT32_IEEE 0 NO_COMPU_METHOD 0.025 0.075 SYMBOL_LINK "Rte_CalprmRom_CalRegn01Cmn_DEFAULT_RTE_CALPRM_GROUP.MotCtrlPrmEstimnMotBackEmfConLoLim_Val" 0 DISPLAY_IDENTIFIER MotCtrlPrmEstimn.CalibrationPorts.MotCtrlPrmEstimnMotBackEmfConLoLim.Val /end CHARACTERISTIC
/begin CHARACTERISTIC MotCtrlPrmEstimn.MotCtrlPrmEstimnMotBackEmfConNom.Val "MICROSAR RTE" VALUE 0x0 RTE_RL_FLOAT32_IEEE 0 NO_COMPU_METHOD 0.025 0.075 SYMBOL_LINK "Rte_CalprmRom_CalRegn01Cmn_DEFAULT_RTE_CALPRM_GROUP.MotCtrlPrmEstimnMotBackEmfConNom_Val" 0 DISPLAY_IDENTIFIER MotCtrlPrmEstimn.CalibrationPorts.MotCtrlPrmEstimnMotBackEmfConNom.Val /end CHARACTERISTIC
/begin CHARACTERISTIC MotCtrlPrmEstimn.MotCtrlPrmEstimnMotBackEmfConSatnScaIvtrLoaMtgtn.Val "MICROSAR RTE" VALUE 0x0 RTE_RL_FLOAT32_IEEE 0 NO_COMPU_METHOD -3.402823466e+38 3.402823466e+38 SYMBOL_LINK "Rte_CalprmRom_CalRegn01Cmn_DEFAULT_RTE_CALPRM_GROUP.MotCtrlPrmEstimnMotBackEmfConSatnScaIvtrLoaMtgtn_Val" 0 DISPLAY_IDENTIFIER MotCtrlPrmEstimn.CalibrationPorts.MotCtrlPrmEstimnMotBackEmfConSatnScaIvtrLoaMtgtn.Val /end CHARACTERISTIC
/begin CHARACTERISTIC MotCtrlPrmEstimn.MotCtrlPrmEstimnMotBackEmfConSatnX.Ary1D "MICROSAR RTE" VAL_BLK 0x0 RTE_RL_UWORD 0 RTE_CM_Curr8 0 200 MATRIX_DIM 16 1 1 SYMBOL_LINK "Rte_CalprmRom_CalRegn01Cmn_DEFAULT_RTE_CALPRM_GROUP.MotCtrlPrmEstimnMotBackEmfConSatnX_Ary1D" 0 DISPLAY_IDENTIFIER MotCtrlPrmEstimn.CalibrationPorts.MotCtrlPrmEstimnMotBackEmfConSatnX.Ary1D /end CHARACTERISTIC
/begin CHARACTERISTIC MotCtrlPrmEstimn.MotCtrlPrmEstimnMotBackEmfConSatnY.Ary1D "MICROSAR RTE" VAL_BLK 0x0 RTE_RL_UWORD 0 RTE_CM_Uls11 0 2 MATRIX_DIM 16 1 1 SYMBOL_LINK "Rte_CalprmRom_CalRegn01Cmn_DEFAULT_RTE_CALPRM_GROUP.MotCtrlPrmEstimnMotBackEmfConSatnY_Ary1D" 0 DISPLAY_IDENTIFIER MotCtrlPrmEstimn.CalibrationPorts.MotCtrlPrmEstimnMotBackEmfConSatnY.Ary1D /end CHARACTERISTIC
/begin CHARACTERISTIC MotCtrlPrmEstimn.MotCtrlPrmEstimnMotCurrDaxInduSatnBilnrSeln.Ary1D "MICROSAR RTE" VAL_BLK 0x0 RTE_RL_UWORD 0 RTE_CM_Curr8 0 200 MATRIX_DIM 6 1 1 SYMBOL_LINK "Rte_CalprmRom_CalRegn01Cmn_DEFAULT_RTE_CALPRM_GROUP.MotCtrlPrmEstimnMotCurrDaxInduSatnBilnrSeln_Ary1D" 0 DISPLAY_IDENTIFIER MotCtrlPrmEstimn.CalibrationPorts.MotCtrlPrmEstimnMotCurrDaxInduSatnBilnrSeln.Ary1D /end CHARACTERISTIC
/begin CHARACTERISTIC MotCtrlPrmEstimn.MotCtrlPrmEstimnMotCurrQaxInduSatnX.Ary1D "MICROSAR RTE" VAL_BLK 0x0 RTE_RL_UWORD 0 RTE_CM_Curr8 0 200 MATRIX_DIM 7 1 1 SYMBOL_LINK "Rte_CalprmRom_CalRegn01Cmn_DEFAULT_RTE_CALPRM_GROUP.MotCtrlPrmEstimnMotCurrQaxInduSatnX_Ary1D" 0 DISPLAY_IDENTIFIER MotCtrlPrmEstimn.CalibrationPorts.MotCtrlPrmEstimnMotCurrQaxInduSatnX.Ary1D /end CHARACTERISTIC
/begin CHARACTERISTIC MotCtrlPrmEstimn.MotCtrlPrmEstimnMotInduDaxHiLim.Val "MICROSAR RTE" VALUE 0x0 RTE_RL_FLOAT32_IEEE 0 NO_COMPU_METHOD 0.00003 0.00041 SYMBOL_LINK "Rte_CalprmRom_CalRegn01Cmn_DEFAULT_RTE_CALPRM_GROUP.MotCtrlPrmEstimnMotInduDaxHiLim_Val" 0 DISPLAY_IDENTIFIER MotCtrlPrmEstimn.CalibrationPorts.MotCtrlPrmEstimnMotInduDaxHiLim.Val /end CHARACTERISTIC
/begin CHARACTERISTIC MotCtrlPrmEstimn.MotCtrlPrmEstimnMotInduDaxIvtrLoaMtgtn.Val "MICROSAR RTE" VALUE 0x0 RTE_RL_FLOAT32_IEEE 0 NO_COMPU_METHOD -3.402823466e+38 3.402823466e+38 SYMBOL_LINK "Rte_CalprmRom_CalRegn01Cmn_DEFAULT_RTE_CALPRM_GROUP.MotCtrlPrmEstimnMotInduDaxIvtrLoaMtgtn_Val" 0 DISPLAY_IDENTIFIER MotCtrlPrmEstimn.CalibrationPorts.MotCtrlPrmEstimnMotInduDaxIvtrLoaMtgtn.Val /end CHARACTERISTIC
/begin CHARACTERISTIC MotCtrlPrmEstimn.MotCtrlPrmEstimnMotInduDaxLoLim.Val "MICROSAR RTE" VALUE 0x0 RTE_RL_FLOAT32_IEEE 0 NO_COMPU_METHOD 0.00003 0.00041 SYMBOL_LINK "Rte_CalprmRom_CalRegn01Cmn_DEFAULT_RTE_CALPRM_GROUP.MotCtrlPrmEstimnMotInduDaxLoLim_Val" 0 DISPLAY_IDENTIFIER MotCtrlPrmEstimn.CalibrationPorts.MotCtrlPrmEstimnMotInduDaxLoLim.Val /end CHARACTERISTIC
/begin CHARACTERISTIC MotCtrlPrmEstimn.MotCtrlPrmEstimnMotInduDaxNom.Val "MICROSAR RTE" VALUE 0x0 RTE_RL_FLOAT32_IEEE 0 NO_COMPU_METHOD 0.00003 0.00041 SYMBOL_LINK "Rte_CalprmRom_CalRegn01Cmn_DEFAULT_RTE_CALPRM_GROUP.MotCtrlPrmEstimnMotInduDaxNom_Val" 0 DISPLAY_IDENTIFIER MotCtrlPrmEstimn.CalibrationPorts.MotCtrlPrmEstimnMotInduDaxNom.Val /end CHARACTERISTIC
/begin CHARACTERISTIC MotCtrlPrmEstimn.MotCtrlPrmEstimnMotInduDaxSatnScaY.Ary2D "MICROSAR RTE" VAL_BLK 0x0 RTE_RL_UWORD 0 NO_COMPU_METHOD 0 65535 MATRIX_DIM 7 6 1 SYMBOL_LINK "Rte_CalprmRom_CalRegn01Cmn_DEFAULT_RTE_CALPRM_GROUP.MotCtrlPrmEstimnMotInduDaxSatnScaY_Ary2D" 0 DISPLAY_IDENTIFIER MotCtrlPrmEstimn.CalibrationPorts.MotCtrlPrmEstimnMotInduDaxSatnScaY.Ary2D /end CHARACTERISTIC
/begin CHARACTERISTIC MotCtrlPrmEstimn.MotCtrlPrmEstimnMotInduQaxHiLim.Val "MICROSAR RTE" VALUE 0x0 RTE_RL_FLOAT32_IEEE 0 NO_COMPU_METHOD 0.00003 0.00041 SYMBOL_LINK "Rte_CalprmRom_CalRegn01Cmn_DEFAULT_RTE_CALPRM_GROUP.MotCtrlPrmEstimnMotInduQaxHiLim_Val" 0 DISPLAY_IDENTIFIER MotCtrlPrmEstimn.CalibrationPorts.MotCtrlPrmEstimnMotInduQaxHiLim.Val /end CHARACTERISTIC
/begin CHARACTERISTIC MotCtrlPrmEstimn.MotCtrlPrmEstimnMotInduQaxIvtrLoaMtgtn.Val "MICROSAR RTE" VALUE 0x0 RTE_RL_FLOAT32_IEEE 0 NO_COMPU_METHOD -3.402823466e+38 3.402823466e+38 SYMBOL_LINK "Rte_CalprmRom_CalRegn01Cmn_DEFAULT_RTE_CALPRM_GROUP.MotCtrlPrmEstimnMotInduQaxIvtrLoaMtgtn_Val" 0 DISPLAY_IDENTIFIER MotCtrlPrmEstimn.CalibrationPorts.MotCtrlPrmEstimnMotInduQaxIvtrLoaMtgtn.Val /end CHARACTERISTIC
/begin CHARACTERISTIC MotCtrlPrmEstimn.MotCtrlPrmEstimnMotInduQaxLoLim.Val "MICROSAR RTE" VALUE 0x0 RTE_RL_FLOAT32_IEEE 0 NO_COMPU_METHOD 0.00003 0.00041 SYMBOL_LINK "Rte_CalprmRom_CalRegn01Cmn_DEFAULT_RTE_CALPRM_GROUP.MotCtrlPrmEstimnMotInduQaxLoLim_Val" 0 DISPLAY_IDENTIFIER MotCtrlPrmEstimn.CalibrationPorts.MotCtrlPrmEstimnMotInduQaxLoLim.Val /end CHARACTERISTIC
/begin CHARACTERISTIC MotCtrlPrmEstimn.MotCtrlPrmEstimnMotInduQaxNom.Val "MICROSAR RTE" VALUE 0x0 RTE_RL_FLOAT32_IEEE 0 NO_COMPU_METHOD 0.00003 0.00041 SYMBOL_LINK "Rte_CalprmRom_CalRegn01Cmn_DEFAULT_RTE_CALPRM_GROUP.MotCtrlPrmEstimnMotInduQaxNom_Val" 0 DISPLAY_IDENTIFIER MotCtrlPrmEstimn.CalibrationPorts.MotCtrlPrmEstimnMotInduQaxNom.Val /end CHARACTERISTIC
/begin CHARACTERISTIC MotCtrlPrmEstimn.MotCtrlPrmEstimnMotInduQaxSatnScaY.Ary2D "MICROSAR RTE" VAL_BLK 0x0 RTE_RL_UWORD 0 NO_COMPU_METHOD 0 65535 MATRIX_DIM 7 6 1 SYMBOL_LINK "Rte_CalprmRom_CalRegn01Cmn_DEFAULT_RTE_CALPRM_GROUP.MotCtrlPrmEstimnMotInduQaxSatnScaY_Ary2D" 0 DISPLAY_IDENTIFIER MotCtrlPrmEstimn.CalibrationPorts.MotCtrlPrmEstimnMotInduQaxSatnScaY.Ary2D /end CHARACTERISTIC
/begin CHARACTERISTIC MotCtrlPrmEstimn.MotCtrlPrmEstimnMotRHiLim.Val "MICROSAR RTE" VALUE 0x0 RTE_RL_FLOAT32_IEEE 0 NO_COMPU_METHOD 0.005 0.12565 SYMBOL_LINK "Rte_CalprmRom_CalRegn01Cmn_DEFAULT_RTE_CALPRM_GROUP.MotCtrlPrmEstimnMotRHiLim_Val" 0 DISPLAY_IDENTIFIER MotCtrlPrmEstimn.CalibrationPorts.MotCtrlPrmEstimnMotRHiLim.Val /end CHARACTERISTIC
/begin CHARACTERISTIC MotCtrlPrmEstimn.MotCtrlPrmEstimnMotRLoLim.Val "MICROSAR RTE" VALUE 0x0 RTE_RL_FLOAT32_IEEE 0 NO_COMPU_METHOD 0.005 0.12565 SYMBOL_LINK "Rte_CalprmRom_CalRegn01Cmn_DEFAULT_RTE_CALPRM_GROUP.MotCtrlPrmEstimnMotRLoLim_Val" 0 DISPLAY_IDENTIFIER MotCtrlPrmEstimn.CalibrationPorts.MotCtrlPrmEstimnMotRLoLim.Val /end CHARACTERISTIC
/begin CHARACTERISTIC MotCtrlPrmEstimn.MotCtrlPrmEstimnMotRNom.Val "MICROSAR RTE" VALUE 0x0 RTE_RL_FLOAT32_IEEE 0 NO_COMPU_METHOD 0.005 0.12565 SYMBOL_LINK "Rte_CalprmRom_CalRegn01Cmn_DEFAULT_RTE_CALPRM_GROUP.MotCtrlPrmEstimnMotRNom_Val" 0 DISPLAY_IDENTIFIER MotCtrlPrmEstimn.CalibrationPorts.MotCtrlPrmEstimnMotRNom.Val /end CHARACTERISTIC
/begin CHARACTERISTIC MotCtrlPrmEstimn.MotCtrlPrmEstimnMotWidgThermCoeff.Val "MICROSAR RTE" VALUE 0x0 RTE_RL_FLOAT32_IEEE 0 NO_COMPU_METHOD 0.0 0.0045 SYMBOL_LINK "Rte_CalprmRom_CalRegn01Cmn_DEFAULT_RTE_CALPRM_GROUP.MotCtrlPrmEstimnMotWidgThermCoeff_Val" 0 DISPLAY_IDENTIFIER MotCtrlPrmEstimn.CalibrationPorts.MotCtrlPrmEstimnMotWidgThermCoeff.Val /end CHARACTERISTIC
/begin CHARACTERISTIC MotCtrlPrmEstimn.MotCtrlPrmEstimnTNom.Val "MICROSAR RTE" VALUE 0x0 RTE_RL_FLOAT32_IEEE 0 NO_COMPU_METHOD -40.0 150.0 SYMBOL_LINK "Rte_CalprmRom_CalRegn01Cmn_DEFAULT_RTE_CALPRM_GROUP.MotCtrlPrmEstimnTNom_Val" 0 DISPLAY_IDENTIFIER MotCtrlPrmEstimn.CalibrationPorts.MotCtrlPrmEstimnTNom.Val /end CHARACTERISTIC
/begin CHARACTERISTIC MotCurrPeakEstimn.MotCurrPeakEstimnCurrFilFrq.Val "MICROSAR RTE" VALUE 0x0 RTE_RL_FLOAT32_IEEE 0 NO_COMPU_METHOD -3.402823466e+38 3.402823466e+38 SYMBOL_LINK "Rte_CalprmRom_CalRegn01Cmn_DEFAULT_RTE_CALPRM_GROUP.MotCurrPeakEstimnCurrFilFrq_Val" 0 DISPLAY_IDENTIFIER MotCurrPeakEstimn.CalibrationPorts.MotCurrPeakEstimnCurrFilFrq.Val /end CHARACTERISTIC
/begin CHARACTERISTIC MotCurrPeakEstimn.MotCurrPeakEstimnCurrPeakEstimdFilFrq.Val "MICROSAR RTE" VALUE 0x0 RTE_RL_FLOAT32_IEEE 0 NO_COMPU_METHOD -3.402823466e+38 3.402823466e+38 SYMBOL_LINK "Rte_CalprmRom_CalRegn01Cmn_DEFAULT_RTE_CALPRM_GROUP.MotCurrPeakEstimnCurrPeakEstimdFilFrq_Val" 0 DISPLAY_IDENTIFIER MotCurrPeakEstimn.CalibrationPorts.MotCurrPeakEstimnCurrPeakEstimdFilFrq.Val /end CHARACTERISTIC
/begin CHARACTERISTIC MotCurrRegCfg.MotCurrRegCfgCtrlrDynGainVehSpdCutOff.Val "MICROSAR RTE" VALUE 0x0 RTE_RL_FLOAT32_IEEE 0 NO_COMPU_METHOD -3.402823466e+38 3.402823466e+38 SYMBOL_LINK "Rte_CalprmRom_CalRegn01Cmn_DEFAULT_RTE_CALPRM_GROUP.MotCurrRegCfgCtrlrDynGainVehSpdCutOff_Val" 0 DISPLAY_IDENTIFIER MotCurrRegCfg.CalibrationPorts.MotCurrRegCfgCtrlrDynGainVehSpdCutOff.Val /end CHARACTERISTIC
/begin CHARACTERISTIC MotCurrRegCfg.MotCurrRegCfgCurrLoopSecOrderTrfFctEna.Logl "MICROSAR RTE" VALUE 0x0 RTE_RL_BOOLEAN 0 RTE_CM_BOOLEAN 0 255 SYMBOL_LINK "Rte_CalprmRom_CalRegn01Cmn_DEFAULT_RTE_CALPRM_GROUP.MotCurrRegCfgCurrLoopSecOrderTrfFctEna_Logl" 0 DISPLAY_IDENTIFIER MotCurrRegCfg.CalibrationPorts.MotCurrRegCfgCurrLoopSecOrderTrfFctEna.Logl /end CHARACTERISTIC
/begin CHARACTERISTIC MotCurrRegCfg.MotCurrRegCfgIntglGainSampleTi.Val "MICROSAR RTE" VALUE 0x0 RTE_RL_FLOAT32_IEEE 0 NO_COMPU_METHOD -3.402823466e+38 3.402823466e+38 SYMBOL_LINK "Rte_CalprmRom_CalRegn01Cmn_DEFAULT_RTE_CALPRM_GROUP.MotCurrRegCfgIntglGainSampleTi_Val" 0 DISPLAY_IDENTIFIER MotCurrRegCfg.CalibrationPorts.MotCurrRegCfgIntglGainSampleTi.Val /end CHARACTERISTIC
/begin CHARACTERISTIC MotCurrRegCfg.MotCurrRegCfgMotAgCompuDly.Val "MICROSAR RTE" VALUE 0x0 RTE_RL_FLOAT32_IEEE 0 NO_COMPU_METHOD -3.402823466e+38 3.402823466e+38 SYMBOL_LINK "Rte_CalprmRom_CalRegn01Cmn_DEFAULT_RTE_CALPRM_GROUP.MotCurrRegCfgMotAgCompuDly_Val" 0 DISPLAY_IDENTIFIER MotCurrRegCfg.CalibrationPorts.MotCurrRegCfgMotAgCompuDly.Val /end CHARACTERISTIC
/begin CHARACTERISTIC MotCurrRegCfg.MotCurrRegCfgMotClsdLoopBwDaxY.Ary1D "MICROSAR RTE" VAL_BLK 0x0 RTE_RL_UWORD 0 NO_COMPU_METHOD 0 65535 MATRIX_DIM 4 1 1 SYMBOL_LINK "Rte_CalprmRom_CalRegn01Cmn_DEFAULT_RTE_CALPRM_GROUP.MotCurrRegCfgMotClsdLoopBwDaxY_Ary1D" 0 DISPLAY_IDENTIFIER MotCurrRegCfg.CalibrationPorts.MotCurrRegCfgMotClsdLoopBwDaxY.Ary1D /end CHARACTERISTIC
/begin CHARACTERISTIC MotCurrRegCfg.MotCurrRegCfgMotClsdLoopBwQaxY.Ary1D "MICROSAR RTE" VAL_BLK 0x0 RTE_RL_UWORD 0 NO_COMPU_METHOD 0 65535 MATRIX_DIM 4 1 1 SYMBOL_LINK "Rte_CalprmRom_CalRegn01Cmn_DEFAULT_RTE_CALPRM_GROUP.MotCurrRegCfgMotClsdLoopBwQaxY_Ary1D" 0 DISPLAY_IDENTIFIER MotCurrRegCfg.CalibrationPorts.MotCurrRegCfgMotClsdLoopBwQaxY.Ary1D /end CHARACTERISTIC
/begin CHARACTERISTIC MotCurrRegCfg.MotCurrRegCfgMotCtrlPrmSelnX.Ary1D "MICROSAR RTE" VAL_BLK 0x0 RTE_RL_UWORD 0 NO_COMPU_METHOD 0 65535 MATRIX_DIM 4 1 1 SYMBOL_LINK "Rte_CalprmRom_CalRegn01Cmn_DEFAULT_RTE_CALPRM_GROUP.MotCurrRegCfgMotCtrlPrmSelnX_Ary1D" 0 DISPLAY_IDENTIFIER MotCurrRegCfg.CalibrationPorts.MotCurrRegCfgMotCtrlPrmSelnX.Ary1D /end CHARACTERISTIC
/begin CHARACTERISTIC MotCurrRegCfg.MotCurrRegCfgMotDampgRatDax.Val "MICROSAR RTE" VALUE 0x0 RTE_RL_FLOAT32_IEEE 0 NO_COMPU_METHOD -3.402823466e+38 3.402823466e+38 SYMBOL_LINK "Rte_CalprmRom_CalRegn01Cmn_DEFAULT_RTE_CALPRM_GROUP.MotCurrRegCfgMotDampgRatDax_Val" 0 DISPLAY_IDENTIFIER MotCurrRegCfg.CalibrationPorts.MotCurrRegCfgMotDampgRatDax.Val /end CHARACTERISTIC
/begin CHARACTERISTIC MotCurrRegCfg.MotCurrRegCfgMotDampgRatQax.Val "MICROSAR RTE" VALUE 0x0 RTE_RL_FLOAT32_IEEE 0 NO_COMPU_METHOD -3.402823466e+38 3.402823466e+38 SYMBOL_LINK "Rte_CalprmRom_CalRegn01Cmn_DEFAULT_RTE_CALPRM_GROUP.MotCurrRegCfgMotDampgRatQax_Val" 0 DISPLAY_IDENTIFIER MotCurrRegCfg.CalibrationPorts.MotCurrRegCfgMotDampgRatQax.Val /end CHARACTERISTIC
/begin CHARACTERISTIC MotCurrRegCfg.MotCurrRegCfgMotNatFrqDaxY.Ary1D "MICROSAR RTE" VAL_BLK 0x0 RTE_RL_UWORD 0 NO_COMPU_METHOD 0 65535 MATRIX_DIM 4 1 1 SYMBOL_LINK "Rte_CalprmRom_CalRegn01Cmn_DEFAULT_RTE_CALPRM_GROUP.MotCurrRegCfgMotNatFrqDaxY_Ary1D" 0 DISPLAY_IDENTIFIER MotCurrRegCfg.CalibrationPorts.MotCurrRegCfgMotNatFrqDaxY.Ary1D /end CHARACTERISTIC
/begin CHARACTERISTIC MotCurrRegCfg.MotCurrRegCfgMotNatFrqQaxY.Ary1D "MICROSAR RTE" VAL_BLK 0x0 RTE_RL_UWORD 0 NO_COMPU_METHOD 0 65535 MATRIX_DIM 4 1 1 SYMBOL_LINK "Rte_CalprmRom_CalRegn01Cmn_DEFAULT_RTE_CALPRM_GROUP.MotCurrRegCfgMotNatFrqQaxY_Ary1D" 0 DISPLAY_IDENTIFIER MotCurrRegCfg.CalibrationPorts.MotCurrRegCfgMotNatFrqQaxY.Ary1D /end CHARACTERISTIC
/begin CHARACTERISTIC MotCurrRegCfg.MotCurrRegCfgMotRVirtDax.Val "MICROSAR RTE" VALUE 0x0 RTE_RL_FLOAT32_IEEE 0 NO_COMPU_METHOD -3.402823466e+38 3.402823466e+38 SYMBOL_LINK "Rte_CalprmRom_CalRegn01Cmn_DEFAULT_RTE_CALPRM_GROUP.MotCurrRegCfgMotRVirtDax_Val" 0 DISPLAY_IDENTIFIER MotCurrRegCfg.CalibrationPorts.MotCurrRegCfgMotRVirtDax.Val /end CHARACTERISTIC
/begin CHARACTERISTIC MotCurrRegCfg.MotCurrRegCfgMotRVirtQax.Val "MICROSAR RTE" VALUE 0x0 RTE_RL_FLOAT32_IEEE 0 NO_COMPU_METHOD -3.402823466e+38 3.402823466e+38 SYMBOL_LINK "Rte_CalprmRom_CalRegn01Cmn_DEFAULT_RTE_CALPRM_GROUP.MotCurrRegCfgMotRVirtQax_Val" 0 DISPLAY_IDENTIFIER MotCurrRegCfg.CalibrationPorts.MotCurrRegCfgMotRVirtQax.Val /end CHARACTERISTIC
/begin CHARACTERISTIC MotCurrRegCfg.MotCurrRegCfgMotVelFilFrq.Val "MICROSAR RTE" VALUE 0x0 RTE_RL_FLOAT32_IEEE 0 NO_COMPU_METHOD -3.402823466e+38 3.402823466e+38 SYMBOL_LINK "Rte_CalprmRom_CalRegn01Cmn_DEFAULT_RTE_CALPRM_GROUP.MotCurrRegCfgMotVelFilFrq_Val" 0 DISPLAY_IDENTIFIER MotCurrRegCfg.CalibrationPorts.MotCurrRegCfgMotVelFilFrq.Val /end CHARACTERISTIC
/begin CHARACTERISTIC MotCurrRegCfg.MotRefMdlFbCtrlDi.Logl "MICROSAR RTE" VALUE 0x0 RTE_RL_BOOLEAN 0 RTE_CM_BOOLEAN 0 255 SYMBOL_LINK "Rte_CalprmRom_CalRegn01Cmn_DEFAULT_RTE_CALPRM_GROUP.MotRefMdlFbCtrlDi_Logl" 0 DISPLAY_IDENTIFIER MotCurrRegCfg.CalibrationPorts.MotRefMdlFbCtrlDi.Logl /end CHARACTERISTIC
/begin CHARACTERISTIC MotCurrRegCfg.SysGlbPrmMotPoleCnt.Val "MICROSAR RTE" VALUE 0x0 RTE_RL_UBYTE 0 NO_COMPU_METHOD 0 255 SYMBOL_LINK "Rte_CalprmRom_CalRegn01Inin00_DEFAULT_RTE_CALPRM_GROUP.SysGlbPrmMotPoleCnt_Val" 0 DISPLAY_IDENTIFIER MotCurrRegCfg.CalibrationPorts.SysGlbPrmMotPoleCnt.Val /end CHARACTERISTIC
/begin CHARACTERISTIC MotQuadDetn.MotQuadDetnMotDirHysInsts.Val "MICROSAR RTE" VALUE 0x0 RTE_RL_SLONG 0 NO_COMPU_METHOD -2147483648 2147483647 SYMBOL_LINK "Rte_CalprmRom_CalRegn01Cmn_DEFAULT_RTE_CALPRM_GROUP.MotQuadDetnMotDirHysInsts_Val" 0 DISPLAY_IDENTIFIER MotQuadDetn.CalibrationPorts.MotQuadDetnMotDirHysInsts.Val /end CHARACTERISTIC
/begin CHARACTERISTIC MotRefMdl.MotRefMdlCurrDaxBoostGain.Val "MICROSAR RTE" VALUE 0x0 RTE_RL_FLOAT32_IEEE 0 NO_COMPU_METHOD 0.0 1.0 SYMBOL_LINK "Rte_CalprmRom_CalRegn01Cmn_DEFAULT_RTE_CALPRM_GROUP.MotRefMdlCurrDaxBoostGain_Val" 0 DISPLAY_IDENTIFIER MotRefMdl.CalibrationPorts.MotRefMdlCurrDaxBoostGain.Val /end CHARACTERISTIC
/begin CHARACTERISTIC MotRefMdl.MotRefMdlCurrDaxBoostTqScaX.Ary1D "MICROSAR RTE" VAL_BLK 0x0 RTE_RL_UWORD 0 RTE_CM_Tq13 0 8.8 MATRIX_DIM 11 1 1 SYMBOL_LINK "Rte_CalprmRom_CalRegn01Cmn_DEFAULT_RTE_CALPRM_GROUP.MotRefMdlCurrDaxBoostTqScaX_Ary1D" 0 DISPLAY_IDENTIFIER MotRefMdl.CalibrationPorts.MotRefMdlCurrDaxBoostTqScaX.Ary1D /end CHARACTERISTIC
/begin CHARACTERISTIC MotRefMdl.MotRefMdlCurrDaxBoostTqScaY.Ary1D "MICROSAR RTE" VAL_BLK 0x0 RTE_RL_UWORD 0 RTE_CM_Uls15 0 1 MATRIX_DIM 11 1 1 SYMBOL_LINK "Rte_CalprmRom_CalRegn01Cmn_DEFAULT_RTE_CALPRM_GROUP.MotRefMdlCurrDaxBoostTqScaY_Ary1D" 0 DISPLAY_IDENTIFIER MotRefMdl.CalibrationPorts.MotRefMdlCurrDaxBoostTqScaY.Ary1D /end CHARACTERISTIC
/begin CHARACTERISTIC MotRefMdl.MotRefMdlCurrDaxQaxRefDelta.Ary1D "MICROSAR RTE" VAL_BLK 0x0 RTE_RL_FLOAT32_IEEE 0 NO_COMPU_METHOD -3.1415927 3.1415927 MATRIX_DIM 8 1 1 SYMBOL_LINK "Rte_CalprmRom_CalRegn01Cmn_DEFAULT_RTE_CALPRM_GROUP.MotRefMdlCurrDaxQaxRefDelta_Ary1D" 0 DISPLAY_IDENTIFIER MotRefMdl.CalibrationPorts.MotRefMdlCurrDaxQaxRefDelta.Ary1D /end CHARACTERISTIC
/begin CHARACTERISTIC MotRefMdl.MotRefMdlCurrItrnTolr.Val "MICROSAR RTE" VALUE 0x0 RTE_RL_FLOAT32_IEEE 0 NO_COMPU_METHOD 0.01 20.0 SYMBOL_LINK "Rte_CalprmRom_CalRegn01Cmn_DEFAULT_RTE_CALPRM_GROUP.MotRefMdlCurrItrnTolr_Val" 0 DISPLAY_IDENTIFIER MotRefMdl.CalibrationPorts.MotRefMdlCurrItrnTolr.Val /end CHARACTERISTIC
/begin CHARACTERISTIC MotRefMdl.MotRefMdlFbCtrlDi.Logl "MICROSAR RTE" VALUE 0x0 RTE_RL_BOOLEAN 0 RTE_CM_BOOLEAN 0 255 SYMBOL_LINK "Rte_CalprmRom_CalRegn01Cmn_DEFAULT_RTE_CALPRM_GROUP.MotRefMdlFbCtrlDi_Logl" 0 DISPLAY_IDENTIFIER MotRefMdl.CalibrationPorts.MotRefMdlFbCtrlDi.Logl /end CHARACTERISTIC
/begin CHARACTERISTIC MotRefMdl.MotRefMdlIvtrDeadTiBrdgVltgSca.Val "MICROSAR RTE" VALUE 0x0 RTE_RL_FLOAT32_IEEE 0 NO_COMPU_METHOD 0.98 1 SYMBOL_LINK "Rte_CalprmRom_CalRegn01Cmn_DEFAULT_RTE_CALPRM_GROUP.MotRefMdlIvtrDeadTiBrdgVltgSca_Val" 0 DISPLAY_IDENTIFIER MotRefMdl.CalibrationPorts.MotRefMdlIvtrDeadTiBrdgVltgSca.Val /end CHARACTERISTIC
/begin CHARACTERISTIC MotRefMdl.MotRefMdlMinCurrItrnLim.Val "MICROSAR RTE" VALUE 0x0 RTE_RL_UBYTE 0 NO_COMPU_METHOD 1.0 5.0 SYMBOL_LINK "Rte_CalprmRom_CalRegn01Cmn_DEFAULT_RTE_CALPRM_GROUP.MotRefMdlMinCurrItrnLim_Val" 0 DISPLAY_IDENTIFIER MotRefMdl.CalibrationPorts.MotRefMdlMinCurrItrnLim.Val /end CHARACTERISTIC
/begin CHARACTERISTIC MotRefMdl.MotRefMdlMotCurrDaxMaxSca.Val "MICROSAR RTE" VALUE 0x0 RTE_RL_FLOAT32_IEEE 0 NO_COMPU_METHOD 1.0 2.0 SYMBOL_LINK "Rte_CalprmRom_CalRegn01Cmn_DEFAULT_RTE_CALPRM_GROUP.MotRefMdlMotCurrDaxMaxSca_Val" 0 DISPLAY_IDENTIFIER MotRefMdl.CalibrationPorts.MotRefMdlMotCurrDaxMaxSca.Val /end CHARACTERISTIC
/begin CHARACTERISTIC MotRefMdl.MotRefMdlMotVelLpFilFrq.Val "MICROSAR RTE" VALUE 0x0 RTE_RL_FLOAT32_IEEE 0 NO_COMPU_METHOD 1.0 200.0 SYMBOL_LINK "Rte_CalprmRom_CalRegn01Cmn_DEFAULT_RTE_CALPRM_GROUP.MotRefMdlMotVelLpFilFrq_Val" 0 DISPLAY_IDENTIFIER MotRefMdl.CalibrationPorts.MotRefMdlMotVelLpFilFrq.Val /end CHARACTERISTIC
/begin CHARACTERISTIC MotRefMdl.MotRefMdlMotVltgDerivtvTiCon.Val "MICROSAR RTE" VALUE 0x0 RTE_RL_FLOAT32_IEEE 0 NO_COMPU_METHOD 0.0 0.05 SYMBOL_LINK "Rte_CalprmRom_CalRegn01Cmn_DEFAULT_RTE_CALPRM_GROUP.MotRefMdlMotVltgDerivtvTiCon_Val" 0 DISPLAY_IDENTIFIER MotRefMdl.CalibrationPorts.MotRefMdlMotVltgDerivtvTiCon.Val /end CHARACTERISTIC
/begin CHARACTERISTIC MotRefMdl.MotRefMdlQuad13VltgSdlX.Ary1D "MICROSAR RTE" VAL_BLK 0x0 RTE_RL_UWORD 0 RTE_CM_Vel4 0 1350 MATRIX_DIM 10 1 1 SYMBOL_LINK "Rte_CalprmRom_CalRegn01Cmn_DEFAULT_RTE_CALPRM_GROUP.MotRefMdlQuad13VltgSdlX_Ary1D" 0 DISPLAY_IDENTIFIER MotRefMdl.CalibrationPorts.MotRefMdlQuad13VltgSdlX.Ary1D /end CHARACTERISTIC
/begin CHARACTERISTIC MotRefMdl.MotRefMdlQuad13VltgSdlY.Ary1D "MICROSAR RTE" VAL_BLK 0x0 RTE_RL_UWORD 0 RTE_CM_Volt18 0 5 MATRIX_DIM 10 1 1 SYMBOL_LINK "Rte_CalprmRom_CalRegn01Cmn_DEFAULT_RTE_CALPRM_GROUP.MotRefMdlQuad13VltgSdlY_Ary1D" 0 DISPLAY_IDENTIFIER MotRefMdl.CalibrationPorts.MotRefMdlQuad13VltgSdlY.Ary1D /end CHARACTERISTIC
/begin CHARACTERISTIC MotRefMdl.MotRefMdlQuad24VltgSdlX.Ary1D "MICROSAR RTE" VAL_BLK 0x0 RTE_RL_UWORD 0 RTE_CM_Vel4 0 1350 MATRIX_DIM 10 1 1 SYMBOL_LINK "Rte_CalprmRom_CalRegn01Cmn_DEFAULT_RTE_CALPRM_GROUP.MotRefMdlQuad24VltgSdlX_Ary1D" 0 DISPLAY_IDENTIFIER MotRefMdl.CalibrationPorts.MotRefMdlQuad24VltgSdlX.Ary1D /end CHARACTERISTIC
/begin CHARACTERISTIC MotRefMdl.MotRefMdlQuad24VltgSdlY.Ary1D "MICROSAR RTE" VAL_BLK 0x0 RTE_RL_UWORD 0 RTE_CM_Volt18 0 5 MATRIX_DIM 10 1 1 SYMBOL_LINK "Rte_CalprmRom_CalRegn01Cmn_DEFAULT_RTE_CALPRM_GROUP.MotRefMdlQuad24VltgSdlY_Ary1D" 0 DISPLAY_IDENTIFIER MotRefMdl.CalibrationPorts.MotRefMdlQuad24VltgSdlY.Ary1D /end CHARACTERISTIC
/begin CHARACTERISTIC MotRefMdl.MotRefMdlRefLocnItrnLim.Val "MICROSAR RTE" VALUE 0x0 RTE_RL_UBYTE 0 NO_COMPU_METHOD 1.0 20.0 SYMBOL_LINK "Rte_CalprmRom_CalRegn01Cmn_DEFAULT_RTE_CALPRM_GROUP.MotRefMdlRefLocnItrnLim_Val" 0 DISPLAY_IDENTIFIER MotRefMdl.CalibrationPorts.MotRefMdlRefLocnItrnLim.Val /end CHARACTERISTIC
/begin CHARACTERISTIC MotRefMdl.MotRefMdlTqItrnLim.Val "MICROSAR RTE" VALUE 0x0 RTE_RL_UBYTE 0 NO_COMPU_METHOD 1.0 5.0 SYMBOL_LINK "Rte_CalprmRom_CalRegn01Cmn_DEFAULT_RTE_CALPRM_GROUP.MotRefMdlTqItrnLim_Val" 0 DISPLAY_IDENTIFIER MotRefMdl.CalibrationPorts.MotRefMdlTqItrnLim.Val /end CHARACTERISTIC
/begin CHARACTERISTIC MotRefMdl.MotRefMdlTqItrnTolr.Val "MICROSAR RTE" VALUE 0x0 RTE_RL_FLOAT32_IEEE 0 NO_COMPU_METHOD 0.001 0.1 SYMBOL_LINK "Rte_CalprmRom_CalRegn01Cmn_DEFAULT_RTE_CALPRM_GROUP.MotRefMdlTqItrnTolr_Val" 0 DISPLAY_IDENTIFIER MotRefMdl.CalibrationPorts.MotRefMdlTqItrnTolr.Val /end CHARACTERISTIC
/begin CHARACTERISTIC MotRefMdl.MotRefMdlVltgModDynCmpEna.Logl "MICROSAR RTE" VALUE 0x0 RTE_RL_BOOLEAN 0 RTE_CM_BOOLEAN 0 255 SYMBOL_LINK "Rte_CalprmRom_CalRegn01Cmn_DEFAULT_RTE_CALPRM_GROUP.MotRefMdlVltgModDynCmpEna_Logl" 0 DISPLAY_IDENTIFIER MotRefMdl.CalibrationPorts.MotRefMdlVltgModDynCmpEna.Logl /end CHARACTERISTIC
/begin CHARACTERISTIC MotRefMdl.MotRefMdlVltgOverRThdSca.Val "MICROSAR RTE" VALUE 0x0 RTE_RL_FLOAT32_IEEE 0 NO_COMPU_METHOD 0.0 1.0 SYMBOL_LINK "Rte_CalprmRom_CalRegn01Cmn_DEFAULT_RTE_CALPRM_GROUP.MotRefMdlVltgOverRThdSca_Val" 0 DISPLAY_IDENTIFIER MotRefMdl.CalibrationPorts.MotRefMdlVltgOverRThdSca.Val /end CHARACTERISTIC
/begin CHARACTERISTIC MotRefMdl.SysGlbPrmMotPoleCnt.Val "MICROSAR RTE" VALUE 0x0 RTE_RL_UBYTE 0 NO_COMPU_METHOD 2 12 SYMBOL_LINK "Rte_CalprmRom_CalRegn01Inin00_DEFAULT_RTE_CALPRM_GROUP.SysGlbPrmMotPoleCnt_Val" 0 DISPLAY_IDENTIFIER MotRefMdl.CalibrationPorts.SysGlbPrmMotPoleCnt.Val /end CHARACTERISTIC
/begin MEASUREMENT LoaMgr.LoaRateLim.Val "MICROSAR RTE" FLOAT32_IEEE NO_COMPU_METHOD 0 0 -3.402823466e+38 3.402823466e+38 ECU_ADDRESS 0 SYMBOL_LINK "Rte_LoaMgr_LoaRateLim_Val" 0 DISPLAY_IDENTIFIER LoaMgr.SenderPorts.LoaRateLim.Val /end MEASUREMENT
/begin MEASUREMENT LoaMgr.LoaSca.Val "MICROSAR RTE" FLOAT32_IEEE NO_COMPU_METHOD 0 0 -3.402823466e+38 3.402823466e+38 ECU_ADDRESS 0 SYMBOL_LINK "Rte_LoaMgr_LoaSca_Val" 0 DISPLAY_IDENTIFIER LoaMgr.SenderPorts.LoaSca.Val /end MEASUREMENT
/begin MEASUREMENT LoaMgr.LoaScaDi.Logl "MICROSAR RTE" UBYTE RTE_CM_BOOLEAN 0 0 0 255 ECU_ADDRESS 0 SYMBOL_LINK "Rte_CmnMfgSrv_LoaScaDi_Logl" 0 DISPLAY_IDENTIFIER LoaMgr.ReceiverPorts.LoaScaDi.Logl /end MEASUREMENT
/begin MEASUREMENT LoaMgr.LoaSt.Val "MICROSAR RTE" UBYTE RTE_CM_ENUM_LoaSt1 0 0 0 255 ECU_ADDRESS 0 SYMBOL_LINK "Rte_LoaMgr_LoaSt_Val" 0 DISPLAY_IDENTIFIER LoaMgr.SenderPorts.LoaSt.Val /end MEASUREMENT
/begin MEASUREMENT LoaMgr.MotAgLoaMtgtnEna.Logl "MICROSAR RTE" UBYTE RTE_CM_BOOLEAN 0 0 0 255 ECU_ADDRESS 0 SYMBOL_LINK "Rte_LoaMgr_MotAgLoaMtgtnEna_Logl" 0 DISPLAY_IDENTIFIER LoaMgr.SenderPorts.MotAgLoaMtgtnEna.Logl /end MEASUREMENT
/begin MEASUREMENT LoaMgr.MotAgMeclIdptSig.Val "MICROSAR RTE" UBYTE NO_COMPU_METHOD 0 0 0 255 ECU_ADDRESS 0 SYMBOL_LINK "Rte_MotAgCorrln_MotAgMeclIdptSig_Val" 0 DISPLAY_IDENTIFIER LoaMgr.ReceiverPorts.MotAgMeclIdptSig.Val /end MEASUREMENT
/begin MEASUREMENT LoaMgr.MotAgSnsrlsAvl.Logl "MICROSAR RTE" UBYTE RTE_CM_BOOLEAN 0 0 0 255 ECU_ADDRESS 0 SYMBOL_LINK "Rte_LoaMgr_MotAgSnsrlsAvl_Logl" 0 DISPLAY_IDENTIFIER LoaMgr.ReceiverPorts.MotAgSnsrlsAvl.Logl /end MEASUREMENT
/begin MEASUREMENT LoaMgr.MotAndThermProtnLoaMod.Val "MICROSAR RTE" UBYTE NO_COMPU_METHOD 0 0 0 255 ECU_ADDRESS 0 SYMBOL_LINK "Rte_LoaMgr_MotAndThermProtnLoaMod_Val" 0 DISPLAY_IDENTIFIER LoaMgr.SenderPorts.MotAndThermProtnLoaMod.Val /end MEASUREMENT
/begin MEASUREMENT LoaMgr.PrevCurrMeasIdptSigResp "MICROSAR RTE" UBYTE NO_COMPU_METHOD 0 0 0 255 ECU_ADDRESS 0 SYMBOL_LINK "Rte_LoaMgr_PrevCurrMeasIdptSigResp" 0 DISPLAY_IDENTIFIER LoaMgr.PerInstanceMemories.PrevCurrMeasIdptSigResp /end MEASUREMENT
/begin MEASUREMENT LoaMgr.PrevCurrMeasIdptSigVal "MICROSAR RTE" UBYTE NO_COMPU_METHOD 0 0 0 255 ECU_ADDRESS 0 SYMBOL_LINK "Rte_LoaMgr_PrevCurrMeasIdptSigVal" 0 DISPLAY_IDENTIFIER LoaMgr.PerInstanceMemories.PrevCurrMeasIdptSigVal /end MEASUREMENT
/begin MEASUREMENT LoaMgr.PrevCurrMeasLoaStSwMtgtnEna "MICROSAR RTE" UBYTE RTE_CM_BOOLEAN 0 0 0 255 ECU_ADDRESS 0 SYMBOL_LINK "Rte_LoaMgr_PrevCurrMeasLoaStSwMtgtnEna" 0 DISPLAY_IDENTIFIER LoaMgr.PerInstanceMemories.PrevCurrMeasLoaStSwMtgtnEna /end MEASUREMENT
/begin MEASUREMENT LoaMgr.PrevHwTqIdptSigResp "MICROSAR RTE" UBYTE NO_COMPU_METHOD 0 0 0 255 ECU_ADDRESS 0 SYMBOL_LINK "Rte_LoaMgr_PrevHwTqIdptSigResp" 0 DISPLAY_IDENTIFIER LoaMgr.PerInstanceMemories.PrevHwTqIdptSigResp /end MEASUREMENT
/begin MEASUREMENT LoaMgr.PrevHwTqIdptSigVal "MICROSAR RTE" UBYTE NO_COMPU_METHOD 0 0 0 255 ECU_ADDRESS 0 SYMBOL_LINK "Rte_LoaMgr_PrevHwTqIdptSigVal" 0 DISPLAY_IDENTIFIER LoaMgr.PerInstanceMemories.PrevHwTqIdptSigVal /end MEASUREMENT
/begin MEASUREMENT LoaMgr.PrevHwTqLoaStSwMtgtnEna "MICROSAR RTE" UBYTE RTE_CM_BOOLEAN 0 0 0 255 ECU_ADDRESS 0 SYMBOL_LINK "Rte_LoaMgr_PrevHwTqLoaStSwMtgtnEna" 0 DISPLAY_IDENTIFIER LoaMgr.PerInstanceMemories.PrevHwTqLoaStSwMtgtnEna /end MEASUREMENT
/begin MEASUREMENT LoaMgr.PrevIvtrIdptSigResp "MICROSAR RTE" UBYTE NO_COMPU_METHOD 0 0 0 255 ECU_ADDRESS 0 SYMBOL_LINK "Rte_LoaMgr_PrevIvtrIdptSigResp" 0 DISPLAY_IDENTIFIER LoaMgr.PerInstanceMemories.PrevIvtrIdptSigResp /end MEASUREMENT
/begin MEASUREMENT LoaMgr.PrevIvtrIdptSigVal "MICROSAR RTE" UBYTE NO_COMPU_METHOD 0 0 0 255 ECU_ADDRESS 0 SYMBOL_LINK "Rte_LoaMgr_PrevIvtrIdptSigVal" 0 DISPLAY_IDENTIFIER LoaMgr.PerInstanceMemories.PrevIvtrIdptSigVal /end MEASUREMENT
/begin MEASUREMENT LoaMgr.PrevIvtrLoaStSwMtgtnEna "MICROSAR RTE" UBYTE RTE_CM_BOOLEAN 0 0 0 255 ECU_ADDRESS 0 SYMBOL_LINK "Rte_LoaMgr_PrevIvtrLoaStSwMtgtnEna" 0 DISPLAY_IDENTIFIER LoaMgr.PerInstanceMemories.PrevIvtrLoaStSwMtgtnEna /end MEASUREMENT
/begin MEASUREMENT LoaMgr.PrevMotAgLoaMtgtnEna "MICROSAR RTE" UBYTE RTE_CM_BOOLEAN 0 0 0 255 ECU_ADDRESS 0 SYMBOL_LINK "Rte_LoaMgr_PrevMotAgLoaMtgtnEna" 0 DISPLAY_IDENTIFIER LoaMgr.PerInstanceMemories.PrevMotAgLoaMtgtnEna /end MEASUREMENT
/begin MEASUREMENT LoaMgr.PrevMotAgLoaStSwMtgtnEna "MICROSAR RTE" UBYTE RTE_CM_BOOLEAN 0 0 0 255 ECU_ADDRESS 0 SYMBOL_LINK "Rte_LoaMgr_PrevMotAgLoaStSwMtgtnEna" 0 DISPLAY_IDENTIFIER LoaMgr.PerInstanceMemories.PrevMotAgLoaStSwMtgtnEna /end MEASUREMENT
/begin MEASUREMENT LoaMgr.PrevMotAgMeclIdptSigResp "MICROSAR RTE" UBYTE NO_COMPU_METHOD 0 0 0 255 ECU_ADDRESS 0 SYMBOL_LINK "Rte_LoaMgr_PrevMotAgMeclIdptSigResp" 0 DISPLAY_IDENTIFIER LoaMgr.PerInstanceMemories.PrevMotAgMeclIdptSigResp /end MEASUREMENT
/begin MEASUREMENT LoaMgr.PrevMotAgMeclIdptSigVal "MICROSAR RTE" UBYTE NO_COMPU_METHOD 0 0 0 255 ECU_ADDRESS 0 SYMBOL_LINK "Rte_LoaMgr_PrevMotAgMeclIdptSigVal" 0 DISPLAY_IDENTIFIER LoaMgr.PerInstanceMemories.PrevMotAgMeclIdptSigVal /end MEASUREMENT
/begin MEASUREMENT LoaMgr.PrevVltgModSrc "MICROSAR RTE" UBYTE NO_COMPU_METHOD 0 0 0 255 ECU_ADDRESS 0 SYMBOL_LINK "Rte_LoaMgr_PrevVltgModSrc" 0 DISPLAY_IDENTIFIER LoaMgr.PerInstanceMemories.PrevVltgModSrc /end MEASUREMENT
/begin MEASUREMENT LoaMgr.TqLoaAvl.Logl "MICROSAR RTE" UBYTE RTE_CM_BOOLEAN 0 0 0 255 ECU_ADDRESS 0 SYMBOL_LINK "Rte_TqLoa_TqLoaAvl_Logl" 0 DISPLAY_IDENTIFIER LoaMgr.ReceiverPorts.TqLoaAvl.Logl /end MEASUREMENT
/begin MEASUREMENT LoaMgr.VehSteerMod.Val "MICROSAR RTE" UBYTE RTE_CM_ENUM_SteerMod1 0 0 0 255 ECU_ADDRESS 0 SYMBOL_LINK "Rte_LoaMgr_VehSteerMod_Val" 0 DISPLAY_IDENTIFIER LoaMgr.ReceiverPorts.VehSteerMod.Val /end MEASUREMENT
/begin MEASUREMENT MotAg2Meas.MotAg2Cos.Val "MICROSAR RTE" FLOAT32_IEEE NO_COMPU_METHOD 0 0 -3.402823466e+38 3.402823466e+38 ECU_ADDRESS 0 SYMBOL_LINK "Rte_CDD_FordT3T6McuCfg_MotAg2Cos_Val" 0 DISPLAY_IDENTIFIER MotAg2Meas.ReceiverPorts.MotAg2Cos.Val /end MEASUREMENT
/begin MEASUREMENT MotAg2Meas.MotAg2CosAdcFaild.Logl "MICROSAR RTE" UBYTE RTE_CM_BOOLEAN 0 0 0 255 ECU_ADDRESS 0 SYMBOL_LINK "Rte_CDD_FordT3T6McuCfg_MotAg2CosAdcFaild_Logl" 0 DISPLAY_IDENTIFIER MotAg2Meas.ReceiverPorts.MotAg2CosAdcFaild.Logl /end MEASUREMENT
/begin MEASUREMENT MotAg2Meas.MotAg2EolPrm.CosAmpRecpr "MICROSAR RTE" FLOAT32_IEEE NO_COMPU_METHOD 0 0 -3.402823466e+38 3.402823466e+38 ECU_ADDRESS 0 SYMBOL_LINK "Rte_MotAg2Meas_MotAg2EolPrm.CosAmpRecpr" 0 DISPLAY_IDENTIFIER MotAg2Meas.PerInstanceMemories.MotAg2EolPrm.CosAmpRecpr /end MEASUREMENT
/begin MEASUREMENT MotAg2Meas.MotAg2EolPrm.CosOffs "MICROSAR RTE" FLOAT32_IEEE NO_COMPU_METHOD 0 0 -3.402823466e+38 3.402823466e+38 ECU_ADDRESS 0 SYMBOL_LINK "Rte_MotAg2Meas_MotAg2EolPrm.CosOffs" 0 DISPLAY_IDENTIFIER MotAg2Meas.PerInstanceMemories.MotAg2EolPrm.CosOffs /end MEASUREMENT
/begin MEASUREMENT MotAg2Meas.MotAg2EolPrm.SinAmpRecpr "MICROSAR RTE" FLOAT32_IEEE NO_COMPU_METHOD 0 0 -3.402823466e+38 3.402823466e+38 ECU_ADDRESS 0 SYMBOL_LINK "Rte_MotAg2Meas_MotAg2EolPrm.SinAmpRecpr" 0 DISPLAY_IDENTIFIER MotAg2Meas.PerInstanceMemories.MotAg2EolPrm.SinAmpRecpr /end MEASUREMENT
/begin MEASUREMENT MotAg2Meas.MotAg2EolPrm.SinDelta "MICROSAR RTE" FLOAT32_IEEE NO_COMPU_METHOD 0 0 -3.402823466e+38 3.402823466e+38 ECU_ADDRESS 0 SYMBOL_LINK "Rte_MotAg2Meas_MotAg2EolPrm.SinDelta" 0 DISPLAY_IDENTIFIER MotAg2Meas.PerInstanceMemories.MotAg2EolPrm.SinDelta /end MEASUREMENT
/begin MEASUREMENT MotAg2Meas.MotAg2EolPrm.SinOffs "MICROSAR RTE" FLOAT32_IEEE NO_COMPU_METHOD 0 0 -3.402823466e+38 3.402823466e+38 ECU_ADDRESS 0 SYMBOL_LINK "Rte_MotAg2Meas_MotAg2EolPrm.SinOffs" 0 DISPLAY_IDENTIFIER MotAg2Meas.PerInstanceMemories.MotAg2EolPrm.SinOffs /end MEASUREMENT
/begin MEASUREMENT MotAg2Meas.MotAg2Mecl.Val "MICROSAR RTE" UWORD NO_COMPU_METHOD 0 0 0 65535 ECU_ADDRESS 0 SYMBOL_LINK "Rte_MotAg2Meas_MotAg2Mecl_Val" 0 DISPLAY_IDENTIFIER MotAg2Meas.SenderPorts.MotAg2Mecl.Val /end MEASUREMENT
/begin MEASUREMENT MotAg2Meas.MotAg2MeclPrev "MICROSAR RTE" FLOAT32_IEEE NO_COMPU_METHOD 0 0 -3.402823466e+38 3.402823466e+38 ECU_ADDRESS 0 SYMBOL_LINK "Rte_MotAg2Meas_MotAg2MeclPrev" 0 DISPLAY_IDENTIFIER MotAg2Meas.PerInstanceMemories.MotAg2MeclPrev /end MEASUREMENT
/begin MEASUREMENT MotAg2Meas.MotAg2MeclQlfr.Val "MICROSAR RTE" UBYTE RTE_CM_ENUM_SigQlfr1 0 0 0 255 ECU_ADDRESS 0 SYMBOL_LINK "Rte_MotAg2Meas_MotAg2MeclQlfr_Val" 0 DISPLAY_IDENTIFIER MotAg2Meas.SenderPorts.MotAg2MeclQlfr.Val /end MEASUREMENT
/begin MEASUREMENT MotAg2Meas.MotAg2MeclRollgCntr.Val "MICROSAR RTE" UBYTE NO_COMPU_METHOD 0 0 0 255 ECU_ADDRESS 0 SYMBOL_LINK "Rte_MotAg2Meas_MotAg2MeclRollgCntr_Val" 0 DISPLAY_IDENTIFIER MotAg2Meas.SenderPorts.MotAg2MeclRollgCntr.Val /end MEASUREMENT
/begin MEASUREMENT MotAg2Meas.MotAg2MeclRollgCntrPrev "MICROSAR RTE" UBYTE NO_COMPU_METHOD 0 0 0 255 ECU_ADDRESS 0 SYMBOL_LINK "Rte_MotAg2Meas_MotAg2MeclRollgCntrPrev" 0 DISPLAY_IDENTIFIER MotAg2Meas.PerInstanceMemories.MotAg2MeclRollgCntrPrev /end MEASUREMENT
/begin MEASUREMENT MotAg2Meas.MotAg2Sin.Val "MICROSAR RTE" FLOAT32_IEEE NO_COMPU_METHOD 0 0 -3.402823466e+38 3.402823466e+38 ECU_ADDRESS 0 SYMBOL_LINK "Rte_CDD_FordT3T6McuCfg_MotAg2Sin_Val" 0 DISPLAY_IDENTIFIER MotAg2Meas.ReceiverPorts.MotAg2Sin.Val /end MEASUREMENT
/begin MEASUREMENT MotAg2Meas.MotAg2SinAdcFaild.Logl "MICROSAR RTE" UBYTE RTE_CM_BOOLEAN 0 0 0 255 ECU_ADDRESS 0 SYMBOL_LINK "Rte_CDD_FordT3T6McuCfg_MotAg2SinAdcFaild_Logl" 0 DISPLAY_IDENTIFIER MotAg2Meas.ReceiverPorts.MotAg2SinAdcFaild.Logl /end MEASUREMENT
/begin MEASUREMENT MotAg2Meas.MotAg2VltgSqd.Val "MICROSAR RTE" FLOAT32_IEEE NO_COMPU_METHOD 0 0 -3.402823466e+38 3.402823466e+38 ECU_ADDRESS 0 SYMBOL_LINK "Rte_MotAg2Meas_MotAg2VltgSqd_Val" 0 DISPLAY_IDENTIFIER MotAg2Meas.SenderPorts.MotAg2VltgSqd.Val /end MEASUREMENT
/begin MEASUREMENT MotAg2Meas.MotAgMecl2Polarity.Val "MICROSAR RTE" SBYTE NO_COMPU_METHOD 0 0 -128 127 ECU_ADDRESS 0 SYMBOL_LINK "Rte_PolarityCfg_MotAgMecl2Polarity_Val" 0 DISPLAY_IDENTIFIER MotAg2Meas.ReceiverPorts.MotAgMecl2Polarity.Val /end MEASUREMENT
/begin MEASUREMENT MotAgCorrln.MotAgABErrTerm.Val "MICROSAR RTE" UWORD NO_COMPU_METHOD 0 0 0 65535 ECU_ADDRESS 0 SYMBOL_LINK "Rte_MotAgCorrln_MotAgABErrTerm_Val" 0 DISPLAY_IDENTIFIER MotAgCorrln.SenderPorts.MotAgABErrTerm.Val /end MEASUREMENT
/begin MEASUREMENT MotAgCorrln.MotAgACErrTerm.Val "MICROSAR RTE" UWORD NO_COMPU_METHOD 0 0 0 65535 ECU_ADDRESS 0 SYMBOL_LINK "Rte_MotAgCorrln_MotAgACErrTerm_Val" 0 DISPLAY_IDENTIFIER MotAgCorrln.SenderPorts.MotAgACErrTerm.Val /end MEASUREMENT
/begin MEASUREMENT MotAgCorrln.MotAgAMecl.Val "MICROSAR RTE" UWORD RTE_CM_Ag5 0 0 0 0.9999847412 ECU_ADDRESS 0 SYMBOL_LINK "Rte_CDD_MotCtrlMgr_MotAg5Mecl_Val" 0 DISPLAY_IDENTIFIER MotAgCorrln.ReceiverPorts.MotAgAMecl.Val /end MEASUREMENT
/begin MEASUREMENT MotAgCorrln.MotAgAMeclQlfr.Val "MICROSAR RTE" UBYTE RTE_CM_ENUM_SigQlfr1 0 0 0 255 ECU_ADDRESS 0 SYMBOL_LINK "Rte_CDD_MotAg5Meas_MotAg5MeclQlfr_Val" 0 DISPLAY_IDENTIFIER MotAgCorrln.ReceiverPorts.MotAgAMeclQlfr.Val /end MEASUREMENT
/begin MEASUREMENT MotAgCorrln.MotAgAMeclRollgCntr.Val "MICROSAR RTE" UBYTE NO_COMPU_METHOD 0 0 0 255 ECU_ADDRESS 0 SYMBOL_LINK "Rte_CDD_MotAg5Meas_MotAg5MeclRollgCntr_Val" 0 DISPLAY_IDENTIFIER MotAgCorrln.ReceiverPorts.MotAgAMeclRollgCntr.Val /end MEASUREMENT
/begin MEASUREMENT MotAgCorrln.MotAgBCErrTerm.Val "MICROSAR RTE" UWORD NO_COMPU_METHOD 0 0 0 65535 ECU_ADDRESS 0 SYMBOL_LINK "Rte_MotAgCorrln_MotAgBCErrTerm_Val" 0 DISPLAY_IDENTIFIER MotAgCorrln.SenderPorts.MotAgBCErrTerm.Val /end MEASUREMENT
/begin MEASUREMENT MotAgCorrln.MotAgBMecl.Val "MICROSAR RTE" UWORD RTE_CM_Ag5 0 0 0 0.9999847412 ECU_ADDRESS 0 SYMBOL_LINK "Rte_CDD_MotCtrlMgr_MotAg6Mecl_Val" 0 DISPLAY_IDENTIFIER MotAgCorrln.ReceiverPorts.MotAgBMecl.Val /end MEASUREMENT
/begin MEASUREMENT MotAgCorrln.MotAgBMeclQlfr.Val "MICROSAR RTE" UBYTE RTE_CM_ENUM_SigQlfr1 0 0 0 255 ECU_ADDRESS 0 SYMBOL_LINK "Rte_CDD_MotAg6Meas_MotAg6MeclQlfr_Val" 0 DISPLAY_IDENTIFIER MotAgCorrln.ReceiverPorts.MotAgBMeclQlfr.Val /end MEASUREMENT
/begin MEASUREMENT MotAgCorrln.MotAgBMeclRollgCntr.Val "MICROSAR RTE" UBYTE NO_COMPU_METHOD 0 0 0 255 ECU_ADDRESS 0 SYMBOL_LINK "Rte_CDD_MotAg6Meas_MotAg6MeclRollgCntr_Val" 0 DISPLAY_IDENTIFIER MotAgCorrln.ReceiverPorts.MotAgBMeclRollgCntr.Val /end MEASUREMENT
/begin MEASUREMENT MotAgCorrln.MotAgCMecl.Val "MICROSAR RTE" UWORD RTE_CM_Ag5 0 0 0 0.9999847412 ECU_ADDRESS 0 SYMBOL_LINK "Rte_MotAg2Meas_MotAg2Mecl_Val" 0 DISPLAY_IDENTIFIER MotAgCorrln.ReceiverPorts.MotAgCMecl.Val /end MEASUREMENT
/begin MEASUREMENT MotAgCorrln.MotAgCMeclQlfr.Val "MICROSAR RTE" UBYTE RTE_CM_ENUM_SigQlfr1 0 0 0 255 ECU_ADDRESS 0 SYMBOL_LINK "Rte_MotAg2Meas_MotAg2MeclQlfr_Val" 0 DISPLAY_IDENTIFIER MotAgCorrln.ReceiverPorts.MotAgCMeclQlfr.Val /end MEASUREMENT
/begin MEASUREMENT MotAgCorrln.MotAgCMeclRollgCntr.Val "MICROSAR RTE" UBYTE NO_COMPU_METHOD 0 0 0 255 ECU_ADDRESS 0 SYMBOL_LINK "Rte_MotAg2Meas_MotAg2MeclRollgCntr_Val" 0 DISPLAY_IDENTIFIER MotAgCorrln.ReceiverPorts.MotAgCMeclRollgCntr.Val /end MEASUREMENT
/begin MEASUREMENT MotAgCorrln.MotAgCorrlnErrThd "MICROSAR RTE" UWORD NO_COMPU_METHOD 0 0 0 65535 ECU_ADDRESS 0 SYMBOL_LINK "Rte_MotAgCorrln_MotAgCorrlnErrThd" 0 DISPLAY_IDENTIFIER MotAgCorrln.PerInstanceMemories.MotAgCorrlnErrThd /end MEASUREMENT
/begin MEASUREMENT MotAgCorrln.MotAgCorrlnMotAgARollgCntPrev "MICROSAR RTE" UBYTE NO_COMPU_METHOD 0 0 0 255 ECU_ADDRESS 0 SYMBOL_LINK "Rte_MotAgCorrln_MotAgCorrlnMotAgARollgCntPrev" 0 DISPLAY_IDENTIFIER MotAgCorrln.PerInstanceMemories.MotAgCorrlnMotAgARollgCntPrev /end MEASUREMENT
/begin MEASUREMENT MotAgCorrln.MotAgCorrlnMotAgAStallCntPrev "MICROSAR RTE" UBYTE NO_COMPU_METHOD 0 0 0 255 ECU_ADDRESS 0 SYMBOL_LINK "Rte_MotAgCorrln_MotAgCorrlnMotAgAStallCntPrev" 0 DISPLAY_IDENTIFIER MotAgCorrln.PerInstanceMemories.MotAgCorrlnMotAgAStallCntPrev /end MEASUREMENT
/begin MEASUREMENT MotAgCorrln.MotAgCorrlnMotAgBRollgCntPrev "MICROSAR RTE" UBYTE NO_COMPU_METHOD 0 0 0 255 ECU_ADDRESS 0 SYMBOL_LINK "Rte_MotAgCorrln_MotAgCorrlnMotAgBRollgCntPrev" 0 DISPLAY_IDENTIFIER MotAgCorrln.PerInstanceMemories.MotAgCorrlnMotAgBRollgCntPrev /end MEASUREMENT
/begin MEASUREMENT MotAgCorrln.MotAgCorrlnMotAgBStallCntPrev "MICROSAR RTE" UBYTE NO_COMPU_METHOD 0 0 0 255 ECU_ADDRESS 0 SYMBOL_LINK "Rte_MotAgCorrln_MotAgCorrlnMotAgBStallCntPrev" 0 DISPLAY_IDENTIFIER MotAgCorrln.PerInstanceMemories.MotAgCorrlnMotAgBStallCntPrev /end MEASUREMENT
/begin MEASUREMENT MotAgCorrln.MotAgCorrlnMotAgCRollgCntPrev "MICROSAR RTE" UBYTE NO_COMPU_METHOD 0 0 0 255 ECU_ADDRESS 0 SYMBOL_LINK "Rte_MotAgCorrln_MotAgCorrlnMotAgCRollgCntPrev" 0 DISPLAY_IDENTIFIER MotAgCorrln.PerInstanceMemories.MotAgCorrlnMotAgCRollgCntPrev /end MEASUREMENT
/begin MEASUREMENT MotAgCorrln.MotAgCorrlnMotAgCStallCntPrev "MICROSAR RTE" UBYTE NO_COMPU_METHOD 0 0 0 255 ECU_ADDRESS 0 SYMBOL_LINK "Rte_MotAgCorrln_MotAgCorrlnMotAgCStallCntPrev" 0 DISPLAY_IDENTIFIER MotAgCorrln.PerInstanceMemories.MotAgCorrlnMotAgCStallCntPrev /end MEASUREMENT
/begin MEASUREMENT MotAgCorrln.MotAgMeclCorrlnSt.Val "MICROSAR RTE" UBYTE NO_COMPU_METHOD 0 0 0 7 ECU_ADDRESS 0 SYMBOL_LINK "Rte_MotAgCorrln_MotAgMeclCorrlnSt_Val" 0 DISPLAY_IDENTIFIER MotAgCorrln.SenderPorts.MotAgMeclCorrlnSt.Val /end MEASUREMENT
/begin MEASUREMENT MotAgCorrln.MotAgMeclIdptSig.Val "MICROSAR RTE" UBYTE NO_COMPU_METHOD 0 0 0 3 ECU_ADDRESS 0 SYMBOL_LINK "Rte_MotAgCorrln_MotAgMeclIdptSig_Val" 0 DISPLAY_IDENTIFIER MotAgCorrln.SenderPorts.MotAgMeclIdptSig.Val /end MEASUREMENT
/begin MEASUREMENT MotAgCorrln.dMotAgCorrlnMotAgAOk "MICROSAR RTE" UBYTE RTE_CM_BOOLEAN 0 0 0 255 ECU_ADDRESS 0 SYMBOL_LINK "Rte_MotAgCorrln_dMotAgCorrlnMotAgAOk" 0 DISPLAY_IDENTIFIER MotAgCorrln.PerInstanceMemories.dMotAgCorrlnMotAgAOk /end MEASUREMENT
/begin MEASUREMENT MotAgCorrln.dMotAgCorrlnMotAgBOk "MICROSAR RTE" UBYTE RTE_CM_BOOLEAN 0 0 0 255 ECU_ADDRESS 0 SYMBOL_LINK "Rte_MotAgCorrln_dMotAgCorrlnMotAgBOk" 0 DISPLAY_IDENTIFIER MotAgCorrln.PerInstanceMemories.dMotAgCorrlnMotAgBOk /end MEASUREMENT
/begin MEASUREMENT MotAgCorrln.dMotAgCorrlnMotAgCOk "MICROSAR RTE" UBYTE RTE_CM_BOOLEAN 0 0 0 255 ECU_ADDRESS 0 SYMBOL_LINK "Rte_MotAgCorrln_dMotAgCorrlnMotAgCOk" 0 DISPLAY_IDENTIFIER MotAgCorrln.PerInstanceMemories.dMotAgCorrlnMotAgCOk /end MEASUREMENT
/begin MEASUREMENT MotCtrlPrmEstimn.DualEcuFltMtgtnEna.Logl "MICROSAR RTE" UBYTE RTE_CM_BOOLEAN 0 0 0 255 ECU_ADDRESS 0 SYMBOL_LINK "Rte_DualCtrlrOutpMgr_DualEcuFltMtgtnEna_Logl" 0 DISPLAY_IDENTIFIER MotCtrlPrmEstimn.ReceiverPorts.DualEcuFltMtgtnEna.Logl /end MEASUREMENT
/begin MEASUREMENT MotCtrlPrmEstimn.MotAndThermProtnLoaMod.Val "MICROSAR RTE" UBYTE NO_COMPU_METHOD 0 0 0 255 ECU_ADDRESS 0 SYMBOL_LINK "Rte_LoaMgr_MotAndThermProtnLoaMod_Val" 0 DISPLAY_IDENTIFIER MotCtrlPrmEstimn.ReceiverPorts.MotAndThermProtnLoaMod.Val /end MEASUREMENT
/begin MEASUREMENT MotCtrlPrmEstimn.MotBackEmfConEstimd.Val "MICROSAR RTE" FLOAT32_IEEE NO_COMPU_METHOD 0 0 0.025 0.075 ECU_ADDRESS 0 SYMBOL_LINK "Rte_MotCtrlPrmEstimn_MotBackEmfConEstimd_Val" 0 DISPLAY_IDENTIFIER MotCtrlPrmEstimn.SenderPorts.MotBackEmfConEstimd.Val /end MEASUREMENT
/begin MEASUREMENT MotCtrlPrmEstimn.MotCurrDaxCmd.Val "MICROSAR RTE" FLOAT32_IEEE NO_COMPU_METHOD 0 0 0.0 200.0 ECU_ADDRESS 0 SYMBOL_LINK "Rte_MotRefMdl_MotCurrDaxCmd_Val" 0 DISPLAY_IDENTIFIER MotCtrlPrmEstimn.ReceiverPorts.MotCurrDaxCmd.Val /end MEASUREMENT
/begin MEASUREMENT MotCtrlPrmEstimn.MotCurrQaxCmd.Val "MICROSAR RTE" FLOAT32_IEEE NO_COMPU_METHOD 0 0 -200 200 ECU_ADDRESS 0 SYMBOL_LINK "Rte_MotRefMdl_MotCurrQaxCmd_Val" 0 DISPLAY_IDENTIFIER MotCtrlPrmEstimn.ReceiverPorts.MotCurrQaxCmd.Val /end MEASUREMENT
/begin MEASUREMENT MotCtrlPrmEstimn.MotFetT.Val "MICROSAR RTE" FLOAT32_IEEE NO_COMPU_METHOD 0 0 -50.0 200.0 ECU_ADDRESS 0 SYMBOL_LINK "Rte_TEstimn_MotFetT_Val" 0 DISPLAY_IDENTIFIER MotCtrlPrmEstimn.ReceiverPorts.MotFetT.Val /end MEASUREMENT
/begin MEASUREMENT MotCtrlPrmEstimn.MotInduDaxEstimd.Val "MICROSAR RTE" FLOAT32_IEEE NO_COMPU_METHOD 0 0 0.00003 0.00041 ECU_ADDRESS 0 SYMBOL_LINK "Rte_MotCtrlPrmEstimn_MotInduDaxEstimd_Val" 0 DISPLAY_IDENTIFIER MotCtrlPrmEstimn.SenderPorts.MotInduDaxEstimd.Val /end MEASUREMENT
/begin MEASUREMENT MotCtrlPrmEstimn.MotInduDaxEstimdIvs.Val "MICROSAR RTE" FLOAT32_IEEE NO_COMPU_METHOD 0 0 0.00003 0.00041 ECU_ADDRESS 0 SYMBOL_LINK "Rte_MotCtrlPrmEstimn_MotInduDaxEstimdIvs_Val" 0 DISPLAY_IDENTIFIER MotCtrlPrmEstimn.SenderPorts.MotInduDaxEstimdIvs.Val /end MEASUREMENT
/begin MEASUREMENT MotCtrlPrmEstimn.MotInduQaxEstimd.Val "MICROSAR RTE" FLOAT32_IEEE NO_COMPU_METHOD 0 0 0.00003 0.00041 ECU_ADDRESS 0 SYMBOL_LINK "Rte_MotCtrlPrmEstimn_MotInduQaxEstimd_Val" 0 DISPLAY_IDENTIFIER MotCtrlPrmEstimn.SenderPorts.MotInduQaxEstimd.Val /end MEASUREMENT
/begin MEASUREMENT MotCtrlPrmEstimn.MotInduQaxEstimdIvs.Val "MICROSAR RTE" FLOAT32_IEEE NO_COMPU_METHOD 0 0 0.00003 0.00041 ECU_ADDRESS 0 SYMBOL_LINK "Rte_MotCtrlPrmEstimn_MotInduQaxEstimdIvs_Val" 0 DISPLAY_IDENTIFIER MotCtrlPrmEstimn.SenderPorts.MotInduQaxEstimdIvs.Val /end MEASUREMENT
/begin MEASUREMENT MotCtrlPrmEstimn.MotMagT.Val "MICROSAR RTE" FLOAT32_IEEE NO_COMPU_METHOD 0 0 -50.0 150.0 ECU_ADDRESS 0 SYMBOL_LINK "Rte_TEstimn_MotMagT_Val" 0 DISPLAY_IDENTIFIER MotCtrlPrmEstimn.ReceiverPorts.MotMagT.Val /end MEASUREMENT
/begin MEASUREMENT MotCtrlPrmEstimn.MotPrmNom.MotBackEmfConNom "MICROSAR RTE" FLOAT32_IEEE NO_COMPU_METHOD 0 0 0.025 0.075 ECU_ADDRESS 0 SYMBOL_LINK "Rte_MotCtrlPrmEstimn_MotPrmNom.MotBackEmfConNom" 0 DISPLAY_IDENTIFIER MotCtrlPrmEstimn.PerInstanceMemories.MotPrmNom.MotBackEmfConNom /end MEASUREMENT
/begin MEASUREMENT MotCtrlPrmEstimn.MotPrmNom.MotRNom "MICROSAR RTE" FLOAT32_IEEE NO_COMPU_METHOD 0 0 0.005 0.12565 ECU_ADDRESS 0 SYMBOL_LINK "Rte_MotCtrlPrmEstimn_MotPrmNom.MotRNom" 0 DISPLAY_IDENTIFIER MotCtrlPrmEstimn.PerInstanceMemories.MotPrmNom.MotRNom /end MEASUREMENT
/begin MEASUREMENT MotCtrlPrmEstimn.MotREstimd.Val "MICROSAR RTE" FLOAT32_IEEE NO_COMPU_METHOD 0 0 0.005 0.12565 ECU_ADDRESS 0 SYMBOL_LINK "Rte_MotCtrlPrmEstimn_MotREstimd_Val" 0 DISPLAY_IDENTIFIER MotCtrlPrmEstimn.SenderPorts.MotREstimd.Val /end MEASUREMENT
/begin MEASUREMENT MotCtrlPrmEstimn.MotWidgT.Val "MICROSAR RTE" FLOAT32_IEEE NO_COMPU_METHOD 0 0 -50.0 300.0 ECU_ADDRESS 0 SYMBOL_LINK "Rte_TEstimn_MotWidgT_Val" 0 DISPLAY_IDENTIFIER MotCtrlPrmEstimn.ReceiverPorts.MotWidgT.Val /end MEASUREMENT
/begin MEASUREMENT MotCtrlPrmEstimn.dMotCtrlPrmEstimnCtrlrREstimdPreLim "MICROSAR RTE" FLOAT32_IEEE NO_COMPU_METHOD 0 0 0.005 0.12565 ECU_ADDRESS 0 SYMBOL_LINK "Rte_MotCtrlPrmEstimn_dMotCtrlPrmEstimnCtrlrREstimdPreLim" 0 DISPLAY_IDENTIFIER MotCtrlPrmEstimn.PerInstanceMemories.dMotCtrlPrmEstimnCtrlrREstimdPreLim /end MEASUREMENT
/begin MEASUREMENT MotCtrlPrmEstimn.dMotCtrlPrmEstimnFetRFfEstimd "MICROSAR RTE" FLOAT32_IEEE NO_COMPU_METHOD 0 0 0.0 0.1 ECU_ADDRESS 0 SYMBOL_LINK "Rte_MotCtrlPrmEstimn_dMotCtrlPrmEstimnFetRFfEstimd" 0 DISPLAY_IDENTIFIER MotCtrlPrmEstimn.PerInstanceMemories.dMotCtrlPrmEstimnFetRFfEstimd /end MEASUREMENT
/begin MEASUREMENT MotCtrlPrmEstimn.dMotCtrlPrmEstimnMotBackEmfConEstimdPreLim "MICROSAR RTE" FLOAT32_IEEE NO_COMPU_METHOD 0 0 0.025 0.075 ECU_ADDRESS 0 SYMBOL_LINK "Rte_MotCtrlPrmEstimn_dMotCtrlPrmEstimnMotBackEmfConEstimdPreLim" 0 DISPLAY_IDENTIFIER MotCtrlPrmEstimn.PerInstanceMemories.dMotCtrlPrmEstimnMotBackEmfConEstimdPreLim /end MEASUREMENT
/begin MEASUREMENT MotCtrlPrmEstimn.dMotCtrlPrmEstimnMotBackEmfConEstimdSatnSca "MICROSAR RTE" FLOAT32_IEEE NO_COMPU_METHOD 0 0 0.0 1.0 ECU_ADDRESS 0 SYMBOL_LINK "Rte_MotCtrlPrmEstimn_dMotCtrlPrmEstimnMotBackEmfConEstimdSatnSca" 0 DISPLAY_IDENTIFIER MotCtrlPrmEstimn.PerInstanceMemories.dMotCtrlPrmEstimnMotBackEmfConEstimdSatnSca /end MEASUREMENT
/begin MEASUREMENT MotCtrlPrmEstimn.dMotCtrlPrmEstimnMotInduEstimdPreLimDax "MICROSAR RTE" FLOAT32_IEEE NO_COMPU_METHOD 0 0 0.00003 0.00041 ECU_ADDRESS 0 SYMBOL_LINK "Rte_MotCtrlPrmEstimn_dMotCtrlPrmEstimnMotInduEstimdPreLimDax" 0 DISPLAY_IDENTIFIER MotCtrlPrmEstimn.PerInstanceMemories.dMotCtrlPrmEstimnMotInduEstimdPreLimDax /end MEASUREMENT
/begin MEASUREMENT MotCtrlPrmEstimn.dMotCtrlPrmEstimnMotInduEstimdPreLimQax "MICROSAR RTE" FLOAT32_IEEE NO_COMPU_METHOD 0 0 0.00003 0.00041 ECU_ADDRESS 0 SYMBOL_LINK "Rte_MotCtrlPrmEstimn_dMotCtrlPrmEstimnMotInduEstimdPreLimQax" 0 DISPLAY_IDENTIFIER MotCtrlPrmEstimn.PerInstanceMemories.dMotCtrlPrmEstimnMotInduEstimdPreLimQax /end MEASUREMENT
/begin MEASUREMENT MotCtrlPrmEstimn.dMotCtrlPrmEstimnMotInduEstimdSatnScaDax "MICROSAR RTE" FLOAT32_IEEE NO_COMPU_METHOD 0 0 0.0 1.0 ECU_ADDRESS 0 SYMBOL_LINK "Rte_MotCtrlPrmEstimn_dMotCtrlPrmEstimnMotInduEstimdSatnScaDax" 0 DISPLAY_IDENTIFIER MotCtrlPrmEstimn.PerInstanceMemories.dMotCtrlPrmEstimnMotInduEstimdSatnScaDax /end MEASUREMENT
/begin MEASUREMENT MotCtrlPrmEstimn.dMotCtrlPrmEstimnMotInduEstimdSatnScaQax "MICROSAR RTE" FLOAT32_IEEE NO_COMPU_METHOD 0 0 0.0 1.0 ECU_ADDRESS 0 SYMBOL_LINK "Rte_MotCtrlPrmEstimn_dMotCtrlPrmEstimnMotInduEstimdSatnScaQax" 0 DISPLAY_IDENTIFIER MotCtrlPrmEstimn.PerInstanceMemories.dMotCtrlPrmEstimnMotInduEstimdSatnScaQax /end MEASUREMENT
/begin MEASUREMENT MotCtrlPrmEstimn.dMotCtrlPrmEstimnMotRFfEstimd "MICROSAR RTE" FLOAT32_IEEE NO_COMPU_METHOD 0 0 0.005 0.12565 ECU_ADDRESS 0 SYMBOL_LINK "Rte_MotCtrlPrmEstimn_dMotCtrlPrmEstimnMotRFfEstimd" 0 DISPLAY_IDENTIFIER MotCtrlPrmEstimn.PerInstanceMemories.dMotCtrlPrmEstimnMotRFfEstimd /end MEASUREMENT
/begin MEASUREMENT MotCurrPeakEstimn.DualEcuMotCtrlMtgtnEna.Logl "MICROSAR RTE" UBYTE RTE_CM_BOOLEAN 0 0 0 255 ECU_ADDRESS 0 SYMBOL_LINK "Rte_DualCtrlrOutpMgr_DualEcuMotCtrlMtgtnEna_Logl" 0 DISPLAY_IDENTIFIER MotCurrPeakEstimn.ReceiverPorts.DualEcuMotCtrlMtgtnEna.Logl /end MEASUREMENT
/begin MEASUREMENT MotCurrPeakEstimn.MotAndThermProtnLoaMod.Val "MICROSAR RTE" UBYTE NO_COMPU_METHOD 0 0 0 255 ECU_ADDRESS 0 SYMBOL_LINK "Rte_LoaMgr_MotAndThermProtnLoaMod_Val" 0 DISPLAY_IDENTIFIER MotCurrPeakEstimn.ReceiverPorts.MotAndThermProtnLoaMod.Val /end MEASUREMENT
/begin MEASUREMENT MotCurrPeakEstimn.MotCurrDax.Val "MICROSAR RTE" FLOAT32_IEEE NO_COMPU_METHOD 0 0 -3.402823466e+38 3.402823466e+38 ECU_ADDRESS 0 SYMBOL_LINK "Rte_CDD_MotCtrlMgr_MotCurrDax_Val" 0 DISPLAY_IDENTIFIER MotCurrPeakEstimn.ReceiverPorts.MotCurrDax.Val /end MEASUREMENT
/begin MEASUREMENT MotCurrPeakEstimn.MotCurrDaxCmd.Val "MICROSAR RTE" FLOAT32_IEEE NO_COMPU_METHOD 0 0 -3.402823466e+38 3.402823466e+38 ECU_ADDRESS 0 SYMBOL_LINK "Rte_MotRefMdl_MotCurrDaxCmd_Val" 0 DISPLAY_IDENTIFIER MotCurrPeakEstimn.ReceiverPorts.MotCurrDaxCmd.Val /end MEASUREMENT
/begin MEASUREMENT MotCurrPeakEstimn.MotCurrDaxFil.FilGain "MICROSAR RTE" FLOAT32_IEEE NO_COMPU_METHOD 0 0 -3.402823466e+38 3.402823466e+38 ECU_ADDRESS 0 SYMBOL_LINK "Rte_MotCurrPeakEstimn_MotCurrDaxFil.FilGain" 0 DISPLAY_IDENTIFIER MotCurrPeakEstimn.PerInstanceMemories.MotCurrDaxFil.FilGain /end MEASUREMENT
/begin MEASUREMENT MotCurrPeakEstimn.MotCurrDaxFil.FilSt "MICROSAR RTE" FLOAT32_IEEE NO_COMPU_METHOD 0 0 -3.402823466e+38 3.402823466e+38 ECU_ADDRESS 0 SYMBOL_LINK "Rte_MotCurrPeakEstimn_MotCurrDaxFil.FilSt" 0 DISPLAY_IDENTIFIER MotCurrPeakEstimn.PerInstanceMemories.MotCurrDaxFil.FilSt /end MEASUREMENT
/begin MEASUREMENT MotCurrPeakEstimn.MotCurrPeakEstimd.Val "MICROSAR RTE" FLOAT32_IEEE NO_COMPU_METHOD 0 0 -3.402823466e+38 3.402823466e+38 ECU_ADDRESS 0 SYMBOL_LINK "Rte_MotCurrPeakEstimn_MotCurrPeakEstimd_Val" 0 DISPLAY_IDENTIFIER MotCurrPeakEstimn.SenderPorts.MotCurrPeakEstimd.Val /end MEASUREMENT
/begin MEASUREMENT MotCurrPeakEstimn.MotCurrPeakEstimdFil.FilGain "MICROSAR RTE" FLOAT32_IEEE NO_COMPU_METHOD 0 0 -3.402823466e+38 3.402823466e+38 ECU_ADDRESS 0 SYMBOL_LINK "Rte_MotCurrPeakEstimn_MotCurrPeakEstimdFil.FilGain" 0 DISPLAY_IDENTIFIER MotCurrPeakEstimn.PerInstanceMemories.MotCurrPeakEstimdFil.FilGain /end MEASUREMENT
/begin MEASUREMENT MotCurrPeakEstimn.MotCurrPeakEstimdFil.FilSt "MICROSAR RTE" FLOAT32_IEEE NO_COMPU_METHOD 0 0 -3.402823466e+38 3.402823466e+38 ECU_ADDRESS 0 SYMBOL_LINK "Rte_MotCurrPeakEstimn_MotCurrPeakEstimdFil.FilSt" 0 DISPLAY_IDENTIFIER MotCurrPeakEstimn.PerInstanceMemories.MotCurrPeakEstimdFil.FilSt /end MEASUREMENT
/begin MEASUREMENT MotCurrPeakEstimn.MotCurrPeakEstimdFild.Val "MICROSAR RTE" FLOAT32_IEEE NO_COMPU_METHOD 0 0 -3.402823466e+38 3.402823466e+38 ECU_ADDRESS 0 SYMBOL_LINK "Rte_MotCurrPeakEstimn_MotCurrPeakEstimdFild_Val" 0 DISPLAY_IDENTIFIER MotCurrPeakEstimn.SenderPorts.MotCurrPeakEstimdFild.Val /end MEASUREMENT
/begin MEASUREMENT MotCurrPeakEstimn.MotCurrQax.Val "MICROSAR RTE" FLOAT32_IEEE NO_COMPU_METHOD 0 0 -3.402823466e+38 3.402823466e+38 ECU_ADDRESS 0 SYMBOL_LINK "Rte_CDD_MotCtrlMgr_MotCurrQax_Val" 0 DISPLAY_IDENTIFIER MotCurrPeakEstimn.ReceiverPorts.MotCurrQax.Val /end MEASUREMENT
/begin MEASUREMENT MotCurrPeakEstimn.MotCurrQaxCmd.Val "MICROSAR RTE" FLOAT32_IEEE NO_COMPU_METHOD 0 0 -3.402823466e+38 3.402823466e+38 ECU_ADDRESS 0 SYMBOL_LINK "Rte_MotRefMdl_MotCurrQaxCmd_Val" 0 DISPLAY_IDENTIFIER MotCurrPeakEstimn.ReceiverPorts.MotCurrQaxCmd.Val /end MEASUREMENT
/begin MEASUREMENT MotCurrPeakEstimn.MotCurrQaxFil.FilGain "MICROSAR RTE" FLOAT32_IEEE NO_COMPU_METHOD 0 0 -3.402823466e+38 3.402823466e+38 ECU_ADDRESS 0 SYMBOL_LINK "Rte_MotCurrPeakEstimn_MotCurrQaxFil.FilGain" 0 DISPLAY_IDENTIFIER MotCurrPeakEstimn.PerInstanceMemories.MotCurrQaxFil.FilGain /end MEASUREMENT
/begin MEASUREMENT MotCurrPeakEstimn.MotCurrQaxFil.FilSt "MICROSAR RTE" FLOAT32_IEEE NO_COMPU_METHOD 0 0 -3.402823466e+38 3.402823466e+38 ECU_ADDRESS 0 SYMBOL_LINK "Rte_MotCurrPeakEstimn_MotCurrQaxFil.FilSt" 0 DISPLAY_IDENTIFIER MotCurrPeakEstimn.PerInstanceMemories.MotCurrQaxFil.FilSt /end MEASUREMENT
/begin MEASUREMENT MotCurrPeakEstimn.dMotCurrPeakEstimnMotCurrDaxFil "MICROSAR RTE" FLOAT32_IEEE NO_COMPU_METHOD 0 0 -3.402823466e+38 3.402823466e+38 ECU_ADDRESS 0 SYMBOL_LINK "Rte_MotCurrPeakEstimn_dMotCurrPeakEstimnMotCurrDaxFil" 0 DISPLAY_IDENTIFIER MotCurrPeakEstimn.PerInstanceMemories.dMotCurrPeakEstimnMotCurrDaxFil /end MEASUREMENT
/begin MEASUREMENT MotCurrPeakEstimn.dMotCurrPeakEstimnMotCurrQaxFil "MICROSAR RTE" FLOAT32_IEEE NO_COMPU_METHOD 0 0 -3.402823466e+38 3.402823466e+38 ECU_ADDRESS 0 SYMBOL_LINK "Rte_MotCurrPeakEstimn_dMotCurrPeakEstimnMotCurrQaxFil" 0 DISPLAY_IDENTIFIER MotCurrPeakEstimn.PerInstanceMemories.dMotCurrPeakEstimnMotCurrQaxFil /end MEASUREMENT
/begin MEASUREMENT MotCurrRegCfg.DualEcuMotCtrlMtgtnEna.Logl "MICROSAR RTE" UBYTE RTE_CM_BOOLEAN 0 0 0 255 ECU_ADDRESS 0 SYMBOL_LINK "Rte_DualCtrlrOutpMgr_DualEcuMotCtrlMtgtnEna_Logl" 0 DISPLAY_IDENTIFIER MotCurrRegCfg.ReceiverPorts.DualEcuMotCtrlMtgtnEna.Logl /end MEASUREMENT
/begin MEASUREMENT MotCurrRegCfg.MotAgElecDly.Val "MICROSAR RTE" FLOAT32_IEEE NO_COMPU_METHOD 0 0 -3.402823466e+38 3.402823466e+38 ECU_ADDRESS 0 SYMBOL_LINK "Rte_MotCurrRegCfg_MotAgElecDly_Val" 0 DISPLAY_IDENTIFIER MotCurrRegCfg.SenderPorts.MotAgElecDly.Val /end MEASUREMENT
/begin MEASUREMENT MotCurrRegCfg.MotAndThermProtnLoaMod.Val "MICROSAR RTE" UBYTE NO_COMPU_METHOD 0 0 0 255 ECU_ADDRESS 0 SYMBOL_LINK "Rte_LoaMgr_MotAndThermProtnLoaMod_Val" 0 DISPLAY_IDENTIFIER MotCurrRegCfg.ReceiverPorts.MotAndThermProtnLoaMod.Val /end MEASUREMENT
/begin MEASUREMENT MotCurrRegCfg.MotCurrEolCalSt.Val "MICROSAR RTE" UBYTE RTE_CM_ENUM_MotCurrEolCalSt2 0 0 0 255 ECU_ADDRESS 0 SYMBOL_LINK "Rte_CDD_CurrMeas_MotCurrEolCalSt_Val" 0 DISPLAY_IDENTIFIER MotCurrRegCfg.ReceiverPorts.MotCurrEolCalSt.Val /end MEASUREMENT
/begin MEASUREMENT MotCurrRegCfg.MotDampgDax.Val "MICROSAR RTE" FLOAT32_IEEE NO_COMPU_METHOD 0 0 -3.402823466e+38 3.402823466e+38 ECU_ADDRESS 0 SYMBOL_LINK "Rte_MotCurrRegCfg_MotDampgDax_Val" 0 DISPLAY_IDENTIFIER MotCurrRegCfg.SenderPorts.MotDampgDax.Val /end MEASUREMENT
/begin MEASUREMENT MotCurrRegCfg.MotDampgQax.Val "MICROSAR RTE" FLOAT32_IEEE NO_COMPU_METHOD 0 0 -3.402823466e+38 3.402823466e+38 ECU_ADDRESS 0 SYMBOL_LINK "Rte_MotCurrRegCfg_MotDampgQax_Val" 0 DISPLAY_IDENTIFIER MotCurrRegCfg.SenderPorts.MotDampgQax.Val /end MEASUREMENT
/begin MEASUREMENT MotCurrRegCfg.MotInduDaxEstimd.Val "MICROSAR RTE" FLOAT32_IEEE NO_COMPU_METHOD 0 0 -3.402823466e+38 3.402823466e+38 ECU_ADDRESS 0 SYMBOL_LINK "Rte_MotCtrlPrmEstimn_MotInduDaxEstimd_Val" 0 DISPLAY_IDENTIFIER MotCurrRegCfg.ReceiverPorts.MotInduDaxEstimd.Val /end MEASUREMENT
/begin MEASUREMENT MotCurrRegCfg.MotInduQaxEstimd.Val "MICROSAR RTE" FLOAT32_IEEE NO_COMPU_METHOD 0 0 -3.402823466e+38 3.402823466e+38 ECU_ADDRESS 0 SYMBOL_LINK "Rte_MotCtrlPrmEstimn_MotInduQaxEstimd_Val" 0 DISPLAY_IDENTIFIER MotCurrRegCfg.ReceiverPorts.MotInduQaxEstimd.Val /end MEASUREMENT
/begin MEASUREMENT MotCurrRegCfg.MotIntglGainDax.Val "MICROSAR RTE" FLOAT32_IEEE NO_COMPU_METHOD 0 0 -3.402823466e+38 3.402823466e+38 ECU_ADDRESS 0 SYMBOL_LINK "Rte_MotCurrRegCfg_MotIntglGainDax_Val" 0 DISPLAY_IDENTIFIER MotCurrRegCfg.SenderPorts.MotIntglGainDax.Val /end MEASUREMENT
/begin MEASUREMENT MotCurrRegCfg.MotIntglGainQax.Val "MICROSAR RTE" FLOAT32_IEEE NO_COMPU_METHOD 0 0 -3.402823466e+38 3.402823466e+38 ECU_ADDRESS 0 SYMBOL_LINK "Rte_MotCurrRegCfg_MotIntglGainQax_Val" 0 DISPLAY_IDENTIFIER MotCurrRegCfg.SenderPorts.MotIntglGainQax.Val /end MEASUREMENT
/begin MEASUREMENT MotCurrRegCfg.MotPropGainDax.Val "MICROSAR RTE" FLOAT32_IEEE NO_COMPU_METHOD 0 0 -3.402823466e+38 3.402823466e+38 ECU_ADDRESS 0 SYMBOL_LINK "Rte_MotCurrRegCfg_MotPropGainDax_Val" 0 DISPLAY_IDENTIFIER MotCurrRegCfg.SenderPorts.MotPropGainDax.Val /end MEASUREMENT
/begin MEASUREMENT MotCurrRegCfg.MotPropGainQax.Val "MICROSAR RTE" FLOAT32_IEEE NO_COMPU_METHOD 0 0 -3.402823466e+38 3.402823466e+38 ECU_ADDRESS 0 SYMBOL_LINK "Rte_MotCurrRegCfg_MotPropGainQax_Val" 0 DISPLAY_IDENTIFIER MotCurrRegCfg.SenderPorts.MotPropGainQax.Val /end MEASUREMENT
/begin MEASUREMENT MotCurrRegCfg.MotREstimd.Val "MICROSAR RTE" FLOAT32_IEEE NO_COMPU_METHOD 0 0 -3.402823466e+38 3.402823466e+38 ECU_ADDRESS 0 SYMBOL_LINK "Rte_MotCtrlPrmEstimn_MotREstimd_Val" 0 DISPLAY_IDENTIFIER MotCurrRegCfg.ReceiverPorts.MotREstimd.Val /end MEASUREMENT
/begin MEASUREMENT MotCurrRegCfg.MotVelMrf.Val "MICROSAR RTE" FLOAT32_IEEE NO_COMPU_METHOD 0 0 -3.402823466e+38 3.402823466e+38 ECU_ADDRESS 0 SYMBOL_LINK "Rte_CDD_MotVel_MotVelMrf_Val" 0 DISPLAY_IDENTIFIER MotCurrRegCfg.ReceiverPorts.MotVelMrf.Val /end MEASUREMENT
/begin MEASUREMENT MotCurrRegCfg.MotVelMrfFild.FilGain "MICROSAR RTE" FLOAT32_IEEE NO_COMPU_METHOD 0 0 -3.402823466e+38 3.402823466e+38 ECU_ADDRESS 0 SYMBOL_LINK "Rte_MotCurrRegCfg_MotVelMrfFild.FilGain" 0 DISPLAY_IDENTIFIER MotCurrRegCfg.PerInstanceMemories.MotVelMrfFild.FilGain /end MEASUREMENT
/begin MEASUREMENT MotCurrRegCfg.MotVelMrfFild.FilSt "MICROSAR RTE" FLOAT32_IEEE NO_COMPU_METHOD 0 0 -3.402823466e+38 3.402823466e+38 ECU_ADDRESS 0 SYMBOL_LINK "Rte_MotCurrRegCfg_MotVelMrfFild.FilSt" 0 DISPLAY_IDENTIFIER MotCurrRegCfg.PerInstanceMemories.MotVelMrfFild.FilSt /end MEASUREMENT
/begin MEASUREMENT MotCurrRegCfg.VehSpd.Val "MICROSAR RTE" FLOAT32_IEEE NO_COMPU_METHOD 0 0 -3.402823466e+38 3.402823466e+38 ECU_ADDRESS 0 SYMBOL_LINK "Rte_ImcSigArbn_VehSpdImcCorrd_Val" 0 DISPLAY_IDENTIFIER MotCurrRegCfg.ReceiverPorts.VehSpd.Val /end MEASUREMENT
/begin MEASUREMENT MotCurrRegCfg.dMotCurrRegCfgMotVelMrfFild "MICROSAR RTE" FLOAT32_IEEE NO_COMPU_METHOD 0 0 -3.402823466e+38 3.402823466e+38 ECU_ADDRESS 0 SYMBOL_LINK "Rte_MotCurrRegCfg_dMotCurrRegCfgMotVelMrfFild" 0 DISPLAY_IDENTIFIER MotCurrRegCfg.PerInstanceMemories.dMotCurrRegCfgMotVelMrfFild /end MEASUREMENT
/begin MEASUREMENT MotQuadDetn.MotAgCumvAlgndMrf.Val "MICROSAR RTE" SLONG NO_COMPU_METHOD 0 0 -2147483648 2147483647 ECU_ADDRESS 0 SYMBOL_LINK "Rte_CDD_MotAgCmp_MotAgCumvAlgndMrf_Val" 0 DISPLAY_IDENTIFIER MotQuadDetn.ReceiverPorts.MotAgCumvAlgndMrf.Val /end MEASUREMENT
/begin MEASUREMENT MotQuadDetn.MotAgCumvPrev "MICROSAR RTE" SLONG NO_COMPU_METHOD 0 0 -2147483648 2147483647 ECU_ADDRESS 0 SYMBOL_LINK "Rte_MotQuadDetn_MotAgCumvPrev" 0 DISPLAY_IDENTIFIER MotQuadDetn.PerInstanceMemories.MotAgCumvPrev /end MEASUREMENT
/begin MEASUREMENT MotQuadDetn.MotDirInsts.Val "MICROSAR RTE" SBYTE NO_COMPU_METHOD 0 0 -128 127 ECU_ADDRESS 0 SYMBOL_LINK "Rte_MotQuadDetn_MotDirInsts_Val" 0 DISPLAY_IDENTIFIER MotQuadDetn.SenderPorts.MotDirInsts.Val /end MEASUREMENT
/begin MEASUREMENT MotQuadDetn.MotDirInstsPrev "MICROSAR RTE" SBYTE NO_COMPU_METHOD 0 0 -128 127 ECU_ADDRESS 0 SYMBOL_LINK "Rte_MotQuadDetn_MotDirInstsPrev" 0 DISPLAY_IDENTIFIER MotQuadDetn.PerInstanceMemories.MotDirInstsPrev /end MEASUREMENT
/begin MEASUREMENT MotQuadDetn.MotQuad.Val "MICROSAR RTE" UBYTE RTE_CM_ENUM_MotQuad1 0 0 0 255 ECU_ADDRESS 0 SYMBOL_LINK "Rte_MotQuadDetn_MotQuad_Val" 0 DISPLAY_IDENTIFIER MotQuadDetn.SenderPorts.MotQuad.Val /end MEASUREMENT
/begin MEASUREMENT MotQuadDetn.MotTqCmd.Val "MICROSAR RTE" FLOAT32_IEEE NO_COMPU_METHOD 0 0 -3.402823466e+38 3.402823466e+38 ECU_ADDRESS 0 SYMBOL_LINK "Rte_MotTqCmdSca_MotTqCmdMrfScad_Val" 0 DISPLAY_IDENTIFIER MotQuadDetn.ReceiverPorts.MotTqCmd.Val /end MEASUREMENT
/begin MEASUREMENT MotQuadDetn.MotTqCmdSignPrev "MICROSAR RTE" SBYTE NO_COMPU_METHOD 0 0 -128 127 ECU_ADDRESS 0 SYMBOL_LINK "Rte_MotQuadDetn_MotTqCmdSignPrev" 0 DISPLAY_IDENTIFIER MotQuadDetn.PerInstanceMemories.MotTqCmdSignPrev /end MEASUREMENT
/begin MEASUREMENT MotQuadDetn.dMotQuadDetnMotAgCumvDelta "MICROSAR RTE" SLONG NO_COMPU_METHOD 0 0 -2147483648 2147483647 ECU_ADDRESS 0 SYMBOL_LINK "Rte_MotQuadDetn_dMotQuadDetnMotAgCumvDelta" 0 DISPLAY_IDENTIFIER MotQuadDetn.PerInstanceMemories.dMotQuadDetnMotAgCumvDelta /end MEASUREMENT
/begin MEASUREMENT MotQuadDetn.dMotQuadDetnTqCmdSign "MICROSAR RTE" SBYTE NO_COMPU_METHOD 0 0 -128 127 ECU_ADDRESS 0 SYMBOL_LINK "Rte_MotQuadDetn_dMotQuadDetnTqCmdSign" 0 DISPLAY_IDENTIFIER MotQuadDetn.PerInstanceMemories.dMotQuadDetnTqCmdSign /end MEASUREMENT
/begin MEASUREMENT MotRefMdl.BrdgVltg.Val "MICROSAR RTE" FLOAT32_IEEE NO_COMPU_METHOD 0 0 6.0 26.5 ECU_ADDRESS 0 SYMBOL_LINK "Rte_BattVltg_BrdgVltg_Val" 0 DISPLAY_IDENTIFIER MotRefMdl.ReceiverPorts.BrdgVltg.Val /end MEASUREMENT
/begin MEASUREMENT MotRefMdl.CosDelta "MICROSAR RTE" FLOAT32_IEEE NO_COMPU_METHOD 0 0 -1.0 1.0 MATRIX_DIM 8 1 1 ECU_ADDRESS 0 SYMBOL_LINK "Rte_MotRefMdl_CosDelta" 0 DISPLAY_IDENTIFIER MotRefMdl.PerInstanceMemories.CosDelta /end MEASUREMENT
/begin MEASUREMENT MotRefMdl.DualEcuMotCtrlMtgtnEna.Logl "MICROSAR RTE" UBYTE RTE_CM_BOOLEAN 0 0 0 255 ECU_ADDRESS 0 SYMBOL_LINK "Rte_DualCtrlrOutpMgr_DualEcuMotCtrlMtgtnEna_Logl" 0 DISPLAY_IDENTIFIER MotRefMdl.ReceiverPorts.DualEcuMotCtrlMtgtnEna.Logl /end MEASUREMENT
/begin MEASUREMENT MotRefMdl.MotAndThermProtnLoaMod.Val "MICROSAR RTE" UBYTE NO_COMPU_METHOD 0 0 0 255 ECU_ADDRESS 0 SYMBOL_LINK "Rte_LoaMgr_MotAndThermProtnLoaMod_Val" 0 DISPLAY_IDENTIFIER MotRefMdl.ReceiverPorts.MotAndThermProtnLoaMod.Val /end MEASUREMENT
/begin MEASUREMENT MotRefMdl.MotBackEmfConEstimd.Val "MICROSAR RTE" FLOAT32_IEEE NO_COMPU_METHOD 0 0 0.025 0.075 ECU_ADDRESS 0 SYMBOL_LINK "Rte_MotCtrlPrmEstimn_MotBackEmfConEstimd_Val" 0 DISPLAY_IDENTIFIER MotRefMdl.ReceiverPorts.MotBackEmfConEstimd.Val /end MEASUREMENT
/begin MEASUREMENT MotRefMdl.MotBackEmfVltg.Val "MICROSAR RTE" FLOAT32_IEEE NO_COMPU_METHOD 0 0 -3.402823466e+38 3.402823466e+38 ECU_ADDRESS 0 SYMBOL_LINK "Rte_MotRefMdl_MotBackEmfVltg_Val" 0 DISPLAY_IDENTIFIER MotRefMdl.SenderPorts.MotBackEmfVltg.Val /end MEASUREMENT
/begin MEASUREMENT MotRefMdl.MotCurrAg.Val "MICROSAR RTE" FLOAT32_IEEE NO_COMPU_METHOD 0 0 0 6.2832 ECU_ADDRESS 0 SYMBOL_LINK "Rte_MotRefMdl_MotCurrAg_Val" 0 DISPLAY_IDENTIFIER MotRefMdl.SenderPorts.MotCurrAg.Val /end MEASUREMENT
/begin MEASUREMENT MotRefMdl.MotCurrDaxCmd.Val "MICROSAR RTE" FLOAT32_IEEE NO_COMPU_METHOD 0 0 0.0 200.0 ECU_ADDRESS 0 SYMBOL_LINK "Rte_MotRefMdl_MotCurrDaxCmd_Val" 0 DISPLAY_IDENTIFIER MotRefMdl.SenderPorts.MotCurrDaxCmd.Val /end MEASUREMENT
/begin MEASUREMENT MotRefMdl.MotCurrDaxCmdPrev "MICROSAR RTE" FLOAT32_IEEE NO_COMPU_METHOD 0 0 0.0 200.0 ECU_ADDRESS 0 SYMBOL_LINK "Rte_MotRefMdl_MotCurrDaxCmdPrev" 0 DISPLAY_IDENTIFIER MotRefMdl.PerInstanceMemories.MotCurrDaxCmdPrev /end MEASUREMENT
/begin MEASUREMENT MotRefMdl.MotCurrDaxMax.Val "MICROSAR RTE" FLOAT32_IEEE NO_COMPU_METHOD 0 0 0.0 200.0 ECU_ADDRESS 0 SYMBOL_LINK "Rte_MotRefMdl_MotCurrDaxMax_Val" 0 DISPLAY_IDENTIFIER MotRefMdl.SenderPorts.MotCurrDaxMax.Val /end MEASUREMENT
/begin MEASUREMENT MotRefMdl.MotCurrQaxCmd.Val "MICROSAR RTE" FLOAT32_IEEE NO_COMPU_METHOD 0 0 -200 200 ECU_ADDRESS 0 SYMBOL_LINK "Rte_MotRefMdl_MotCurrQaxCmd_Val" 0 DISPLAY_IDENTIFIER MotRefMdl.SenderPorts.MotCurrQaxCmd.Val /end MEASUREMENT
/begin MEASUREMENT MotRefMdl.MotCurrQaxCmdPrev "MICROSAR RTE" FLOAT32_IEEE NO_COMPU_METHOD 0 0 -200 200 ECU_ADDRESS 0 SYMBOL_LINK "Rte_MotRefMdl_MotCurrQaxCmdPrev" 0 DISPLAY_IDENTIFIER MotRefMdl.PerInstanceMemories.MotCurrQaxCmdPrev /end MEASUREMENT
/begin MEASUREMENT MotRefMdl.MotInduDaxEstimd.Val "MICROSAR RTE" FLOAT32_IEEE NO_COMPU_METHOD 0 0 0.00003 0.00041 ECU_ADDRESS 0 SYMBOL_LINK "Rte_MotCtrlPrmEstimn_MotInduDaxEstimd_Val" 0 DISPLAY_IDENTIFIER MotRefMdl.ReceiverPorts.MotInduDaxEstimd.Val /end MEASUREMENT
/begin MEASUREMENT MotRefMdl.MotInduQaxEstimd.Val "MICROSAR RTE" FLOAT32_IEEE NO_COMPU_METHOD 0 0 0.00003 0.00041 ECU_ADDRESS 0 SYMBOL_LINK "Rte_MotCtrlPrmEstimn_MotInduQaxEstimd_Val" 0 DISPLAY_IDENTIFIER MotRefMdl.ReceiverPorts.MotInduQaxEstimd.Val /end MEASUREMENT
/begin MEASUREMENT MotRefMdl.MotQuad.Val "MICROSAR RTE" UBYTE RTE_CM_ENUM_MotQuad1 0 0 0 255 ECU_ADDRESS 0 SYMBOL_LINK "Rte_MotQuadDetn_MotQuad_Val" 0 DISPLAY_IDENTIFIER MotRefMdl.ReceiverPorts.MotQuad.Val /end MEASUREMENT
/begin MEASUREMENT MotRefMdl.MotREstimd.Val "MICROSAR RTE" FLOAT32_IEEE NO_COMPU_METHOD 0 0 0.005 0.125 ECU_ADDRESS 0 SYMBOL_LINK "Rte_MotCtrlPrmEstimn_MotREstimd_Val" 0 DISPLAY_IDENTIFIER MotRefMdl.ReceiverPorts.MotREstimd.Val /end MEASUREMENT
/begin MEASUREMENT MotRefMdl.MotReacncDax.Val "MICROSAR RTE" FLOAT32_IEEE NO_COMPU_METHOD 0 0 -3.402823466e+38 3.402823466e+38 ECU_ADDRESS 0 SYMBOL_LINK "Rte_MotRefMdl_MotReacncDax_Val" 0 DISPLAY_IDENTIFIER MotRefMdl.SenderPorts.MotReacncDax.Val /end MEASUREMENT
/begin MEASUREMENT MotRefMdl.MotReacncQax.Val "MICROSAR RTE" FLOAT32_IEEE NO_COMPU_METHOD 0 0 -3.402823466e+38 3.402823466e+38 ECU_ADDRESS 0 SYMBOL_LINK "Rte_MotRefMdl_MotReacncQax_Val" 0 DISPLAY_IDENTIFIER MotRefMdl.SenderPorts.MotReacncQax.Val /end MEASUREMENT
/begin MEASUREMENT MotRefMdl.MotTqCmdMrfScad.Val "MICROSAR RTE" FLOAT32_IEEE NO_COMPU_METHOD 0 0 -8.8 8.8 ECU_ADDRESS 0 SYMBOL_LINK "Rte_MotTqCmdSca_MotTqCmdMrfScad_Val" 0 DISPLAY_IDENTIFIER MotRefMdl.ReceiverPorts.MotTqCmdMrfScad.Val /end MEASUREMENT
/begin MEASUREMENT MotRefMdl.MotVelLpFil.FilGain "MICROSAR RTE" FLOAT32_IEEE NO_COMPU_METHOD 0 0 -3.402823466e+38 3.402823466e+38 ECU_ADDRESS 0 SYMBOL_LINK "Rte_MotRefMdl_MotVelLpFil.FilGain" 0 DISPLAY_IDENTIFIER MotRefMdl.PerInstanceMemories.MotVelLpFil.FilGain /end MEASUREMENT
/begin MEASUREMENT MotRefMdl.MotVelLpFil.FilSt "MICROSAR RTE" FLOAT32_IEEE NO_COMPU_METHOD 0 0 -3.402823466e+38 3.402823466e+38 ECU_ADDRESS 0 SYMBOL_LINK "Rte_MotRefMdl_MotVelLpFil.FilSt" 0 DISPLAY_IDENTIFIER MotRefMdl.PerInstanceMemories.MotVelLpFil.FilSt /end MEASUREMENT
/begin MEASUREMENT MotRefMdl.MotVelMrf.Val "MICROSAR RTE" FLOAT32_IEEE NO_COMPU_METHOD 0 0 -1350 1350.0 ECU_ADDRESS 0 SYMBOL_LINK "Rte_CDD_MotVel_MotVelMrf_Val" 0 DISPLAY_IDENTIFIER MotRefMdl.ReceiverPorts.MotVelMrf.Val /end MEASUREMENT
/begin MEASUREMENT MotRefMdl.MotVltgDaxFf.Val "MICROSAR RTE" FLOAT32_IEEE NO_COMPU_METHOD 0 0 -26.5 26.5 ECU_ADDRESS 0 SYMBOL_LINK "Rte_MotRefMdl_MotVltgDaxFf_Val" 0 DISPLAY_IDENTIFIER MotRefMdl.SenderPorts.MotVltgDaxFf.Val /end MEASUREMENT
/begin MEASUREMENT MotRefMdl.MotVltgDaxFfStat.Val "MICROSAR RTE" FLOAT32_IEEE NO_COMPU_METHOD 0 0 -3.402823466e+38 3.402823466e+38 ECU_ADDRESS 0 SYMBOL_LINK "Rte_MotRefMdl_MotVltgDaxFfStat_Val" 0 DISPLAY_IDENTIFIER MotRefMdl.SenderPorts.MotVltgDaxFfStat.Val /end MEASUREMENT
/begin MEASUREMENT MotRefMdl.MotVltgQaxFf.Val "MICROSAR RTE" FLOAT32_IEEE NO_COMPU_METHOD 0 0 -26.5 26.5 ECU_ADDRESS 0 SYMBOL_LINK "Rte_MotRefMdl_MotVltgQaxFf_Val" 0 DISPLAY_IDENTIFIER MotRefMdl.SenderPorts.MotVltgQaxFf.Val /end MEASUREMENT
/begin MEASUREMENT MotRefMdl.MotVltgQaxFfStat.Val "MICROSAR RTE" FLOAT32_IEEE NO_COMPU_METHOD 0 0 -3.402823466e+38 3.402823466e+38 ECU_ADDRESS 0 SYMBOL_LINK "Rte_MotRefMdl_MotVltgQaxFfStat_Val" 0 DISPLAY_IDENTIFIER MotRefMdl.SenderPorts.MotVltgQaxFfStat.Val /end MEASUREMENT
/begin MEASUREMENT MotRefMdl.MotVltgSatnIndFf.Val "MICROSAR RTE" FLOAT32_IEEE NO_COMPU_METHOD 0 0 -3.402823466e+38 3.402823466e+38 ECU_ADDRESS 0 SYMBOL_LINK "Rte_MotRefMdl_MotVltgSatnIndFf_Val" 0 DISPLAY_IDENTIFIER MotRefMdl.SenderPorts.MotVltgSatnIndFf.Val /end MEASUREMENT
/begin MEASUREMENT MotRefMdl.SinDelta "MICROSAR RTE" FLOAT32_IEEE NO_COMPU_METHOD 0 0 -1.0 1.0 MATRIX_DIM 8 1 1 ECU_ADDRESS 0 SYMBOL_LINK "Rte_MotRefMdl_SinDelta" 0 DISPLAY_IDENTIFIER MotRefMdl.PerInstanceMemories.SinDelta /end MEASUREMENT
/begin MEASUREMENT MotRefMdl.VltgDaxFfTermPrev "MICROSAR RTE" FLOAT32_IEEE NO_COMPU_METHOD 0 0 -26.5 26.5 ECU_ADDRESS 0 SYMBOL_LINK "Rte_MotRefMdl_VltgDaxFfTermPrev" 0 DISPLAY_IDENTIFIER MotRefMdl.PerInstanceMemories.VltgDaxFfTermPrev /end MEASUREMENT
/begin MEASUREMENT MotRefMdl.VltgQaxFfTermPrev "MICROSAR RTE" FLOAT32_IEEE NO_COMPU_METHOD 0 0 -26.5 26.5 ECU_ADDRESS 0 SYMBOL_LINK "Rte_MotRefMdl_VltgQaxFfTermPrev" 0 DISPLAY_IDENTIFIER MotRefMdl.PerInstanceMemories.VltgQaxFfTermPrev /end MEASUREMENT
/begin MEASUREMENT MotRefMdl.dMotRefMdlCurrDaxAtPeakTq "MICROSAR RTE" FLOAT32_IEEE NO_COMPU_METHOD 0 0 0.0 200.0 ECU_ADDRESS 0 SYMBOL_LINK "Rte_MotRefMdl_dMotRefMdlCurrDaxAtPeakTq" 0 DISPLAY_IDENTIFIER MotRefMdl.PerInstanceMemories.dMotRefMdlCurrDaxAtPeakTq /end MEASUREMENT
/begin MEASUREMENT MotRefMdl.dMotRefMdlCurrDaxMin "MICROSAR RTE" FLOAT32_IEEE NO_COMPU_METHOD 0 0 0.0 200.0 ECU_ADDRESS 0 SYMBOL_LINK "Rte_MotRefMdl_dMotRefMdlCurrDaxMin" 0 DISPLAY_IDENTIFIER MotRefMdl.PerInstanceMemories.dMotRefMdlCurrDaxMin /end MEASUREMENT
/begin MEASUREMENT MotRefMdl.dMotRefMdlCurrQaxMin "MICROSAR RTE" FLOAT32_IEEE NO_COMPU_METHOD 0 0 -200 200 ECU_ADDRESS 0 SYMBOL_LINK "Rte_MotRefMdl_dMotRefMdlCurrQaxMin" 0 DISPLAY_IDENTIFIER MotRefMdl.PerInstanceMemories.dMotRefMdlCurrQaxMin /end MEASUREMENT
/begin MEASUREMENT MotRefMdl.dMotRefMdlCurrSqdMin "MICROSAR RTE" FLOAT32_IEEE NO_COMPU_METHOD 0 0 0.0 40000.0 ECU_ADDRESS 0 SYMBOL_LINK "Rte_MotRefMdl_dMotRefMdlCurrSqdMin" 0 DISPLAY_IDENTIFIER MotRefMdl.PerInstanceMemories.dMotRefMdlCurrSqdMin /end MEASUREMENT
/begin MEASUREMENT MotRefMdl.dMotRefMdlInterCalcnCurrDaxMax "MICROSAR RTE" FLOAT32_IEEE NO_COMPU_METHOD 0 0 0.0 200.0 ECU_ADDRESS 0 SYMBOL_LINK "Rte_MotRefMdl_dMotRefMdlInterCalcnCurrDaxMax" 0 DISPLAY_IDENTIFIER MotRefMdl.PerInstanceMemories.dMotRefMdlInterCalcnCurrDaxMax /end MEASUREMENT
/begin MEASUREMENT MotRefMdl.dMotRefMdlMinCurrNrItrn "MICROSAR RTE" UBYTE NO_COMPU_METHOD 0 0 0.0 255.0 ECU_ADDRESS 0 SYMBOL_LINK "Rte_MotRefMdl_dMotRefMdlMinCurrNrItrn" 0 DISPLAY_IDENTIFIER MotRefMdl.PerInstanceMemories.dMotRefMdlMinCurrNrItrn /end MEASUREMENT
/begin MEASUREMENT MotRefMdl.dMotRefMdlMotCurrDaxBoost "MICROSAR RTE" FLOAT32_IEEE NO_COMPU_METHOD 0 0 0.0 200.0 ECU_ADDRESS 0 SYMBOL_LINK "Rte_MotRefMdl_dMotRefMdlMotCurrDaxBoost" 0 DISPLAY_IDENTIFIER MotRefMdl.PerInstanceMemories.dMotRefMdlMotCurrDaxBoost /end MEASUREMENT
/begin MEASUREMENT MotRefMdl.dMotRefMdlMotTqCmdLimd "MICROSAR RTE" FLOAT32_IEEE NO_COMPU_METHOD 0 0 -8.8 8.8 ECU_ADDRESS 0 SYMBOL_LINK "Rte_MotRefMdl_dMotRefMdlMotTqCmdLimd" 0 DISPLAY_IDENTIFIER MotRefMdl.PerInstanceMemories.dMotRefMdlMotTqCmdLimd /end MEASUREMENT
/begin MEASUREMENT MotRefMdl.dMotRefMdlMotVelFildFf "MICROSAR RTE" FLOAT32_IEEE NO_COMPU_METHOD 0 0 -1350 1350.0 ECU_ADDRESS 0 SYMBOL_LINK "Rte_MotRefMdl_dMotRefMdlMotVelFildFf" 0 DISPLAY_IDENTIFIER MotRefMdl.PerInstanceMemories.dMotRefMdlMotVelFildFf /end MEASUREMENT
/begin MEASUREMENT MotRefMdl.dMotRefMdlMotVltgDaxFfDyn "MICROSAR RTE" FLOAT32_IEEE NO_COMPU_METHOD 0 0 -26.5 26.5 ECU_ADDRESS 0 SYMBOL_LINK "Rte_MotRefMdl_dMotRefMdlMotVltgDaxFfDyn" 0 DISPLAY_IDENTIFIER MotRefMdl.PerInstanceMemories.dMotRefMdlMotVltgDaxFfDyn /end MEASUREMENT
/begin MEASUREMENT MotRefMdl.dMotRefMdlMotVltgDaxFfDynTerm "MICROSAR RTE" FLOAT32_IEEE NO_COMPU_METHOD 0 0 -26.5 26.5 ECU_ADDRESS 0 SYMBOL_LINK "Rte_MotRefMdl_dMotRefMdlMotVltgDaxFfDynTerm" 0 DISPLAY_IDENTIFIER MotRefMdl.PerInstanceMemories.dMotRefMdlMotVltgDaxFfDynTerm /end MEASUREMENT
/begin MEASUREMENT MotRefMdl.dMotRefMdlMotVltgDaxFfStat "MICROSAR RTE" FLOAT32_IEEE NO_COMPU_METHOD 0 0 -3.402823466e+38 3.402823466e+38 ECU_ADDRESS 0 SYMBOL_LINK "Rte_MotRefMdl_dMotRefMdlMotVltgDaxFfStat" 0 DISPLAY_IDENTIFIER MotRefMdl.PerInstanceMemories.dMotRefMdlMotVltgDaxFfStat /end MEASUREMENT
/begin MEASUREMENT MotRefMdl.dMotRefMdlMotVltgQaxFfDyn "MICROSAR RTE" FLOAT32_IEEE NO_COMPU_METHOD 0 0 -26.5 26.5 ECU_ADDRESS 0 SYMBOL_LINK "Rte_MotRefMdl_dMotRefMdlMotVltgQaxFfDyn" 0 DISPLAY_IDENTIFIER MotRefMdl.PerInstanceMemories.dMotRefMdlMotVltgQaxFfDyn /end MEASUREMENT
/begin MEASUREMENT MotRefMdl.dMotRefMdlMotVltgQaxFfDynTerm "MICROSAR RTE" FLOAT32_IEEE NO_COMPU_METHOD 0 0 -26.5 26.5 ECU_ADDRESS 0 SYMBOL_LINK "Rte_MotRefMdl_dMotRefMdlMotVltgQaxFfDynTerm" 0 DISPLAY_IDENTIFIER MotRefMdl.PerInstanceMemories.dMotRefMdlMotVltgQaxFfDynTerm /end MEASUREMENT
/begin MEASUREMENT MotRefMdl.dMotRefMdlMotVltgQaxFfStat "MICROSAR RTE" FLOAT32_IEEE NO_COMPU_METHOD 0 0 -3.402823466e+38 3.402823466e+38 ECU_ADDRESS 0 SYMBOL_LINK "Rte_MotRefMdl_dMotRefMdlMotVltgQaxFfStat" 0 DISPLAY_IDENTIFIER MotRefMdl.PerInstanceMemories.dMotRefMdlMotVltgQaxFfStat /end MEASUREMENT
/begin MEASUREMENT MotRefMdl.dMotRefMdlPeakTq "MICROSAR RTE" FLOAT32_IEEE NO_COMPU_METHOD 0 0 -8.8 8.8 ECU_ADDRESS 0 SYMBOL_LINK "Rte_MotRefMdl_dMotRefMdlPeakTq" 0 DISPLAY_IDENTIFIER MotRefMdl.PerInstanceMemories.dMotRefMdlPeakTq /end MEASUREMENT
/begin MEASUREMENT MotRefMdl.dMotRefMdlPeakTqNrItrn "MICROSAR RTE" UBYTE NO_COMPU_METHOD 0 0 0.0 255.0 ECU_ADDRESS 0 SYMBOL_LINK "Rte_MotRefMdl_dMotRefMdlPeakTqNrItrn" 0 DISPLAY_IDENTIFIER MotRefMdl.PerInstanceMemories.dMotRefMdlPeakTqNrItrn /end MEASUREMENT
/begin MEASUREMENT MotRefMdl.dMotRefMdlPhaAdvAtPeakTq "MICROSAR RTE" FLOAT32_IEEE NO_COMPU_METHOD 0 0 0 6.2832 ECU_ADDRESS 0 SYMBOL_LINK "Rte_MotRefMdl_dMotRefMdlPhaAdvAtPeakTq" 0 DISPLAY_IDENTIFIER MotRefMdl.PerInstanceMemories.dMotRefMdlPhaAdvAtPeakTq /end MEASUREMENT
/begin GROUP LoaMgr.LoaMgrCurrMeasIdptSig0Resp.Val "MICROSAR RTE" /begin SUB_GROUP /end SUB_GROUP /begin FUNCTION_LIST /end FUNCTION_LIST /begin REF_CHARACTERISTIC LoaMgr.LoaMgrCurrMeasIdptSig0Resp.Val /end REF_CHARACTERISTIC /begin REF_MEASUREMENT /end REF_MEASUREMENT /end GROUP
/begin GROUP LoaMgr.LoaMgrCurrMeasIdptSig1Resp.Val "MICROSAR RTE" /begin SUB_GROUP /end SUB_GROUP /begin FUNCTION_LIST /end FUNCTION_LIST /begin REF_CHARACTERISTIC LoaMgr.LoaMgrCurrMeasIdptSig1Resp.Val /end REF_CHARACTERISTIC /begin REF_MEASUREMENT /end REF_MEASUREMENT /end GROUP
/begin GROUP LoaMgr.LoaMgrCurrMeasIdptSig2Resp.Val "MICROSAR RTE" /begin SUB_GROUP /end SUB_GROUP /begin FUNCTION_LIST /end FUNCTION_LIST /begin REF_CHARACTERISTIC LoaMgr.LoaMgrCurrMeasIdptSig2Resp.Val /end REF_CHARACTERISTIC /begin REF_MEASUREMENT /end REF_MEASUREMENT /end GROUP
/begin GROUP LoaMgr.LoaMgrCurrMeasIdptSigFltThd.Val "MICROSAR RTE" /begin SUB_GROUP /end SUB_GROUP /begin FUNCTION_LIST /end FUNCTION_LIST /begin REF_CHARACTERISTIC LoaMgr.LoaMgrCurrMeasIdptSigFltThd.Val /end REF_CHARACTERISTIC /begin REF_MEASUREMENT /end REF_MEASUREMENT /end GROUP
/begin GROUP LoaMgr.LoaMgrCurrMeasMtgtnRate.Val "MICROSAR RTE" /begin SUB_GROUP /end SUB_GROUP /begin FUNCTION_LIST /end FUNCTION_LIST /begin REF_CHARACTERISTIC LoaMgr.LoaMgrCurrMeasMtgtnRate.Val /end REF_CHARACTERISTIC /begin REF_MEASUREMENT /end REF_MEASUREMENT /end GROUP
/begin GROUP LoaMgr.LoaMgrCurrMeasMtgtnSca.Val "MICROSAR RTE" /begin SUB_GROUP /end SUB_GROUP /begin FUNCTION_LIST /end FUNCTION_LIST /begin REF_CHARACTERISTIC LoaMgr.LoaMgrCurrMeasMtgtnSca.Val /end REF_CHARACTERISTIC /begin REF_MEASUREMENT /end REF_MEASUREMENT /end GROUP
/begin GROUP LoaMgr.LoaMgrCurrMeasMtgtnScaZeroEna.Logl "MICROSAR RTE" /begin SUB_GROUP /end SUB_GROUP /begin FUNCTION_LIST /end FUNCTION_LIST /begin REF_CHARACTERISTIC LoaMgr.LoaMgrCurrMeasMtgtnScaZeroEna.Logl /end REF_CHARACTERISTIC /begin REF_MEASUREMENT /end REF_MEASUREMENT /end GROUP
/begin GROUP LoaMgr.LoaMgrFadeOutStRate.Val "MICROSAR RTE" /begin SUB_GROUP /end SUB_GROUP /begin FUNCTION_LIST /end FUNCTION_LIST /begin REF_CHARACTERISTIC LoaMgr.LoaMgrFadeOutStRate.Val /end REF_CHARACTERISTIC /begin REF_MEASUREMENT /end REF_MEASUREMENT /end GROUP
/begin GROUP LoaMgr.LoaMgrHwTqIdptSig0NoTqLoaResp.Val "MICROSAR RTE" /begin SUB_GROUP /end SUB_GROUP /begin FUNCTION_LIST /end FUNCTION_LIST /begin REF_CHARACTERISTIC LoaMgr.LoaMgrHwTqIdptSig0NoTqLoaResp.Val /end REF_CHARACTERISTIC /begin REF_MEASUREMENT /end REF_MEASUREMENT /end GROUP
/begin GROUP LoaMgr.LoaMgrHwTqIdptSig1NoTqLoaResp.Val "MICROSAR RTE" /begin SUB_GROUP /end SUB_GROUP /begin FUNCTION_LIST /end FUNCTION_LIST /begin REF_CHARACTERISTIC LoaMgr.LoaMgrHwTqIdptSig1NoTqLoaResp.Val /end REF_CHARACTERISTIC /begin REF_MEASUREMENT /end REF_MEASUREMENT /end GROUP
/begin GROUP LoaMgr.LoaMgrHwTqIdptSig2Resp.Val "MICROSAR RTE" /begin SUB_GROUP /end SUB_GROUP /begin FUNCTION_LIST /end FUNCTION_LIST /begin REF_CHARACTERISTIC LoaMgr.LoaMgrHwTqIdptSig2Resp.Val /end REF_CHARACTERISTIC /begin REF_MEASUREMENT /end REF_MEASUREMENT /end GROUP
/begin GROUP LoaMgr.LoaMgrHwTqIdptSig3Resp.Val "MICROSAR RTE" /begin SUB_GROUP /end SUB_GROUP /begin FUNCTION_LIST /end FUNCTION_LIST /begin REF_CHARACTERISTIC LoaMgr.LoaMgrHwTqIdptSig3Resp.Val /end REF_CHARACTERISTIC /begin REF_MEASUREMENT /end REF_MEASUREMENT /end GROUP
/begin GROUP LoaMgr.LoaMgrHwTqIdptSig4Resp.Val "MICROSAR RTE" /begin SUB_GROUP /end SUB_GROUP /begin FUNCTION_LIST /end FUNCTION_LIST /begin REF_CHARACTERISTIC LoaMgr.LoaMgrHwTqIdptSig4Resp.Val /end REF_CHARACTERISTIC /begin REF_MEASUREMENT /end REF_MEASUREMENT /end GROUP
/begin GROUP LoaMgr.LoaMgrHwTqIdptSigFltThd.Val "MICROSAR RTE" /begin SUB_GROUP /end SUB_GROUP /begin FUNCTION_LIST /end FUNCTION_LIST /begin REF_CHARACTERISTIC LoaMgr.LoaMgrHwTqIdptSigFltThd.Val /end REF_CHARACTERISTIC /begin REF_MEASUREMENT /end REF_MEASUREMENT /end GROUP
/begin GROUP LoaMgr.LoaMgrHwTqLoaAvlResp.Val "MICROSAR RTE" /begin SUB_GROUP /end SUB_GROUP /begin FUNCTION_LIST /end FUNCTION_LIST /begin REF_CHARACTERISTIC LoaMgr.LoaMgrHwTqLoaAvlResp.Val /end REF_CHARACTERISTIC /begin REF_MEASUREMENT /end REF_MEASUREMENT /end GROUP
/begin GROUP LoaMgr.LoaMgrIvtrIdptSig0Resp.Val "MICROSAR RTE" /begin SUB_GROUP /end SUB_GROUP /begin FUNCTION_LIST /end FUNCTION_LIST /begin REF_CHARACTERISTIC LoaMgr.LoaMgrIvtrIdptSig0Resp.Val /end REF_CHARACTERISTIC /begin REF_MEASUREMENT /end REF_MEASUREMENT /end GROUP
/begin GROUP LoaMgr.LoaMgrIvtrIdptSig1Resp.Val "MICROSAR RTE" /begin SUB_GROUP /end SUB_GROUP /begin FUNCTION_LIST /end FUNCTION_LIST /begin REF_CHARACTERISTIC LoaMgr.LoaMgrIvtrIdptSig1Resp.Val /end REF_CHARACTERISTIC /begin REF_MEASUREMENT /end REF_MEASUREMENT /end GROUP
/begin GROUP LoaMgr.LoaMgrIvtrIdptSig2Resp.Val "MICROSAR RTE" /begin SUB_GROUP /end SUB_GROUP /begin FUNCTION_LIST /end FUNCTION_LIST /begin REF_CHARACTERISTIC LoaMgr.LoaMgrIvtrIdptSig2Resp.Val /end REF_CHARACTERISTIC /begin REF_MEASUREMENT /end REF_MEASUREMENT /end GROUP
/begin GROUP LoaMgr.LoaMgrIvtrIdptSigFltThd.Val "MICROSAR RTE" /begin SUB_GROUP /end SUB_GROUP /begin FUNCTION_LIST /end FUNCTION_LIST /begin REF_CHARACTERISTIC LoaMgr.LoaMgrIvtrIdptSigFltThd.Val /end REF_CHARACTERISTIC /begin REF_MEASUREMENT /end REF_MEASUREMENT /end GROUP
/begin GROUP LoaMgr.LoaMgrIvtrMtgtnRate.Val "MICROSAR RTE" /begin SUB_GROUP /end SUB_GROUP /begin FUNCTION_LIST /end FUNCTION_LIST /begin REF_CHARACTERISTIC LoaMgr.LoaMgrIvtrMtgtnRate.Val /end REF_CHARACTERISTIC /begin REF_MEASUREMENT /end REF_MEASUREMENT /end GROUP
/begin GROUP LoaMgr.LoaMgrIvtrMtgtnSca.Val "MICROSAR RTE" /begin SUB_GROUP /end SUB_GROUP /begin FUNCTION_LIST /end FUNCTION_LIST /begin REF_CHARACTERISTIC LoaMgr.LoaMgrIvtrMtgtnSca.Val /end REF_CHARACTERISTIC /begin REF_MEASUREMENT /end REF_MEASUREMENT /end GROUP
/begin GROUP LoaMgr.LoaMgrIvtrMtgtnScaZeroEna.Logl "MICROSAR RTE" /begin SUB_GROUP /end SUB_GROUP /begin FUNCTION_LIST /end FUNCTION_LIST /begin REF_CHARACTERISTIC LoaMgr.LoaMgrIvtrMtgtnScaZeroEna.Logl /end REF_CHARACTERISTIC /begin REF_MEASUREMENT /end REF_MEASUREMENT /end GROUP
/begin GROUP LoaMgr.LoaMgrLimdStRate.Val "MICROSAR RTE" /begin SUB_GROUP /end SUB_GROUP /begin FUNCTION_LIST /end FUNCTION_LIST /begin REF_CHARACTERISTIC LoaMgr.LoaMgrLimdStRate.Val /end REF_CHARACTERISTIC /begin REF_MEASUREMENT /end REF_MEASUREMENT /end GROUP
/begin GROUP LoaMgr.LoaMgrLimdStSca.Val "MICROSAR RTE" /begin SUB_GROUP /end SUB_GROUP /begin FUNCTION_LIST /end FUNCTION_LIST /begin REF_CHARACTERISTIC LoaMgr.LoaMgrLimdStSca.Val /end REF_CHARACTERISTIC /begin REF_MEASUREMENT /end REF_MEASUREMENT /end GROUP
/begin GROUP LoaMgr.LoaMgrMotAgAvlSnsrlsResp.Val "MICROSAR RTE" /begin SUB_GROUP /end SUB_GROUP /begin FUNCTION_LIST /end FUNCTION_LIST /begin REF_CHARACTERISTIC LoaMgr.LoaMgrMotAgAvlSnsrlsResp.Val /end REF_CHARACTERISTIC /begin REF_MEASUREMENT /end REF_MEASUREMENT /end GROUP
/begin GROUP LoaMgr.LoaMgrMotAgIdptSig0NoSnsrlsResp.Val "MICROSAR RTE" /begin SUB_GROUP /end SUB_GROUP /begin FUNCTION_LIST /end FUNCTION_LIST /begin REF_CHARACTERISTIC LoaMgr.LoaMgrMotAgIdptSig0NoSnsrlsResp.Val /end REF_CHARACTERISTIC /begin REF_MEASUREMENT /end REF_MEASUREMENT /end GROUP
/begin GROUP LoaMgr.LoaMgrMotAgIdptSig1NoSnsrlsResp.Val "MICROSAR RTE" /begin SUB_GROUP /end SUB_GROUP /begin FUNCTION_LIST /end FUNCTION_LIST /begin REF_CHARACTERISTIC LoaMgr.LoaMgrMotAgIdptSig1NoSnsrlsResp.Val /end REF_CHARACTERISTIC /begin REF_MEASUREMENT /end REF_MEASUREMENT /end GROUP
/begin GROUP LoaMgr.LoaMgrMotAgIdptSig2Resp.Val "MICROSAR RTE" /begin SUB_GROUP /end SUB_GROUP /begin FUNCTION_LIST /end FUNCTION_LIST /begin REF_CHARACTERISTIC LoaMgr.LoaMgrMotAgIdptSig2Resp.Val /end REF_CHARACTERISTIC /begin REF_MEASUREMENT /end REF_MEASUREMENT /end GROUP
/begin GROUP LoaMgr.LoaMgrMotAgIdptSig3Resp.Val "MICROSAR RTE" /begin SUB_GROUP /end SUB_GROUP /begin FUNCTION_LIST /end FUNCTION_LIST /begin REF_CHARACTERISTIC LoaMgr.LoaMgrMotAgIdptSig3Resp.Val /end REF_CHARACTERISTIC /begin REF_MEASUREMENT /end REF_MEASUREMENT /end GROUP
/begin GROUP LoaMgr.LoaMgrMotAgIdptSigFltThd.Val "MICROSAR RTE" /begin SUB_GROUP /end SUB_GROUP /begin FUNCTION_LIST /end FUNCTION_LIST /begin REF_CHARACTERISTIC LoaMgr.LoaMgrMotAgIdptSigFltThd.Val /end REF_CHARACTERISTIC /begin REF_MEASUREMENT /end REF_MEASUREMENT /end GROUP
/begin GROUP LoaMgr.LoaMgrMotAgMtgtnRate.Val "MICROSAR RTE" /begin SUB_GROUP /end SUB_GROUP /begin FUNCTION_LIST /end FUNCTION_LIST /begin REF_CHARACTERISTIC LoaMgr.LoaMgrMotAgMtgtnRate.Val /end REF_CHARACTERISTIC /begin REF_MEASUREMENT /end REF_MEASUREMENT /end GROUP
/begin GROUP LoaMgr.LoaMgrMotAgMtgtnSca.Val "MICROSAR RTE" /begin SUB_GROUP /end SUB_GROUP /begin FUNCTION_LIST /end FUNCTION_LIST /begin REF_CHARACTERISTIC LoaMgr.LoaMgrMotAgMtgtnSca.Val /end REF_CHARACTERISTIC /begin REF_MEASUREMENT /end REF_MEASUREMENT /end GROUP
/begin GROUP LoaMgr.LoaMgrMotAgMtgtnScaZeroEna.Logl "MICROSAR RTE" /begin SUB_GROUP /end SUB_GROUP /begin FUNCTION_LIST /end FUNCTION_LIST /begin REF_CHARACTERISTIC LoaMgr.LoaMgrMotAgMtgtnScaZeroEna.Logl /end REF_CHARACTERISTIC /begin REF_MEASUREMENT /end REF_MEASUREMENT /end GROUP
/begin GROUP LoaMgr.LoaRateLim.Val "MICROSAR RTE" /begin SUB_GROUP /end SUB_GROUP /begin FUNCTION_LIST /end FUNCTION_LIST /begin REF_CHARACTERISTIC /end REF_CHARACTERISTIC /begin REF_MEASUREMENT LoaMgr.LoaRateLim.Val /end REF_MEASUREMENT /end GROUP
/begin GROUP LoaMgr.LoaSca.Val "MICROSAR RTE" /begin SUB_GROUP /end SUB_GROUP /begin FUNCTION_LIST /end FUNCTION_LIST /begin REF_CHARACTERISTIC /end REF_CHARACTERISTIC /begin REF_MEASUREMENT LoaMgr.LoaSca.Val /end REF_MEASUREMENT /end GROUP
/begin GROUP LoaMgr.LoaScaDi.Logl "MICROSAR RTE" /begin SUB_GROUP /end SUB_GROUP /begin FUNCTION_LIST /end FUNCTION_LIST /begin REF_CHARACTERISTIC /end REF_CHARACTERISTIC /begin REF_MEASUREMENT LoaMgr.LoaScaDi.Logl /end REF_MEASUREMENT /end GROUP
/begin GROUP LoaMgr.LoaSt.Val "MICROSAR RTE" /begin SUB_GROUP /end SUB_GROUP /begin FUNCTION_LIST /end FUNCTION_LIST /begin REF_CHARACTERISTIC /end REF_CHARACTERISTIC /begin REF_MEASUREMENT LoaMgr.LoaSt.Val /end REF_MEASUREMENT /end GROUP
/begin GROUP LoaMgr.MotAgLoaMtgtnEna.Logl "MICROSAR RTE" /begin SUB_GROUP /end SUB_GROUP /begin FUNCTION_LIST /end FUNCTION_LIST /begin REF_CHARACTERISTIC /end REF_CHARACTERISTIC /begin REF_MEASUREMENT LoaMgr.MotAgLoaMtgtnEna.Logl /end REF_MEASUREMENT /end GROUP
/begin GROUP LoaMgr.MotAgMeclIdptSig.Val "MICROSAR RTE" /begin SUB_GROUP /end SUB_GROUP /begin FUNCTION_LIST /end FUNCTION_LIST /begin REF_CHARACTERISTIC /end REF_CHARACTERISTIC /begin REF_MEASUREMENT LoaMgr.MotAgMeclIdptSig.Val /end REF_MEASUREMENT /end GROUP
/begin GROUP LoaMgr.MotAgSnsrlsAvl.Logl "MICROSAR RTE" /begin SUB_GROUP /end SUB_GROUP /begin FUNCTION_LIST /end FUNCTION_LIST /begin REF_CHARACTERISTIC /end REF_CHARACTERISTIC /begin REF_MEASUREMENT LoaMgr.MotAgSnsrlsAvl.Logl /end REF_MEASUREMENT /end GROUP
/begin GROUP LoaMgr.MotAndThermProtnLoaMod.Val "MICROSAR RTE" /begin SUB_GROUP /end SUB_GROUP /begin FUNCTION_LIST /end FUNCTION_LIST /begin REF_CHARACTERISTIC /end REF_CHARACTERISTIC /begin REF_MEASUREMENT LoaMgr.MotAndThermProtnLoaMod.Val /end REF_MEASUREMENT /end GROUP
/begin GROUP LoaMgr.PerInstanceMemories "MICROSAR RTE"
 /begin SUB_GROUP LoaMgr.PrevCurrMeasIdptSigResp LoaMgr.PrevCurrMeasIdptSigVal LoaMgr.PrevCurrMeasLoaStSwMtgtnEna LoaMgr.PrevHwTqIdptSigResp LoaMgr.PrevHwTqIdptSigVal LoaMgr.PrevHwTqLoaStSwMtgtnEna LoaMgr.PrevIvtrIdptSigResp LoaMgr.PrevIvtrIdptSigVal LoaMgr.PrevIvtrLoaStSwMtgtnEna LoaMgr.PrevMotAgLoaMtgtnEna LoaMgr.PrevMotAgLoaStSwMtgtnEna LoaMgr.PrevMotAgMeclIdptSigResp LoaMgr.PrevMotAgMeclIdptSigVal LoaMgr.PrevVltgModSrc /end SUB_GROUP
 /begin FUNCTION_LIST /end FUNCTION_LIST
 /begin REF_CHARACTERISTIC /end REF_CHARACTERISTIC
 /begin REF_MEASUREMENT /end REF_MEASUREMENT
/end GROUP
/begin GROUP LoaMgr.PrevCurrMeasIdptSigResp "MICROSAR RTE" /begin SUB_GROUP /end SUB_GROUP /begin FUNCTION_LIST /end FUNCTION_LIST /begin REF_CHARACTERISTIC /end REF_CHARACTERISTIC /begin REF_MEASUREMENT LoaMgr.PrevCurrMeasIdptSigResp /end REF_MEASUREMENT /end GROUP
/begin GROUP LoaMgr.PrevCurrMeasIdptSigVal "MICROSAR RTE" /begin SUB_GROUP /end SUB_GROUP /begin FUNCTION_LIST /end FUNCTION_LIST /begin REF_CHARACTERISTIC /end REF_CHARACTERISTIC /begin REF_MEASUREMENT LoaMgr.PrevCurrMeasIdptSigVal /end REF_MEASUREMENT /end GROUP
/begin GROUP LoaMgr.PrevCurrMeasLoaStSwMtgtnEna "MICROSAR RTE" /begin SUB_GROUP /end SUB_GROUP /begin FUNCTION_LIST /end FUNCTION_LIST /begin REF_CHARACTERISTIC /end REF_CHARACTERISTIC /begin REF_MEASUREMENT LoaMgr.PrevCurrMeasLoaStSwMtgtnEna /end REF_MEASUREMENT /end GROUP
/begin GROUP LoaMgr.PrevHwTqIdptSigResp "MICROSAR RTE" /begin SUB_GROUP /end SUB_GROUP /begin FUNCTION_LIST /end FUNCTION_LIST /begin REF_CHARACTERISTIC /end REF_CHARACTERISTIC /begin REF_MEASUREMENT LoaMgr.PrevHwTqIdptSigResp /end REF_MEASUREMENT /end GROUP
/begin GROUP LoaMgr.PrevHwTqIdptSigVal "MICROSAR RTE" /begin SUB_GROUP /end SUB_GROUP /begin FUNCTION_LIST /end FUNCTION_LIST /begin REF_CHARACTERISTIC /end REF_CHARACTERISTIC /begin REF_MEASUREMENT LoaMgr.PrevHwTqIdptSigVal /end REF_MEASUREMENT /end GROUP
/begin GROUP LoaMgr.PrevHwTqLoaStSwMtgtnEna "MICROSAR RTE" /begin SUB_GROUP /end SUB_GROUP /begin FUNCTION_LIST /end FUNCTION_LIST /begin REF_CHARACTERISTIC /end REF_CHARACTERISTIC /begin REF_MEASUREMENT LoaMgr.PrevHwTqLoaStSwMtgtnEna /end REF_MEASUREMENT /end GROUP
/begin GROUP LoaMgr.PrevIvtrIdptSigResp "MICROSAR RTE" /begin SUB_GROUP /end SUB_GROUP /begin FUNCTION_LIST /end FUNCTION_LIST /begin REF_CHARACTERISTIC /end REF_CHARACTERISTIC /begin REF_MEASUREMENT LoaMgr.PrevIvtrIdptSigResp /end REF_MEASUREMENT /end GROUP
/begin GROUP LoaMgr.PrevIvtrIdptSigVal "MICROSAR RTE" /begin SUB_GROUP /end SUB_GROUP /begin FUNCTION_LIST /end FUNCTION_LIST /begin REF_CHARACTERISTIC /end REF_CHARACTERISTIC /begin REF_MEASUREMENT LoaMgr.PrevIvtrIdptSigVal /end REF_MEASUREMENT /end GROUP
/begin GROUP LoaMgr.PrevIvtrLoaStSwMtgtnEna "MICROSAR RTE" /begin SUB_GROUP /end SUB_GROUP /begin FUNCTION_LIST /end FUNCTION_LIST /begin REF_CHARACTERISTIC /end REF_CHARACTERISTIC /begin REF_MEASUREMENT LoaMgr.PrevIvtrLoaStSwMtgtnEna /end REF_MEASUREMENT /end GROUP
/begin GROUP LoaMgr.PrevMotAgLoaMtgtnEna "MICROSAR RTE" /begin SUB_GROUP /end SUB_GROUP /begin FUNCTION_LIST /end FUNCTION_LIST /begin REF_CHARACTERISTIC /end REF_CHARACTERISTIC /begin REF_MEASUREMENT LoaMgr.PrevMotAgLoaMtgtnEna /end REF_MEASUREMENT /end GROUP
/begin GROUP LoaMgr.PrevMotAgLoaStSwMtgtnEna "MICROSAR RTE" /begin SUB_GROUP /end SUB_GROUP /begin FUNCTION_LIST /end FUNCTION_LIST /begin REF_CHARACTERISTIC /end REF_CHARACTERISTIC /begin REF_MEASUREMENT LoaMgr.PrevMotAgLoaStSwMtgtnEna /end REF_MEASUREMENT /end GROUP
/begin GROUP LoaMgr.PrevMotAgMeclIdptSigResp "MICROSAR RTE" /begin SUB_GROUP /end SUB_GROUP /begin FUNCTION_LIST /end FUNCTION_LIST /begin REF_CHARACTERISTIC /end REF_CHARACTERISTIC /begin REF_MEASUREMENT LoaMgr.PrevMotAgMeclIdptSigResp /end REF_MEASUREMENT /end GROUP
/begin GROUP LoaMgr.PrevMotAgMeclIdptSigVal "MICROSAR RTE" /begin SUB_GROUP /end SUB_GROUP /begin FUNCTION_LIST /end FUNCTION_LIST /begin REF_CHARACTERISTIC /end REF_CHARACTERISTIC /begin REF_MEASUREMENT LoaMgr.PrevMotAgMeclIdptSigVal /end REF_MEASUREMENT /end GROUP
/begin GROUP LoaMgr.PrevVltgModSrc "MICROSAR RTE" /begin SUB_GROUP /end SUB_GROUP /begin FUNCTION_LIST /end FUNCTION_LIST /begin REF_CHARACTERISTIC /end REF_CHARACTERISTIC /begin REF_MEASUREMENT LoaMgr.PrevVltgModSrc /end REF_MEASUREMENT /end GROUP
/begin GROUP LoaMgr.ReceiverPorts "MICROSAR RTE"
 /begin SUB_GROUP LoaMgr.CurrMeasIdptSig.Val LoaMgr.DiagcStsIvtr1Inactv.Logl LoaMgr.DiagcStsIvtr2Inactv.Logl LoaMgr.HwTqIdptSig.Val LoaMgr.IvtrFetFltTyp.Val LoaMgr.LoaScaDi.Logl LoaMgr.MotAgMeclIdptSig.Val LoaMgr.MotAgSnsrlsAvl.Logl LoaMgr.TqLoaAvl.Logl LoaMgr.VehSteerMod.Val /end SUB_GROUP
 /begin FUNCTION_LIST /end FUNCTION_LIST
 /begin REF_CHARACTERISTIC /end REF_CHARACTERISTIC
 /begin REF_MEASUREMENT /end REF_MEASUREMENT
/end GROUP
/begin GROUP LoaMgr.SenderPorts "MICROSAR RTE"
 /begin SUB_GROUP LoaMgr.HwTqLoaMtgtnEna.Logl LoaMgr.LoaRateLim.Val LoaMgr.LoaSca.Val LoaMgr.LoaSt.Val LoaMgr.MotAgLoaMtgtnEna.Logl LoaMgr.MotAndThermProtnLoaMod.Val /end SUB_GROUP
 /begin FUNCTION_LIST /end FUNCTION_LIST
 /begin REF_CHARACTERISTIC /end REF_CHARACTERISTIC
 /begin REF_MEASUREMENT /end REF_MEASUREMENT
/end GROUP
/begin GROUP LoaMgr.TqLoaAvl.Logl "MICROSAR RTE" /begin SUB_GROUP /end SUB_GROUP /begin FUNCTION_LIST /end FUNCTION_LIST /begin REF_CHARACTERISTIC /end REF_CHARACTERISTIC /begin REF_MEASUREMENT LoaMgr.TqLoaAvl.Logl /end REF_MEASUREMENT /end GROUP
/begin GROUP LoaMgr.VehSteerMod.Val "MICROSAR RTE" /begin SUB_GROUP /end SUB_GROUP /begin FUNCTION_LIST /end FUNCTION_LIST /begin REF_CHARACTERISTIC /end REF_CHARACTERISTIC /begin REF_MEASUREMENT LoaMgr.VehSteerMod.Val /end REF_MEASUREMENT /end GROUP
/begin GROUP MotAg2Meas "MICROSAR RTE"
 /begin SUB_GROUP MotAg2Meas.CalibrationParameters MotAg2Meas.CalibrationPorts MotAg2Meas.PerInstanceMemories MotAg2Meas.ReceiverPorts MotAg2Meas.SenderPorts /end SUB_GROUP
 /begin FUNCTION_LIST /end FUNCTION_LIST
 /begin REF_CHARACTERISTIC /end REF_CHARACTERISTIC
 /begin REF_MEASUREMENT /end REF_MEASUREMENT
/end GROUP
/begin GROUP MotAg2Meas.CalibrationParameters "MICROSAR RTE" /begin SUB_GROUP MotAg2Meas.MotAg2EolPrmDft /end SUB_GROUP /begin FUNCTION_LIST /end FUNCTION_LIST /begin REF_CHARACTERISTIC /end REF_CHARACTERISTIC /begin REF_MEASUREMENT /end REF_MEASUREMENT /end GROUP
/begin GROUP MotAg2Meas.CalibrationPorts "MICROSAR RTE" /begin SUB_GROUP MotAg2Meas.MotAg2MeasOffs.Val /end SUB_GROUP /begin FUNCTION_LIST /end FUNCTION_LIST /begin REF_CHARACTERISTIC /end REF_CHARACTERISTIC /begin REF_MEASUREMENT /end REF_MEASUREMENT /end GROUP
/begin GROUP MotAg2Meas.MotAg2Cos.Val "MICROSAR RTE" /begin SUB_GROUP /end SUB_GROUP /begin FUNCTION_LIST /end FUNCTION_LIST /begin REF_CHARACTERISTIC /end REF_CHARACTERISTIC /begin REF_MEASUREMENT MotAg2Meas.MotAg2Cos.Val /end REF_MEASUREMENT /end GROUP
/begin GROUP MotAg2Meas.MotAg2CosAdcFaild.Logl "MICROSAR RTE" /begin SUB_GROUP /end SUB_GROUP /begin FUNCTION_LIST /end FUNCTION_LIST /begin REF_CHARACTERISTIC /end REF_CHARACTERISTIC /begin REF_MEASUREMENT MotAg2Meas.MotAg2CosAdcFaild.Logl /end REF_MEASUREMENT /end GROUP
/begin GROUP MotAg2Meas.MotAg2EolPrm "MICROSAR RTE" /begin SUB_GROUP /end SUB_GROUP /begin FUNCTION_LIST /end FUNCTION_LIST /begin REF_CHARACTERISTIC /end REF_CHARACTERISTIC
 /begin REF_MEASUREMENT MotAg2Meas.MotAg2EolPrm.CosAmpRecpr MotAg2Meas.MotAg2EolPrm.CosOffs MotAg2Meas.MotAg2EolPrm.SinAmpRecpr MotAg2Meas.MotAg2EolPrm.SinDelta MotAg2Meas.MotAg2EolPrm.SinOffs /end REF_MEASUREMENT
/end GROUP
/begin GROUP MotAg2Meas.MotAg2EolPrmDft "MICROSAR RTE" /begin SUB_GROUP /end SUB_GROUP /begin FUNCTION_LIST /end FUNCTION_LIST
 /begin REF_CHARACTERISTIC MotAg2Meas.MotAg2EolPrmDft.CosAmpRecpr MotAg2Meas.MotAg2EolPrmDft.CosOffs MotAg2Meas.MotAg2EolPrmDft.SinAmpRecpr MotAg2Meas.MotAg2EolPrmDft.SinDelta MotAg2Meas.MotAg2EolPrmDft.SinOffs /end REF_CHARACTERISTIC
 /begin REF_MEASUREMENT /end REF_MEASUREMENT
/end GROUP
/begin GROUP MotAg2Meas.MotAg2MeasOffs.Val "MICROSAR RTE" /begin SUB_GROUP /end SUB_GROUP /begin FUNCTION_LIST /end FUNCTION_LIST /begin REF_CHARACTERISTIC MotAg2Meas.MotAg2MeasOffs.Val /end REF_CHARACTERISTIC /begin REF_MEASUREMENT /end REF_MEASUREMENT /end GROUP
/begin GROUP MotAg2Meas.MotAg2Mecl.Val "MICROSAR RTE" /begin SUB_GROUP /end SUB_GROUP /begin FUNCTION_LIST /end FUNCTION_LIST /begin REF_CHARACTERISTIC /end REF_CHARACTERISTIC /begin REF_MEASUREMENT MotAg2Meas.MotAg2Mecl.Val /end REF_MEASUREMENT /end GROUP
/begin GROUP MotAg2Meas.MotAg2MeclPrev "MICROSAR RTE" /begin SUB_GROUP /end SUB_GROUP /begin FUNCTION_LIST /end FUNCTION_LIST /begin REF_CHARACTERISTIC /end REF_CHARACTERISTIC /begin REF_MEASUREMENT MotAg2Meas.MotAg2MeclPrev /end REF_MEASUREMENT /end GROUP
/begin GROUP MotAg2Meas.MotAg2MeclQlfr.Val "MICROSAR RTE" /begin SUB_GROUP /end SUB_GROUP /begin FUNCTION_LIST /end FUNCTION_LIST /begin REF_CHARACTERISTIC /end REF_CHARACTERISTIC /begin REF_MEASUREMENT MotAg2Meas.MotAg2MeclQlfr.Val /end REF_MEASUREMENT /end GROUP
/begin GROUP MotAg2Meas.MotAg2MeclRollgCntr.Val "MICROSAR RTE" /begin SUB_GROUP /end SUB_GROUP /begin FUNCTION_LIST /end FUNCTION_LIST /begin REF_CHARACTERISTIC /end REF_CHARACTERISTIC /begin REF_MEASUREMENT MotAg2Meas.MotAg2MeclRollgCntr.Val /end REF_MEASUREMENT /end GROUP
/begin GROUP MotAg2Meas.MotAg2MeclRollgCntrPrev "MICROSAR RTE" /begin SUB_GROUP /end SUB_GROUP /begin FUNCTION_LIST /end FUNCTION_LIST /begin REF_CHARACTERISTIC /end REF_CHARACTERISTIC /begin REF_MEASUREMENT MotAg2Meas.MotAg2MeclRollgCntrPrev /end REF_MEASUREMENT /end GROUP
/begin GROUP MotAg2Meas.MotAg2Sin.Val "MICROSAR RTE" /begin SUB_GROUP /end SUB_GROUP /begin FUNCTION_LIST /end FUNCTION_LIST /begin REF_CHARACTERISTIC /end REF_CHARACTERISTIC /begin REF_MEASUREMENT MotAg2Meas.MotAg2Sin.Val /end REF_MEASUREMENT /end GROUP
/begin GROUP MotAg2Meas.MotAg2SinAdcFaild.Logl "MICROSAR RTE" /begin SUB_GROUP /end SUB_GROUP /begin FUNCTION_LIST /end FUNCTION_LIST /begin REF_CHARACTERISTIC /end REF_CHARACTERISTIC /begin REF_MEASUREMENT MotAg2Meas.MotAg2SinAdcFaild.Logl /end REF_MEASUREMENT /end GROUP
/begin GROUP MotAg2Meas.MotAg2VltgSqd.Val "MICROSAR RTE" /begin SUB_GROUP /end SUB_GROUP /begin FUNCTION_LIST /end FUNCTION_LIST /begin REF_CHARACTERISTIC /end REF_CHARACTERISTIC /begin REF_MEASUREMENT MotAg2Meas.MotAg2VltgSqd.Val /end REF_MEASUREMENT /end GROUP
/begin GROUP MotAg2Meas.MotAgMecl2Polarity.Val "MICROSAR RTE" /begin SUB_GROUP /end SUB_GROUP /begin FUNCTION_LIST /end FUNCTION_LIST /begin REF_CHARACTERISTIC /end REF_CHARACTERISTIC /begin REF_MEASUREMENT MotAg2Meas.MotAgMecl2Polarity.Val /end REF_MEASUREMENT /end GROUP
/begin GROUP MotAg2Meas.PerInstanceMemories "MICROSAR RTE"
 /begin SUB_GROUP MotAg2Meas.MotAg2EolPrm MotAg2Meas.MotAg2MeclPrev MotAg2Meas.MotAg2MeclRollgCntrPrev /end SUB_GROUP
 /begin FUNCTION_LIST /end FUNCTION_LIST
 /begin REF_CHARACTERISTIC /end REF_CHARACTERISTIC
 /begin REF_MEASUREMENT /end REF_MEASUREMENT
/end GROUP
/begin GROUP MotAg2Meas.ReceiverPorts "MICROSAR RTE"
 /begin SUB_GROUP MotAg2Meas.MotAg2Cos.Val MotAg2Meas.MotAg2CosAdcFaild.Logl MotAg2Meas.MotAg2Sin.Val MotAg2Meas.MotAg2SinAdcFaild.Logl MotAg2Meas.MotAgMecl2Polarity.Val /end SUB_GROUP
 /begin FUNCTION_LIST /end FUNCTION_LIST
 /begin REF_CHARACTERISTIC /end REF_CHARACTERISTIC
 /begin REF_MEASUREMENT /end REF_MEASUREMENT
/end GROUP
/begin GROUP MotAg2Meas.SenderPorts "MICROSAR RTE"
 /begin SUB_GROUP MotAg2Meas.MotAg2Mecl.Val MotAg2Meas.MotAg2MeclQlfr.Val MotAg2Meas.MotAg2MeclRollgCntr.Val MotAg2Meas.MotAg2VltgSqd.Val /end SUB_GROUP
 /begin FUNCTION_LIST /end FUNCTION_LIST
 /begin REF_CHARACTERISTIC /end REF_CHARACTERISTIC
 /begin REF_MEASUREMENT /end REF_MEASUREMENT
/end GROUP
/begin GROUP MotAgCorrln "MICROSAR RTE"
 /begin SUB_GROUP MotAgCorrln.CalibrationPorts MotAgCorrln.PerInstanceMemories MotAgCorrln.ReceiverPorts MotAgCorrln.SenderPorts /end SUB_GROUP
 /begin FUNCTION_LIST /end FUNCTION_LIST
 /begin REF_CHARACTERISTIC /end REF_CHARACTERISTIC
 /begin REF_MEASUREMENT /end REF_MEASUREMENT
/end GROUP
/begin GROUP MotAgCorrln.CalibrationPorts "MICROSAR RTE" /begin SUB_GROUP MotAgCorrln.SysGlbPrmMotPoleCnt.Val /end SUB_GROUP /begin FUNCTION_LIST /end FUNCTION_LIST /begin REF_CHARACTERISTIC /end REF_CHARACTERISTIC /begin REF_MEASUREMENT /end REF_MEASUREMENT /end GROUP
/begin GROUP MotAgCorrln.MotAgABErrTerm.Val "MICROSAR RTE" /begin SUB_GROUP /end SUB_GROUP /begin FUNCTION_LIST /end FUNCTION_LIST /begin REF_CHARACTERISTIC /end REF_CHARACTERISTIC /begin REF_MEASUREMENT MotAgCorrln.MotAgABErrTerm.Val /end REF_MEASUREMENT /end GROUP
/begin GROUP MotAgCorrln.MotAgACErrTerm.Val "MICROSAR RTE" /begin SUB_GROUP /end SUB_GROUP /begin FUNCTION_LIST /end FUNCTION_LIST /begin REF_CHARACTERISTIC /end REF_CHARACTERISTIC /begin REF_MEASUREMENT MotAgCorrln.MotAgACErrTerm.Val /end REF_MEASUREMENT /end GROUP
/begin GROUP MotAgCorrln.MotAgAMecl.Val "MICROSAR RTE" /begin SUB_GROUP /end SUB_GROUP /begin FUNCTION_LIST /end FUNCTION_LIST /begin REF_CHARACTERISTIC /end REF_CHARACTERISTIC /begin REF_MEASUREMENT MotAgCorrln.MotAgAMecl.Val /end REF_MEASUREMENT /end GROUP
/begin GROUP MotAgCorrln.MotAgAMeclQlfr.Val "MICROSAR RTE" /begin SUB_GROUP /end SUB_GROUP /begin FUNCTION_LIST /end FUNCTION_LIST /begin REF_CHARACTERISTIC /end REF_CHARACTERISTIC /begin REF_MEASUREMENT MotAgCorrln.MotAgAMeclQlfr.Val /end REF_MEASUREMENT /end GROUP
/begin GROUP MotAgCorrln.MotAgAMeclRollgCntr.Val "MICROSAR RTE" /begin SUB_GROUP /end SUB_GROUP /begin FUNCTION_LIST /end FUNCTION_LIST /begin REF_CHARACTERISTIC /end REF_CHARACTERISTIC /begin REF_MEASUREMENT MotAgCorrln.MotAgAMeclRollgCntr.Val /end REF_MEASUREMENT /end GROUP
/begin GROUP MotAgCorrln.MotAgBCErrTerm.Val "MICROSAR RTE" /begin SUB_GROUP /end SUB_GROUP /begin FUNCTION_LIST /end FUNCTION_LIST /begin REF_CHARACTERISTIC /end REF_CHARACTERISTIC /begin REF_MEASUREMENT MotAgCorrln.MotAgBCErrTerm.Val /end REF_MEASUREMENT /end GROUP
/begin GROUP MotAgCorrln.MotAgBMecl.Val "MICROSAR RTE" /begin SUB_GROUP /end SUB_GROUP /begin FUNCTION_LIST /end FUNCTION_LIST /begin REF_CHARACTERISTIC /end REF_CHARACTERISTIC /begin REF_MEASUREMENT MotAgCorrln.MotAgBMecl.Val /end REF_MEASUREMENT /end GROUP
/begin GROUP MotAgCorrln.MotAgBMeclQlfr.Val "MICROSAR RTE" /begin SUB_GROUP /end SUB_GROUP /begin FUNCTION_LIST /end FUNCTION_LIST /begin REF_CHARACTERISTIC /end REF_CHARACTERISTIC /begin REF_MEASUREMENT MotAgCorrln.MotAgBMeclQlfr.Val /end REF_MEASUREMENT /end GROUP
/begin GROUP MotAgCorrln.MotAgBMeclRollgCntr.Val "MICROSAR RTE" /begin SUB_GROUP /end SUB_GROUP /begin FUNCTION_LIST /end FUNCTION_LIST /begin REF_CHARACTERISTIC /end REF_CHARACTERISTIC /begin REF_MEASUREMENT MotAgCorrln.MotAgBMeclRollgCntr.Val /end REF_MEASUREMENT /end GROUP
/begin GROUP MotAgCorrln.MotAgCMecl.Val "MICROSAR RTE" /begin SUB_GROUP /end SUB_GROUP /begin FUNCTION_LIST /end FUNCTION_LIST /begin REF_CHARACTERISTIC /end REF_CHARACTERISTIC /begin REF_MEASUREMENT MotAgCorrln.MotAgCMecl.Val /end REF_MEASUREMENT /end GROUP
/begin GROUP MotAgCorrln.MotAgCMeclQlfr.Val "MICROSAR RTE" /begin SUB_GROUP /end SUB_GROUP /begin FUNCTION_LIST /end FUNCTION_LIST /begin REF_CHARACTERISTIC /end REF_CHARACTERISTIC /begin REF_MEASUREMENT MotAgCorrln.MotAgCMeclQlfr.Val /end REF_MEASUREMENT /end GROUP
/begin GROUP MotAgCorrln.MotAgCMeclRollgCntr.Val "MICROSAR RTE" /begin SUB_GROUP /end SUB_GROUP /begin FUNCTION_LIST /end FUNCTION_LIST /begin REF_CHARACTERISTIC /end REF_CHARACTERISTIC /begin REF_MEASUREMENT MotAgCorrln.MotAgCMeclRollgCntr.Val /end REF_MEASUREMENT /end GROUP
/begin GROUP MotAgCorrln.MotAgCorrlnErrThd "MICROSAR RTE" /begin SUB_GROUP /end SUB_GROUP /begin FUNCTION_LIST /end FUNCTION_LIST /begin REF_CHARACTERISTIC /end REF_CHARACTERISTIC /begin REF_MEASUREMENT MotAgCorrln.MotAgCorrlnErrThd /end REF_MEASUREMENT /end GROUP
/begin GROUP MotAgCorrln.MotAgCorrlnMotAgARollgCntPrev "MICROSAR RTE" /begin SUB_GROUP /end SUB_GROUP /begin FUNCTION_LIST /end FUNCTION_LIST /begin REF_CHARACTERISTIC /end REF_CHARACTERISTIC /begin REF_MEASUREMENT MotAgCorrln.MotAgCorrlnMotAgARollgCntPrev /end REF_MEASUREMENT /end GROUP
/begin GROUP MotAgCorrln.MotAgCorrlnMotAgAStallCntPrev "MICROSAR RTE" /begin SUB_GROUP /end SUB_GROUP /begin FUNCTION_LIST /end FUNCTION_LIST /begin REF_CHARACTERISTIC /end REF_CHARACTERISTIC /begin REF_MEASUREMENT MotAgCorrln.MotAgCorrlnMotAgAStallCntPrev /end REF_MEASUREMENT /end GROUP
/begin GROUP MotAgCorrln.MotAgCorrlnMotAgBRollgCntPrev "MICROSAR RTE" /begin SUB_GROUP /end SUB_GROUP /begin FUNCTION_LIST /end FUNCTION_LIST /begin REF_CHARACTERISTIC /end REF_CHARACTERISTIC /begin REF_MEASUREMENT MotAgCorrln.MotAgCorrlnMotAgBRollgCntPrev /end REF_MEASUREMENT /end GROUP
/begin GROUP MotAgCorrln.MotAgCorrlnMotAgBStallCntPrev "MICROSAR RTE" /begin SUB_GROUP /end SUB_GROUP /begin FUNCTION_LIST /end FUNCTION_LIST /begin REF_CHARACTERISTIC /end REF_CHARACTERISTIC /begin REF_MEASUREMENT MotAgCorrln.MotAgCorrlnMotAgBStallCntPrev /end REF_MEASUREMENT /end GROUP
/begin GROUP MotAgCorrln.MotAgCorrlnMotAgCRollgCntPrev "MICROSAR RTE" /begin SUB_GROUP /end SUB_GROUP /begin FUNCTION_LIST /end FUNCTION_LIST /begin REF_CHARACTERISTIC /end REF_CHARACTERISTIC /begin REF_MEASUREMENT MotAgCorrln.MotAgCorrlnMotAgCRollgCntPrev /end REF_MEASUREMENT /end GROUP
/begin GROUP MotAgCorrln.MotAgCorrlnMotAgCStallCntPrev "MICROSAR RTE" /begin SUB_GROUP /end SUB_GROUP /begin FUNCTION_LIST /end FUNCTION_LIST /begin REF_CHARACTERISTIC /end REF_CHARACTERISTIC /begin REF_MEASUREMENT MotAgCorrln.MotAgCorrlnMotAgCStallCntPrev /end REF_MEASUREMENT /end GROUP
/begin GROUP MotAgCorrln.MotAgMeclCorrlnSt.Val "MICROSAR RTE" /begin SUB_GROUP /end SUB_GROUP /begin FUNCTION_LIST /end FUNCTION_LIST /begin REF_CHARACTERISTIC /end REF_CHARACTERISTIC /begin REF_MEASUREMENT MotAgCorrln.MotAgMeclCorrlnSt.Val /end REF_MEASUREMENT /end GROUP
/begin GROUP MotAgCorrln.MotAgMeclIdptSig.Val "MICROSAR RTE" /begin SUB_GROUP /end SUB_GROUP /begin FUNCTION_LIST /end FUNCTION_LIST /begin REF_CHARACTERISTIC /end REF_CHARACTERISTIC /begin REF_MEASUREMENT MotAgCorrln.MotAgMeclIdptSig.Val /end REF_MEASUREMENT /end GROUP
/begin GROUP MotAgCorrln.PerInstanceMemories "MICROSAR RTE"
 /begin SUB_GROUP MotAgCorrln.MotAgCorrlnErrThd MotAgCorrln.MotAgCorrlnMotAgARollgCntPrev MotAgCorrln.MotAgCorrlnMotAgAStallCntPrev MotAgCorrln.MotAgCorrlnMotAgBRollgCntPrev MotAgCorrln.MotAgCorrlnMotAgBStallCntPrev MotAgCorrln.MotAgCorrlnMotAgCRollgCntPrev MotAgCorrln.MotAgCorrlnMotAgCStallCntPrev MotAgCorrln.dMotAgCorrlnMotAgAOk MotAgCorrln.dMotAgCorrlnMotAgBOk MotAgCorrln.dMotAgCorrlnMotAgCOk /end SUB_GROUP
 /begin FUNCTION_LIST /end FUNCTION_LIST
 /begin REF_CHARACTERISTIC /end REF_CHARACTERISTIC
 /begin REF_MEASUREMENT /end REF_MEASUREMENT
/end GROUP
/begin GROUP MotAgCorrln.ReceiverPorts "MICROSAR RTE"
 /begin SUB_GROUP MotAgCorrln.MotAgAMecl.Val MotAgCorrln.MotAgAMeclQlfr.Val MotAgCorrln.MotAgAMeclRollgCntr.Val MotAgCorrln.MotAgBMecl.Val MotAgCorrln.MotAgBMeclQlfr.Val MotAgCorrln.MotAgBMeclRollgCntr.Val MotAgCorrln.MotAgCMecl.Val MotAgCorrln.MotAgCMeclQlfr.Val MotAgCorrln.MotAgCMeclRollgCntr.Val /end SUB_GROUP
 /begin FUNCTION_LIST /end FUNCTION_LIST
 /begin REF_CHARACTERISTIC /end REF_CHARACTERISTIC
 /begin REF_MEASUREMENT /end REF_MEASUREMENT
/end GROUP
/begin GROUP MotAgCorrln.SenderPorts "MICROSAR RTE"
 /begin SUB_GROUP MotAgCorrln.MotAgABErrTerm.Val MotAgCorrln.MotAgACErrTerm.Val MotAgCorrln.MotAgBCErrTerm.Val MotAgCorrln.MotAgMeclCorrlnSt.Val MotAgCorrln.MotAgMeclIdptSig.Val /end SUB_GROUP
 /begin FUNCTION_LIST /end FUNCTION_LIST
 /begin REF_CHARACTERISTIC /end REF_CHARACTERISTIC
 /begin REF_MEASUREMENT /end REF_MEASUREMENT
/end GROUP
/begin GROUP MotAgCorrln.SysGlbPrmMotPoleCnt.Val "MICROSAR RTE" /begin SUB_GROUP /end SUB_GROUP /begin FUNCTION_LIST /end FUNCTION_LIST /begin REF_CHARACTERISTIC MotAgCorrln.SysGlbPrmMotPoleCnt.Val /end REF_CHARACTERISTIC /begin REF_MEASUREMENT /end REF_MEASUREMENT /end GROUP
/begin GROUP MotAgCorrln.dMotAgCorrlnMotAgAOk "MICROSAR RTE" /begin SUB_GROUP /end SUB_GROUP /begin FUNCTION_LIST /end FUNCTION_LIST /begin REF_CHARACTERISTIC /end REF_CHARACTERISTIC /begin REF_MEASUREMENT MotAgCorrln.dMotAgCorrlnMotAgAOk /end REF_MEASUREMENT /end GROUP
/begin GROUP MotAgCorrln.dMotAgCorrlnMotAgBOk "MICROSAR RTE" /begin SUB_GROUP /end SUB_GROUP /begin FUNCTION_LIST /end FUNCTION_LIST /begin REF_CHARACTERISTIC /end REF_CHARACTERISTIC /begin REF_MEASUREMENT MotAgCorrln.dMotAgCorrlnMotAgBOk /end REF_MEASUREMENT /end GROUP
/begin GROUP MotAgCorrln.dMotAgCorrlnMotAgCOk "MICROSAR RTE" /begin SUB_GROUP /end SUB_GROUP /begin FUNCTION_LIST /end FUNCTION_LIST /begin REF_CHARACTERISTIC /end REF_CHARACTERISTIC /begin REF_MEASUREMENT MotAgCorrln.dMotAgCorrlnMotAgCOk /end REF_MEASUREMENT /end GROUP
/begin GROUP MotCtrlPrmEstimn "MICROSAR RTE"
 /begin SUB_GROUP MotCtrlPrmEstimn.CalibrationPorts MotCtrlPrmEstimn.PerInstanceMemories MotCtrlPrmEstimn.ReceiverPorts MotCtrlPrmEstimn.SenderPorts /end SUB_GROUP
 /begin FUNCTION_LIST /end FUNCTION_LIST
 /begin REF_CHARACTERISTIC /end REF_CHARACTERISTIC
 /begin REF_MEASUREMENT /end REF_MEASUREMENT
/end GROUP
/begin GROUP MotCtrlPrmEstimn.CalibrationPorts "MICROSAR RTE"
 /begin SUB_GROUP MotCtrlPrmEstimn.MotCtrlPrmEstimnFetRNom.Val MotCtrlPrmEstimn.MotCtrlPrmEstimnFetThermCoeff.Val MotCtrlPrmEstimn.MotCtrlPrmEstimnMagThermCoeff.Val MotCtrlPrmEstimn.MotCtrlPrmEstimnMotBackEmfConHiLim.Val MotCtrlPrmEstimn.MotCtrlPrmEstimnMotBackEmfConLoLim.Val MotCtrlPrmEstimn.MotCtrlPrmEstimnMotBackEmfConNom.Val MotCtrlPrmEstimn.MotCtrlPrmEstimnMotBackEmfConSatnScaIvtrLoaMtgtn.Val MotCtrlPrmEstimn.MotCtrlPrmEstimnMotBackEmfConSatnX.Ary1D MotCtrlPrmEstimn.MotCtrlPrmEstimnMotBackEmfConSatnY.Ary1D MotCtrlPrmEstimn.MotCtrlPrmEstimnMotCurrDaxInduSatnBilnrSeln.Ary1D MotCtrlPrmEstimn.MotCtrlPrmEstimnMotCurrQaxInduSatnX.Ary1D MotCtrlPrmEstimn.MotCtrlPrmEstimnMotInduDaxHiLim.Val MotCtrlPrmEstimn.MotCtrlPrmEstimnMotInduDaxIvtrLoaMtgtn.Val MotCtrlPrmEstimn.MotCtrlPrmEstimnMotInduDaxLoLim.Val MotCtrlPrmEstimn.MotCtrlPrmEstimnMotInduDaxNom.Val MotCtrlPrmEstimn.MotCtrlPrmEstimnMotInduDaxSatnScaY.Ary2D MotCtrlPrmEstimn.MotCtrlPrmEstimnMotInduQaxHiLim.Val MotCtrlPrmEstimn.MotCtrlPrmEstimnMotInduQaxIvtrLoaMtgtn.Val MotCtrlPrmEstimn.MotCtrlPrmEstimnMotInduQaxLoLim.Val MotCtrlPrmEstimn.MotCtrlPrmEstimnMotInduQaxNom.Val MotCtrlPrmEstimn.MotCtrlPrmEstimnMotInduQaxSatnScaY.Ary2D MotCtrlPrmEstimn.MotCtrlPrmEstimnMotRHiLim.Val MotCtrlPrmEstimn.MotCtrlPrmEstimnMotRLoLim.Val MotCtrlPrmEstimn.MotCtrlPrmEstimnMotRNom.Val MotCtrlPrmEstimn.MotCtrlPrmEstimnMotWidgThermCoeff.Val MotCtrlPrmEstimn.MotCtrlPrmEstimnTNom.Val /end SUB_GROUP
 /begin FUNCTION_LIST /end FUNCTION_LIST
 /begin REF_CHARACTERISTIC /end REF_CHARACTERISTIC
 /begin REF_MEASUREMENT /end REF_MEASUREMENT
/end GROUP
/begin GROUP MotCtrlPrmEstimn.DualEcuFltMtgtnEna.Logl "MICROSAR RTE" /begin SUB_GROUP /end SUB_GROUP /begin FUNCTION_LIST /end FUNCTION_LIST /begin REF_CHARACTERISTIC /end REF_CHARACTERISTIC /begin REF_MEASUREMENT MotCtrlPrmEstimn.DualEcuFltMtgtnEna.Logl /end REF_MEASUREMENT /end GROUP
/begin GROUP MotCtrlPrmEstimn.MotAndThermProtnLoaMod.Val "MICROSAR RTE" /begin SUB_GROUP /end SUB_GROUP /begin FUNCTION_LIST /end FUNCTION_LIST /begin REF_CHARACTERISTIC /end REF_CHARACTERISTIC /begin REF_MEASUREMENT MotCtrlPrmEstimn.MotAndThermProtnLoaMod.Val /end REF_MEASUREMENT /end GROUP
/begin GROUP MotCtrlPrmEstimn.MotBackEmfConEstimd.Val "MICROSAR RTE" /begin SUB_GROUP /end SUB_GROUP /begin FUNCTION_LIST /end FUNCTION_LIST /begin REF_CHARACTERISTIC /end REF_CHARACTERISTIC /begin REF_MEASUREMENT MotCtrlPrmEstimn.MotBackEmfConEstimd.Val /end REF_MEASUREMENT /end GROUP
/begin GROUP MotCtrlPrmEstimn.MotCtrlPrmEstimnFetRNom.Val "MICROSAR RTE" /begin SUB_GROUP /end SUB_GROUP /begin FUNCTION_LIST /end FUNCTION_LIST /begin REF_CHARACTERISTIC MotCtrlPrmEstimn.MotCtrlPrmEstimnFetRNom.Val /end REF_CHARACTERISTIC /begin REF_MEASUREMENT /end REF_MEASUREMENT /end GROUP
/begin GROUP MotCtrlPrmEstimn.MotCtrlPrmEstimnFetThermCoeff.Val "MICROSAR RTE" /begin SUB_GROUP /end SUB_GROUP /begin FUNCTION_LIST /end FUNCTION_LIST /begin REF_CHARACTERISTIC MotCtrlPrmEstimn.MotCtrlPrmEstimnFetThermCoeff.Val /end REF_CHARACTERISTIC /begin REF_MEASUREMENT /end REF_MEASUREMENT /end GROUP
/begin GROUP MotCtrlPrmEstimn.MotCtrlPrmEstimnMagThermCoeff.Val "MICROSAR RTE" /begin SUB_GROUP /end SUB_GROUP /begin FUNCTION_LIST /end FUNCTION_LIST /begin REF_CHARACTERISTIC MotCtrlPrmEstimn.MotCtrlPrmEstimnMagThermCoeff.Val /end REF_CHARACTERISTIC /begin REF_MEASUREMENT /end REF_MEASUREMENT /end GROUP
/begin GROUP MotCtrlPrmEstimn.MotCtrlPrmEstimnMotBackEmfConHiLim.Val "MICROSAR RTE" /begin SUB_GROUP /end SUB_GROUP /begin FUNCTION_LIST /end FUNCTION_LIST /begin REF_CHARACTERISTIC MotCtrlPrmEstimn.MotCtrlPrmEstimnMotBackEmfConHiLim.Val /end REF_CHARACTERISTIC /begin REF_MEASUREMENT /end REF_MEASUREMENT /end GROUP
/begin GROUP MotCtrlPrmEstimn.MotCtrlPrmEstimnMotBackEmfConLoLim.Val "MICROSAR RTE" /begin SUB_GROUP /end SUB_GROUP /begin FUNCTION_LIST /end FUNCTION_LIST /begin REF_CHARACTERISTIC MotCtrlPrmEstimn.MotCtrlPrmEstimnMotBackEmfConLoLim.Val /end REF_CHARACTERISTIC /begin REF_MEASUREMENT /end REF_MEASUREMENT /end GROUP
/begin GROUP MotCtrlPrmEstimn.MotCtrlPrmEstimnMotBackEmfConNom.Val "MICROSAR RTE" /begin SUB_GROUP /end SUB_GROUP /begin FUNCTION_LIST /end FUNCTION_LIST /begin REF_CHARACTERISTIC MotCtrlPrmEstimn.MotCtrlPrmEstimnMotBackEmfConNom.Val /end REF_CHARACTERISTIC /begin REF_MEASUREMENT /end REF_MEASUREMENT /end GROUP
/begin GROUP MotCtrlPrmEstimn.MotCtrlPrmEstimnMotBackEmfConSatnScaIvtrLoaMtgtn.Val "MICROSAR RTE" /begin SUB_GROUP /end SUB_GROUP /begin FUNCTION_LIST /end FUNCTION_LIST
 /begin REF_CHARACTERISTIC MotCtrlPrmEstimn.MotCtrlPrmEstimnMotBackEmfConSatnScaIvtrLoaMtgtn.Val /end REF_CHARACTERISTIC
 /begin REF_MEASUREMENT /end REF_MEASUREMENT
/end GROUP
/begin GROUP MotCtrlPrmEstimn.MotCtrlPrmEstimnMotBackEmfConSatnX.Ary1D "MICROSAR RTE" /begin SUB_GROUP /end SUB_GROUP /begin FUNCTION_LIST /end FUNCTION_LIST /begin REF_CHARACTERISTIC MotCtrlPrmEstimn.MotCtrlPrmEstimnMotBackEmfConSatnX.Ary1D /end REF_CHARACTERISTIC /begin REF_MEASUREMENT /end REF_MEASUREMENT /end GROUP
/begin GROUP MotCtrlPrmEstimn.MotCtrlPrmEstimnMotBackEmfConSatnY.Ary1D "MICROSAR RTE" /begin SUB_GROUP /end SUB_GROUP /begin FUNCTION_LIST /end FUNCTION_LIST /begin REF_CHARACTERISTIC MotCtrlPrmEstimn.MotCtrlPrmEstimnMotBackEmfConSatnY.Ary1D /end REF_CHARACTERISTIC /begin REF_MEASUREMENT /end REF_MEASUREMENT /end GROUP
/begin GROUP MotCtrlPrmEstimn.MotCtrlPrmEstimnMotCurrDaxInduSatnBilnrSeln.Ary1D "MICROSAR RTE" /begin SUB_GROUP /end SUB_GROUP /begin FUNCTION_LIST /end FUNCTION_LIST
 /begin REF_CHARACTERISTIC MotCtrlPrmEstimn.MotCtrlPrmEstimnMotCurrDaxInduSatnBilnrSeln.Ary1D /end REF_CHARACTERISTIC
 /begin REF_MEASUREMENT /end REF_MEASUREMENT
/end GROUP
/begin GROUP MotCtrlPrmEstimn.MotCtrlPrmEstimnMotCurrQaxInduSatnX.Ary1D "MICROSAR RTE" /begin SUB_GROUP /end SUB_GROUP /begin FUNCTION_LIST /end FUNCTION_LIST /begin REF_CHARACTERISTIC MotCtrlPrmEstimn.MotCtrlPrmEstimnMotCurrQaxInduSatnX.Ary1D /end REF_CHARACTERISTIC /begin REF_MEASUREMENT /end REF_MEASUREMENT /end GROUP
/begin GROUP MotCtrlPrmEstimn.MotCtrlPrmEstimnMotInduDaxHiLim.Val "MICROSAR RTE" /begin SUB_GROUP /end SUB_GROUP /begin FUNCTION_LIST /end FUNCTION_LIST /begin REF_CHARACTERISTIC MotCtrlPrmEstimn.MotCtrlPrmEstimnMotInduDaxHiLim.Val /end REF_CHARACTERISTIC /begin REF_MEASUREMENT /end REF_MEASUREMENT /end GROUP
/begin GROUP MotCtrlPrmEstimn.MotCtrlPrmEstimnMotInduDaxIvtrLoaMtgtn.Val "MICROSAR RTE" /begin SUB_GROUP /end SUB_GROUP /begin FUNCTION_LIST /end FUNCTION_LIST
 /begin REF_CHARACTERISTIC MotCtrlPrmEstimn.MotCtrlPrmEstimnMotInduDaxIvtrLoaMtgtn.Val /end REF_CHARACTERISTIC
 /begin REF_MEASUREMENT /end REF_MEASUREMENT
/end GROUP
/begin GROUP MotCtrlPrmEstimn.MotCtrlPrmEstimnMotInduDaxLoLim.Val "MICROSAR RTE" /begin SUB_GROUP /end SUB_GROUP /begin FUNCTION_LIST /end FUNCTION_LIST /begin REF_CHARACTERISTIC MotCtrlPrmEstimn.MotCtrlPrmEstimnMotInduDaxLoLim.Val /end REF_CHARACTERISTIC /begin REF_MEASUREMENT /end REF_MEASUREMENT /end GROUP
/begin GROUP MotCtrlPrmEstimn.MotCtrlPrmEstimnMotInduDaxNom.Val "MICROSAR RTE" /begin SUB_GROUP /end SUB_GROUP /begin FUNCTION_LIST /end FUNCTION_LIST /begin REF_CHARACTERISTIC MotCtrlPrmEstimn.MotCtrlPrmEstimnMotInduDaxNom.Val /end REF_CHARACTERISTIC /begin REF_MEASUREMENT /end REF_MEASUREMENT /end GROUP
/begin GROUP MotCtrlPrmEstimn.MotCtrlPrmEstimnMotInduDaxSatnScaY.Ary2D "MICROSAR RTE" /begin SUB_GROUP /end SUB_GROUP /begin FUNCTION_LIST /end FUNCTION_LIST /begin REF_CHARACTERISTIC MotCtrlPrmEstimn.MotCtrlPrmEstimnMotInduDaxSatnScaY.Ary2D /end REF_CHARACTERISTIC /begin REF_MEASUREMENT /end REF_MEASUREMENT /end GROUP
/begin GROUP MotCtrlPrmEstimn.MotCtrlPrmEstimnMotInduQaxHiLim.Val "MICROSAR RTE" /begin SUB_GROUP /end SUB_GROUP /begin FUNCTION_LIST /end FUNCTION_LIST /begin REF_CHARACTERISTIC MotCtrlPrmEstimn.MotCtrlPrmEstimnMotInduQaxHiLim.Val /end REF_CHARACTERISTIC /begin REF_MEASUREMENT /end REF_MEASUREMENT /end GROUP
/begin GROUP MotCtrlPrmEstimn.MotCtrlPrmEstimnMotInduQaxIvtrLoaMtgtn.Val "MICROSAR RTE" /begin SUB_GROUP /end SUB_GROUP /begin FUNCTION_LIST /end FUNCTION_LIST
 /begin REF_CHARACTERISTIC MotCtrlPrmEstimn.MotCtrlPrmEstimnMotInduQaxIvtrLoaMtgtn.Val /end REF_CHARACTERISTIC
 /begin REF_MEASUREMENT /end REF_MEASUREMENT
/end GROUP
/begin GROUP MotCtrlPrmEstimn.MotCtrlPrmEstimnMotInduQaxLoLim.Val "MICROSAR RTE" /begin SUB_GROUP /end SUB_GROUP /begin FUNCTION_LIST /end FUNCTION_LIST /begin REF_CHARACTERISTIC MotCtrlPrmEstimn.MotCtrlPrmEstimnMotInduQaxLoLim.Val /end REF_CHARACTERISTIC /begin REF_MEASUREMENT /end REF_MEASUREMENT /end GROUP
/begin GROUP MotCtrlPrmEstimn.MotCtrlPrmEstimnMotInduQaxNom.Val "MICROSAR RTE" /begin SUB_GROUP /end SUB_GROUP /begin FUNCTION_LIST /end FUNCTION_LIST /begin REF_CHARACTERISTIC MotCtrlPrmEstimn.MotCtrlPrmEstimnMotInduQaxNom.Val /end REF_CHARACTERISTIC /begin REF_MEASUREMENT /end REF_MEASUREMENT /end GROUP
/begin GROUP MotCtrlPrmEstimn.MotCtrlPrmEstimnMotInduQaxSatnScaY.Ary2D "MICROSAR RTE" /begin SUB_GROUP /end SUB_GROUP /begin FUNCTION_LIST /end FUNCTION_LIST /begin REF_CHARACTERISTIC MotCtrlPrmEstimn.MotCtrlPrmEstimnMotInduQaxSatnScaY.Ary2D /end REF_CHARACTERISTIC /begin REF_MEASUREMENT /end REF_MEASUREMENT /end GROUP
/begin GROUP MotCtrlPrmEstimn.MotCtrlPrmEstimnMotRHiLim.Val "MICROSAR RTE" /begin SUB_GROUP /end SUB_GROUP /begin FUNCTION_LIST /end FUNCTION_LIST /begin REF_CHARACTERISTIC MotCtrlPrmEstimn.MotCtrlPrmEstimnMotRHiLim.Val /end REF_CHARACTERISTIC /begin REF_MEASUREMENT /end REF_MEASUREMENT /end GROUP
/begin GROUP MotCtrlPrmEstimn.MotCtrlPrmEstimnMotRLoLim.Val "MICROSAR RTE" /begin SUB_GROUP /end SUB_GROUP /begin FUNCTION_LIST /end FUNCTION_LIST /begin REF_CHARACTERISTIC MotCtrlPrmEstimn.MotCtrlPrmEstimnMotRLoLim.Val /end REF_CHARACTERISTIC /begin REF_MEASUREMENT /end REF_MEASUREMENT /end GROUP
/begin GROUP MotCtrlPrmEstimn.MotCtrlPrmEstimnMotRNom.Val "MICROSAR RTE" /begin SUB_GROUP /end SUB_GROUP /begin FUNCTION_LIST /end FUNCTION_LIST /begin REF_CHARACTERISTIC MotCtrlPrmEstimn.MotCtrlPrmEstimnMotRNom.Val /end REF_CHARACTERISTIC /begin REF_MEASUREMENT /end REF_MEASUREMENT /end GROUP
/begin GROUP MotCtrlPrmEstimn.MotCtrlPrmEstimnMotWidgThermCoeff.Val "MICROSAR RTE" /begin SUB_GROUP /end SUB_GROUP /begin FUNCTION_LIST /end FUNCTION_LIST /begin REF_CHARACTERISTIC MotCtrlPrmEstimn.MotCtrlPrmEstimnMotWidgThermCoeff.Val /end REF_CHARACTERISTIC /begin REF_MEASUREMENT /end REF_MEASUREMENT /end GROUP
/begin GROUP MotCtrlPrmEstimn.MotCtrlPrmEstimnTNom.Val "MICROSAR RTE" /begin SUB_GROUP /end SUB_GROUP /begin FUNCTION_LIST /end FUNCTION_LIST /begin REF_CHARACTERISTIC MotCtrlPrmEstimn.MotCtrlPrmEstimnTNom.Val /end REF_CHARACTERISTIC /begin REF_MEASUREMENT /end REF_MEASUREMENT /end GROUP
/begin GROUP MotCtrlPrmEstimn.MotCurrDaxCmd.Val "MICROSAR RTE" /begin SUB_GROUP /end SUB_GROUP /begin FUNCTION_LIST /end FUNCTION_LIST /begin REF_CHARACTERISTIC /end REF_CHARACTERISTIC /begin REF_MEASUREMENT MotCtrlPrmEstimn.MotCurrDaxCmd.Val /end REF_MEASUREMENT /end GROUP
/begin GROUP MotCtrlPrmEstimn.MotCurrQaxCmd.Val "MICROSAR RTE" /begin SUB_GROUP /end SUB_GROUP /begin FUNCTION_LIST /end FUNCTION_LIST /begin REF_CHARACTERISTIC /end REF_CHARACTERISTIC /begin REF_MEASUREMENT MotCtrlPrmEstimn.MotCurrQaxCmd.Val /end REF_MEASUREMENT /end GROUP
/begin GROUP MotCtrlPrmEstimn.MotFetT.Val "MICROSAR RTE" /begin SUB_GROUP /end SUB_GROUP /begin FUNCTION_LIST /end FUNCTION_LIST /begin REF_CHARACTERISTIC /end REF_CHARACTERISTIC /begin REF_MEASUREMENT MotCtrlPrmEstimn.MotFetT.Val /end REF_MEASUREMENT /end GROUP
/begin GROUP MotCtrlPrmEstimn.MotInduDaxEstimd.Val "MICROSAR RTE" /begin SUB_GROUP /end SUB_GROUP /begin FUNCTION_LIST /end FUNCTION_LIST /begin REF_CHARACTERISTIC /end REF_CHARACTERISTIC /begin REF_MEASUREMENT MotCtrlPrmEstimn.MotInduDaxEstimd.Val /end REF_MEASUREMENT /end GROUP
/begin GROUP MotCtrlPrmEstimn.MotInduDaxEstimdIvs.Val "MICROSAR RTE" /begin SUB_GROUP /end SUB_GROUP /begin FUNCTION_LIST /end FUNCTION_LIST /begin REF_CHARACTERISTIC /end REF_CHARACTERISTIC /begin REF_MEASUREMENT MotCtrlPrmEstimn.MotInduDaxEstimdIvs.Val /end REF_MEASUREMENT /end GROUP
/begin GROUP MotCtrlPrmEstimn.MotInduQaxEstimd.Val "MICROSAR RTE" /begin SUB_GROUP /end SUB_GROUP /begin FUNCTION_LIST /end FUNCTION_LIST /begin REF_CHARACTERISTIC /end REF_CHARACTERISTIC /begin REF_MEASUREMENT MotCtrlPrmEstimn.MotInduQaxEstimd.Val /end REF_MEASUREMENT /end GROUP
/begin GROUP MotCtrlPrmEstimn.MotInduQaxEstimdIvs.Val "MICROSAR RTE" /begin SUB_GROUP /end SUB_GROUP /begin FUNCTION_LIST /end FUNCTION_LIST /begin REF_CHARACTERISTIC /end REF_CHARACTERISTIC /begin REF_MEASUREMENT MotCtrlPrmEstimn.MotInduQaxEstimdIvs.Val /end REF_MEASUREMENT /end GROUP
/begin GROUP MotCtrlPrmEstimn.MotMagT.Val "MICROSAR RTE" /begin SUB_GROUP /end SUB_GROUP /begin FUNCTION_LIST /end FUNCTION_LIST /begin REF_CHARACTERISTIC /end REF_CHARACTERISTIC /begin REF_MEASUREMENT MotCtrlPrmEstimn.MotMagT.Val /end REF_MEASUREMENT /end GROUP
/begin GROUP MotCtrlPrmEstimn.MotPrmNom "MICROSAR RTE" /begin SUB_GROUP /end SUB_GROUP /begin FUNCTION_LIST /end FUNCTION_LIST /begin REF_CHARACTERISTIC /end REF_CHARACTERISTIC
 /begin REF_MEASUREMENT MotCtrlPrmEstimn.MotPrmNom.MotBackEmfConNom MotCtrlPrmEstimn.MotPrmNom.MotRNom /end REF_MEASUREMENT
/end GROUP
/begin GROUP MotCtrlPrmEstimn.MotREstimd.Val "MICROSAR RTE" /begin SUB_GROUP /end SUB_GROUP /begin FUNCTION_LIST /end FUNCTION_LIST /begin REF_CHARACTERISTIC /end REF_CHARACTERISTIC /begin REF_MEASUREMENT MotCtrlPrmEstimn.MotREstimd.Val /end REF_MEASUREMENT /end GROUP
/begin GROUP MotCtrlPrmEstimn.MotWidgT.Val "MICROSAR RTE" /begin SUB_GROUP /end SUB_GROUP /begin FUNCTION_LIST /end FUNCTION_LIST /begin REF_CHARACTERISTIC /end REF_CHARACTERISTIC /begin REF_MEASUREMENT MotCtrlPrmEstimn.MotWidgT.Val /end REF_MEASUREMENT /end GROUP
/begin GROUP MotCtrlPrmEstimn.PerInstanceMemories "MICROSAR RTE"
 /begin SUB_GROUP MotCtrlPrmEstimn.MotPrmNom MotCtrlPrmEstimn.dMotCtrlPrmEstimnCtrlrREstimdPreLim MotCtrlPrmEstimn.dMotCtrlPrmEstimnFetRFfEstimd MotCtrlPrmEstimn.dMotCtrlPrmEstimnMotBackEmfConEstimdPreLim MotCtrlPrmEstimn.dMotCtrlPrmEstimnMotBackEmfConEstimdSatnSca MotCtrlPrmEstimn.dMotCtrlPrmEstimnMotInduEstimdPreLimDax MotCtrlPrmEstimn.dMotCtrlPrmEstimnMotInduEstimdPreLimQax MotCtrlPrmEstimn.dMotCtrlPrmEstimnMotInduEstimdSatnScaDax MotCtrlPrmEstimn.dMotCtrlPrmEstimnMotInduEstimdSatnScaQax MotCtrlPrmEstimn.dMotCtrlPrmEstimnMotRFfEstimd /end SUB_GROUP
 /begin FUNCTION_LIST /end FUNCTION_LIST
 /begin REF_CHARACTERISTIC /end REF_CHARACTERISTIC
 /begin REF_MEASUREMENT /end REF_MEASUREMENT
/end GROUP
/begin GROUP MotCtrlPrmEstimn.ReceiverPorts "MICROSAR RTE"
 /begin SUB_GROUP MotCtrlPrmEstimn.DualEcuFltMtgtnEna.Logl MotCtrlPrmEstimn.MotAndThermProtnLoaMod.Val MotCtrlPrmEstimn.MotCurrDaxCmd.Val MotCtrlPrmEstimn.MotCurrQaxCmd.Val MotCtrlPrmEstimn.MotFetT.Val MotCtrlPrmEstimn.MotMagT.Val MotCtrlPrmEstimn.MotWidgT.Val /end SUB_GROUP
 /begin FUNCTION_LIST /end FUNCTION_LIST
 /begin REF_CHARACTERISTIC /end REF_CHARACTERISTIC
 /begin REF_MEASUREMENT /end REF_MEASUREMENT
/end GROUP
/begin GROUP MotCtrlPrmEstimn.SenderPorts "MICROSAR RTE"
 /begin SUB_GROUP MotCtrlPrmEstimn.MotBackEmfConEstimd.Val MotCtrlPrmEstimn.MotInduDaxEstimd.Val MotCtrlPrmEstimn.MotInduDaxEstimdIvs.Val MotCtrlPrmEstimn.MotInduQaxEstimd.Val MotCtrlPrmEstimn.MotInduQaxEstimdIvs.Val MotCtrlPrmEstimn.MotREstimd.Val /end SUB_GROUP
 /begin FUNCTION_LIST /end FUNCTION_LIST
 /begin REF_CHARACTERISTIC /end REF_CHARACTERISTIC
 /begin REF_MEASUREMENT /end REF_MEASUREMENT
/end GROUP
/begin GROUP MotCtrlPrmEstimn.dMotCtrlPrmEstimnCtrlrREstimdPreLim "MICROSAR RTE" /begin SUB_GROUP /end SUB_GROUP /begin FUNCTION_LIST /end FUNCTION_LIST /begin REF_CHARACTERISTIC /end REF_CHARACTERISTIC /begin REF_MEASUREMENT MotCtrlPrmEstimn.dMotCtrlPrmEstimnCtrlrREstimdPreLim /end REF_MEASUREMENT /end GROUP
/begin GROUP MotCtrlPrmEstimn.dMotCtrlPrmEstimnFetRFfEstimd "MICROSAR RTE" /begin SUB_GROUP /end SUB_GROUP /begin FUNCTION_LIST /end FUNCTION_LIST /begin REF_CHARACTERISTIC /end REF_CHARACTERISTIC /begin REF_MEASUREMENT MotCtrlPrmEstimn.dMotCtrlPrmEstimnFetRFfEstimd /end REF_MEASUREMENT /end GROUP
/begin GROUP MotCtrlPrmEstimn.dMotCtrlPrmEstimnMotBackEmfConEstimdPreLim "MICROSAR RTE" /begin SUB_GROUP /end SUB_GROUP /begin FUNCTION_LIST /end FUNCTION_LIST /begin REF_CHARACTERISTIC /end REF_CHARACTERISTIC
 /begin REF_MEASUREMENT MotCtrlPrmEstimn.dMotCtrlPrmEstimnMotBackEmfConEstimdPreLim /end REF_MEASUREMENT
/end GROUP
/begin GROUP MotCtrlPrmEstimn.dMotCtrlPrmEstimnMotBackEmfConEstimdSatnSca "MICROSAR RTE" /begin SUB_GROUP /end SUB_GROUP /begin FUNCTION_LIST /end FUNCTION_LIST /begin REF_CHARACTERISTIC /end REF_CHARACTERISTIC
 /begin REF_MEASUREMENT MotCtrlPrmEstimn.dMotCtrlPrmEstimnMotBackEmfConEstimdSatnSca /end REF_MEASUREMENT
/end GROUP
/begin GROUP MotCtrlPrmEstimn.dMotCtrlPrmEstimnMotInduEstimdPreLimDax "MICROSAR RTE" /begin SUB_GROUP /end SUB_GROUP /begin FUNCTION_LIST /end FUNCTION_LIST /begin REF_CHARACTERISTIC /end REF_CHARACTERISTIC /begin REF_MEASUREMENT MotCtrlPrmEstimn.dMotCtrlPrmEstimnMotInduEstimdPreLimDax /end REF_MEASUREMENT /end GROUP
/begin GROUP MotCtrlPrmEstimn.dMotCtrlPrmEstimnMotInduEstimdPreLimQax "MICROSAR RTE" /begin SUB_GROUP /end SUB_GROUP /begin FUNCTION_LIST /end FUNCTION_LIST /begin REF_CHARACTERISTIC /end REF_CHARACTERISTIC /begin REF_MEASUREMENT MotCtrlPrmEstimn.dMotCtrlPrmEstimnMotInduEstimdPreLimQax /end REF_MEASUREMENT /end GROUP
/begin GROUP MotCtrlPrmEstimn.dMotCtrlPrmEstimnMotInduEstimdSatnScaDax "MICROSAR RTE" /begin SUB_GROUP /end SUB_GROUP /begin FUNCTION_LIST /end FUNCTION_LIST /begin REF_CHARACTERISTIC /end REF_CHARACTERISTIC /begin REF_MEASUREMENT MotCtrlPrmEstimn.dMotCtrlPrmEstimnMotInduEstimdSatnScaDax /end REF_MEASUREMENT /end GROUP
/begin GROUP MotCtrlPrmEstimn.dMotCtrlPrmEstimnMotInduEstimdSatnScaQax "MICROSAR RTE" /begin SUB_GROUP /end SUB_GROUP /begin FUNCTION_LIST /end FUNCTION_LIST /begin REF_CHARACTERISTIC /end REF_CHARACTERISTIC /begin REF_MEASUREMENT MotCtrlPrmEstimn.dMotCtrlPrmEstimnMotInduEstimdSatnScaQax /end REF_MEASUREMENT /end GROUP
/begin GROUP MotCtrlPrmEstimn.dMotCtrlPrmEstimnMotRFfEstimd "MICROSAR RTE" /begin SUB_GROUP /end SUB_GROUP /begin FUNCTION_LIST /end FUNCTION_LIST /begin REF_CHARACTERISTIC /end REF_CHARACTERISTIC /begin REF_MEASUREMENT MotCtrlPrmEstimn.dMotCtrlPrmEstimnMotRFfEstimd /end REF_MEASUREMENT /end GROUP
/begin GROUP MotCurrPeakEstimn "MICROSAR RTE"
 /begin SUB_GROUP MotCurrPeakEstimn.CalibrationPorts MotCurrPeakEstimn.PerInstanceMemories MotCurrPeakEstimn.ReceiverPorts MotCurrPeakEstimn.SenderPorts /end SUB_GROUP
 /begin FUNCTION_LIST /end FUNCTION_LIST
 /begin REF_CHARACTERISTIC /end REF_CHARACTERISTIC
 /begin REF_MEASUREMENT /end REF_MEASUREMENT
/end GROUP
/begin GROUP MotCurrPeakEstimn.CalibrationPorts "MICROSAR RTE"
 /begin SUB_GROUP MotCurrPeakEstimn.MotCurrPeakEstimnCurrFilFrq.Val MotCurrPeakEstimn.MotCurrPeakEstimnCurrPeakEstimdFilFrq.Val /end SUB_GROUP
 /begin FUNCTION_LIST /end FUNCTION_LIST
 /begin REF_CHARACTERISTIC /end REF_CHARACTERISTIC
 /begin REF_MEASUREMENT /end REF_MEASUREMENT
/end GROUP
/begin GROUP MotCurrPeakEstimn.DualEcuMotCtrlMtgtnEna.Logl "MICROSAR RTE" /begin SUB_GROUP /end SUB_GROUP /begin FUNCTION_LIST /end FUNCTION_LIST /begin REF_CHARACTERISTIC /end REF_CHARACTERISTIC /begin REF_MEASUREMENT MotCurrPeakEstimn.DualEcuMotCtrlMtgtnEna.Logl /end REF_MEASUREMENT /end GROUP
/begin GROUP MotCurrPeakEstimn.MotAndThermProtnLoaMod.Val "MICROSAR RTE" /begin SUB_GROUP /end SUB_GROUP /begin FUNCTION_LIST /end FUNCTION_LIST /begin REF_CHARACTERISTIC /end REF_CHARACTERISTIC /begin REF_MEASUREMENT MotCurrPeakEstimn.MotAndThermProtnLoaMod.Val /end REF_MEASUREMENT /end GROUP
/begin GROUP MotCurrPeakEstimn.MotCurrDax.Val "MICROSAR RTE" /begin SUB_GROUP /end SUB_GROUP /begin FUNCTION_LIST /end FUNCTION_LIST /begin REF_CHARACTERISTIC /end REF_CHARACTERISTIC /begin REF_MEASUREMENT MotCurrPeakEstimn.MotCurrDax.Val /end REF_MEASUREMENT /end GROUP
/begin GROUP MotCurrPeakEstimn.MotCurrDaxCmd.Val "MICROSAR RTE" /begin SUB_GROUP /end SUB_GROUP /begin FUNCTION_LIST /end FUNCTION_LIST /begin REF_CHARACTERISTIC /end REF_CHARACTERISTIC /begin REF_MEASUREMENT MotCurrPeakEstimn.MotCurrDaxCmd.Val /end REF_MEASUREMENT /end GROUP
/begin GROUP MotCurrPeakEstimn.MotCurrDaxFil "MICROSAR RTE" /begin SUB_GROUP /end SUB_GROUP /begin FUNCTION_LIST /end FUNCTION_LIST /begin REF_CHARACTERISTIC /end REF_CHARACTERISTIC
 /begin REF_MEASUREMENT MotCurrPeakEstimn.MotCurrDaxFil.FilGain MotCurrPeakEstimn.MotCurrDaxFil.FilSt /end REF_MEASUREMENT
/end GROUP
/begin GROUP MotCurrPeakEstimn.MotCurrPeakEstimd.Val "MICROSAR RTE" /begin SUB_GROUP /end SUB_GROUP /begin FUNCTION_LIST /end FUNCTION_LIST /begin REF_CHARACTERISTIC /end REF_CHARACTERISTIC /begin REF_MEASUREMENT MotCurrPeakEstimn.MotCurrPeakEstimd.Val /end REF_MEASUREMENT /end GROUP
/begin GROUP MotCurrPeakEstimn.MotCurrPeakEstimdFil "MICROSAR RTE" /begin SUB_GROUP /end SUB_GROUP /begin FUNCTION_LIST /end FUNCTION_LIST /begin REF_CHARACTERISTIC /end REF_CHARACTERISTIC
 /begin REF_MEASUREMENT MotCurrPeakEstimn.MotCurrPeakEstimdFil.FilGain MotCurrPeakEstimn.MotCurrPeakEstimdFil.FilSt /end REF_MEASUREMENT
/end GROUP
/begin GROUP MotCurrPeakEstimn.MotCurrPeakEstimdFild.Val "MICROSAR RTE" /begin SUB_GROUP /end SUB_GROUP /begin FUNCTION_LIST /end FUNCTION_LIST /begin REF_CHARACTERISTIC /end REF_CHARACTERISTIC /begin REF_MEASUREMENT MotCurrPeakEstimn.MotCurrPeakEstimdFild.Val /end REF_MEASUREMENT /end GROUP
/begin GROUP MotCurrPeakEstimn.MotCurrPeakEstimnCurrFilFrq.Val "MICROSAR RTE" /begin SUB_GROUP /end SUB_GROUP /begin FUNCTION_LIST /end FUNCTION_LIST /begin REF_CHARACTERISTIC MotCurrPeakEstimn.MotCurrPeakEstimnCurrFilFrq.Val /end REF_CHARACTERISTIC /begin REF_MEASUREMENT /end REF_MEASUREMENT /end GROUP
/begin GROUP MotCurrPeakEstimn.MotCurrPeakEstimnCurrPeakEstimdFilFrq.Val "MICROSAR RTE" /begin SUB_GROUP /end SUB_GROUP /begin FUNCTION_LIST /end FUNCTION_LIST
 /begin REF_CHARACTERISTIC MotCurrPeakEstimn.MotCurrPeakEstimnCurrPeakEstimdFilFrq.Val /end REF_CHARACTERISTIC
 /begin REF_MEASUREMENT /end REF_MEASUREMENT
/end GROUP
/begin GROUP MotCurrPeakEstimn.MotCurrQax.Val "MICROSAR RTE" /begin SUB_GROUP /end SUB_GROUP /begin FUNCTION_LIST /end FUNCTION_LIST /begin REF_CHARACTERISTIC /end REF_CHARACTERISTIC /begin REF_MEASUREMENT MotCurrPeakEstimn.MotCurrQax.Val /end REF_MEASUREMENT /end GROUP
/begin GROUP MotCurrPeakEstimn.MotCurrQaxCmd.Val "MICROSAR RTE" /begin SUB_GROUP /end SUB_GROUP /begin FUNCTION_LIST /end FUNCTION_LIST /begin REF_CHARACTERISTIC /end REF_CHARACTERISTIC /begin REF_MEASUREMENT MotCurrPeakEstimn.MotCurrQaxCmd.Val /end REF_MEASUREMENT /end GROUP
/begin GROUP MotCurrPeakEstimn.MotCurrQaxFil "MICROSAR RTE" /begin SUB_GROUP /end SUB_GROUP /begin FUNCTION_LIST /end FUNCTION_LIST /begin REF_CHARACTERISTIC /end REF_CHARACTERISTIC
 /begin REF_MEASUREMENT MotCurrPeakEstimn.MotCurrQaxFil.FilGain MotCurrPeakEstimn.MotCurrQaxFil.FilSt /end REF_MEASUREMENT
/end GROUP
/begin GROUP MotCurrPeakEstimn.PerInstanceMemories "MICROSAR RTE"
 /begin SUB_GROUP MotCurrPeakEstimn.MotCurrDaxFil MotCurrPeakEstimn.MotCurrPeakEstimdFil MotCurrPeakEstimn.MotCurrQaxFil MotCurrPeakEstimn.dMotCurrPeakEstimnMotCurrDaxFil MotCurrPeakEstimn.dMotCurrPeakEstimnMotCurrQaxFil /end SUB_GROUP
 /begin FUNCTION_LIST /end FUNCTION_LIST
 /begin REF_CHARACTERISTIC /end REF_CHARACTERISTIC
 /begin REF_MEASUREMENT /end REF_MEASUREMENT
/end GROUP
/begin GROUP MotCurrPeakEstimn.ReceiverPorts "MICROSAR RTE"
 /begin SUB_GROUP MotCurrPeakEstimn.DualEcuMotCtrlMtgtnEna.Logl MotCurrPeakEstimn.MotAndThermProtnLoaMod.Val MotCurrPeakEstimn.MotCurrDax.Val MotCurrPeakEstimn.MotCurrDaxCmd.Val MotCurrPeakEstimn.MotCurrQax.Val MotCurrPeakEstimn.MotCurrQaxCmd.Val /end SUB_GROUP
 /begin FUNCTION_LIST /end FUNCTION_LIST
 /begin REF_CHARACTERISTIC /end REF_CHARACTERISTIC
 /begin REF_MEASUREMENT /end REF_MEASUREMENT
/end GROUP
/begin GROUP MotCurrPeakEstimn.SenderPorts "MICROSAR RTE"
 /begin SUB_GROUP MotCurrPeakEstimn.MotCurrPeakEstimd.Val MotCurrPeakEstimn.MotCurrPeakEstimdFild.Val /end SUB_GROUP
 /begin FUNCTION_LIST /end FUNCTION_LIST
 /begin REF_CHARACTERISTIC /end REF_CHARACTERISTIC
 /begin REF_MEASUREMENT /end REF_MEASUREMENT
/end GROUP
/begin GROUP MotCurrPeakEstimn.dMotCurrPeakEstimnMotCurrDaxFil "MICROSAR RTE" /begin SUB_GROUP /end SUB_GROUP /begin FUNCTION_LIST /end FUNCTION_LIST /begin REF_CHARACTERISTIC /end REF_CHARACTERISTIC /begin REF_MEASUREMENT MotCurrPeakEstimn.dMotCurrPeakEstimnMotCurrDaxFil /end REF_MEASUREMENT /end GROUP
/begin GROUP MotCurrPeakEstimn.dMotCurrPeakEstimnMotCurrQaxFil "MICROSAR RTE" /begin SUB_GROUP /end SUB_GROUP /begin FUNCTION_LIST /end FUNCTION_LIST /begin REF_CHARACTERISTIC /end REF_CHARACTERISTIC /begin REF_MEASUREMENT MotCurrPeakEstimn.dMotCurrPeakEstimnMotCurrQaxFil /end REF_MEASUREMENT /end GROUP
/begin GROUP MotCurrRegCfg "MICROSAR RTE"
 /begin SUB_GROUP MotCurrRegCfg.CalibrationPorts MotCurrRegCfg.PerInstanceMemories MotCurrRegCfg.ReceiverPorts MotCurrRegCfg.SenderPorts /end SUB_GROUP
 /begin FUNCTION_LIST /end FUNCTION_LIST
 /begin REF_CHARACTERISTIC /end REF_CHARACTERISTIC
 /begin REF_MEASUREMENT /end REF_MEASUREMENT
/end GROUP
/begin GROUP MotCurrRegCfg.CalibrationPorts "MICROSAR RTE"
 /begin SUB_GROUP MotCurrRegCfg.MotCurrRegCfgCtrlrDynGainVehSpdCutOff.Val MotCurrRegCfg.MotCurrRegCfgCurrLoopSecOrderTrfFctEna.Logl MotCurrRegCfg.MotCurrRegCfgIntglGainSampleTi.Val MotCurrRegCfg.MotCurrRegCfgMotAgCompuDly.Val MotCurrRegCfg.MotCurrRegCfgMotClsdLoopBwDaxY.Ary1D MotCurrRegCfg.MotCurrRegCfgMotClsdLoopBwQaxY.Ary1D MotCurrRegCfg.MotCurrRegCfgMotCtrlPrmSelnX.Ary1D MotCurrRegCfg.MotCurrRegCfgMotDampgRatDax.Val MotCurrRegCfg.MotCurrRegCfgMotDampgRatQax.Val MotCurrRegCfg.MotCurrRegCfgMotNatFrqDaxY.Ary1D MotCurrRegCfg.MotCurrRegCfgMotNatFrqQaxY.Ary1D MotCurrRegCfg.MotCurrRegCfgMotRVirtDax.Val MotCurrRegCfg.MotCurrRegCfgMotRVirtQax.Val MotCurrRegCfg.MotCurrRegCfgMotVelFilFrq.Val MotCurrRegCfg.MotRefMdlFbCtrlDi.Logl MotCurrRegCfg.SysGlbPrmMotPoleCnt.Val /end SUB_GROUP
 /begin FUNCTION_LIST /end FUNCTION_LIST
 /begin REF_CHARACTERISTIC /end REF_CHARACTERISTIC
 /begin REF_MEASUREMENT /end REF_MEASUREMENT
/end GROUP
/begin GROUP MotCurrRegCfg.DualEcuMotCtrlMtgtnEna.Logl "MICROSAR RTE" /begin SUB_GROUP /end SUB_GROUP /begin FUNCTION_LIST /end FUNCTION_LIST /begin REF_CHARACTERISTIC /end REF_CHARACTERISTIC /begin REF_MEASUREMENT MotCurrRegCfg.DualEcuMotCtrlMtgtnEna.Logl /end REF_MEASUREMENT /end GROUP
/begin GROUP MotCurrRegCfg.MotAgElecDly.Val "MICROSAR RTE" /begin SUB_GROUP /end SUB_GROUP /begin FUNCTION_LIST /end FUNCTION_LIST /begin REF_CHARACTERISTIC /end REF_CHARACTERISTIC /begin REF_MEASUREMENT MotCurrRegCfg.MotAgElecDly.Val /end REF_MEASUREMENT /end GROUP
/begin GROUP MotCurrRegCfg.MotAndThermProtnLoaMod.Val "MICROSAR RTE" /begin SUB_GROUP /end SUB_GROUP /begin FUNCTION_LIST /end FUNCTION_LIST /begin REF_CHARACTERISTIC /end REF_CHARACTERISTIC /begin REF_MEASUREMENT MotCurrRegCfg.MotAndThermProtnLoaMod.Val /end REF_MEASUREMENT /end GROUP
/begin GROUP MotCurrRegCfg.MotCurrEolCalSt.Val "MICROSAR RTE" /begin SUB_GROUP /end SUB_GROUP /begin FUNCTION_LIST /end FUNCTION_LIST /begin REF_CHARACTERISTIC /end REF_CHARACTERISTIC /begin REF_MEASUREMENT MotCurrRegCfg.MotCurrEolCalSt.Val /end REF_MEASUREMENT /end GROUP
/begin GROUP MotCurrRegCfg.MotCurrRegCfgCtrlrDynGainVehSpdCutOff.Val "MICROSAR RTE" /begin SUB_GROUP /end SUB_GROUP /begin FUNCTION_LIST /end FUNCTION_LIST /begin REF_CHARACTERISTIC MotCurrRegCfg.MotCurrRegCfgCtrlrDynGainVehSpdCutOff.Val /end REF_CHARACTERISTIC /begin REF_MEASUREMENT /end REF_MEASUREMENT /end GROUP
/begin GROUP MotCurrRegCfg.MotCurrRegCfgCurrLoopSecOrderTrfFctEna.Logl "MICROSAR RTE" /begin SUB_GROUP /end SUB_GROUP /begin FUNCTION_LIST /end FUNCTION_LIST /begin REF_CHARACTERISTIC MotCurrRegCfg.MotCurrRegCfgCurrLoopSecOrderTrfFctEna.Logl /end REF_CHARACTERISTIC /begin REF_MEASUREMENT /end REF_MEASUREMENT /end GROUP
/begin GROUP MotCurrRegCfg.MotCurrRegCfgIntglGainSampleTi.Val "MICROSAR RTE" /begin SUB_GROUP /end SUB_GROUP /begin FUNCTION_LIST /end FUNCTION_LIST /begin REF_CHARACTERISTIC MotCurrRegCfg.MotCurrRegCfgIntglGainSampleTi.Val /end REF_CHARACTERISTIC /begin REF_MEASUREMENT /end REF_MEASUREMENT /end GROUP
/begin GROUP MotCurrRegCfg.MotCurrRegCfgMotAgCompuDly.Val "MICROSAR RTE" /begin SUB_GROUP /end SUB_GROUP /begin FUNCTION_LIST /end FUNCTION_LIST /begin REF_CHARACTERISTIC MotCurrRegCfg.MotCurrRegCfgMotAgCompuDly.Val /end REF_CHARACTERISTIC /begin REF_MEASUREMENT /end REF_MEASUREMENT /end GROUP
/begin GROUP MotCurrRegCfg.MotCurrRegCfgMotClsdLoopBwDaxY.Ary1D "MICROSAR RTE" /begin SUB_GROUP /end SUB_GROUP /begin FUNCTION_LIST /end FUNCTION_LIST /begin REF_CHARACTERISTIC MotCurrRegCfg.MotCurrRegCfgMotClsdLoopBwDaxY.Ary1D /end REF_CHARACTERISTIC /begin REF_MEASUREMENT /end REF_MEASUREMENT /end GROUP
/begin GROUP MotCurrRegCfg.MotCurrRegCfgMotClsdLoopBwQaxY.Ary1D "MICROSAR RTE" /begin SUB_GROUP /end SUB_GROUP /begin FUNCTION_LIST /end FUNCTION_LIST /begin REF_CHARACTERISTIC MotCurrRegCfg.MotCurrRegCfgMotClsdLoopBwQaxY.Ary1D /end REF_CHARACTERISTIC /begin REF_MEASUREMENT /end REF_MEASUREMENT /end GROUP
/begin GROUP MotCurrRegCfg.MotCurrRegCfgMotCtrlPrmSelnX.Ary1D "MICROSAR RTE" /begin SUB_GROUP /end SUB_GROUP /begin FUNCTION_LIST /end FUNCTION_LIST /begin REF_CHARACTERISTIC MotCurrRegCfg.MotCurrRegCfgMotCtrlPrmSelnX.Ary1D /end REF_CHARACTERISTIC /begin REF_MEASUREMENT /end REF_MEASUREMENT /end GROUP
/begin GROUP MotCurrRegCfg.MotCurrRegCfgMotDampgRatDax.Val "MICROSAR RTE" /begin SUB_GROUP /end SUB_GROUP /begin FUNCTION_LIST /end FUNCTION_LIST /begin REF_CHARACTERISTIC MotCurrRegCfg.MotCurrRegCfgMotDampgRatDax.Val /end REF_CHARACTERISTIC /begin REF_MEASUREMENT /end REF_MEASUREMENT /end GROUP
/begin GROUP MotCurrRegCfg.MotCurrRegCfgMotDampgRatQax.Val "MICROSAR RTE" /begin SUB_GROUP /end SUB_GROUP /begin FUNCTION_LIST /end FUNCTION_LIST /begin REF_CHARACTERISTIC MotCurrRegCfg.MotCurrRegCfgMotDampgRatQax.Val /end REF_CHARACTERISTIC /begin REF_MEASUREMENT /end REF_MEASUREMENT /end GROUP
/begin GROUP MotCurrRegCfg.MotCurrRegCfgMotNatFrqDaxY.Ary1D "MICROSAR RTE" /begin SUB_GROUP /end SUB_GROUP /begin FUNCTION_LIST /end FUNCTION_LIST /begin REF_CHARACTERISTIC MotCurrRegCfg.MotCurrRegCfgMotNatFrqDaxY.Ary1D /end REF_CHARACTERISTIC /begin REF_MEASUREMENT /end REF_MEASUREMENT /end GROUP
/begin GROUP MotCurrRegCfg.MotCurrRegCfgMotNatFrqQaxY.Ary1D "MICROSAR RTE" /begin SUB_GROUP /end SUB_GROUP /begin FUNCTION_LIST /end FUNCTION_LIST /begin REF_CHARACTERISTIC MotCurrRegCfg.MotCurrRegCfgMotNatFrqQaxY.Ary1D /end REF_CHARACTERISTIC /begin REF_MEASUREMENT /end REF_MEASUREMENT /end GROUP
/begin GROUP MotCurrRegCfg.MotCurrRegCfgMotRVirtDax.Val "MICROSAR RTE" /begin SUB_GROUP /end SUB_GROUP /begin FUNCTION_LIST /end FUNCTION_LIST /begin REF_CHARACTERISTIC MotCurrRegCfg.MotCurrRegCfgMotRVirtDax.Val /end REF_CHARACTERISTIC /begin REF_MEASUREMENT /end REF_MEASUREMENT /end GROUP
/begin GROUP MotCurrRegCfg.MotCurrRegCfgMotRVirtQax.Val "MICROSAR RTE" /begin SUB_GROUP /end SUB_GROUP /begin FUNCTION_LIST /end FUNCTION_LIST /begin REF_CHARACTERISTIC MotCurrRegCfg.MotCurrRegCfgMotRVirtQax.Val /end REF_CHARACTERISTIC /begin REF_MEASUREMENT /end REF_MEASUREMENT /end GROUP
/begin GROUP MotCurrRegCfg.MotCurrRegCfgMotVelFilFrq.Val "MICROSAR RTE" /begin SUB_GROUP /end SUB_GROUP /begin FUNCTION_LIST /end FUNCTION_LIST /begin REF_CHARACTERISTIC MotCurrRegCfg.MotCurrRegCfgMotVelFilFrq.Val /end REF_CHARACTERISTIC /begin REF_MEASUREMENT /end REF_MEASUREMENT /end GROUP
/begin GROUP MotCurrRegCfg.MotDampgDax.Val "MICROSAR RTE" /begin SUB_GROUP /end SUB_GROUP /begin FUNCTION_LIST /end FUNCTION_LIST /begin REF_CHARACTERISTIC /end REF_CHARACTERISTIC /begin REF_MEASUREMENT MotCurrRegCfg.MotDampgDax.Val /end REF_MEASUREMENT /end GROUP
/begin GROUP MotCurrRegCfg.MotDampgQax.Val "MICROSAR RTE" /begin SUB_GROUP /end SUB_GROUP /begin FUNCTION_LIST /end FUNCTION_LIST /begin REF_CHARACTERISTIC /end REF_CHARACTERISTIC /begin REF_MEASUREMENT MotCurrRegCfg.MotDampgQax.Val /end REF_MEASUREMENT /end GROUP
/begin GROUP MotCurrRegCfg.MotInduDaxEstimd.Val "MICROSAR RTE" /begin SUB_GROUP /end SUB_GROUP /begin FUNCTION_LIST /end FUNCTION_LIST /begin REF_CHARACTERISTIC /end REF_CHARACTERISTIC /begin REF_MEASUREMENT MotCurrRegCfg.MotInduDaxEstimd.Val /end REF_MEASUREMENT /end GROUP
/begin GROUP MotCurrRegCfg.MotInduQaxEstimd.Val "MICROSAR RTE" /begin SUB_GROUP /end SUB_GROUP /begin FUNCTION_LIST /end FUNCTION_LIST /begin REF_CHARACTERISTIC /end REF_CHARACTERISTIC /begin REF_MEASUREMENT MotCurrRegCfg.MotInduQaxEstimd.Val /end REF_MEASUREMENT /end GROUP
/begin GROUP MotCurrRegCfg.MotIntglGainDax.Val "MICROSAR RTE" /begin SUB_GROUP /end SUB_GROUP /begin FUNCTION_LIST /end FUNCTION_LIST /begin REF_CHARACTERISTIC /end REF_CHARACTERISTIC /begin REF_MEASUREMENT MotCurrRegCfg.MotIntglGainDax.Val /end REF_MEASUREMENT /end GROUP
/begin GROUP MotCurrRegCfg.MotIntglGainQax.Val "MICROSAR RTE" /begin SUB_GROUP /end SUB_GROUP /begin FUNCTION_LIST /end FUNCTION_LIST /begin REF_CHARACTERISTIC /end REF_CHARACTERISTIC /begin REF_MEASUREMENT MotCurrRegCfg.MotIntglGainQax.Val /end REF_MEASUREMENT /end GROUP
/begin GROUP MotCurrRegCfg.MotPropGainDax.Val "MICROSAR RTE" /begin SUB_GROUP /end SUB_GROUP /begin FUNCTION_LIST /end FUNCTION_LIST /begin REF_CHARACTERISTIC /end REF_CHARACTERISTIC /begin REF_MEASUREMENT MotCurrRegCfg.MotPropGainDax.Val /end REF_MEASUREMENT /end GROUP
/begin GROUP MotCurrRegCfg.MotPropGainQax.Val "MICROSAR RTE" /begin SUB_GROUP /end SUB_GROUP /begin FUNCTION_LIST /end FUNCTION_LIST /begin REF_CHARACTERISTIC /end REF_CHARACTERISTIC /begin REF_MEASUREMENT MotCurrRegCfg.MotPropGainQax.Val /end REF_MEASUREMENT /end GROUP
/begin GROUP MotCurrRegCfg.MotREstimd.Val "MICROSAR RTE" /begin SUB_GROUP /end SUB_GROUP /begin FUNCTION_LIST /end FUNCTION_LIST /begin REF_CHARACTERISTIC /end REF_CHARACTERISTIC /begin REF_MEASUREMENT MotCurrRegCfg.MotREstimd.Val /end REF_MEASUREMENT /end GROUP
/begin GROUP MotCurrRegCfg.MotRefMdlFbCtrlDi.Logl "MICROSAR RTE" /begin SUB_GROUP /end SUB_GROUP /begin FUNCTION_LIST /end FUNCTION_LIST /begin REF_CHARACTERISTIC MotCurrRegCfg.MotRefMdlFbCtrlDi.Logl /end REF_CHARACTERISTIC /begin REF_MEASUREMENT /end REF_MEASUREMENT /end GROUP
/begin GROUP MotCurrRegCfg.MotVelMrf.Val "MICROSAR RTE" /begin SUB_GROUP /end SUB_GROUP /begin FUNCTION_LIST /end FUNCTION_LIST /begin REF_CHARACTERISTIC /end REF_CHARACTERISTIC /begin REF_MEASUREMENT MotCurrRegCfg.MotVelMrf.Val /end REF_MEASUREMENT /end GROUP
/begin GROUP MotCurrRegCfg.MotVelMrfFild "MICROSAR RTE" /begin SUB_GROUP /end SUB_GROUP /begin FUNCTION_LIST /end FUNCTION_LIST /begin REF_CHARACTERISTIC /end REF_CHARACTERISTIC
 /begin REF_MEASUREMENT MotCurrRegCfg.MotVelMrfFild.FilGain MotCurrRegCfg.MotVelMrfFild.FilSt /end REF_MEASUREMENT
/end GROUP
/begin GROUP MotCurrRegCfg.PerInstanceMemories "MICROSAR RTE"
 /begin SUB_GROUP MotCurrRegCfg.MotVelMrfFild MotCurrRegCfg.dMotCurrRegCfgMotVelMrfFild /end SUB_GROUP
 /begin FUNCTION_LIST /end FUNCTION_LIST
 /begin REF_CHARACTERISTIC /end REF_CHARACTERISTIC
 /begin REF_MEASUREMENT /end REF_MEASUREMENT
/end GROUP
/begin GROUP MotCurrRegCfg.ReceiverPorts "MICROSAR RTE"
 /begin SUB_GROUP MotCurrRegCfg.DualEcuMotCtrlMtgtnEna.Logl MotCurrRegCfg.MotAndThermProtnLoaMod.Val MotCurrRegCfg.MotCurrEolCalSt.Val MotCurrRegCfg.MotInduDaxEstimd.Val MotCurrRegCfg.MotInduQaxEstimd.Val MotCurrRegCfg.MotREstimd.Val MotCurrRegCfg.MotVelMrf.Val MotCurrRegCfg.VehSpd.Val /end SUB_GROUP
 /begin FUNCTION_LIST /end FUNCTION_LIST
 /begin REF_CHARACTERISTIC /end REF_CHARACTERISTIC
 /begin REF_MEASUREMENT /end REF_MEASUREMENT
/end GROUP
/begin GROUP MotCurrRegCfg.SenderPorts "MICROSAR RTE"
 /begin SUB_GROUP MotCurrRegCfg.MotAgElecDly.Val MotCurrRegCfg.MotDampgDax.Val MotCurrRegCfg.MotDampgQax.Val MotCurrRegCfg.MotIntglGainDax.Val MotCurrRegCfg.MotIntglGainQax.Val MotCurrRegCfg.MotPropGainDax.Val MotCurrRegCfg.MotPropGainQax.Val /end SUB_GROUP
 /begin FUNCTION_LIST /end FUNCTION_LIST
 /begin REF_CHARACTERISTIC /end REF_CHARACTERISTIC
 /begin REF_MEASUREMENT /end REF_MEASUREMENT
/end GROUP
/begin GROUP MotCurrRegCfg.SysGlbPrmMotPoleCnt.Val "MICROSAR RTE" /begin SUB_GROUP /end SUB_GROUP /begin FUNCTION_LIST /end FUNCTION_LIST /begin REF_CHARACTERISTIC MotCurrRegCfg.SysGlbPrmMotPoleCnt.Val /end REF_CHARACTERISTIC /begin REF_MEASUREMENT /end REF_MEASUREMENT /end GROUP
/begin GROUP MotCurrRegCfg.VehSpd.Val "MICROSAR RTE" /begin SUB_GROUP /end SUB_GROUP /begin FUNCTION_LIST /end FUNCTION_LIST /begin REF_CHARACTERISTIC /end REF_CHARACTERISTIC /begin REF_MEASUREMENT MotCurrRegCfg.VehSpd.Val /end REF_MEASUREMENT /end GROUP
/begin GROUP MotCurrRegCfg.dMotCurrRegCfgMotVelMrfFild "MICROSAR RTE" /begin SUB_GROUP /end SUB_GROUP /begin FUNCTION_LIST /end FUNCTION_LIST /begin REF_CHARACTERISTIC /end REF_CHARACTERISTIC /begin REF_MEASUREMENT MotCurrRegCfg.dMotCurrRegCfgMotVelMrfFild /end REF_MEASUREMENT /end GROUP
/begin GROUP MotQuadDetn "MICROSAR RTE"
 /begin SUB_GROUP MotQuadDetn.CalibrationPorts MotQuadDetn.PerInstanceMemories MotQuadDetn.ReceiverPorts MotQuadDetn.SenderPorts /end SUB_GROUP
 /begin FUNCTION_LIST /end FUNCTION_LIST
 /begin REF_CHARACTERISTIC /end REF_CHARACTERISTIC
 /begin REF_MEASUREMENT /end REF_MEASUREMENT
/end GROUP
/begin GROUP MotQuadDetn.CalibrationPorts "MICROSAR RTE" /begin SUB_GROUP MotQuadDetn.MotQuadDetnMotDirHysInsts.Val /end SUB_GROUP /begin FUNCTION_LIST /end FUNCTION_LIST /begin REF_CHARACTERISTIC /end REF_CHARACTERISTIC /begin REF_MEASUREMENT /end REF_MEASUREMENT /end GROUP
/begin GROUP MotQuadDetn.MotAgCumvAlgndMrf.Val "MICROSAR RTE" /begin SUB_GROUP /end SUB_GROUP /begin FUNCTION_LIST /end FUNCTION_LIST /begin REF_CHARACTERISTIC /end REF_CHARACTERISTIC /begin REF_MEASUREMENT MotQuadDetn.MotAgCumvAlgndMrf.Val /end REF_MEASUREMENT /end GROUP
/begin GROUP MotQuadDetn.MotAgCumvPrev "MICROSAR RTE" /begin SUB_GROUP /end SUB_GROUP /begin FUNCTION_LIST /end FUNCTION_LIST /begin REF_CHARACTERISTIC /end REF_CHARACTERISTIC /begin REF_MEASUREMENT MotQuadDetn.MotAgCumvPrev /end REF_MEASUREMENT /end GROUP
/begin GROUP MotQuadDetn.MotDirInsts.Val "MICROSAR RTE" /begin SUB_GROUP /end SUB_GROUP /begin FUNCTION_LIST /end FUNCTION_LIST /begin REF_CHARACTERISTIC /end REF_CHARACTERISTIC /begin REF_MEASUREMENT MotQuadDetn.MotDirInsts.Val /end REF_MEASUREMENT /end GROUP
/begin GROUP MotQuadDetn.MotDirInstsPrev "MICROSAR RTE" /begin SUB_GROUP /end SUB_GROUP /begin FUNCTION_LIST /end FUNCTION_LIST /begin REF_CHARACTERISTIC /end REF_CHARACTERISTIC /begin REF_MEASUREMENT MotQuadDetn.MotDirInstsPrev /end REF_MEASUREMENT /end GROUP
/begin GROUP MotQuadDetn.MotQuad.Val "MICROSAR RTE" /begin SUB_GROUP /end SUB_GROUP /begin FUNCTION_LIST /end FUNCTION_LIST /begin REF_CHARACTERISTIC /end REF_CHARACTERISTIC /begin REF_MEASUREMENT MotQuadDetn.MotQuad.Val /end REF_MEASUREMENT /end GROUP
/begin GROUP MotQuadDetn.MotQuadDetnMotDirHysInsts.Val "MICROSAR RTE" /begin SUB_GROUP /end SUB_GROUP /begin FUNCTION_LIST /end FUNCTION_LIST /begin REF_CHARACTERISTIC MotQuadDetn.MotQuadDetnMotDirHysInsts.Val /end REF_CHARACTERISTIC /begin REF_MEASUREMENT /end REF_MEASUREMENT /end GROUP
/begin GROUP MotQuadDetn.MotTqCmd.Val "MICROSAR RTE" /begin SUB_GROUP /end SUB_GROUP /begin FUNCTION_LIST /end FUNCTION_LIST /begin REF_CHARACTERISTIC /end REF_CHARACTERISTIC /begin REF_MEASUREMENT MotQuadDetn.MotTqCmd.Val /end REF_MEASUREMENT /end GROUP
/begin GROUP MotQuadDetn.MotTqCmdSignPrev "MICROSAR RTE" /begin SUB_GROUP /end SUB_GROUP /begin FUNCTION_LIST /end FUNCTION_LIST /begin REF_CHARACTERISTIC /end REF_CHARACTERISTIC /begin REF_MEASUREMENT MotQuadDetn.MotTqCmdSignPrev /end REF_MEASUREMENT /end GROUP
/begin GROUP MotQuadDetn.PerInstanceMemories "MICROSAR RTE"
 /begin SUB_GROUP MotQuadDetn.MotAgCumvPrev MotQuadDetn.MotDirInstsPrev MotQuadDetn.MotTqCmdSignPrev MotQuadDetn.dMotQuadDetnMotAgCumvDelta MotQuadDetn.dMotQuadDetnTqCmdSign /end SUB_GROUP
 /begin FUNCTION_LIST /end FUNCTION_LIST
 /begin REF_CHARACTERISTIC /end REF_CHARACTERISTIC
 /begin REF_MEASUREMENT /end REF_MEASUREMENT
/end GROUP
/begin GROUP MotQuadDetn.ReceiverPorts "MICROSAR RTE" /begin SUB_GROUP MotQuadDetn.MotAgCumvAlgndMrf.Val MotQuadDetn.MotTqCmd.Val /end SUB_GROUP /begin FUNCTION_LIST /end FUNCTION_LIST /begin REF_CHARACTERISTIC /end REF_CHARACTERISTIC /begin REF_MEASUREMENT /end REF_MEASUREMENT /end GROUP
/begin GROUP MotQuadDetn.SenderPorts "MICROSAR RTE" /begin SUB_GROUP MotQuadDetn.MotDirInsts.Val MotQuadDetn.MotQuad.Val /end SUB_GROUP /begin FUNCTION_LIST /end FUNCTION_LIST /begin REF_CHARACTERISTIC /end REF_CHARACTERISTIC /begin REF_MEASUREMENT /end REF_MEASUREMENT /end GROUP
/begin GROUP MotQuadDetn.dMotQuadDetnMotAgCumvDelta "MICROSAR RTE" /begin SUB_GROUP /end SUB_GROUP /begin FUNCTION_LIST /end FUNCTION_LIST /begin REF_CHARACTERISTIC /end REF_CHARACTERISTIC /begin REF_MEASUREMENT MotQuadDetn.dMotQuadDetnMotAgCumvDelta /end REF_MEASUREMENT /end GROUP
/begin GROUP MotQuadDetn.dMotQuadDetnTqCmdSign "MICROSAR RTE" /begin SUB_GROUP /end SUB_GROUP /begin FUNCTION_LIST /end FUNCTION_LIST /begin REF_CHARACTERISTIC /end REF_CHARACTERISTIC /begin REF_MEASUREMENT MotQuadDetn.dMotQuadDetnTqCmdSign /end REF_MEASUREMENT /end GROUP
/begin GROUP MotRefMdl "MICROSAR RTE"
 /begin SUB_GROUP MotRefMdl.CalibrationPorts MotRefMdl.PerInstanceMemories MotRefMdl.ReceiverPorts MotRefMdl.SenderPorts /end SUB_GROUP
 /begin FUNCTION_LIST /end FUNCTION_LIST
 /begin REF_CHARACTERISTIC /end REF_CHARACTERISTIC
 /begin REF_MEASUREMENT /end REF_MEASUREMENT
/end GROUP
/begin GROUP MotRefMdl.BrdgVltg.Val "MICROSAR RTE" /begin SUB_GROUP /end SUB_GROUP /begin FUNCTION_LIST /end FUNCTION_LIST /begin REF_CHARACTERISTIC /end REF_CHARACTERISTIC /begin REF_MEASUREMENT MotRefMdl.BrdgVltg.Val /end REF_MEASUREMENT /end GROUP
/begin GROUP MotRefMdl.CalibrationPorts "MICROSAR RTE"
 /begin SUB_GROUP MotRefMdl.MotRefMdlCurrDaxBoostGain.Val MotRefMdl.MotRefMdlCurrDaxBoostTqScaX.Ary1D MotRefMdl.MotRefMdlCurrDaxBoostTqScaY.Ary1D MotRefMdl.MotRefMdlCurrDaxQaxRefDelta.Ary1D MotRefMdl.MotRefMdlCurrItrnTolr.Val MotRefMdl.MotRefMdlFbCtrlDi.Logl MotRefMdl.MotRefMdlIvtrDeadTiBrdgVltgSca.Val MotRefMdl.MotRefMdlMinCurrItrnLim.Val MotRefMdl.MotRefMdlMotCurrDaxMaxSca.Val MotRefMdl.MotRefMdlMotVelLpFilFrq.Val MotRefMdl.MotRefMdlMotVltgDerivtvTiCon.Val MotRefMdl.MotRefMdlQuad13VltgSdlX.Ary1D MotRefMdl.MotRefMdlQuad13VltgSdlY.Ary1D MotRefMdl.MotRefMdlQuad24VltgSdlX.Ary1D MotRefMdl.MotRefMdlQuad24VltgSdlY.Ary1D MotRefMdl.MotRefMdlRefLocnItrnLim.Val MotRefMdl.MotRefMdlTqItrnLim.Val MotRefMdl.MotRefMdlTqItrnTolr.Val MotRefMdl.MotRefMdlVltgModDynCmpEna.Logl MotRefMdl.MotRefMdlVltgOverRThdSca.Val MotRefMdl.SysGlbPrmMotPoleCnt.Val /end SUB_GROUP
 /begin FUNCTION_LIST /end FUNCTION_LIST
 /begin REF_CHARACTERISTIC /end REF_CHARACTERISTIC
 /begin REF_MEASUREMENT /end REF_MEASUREMENT
/end GROUP
/begin GROUP MotRefMdl.CosDelta "MICROSAR RTE" /begin SUB_GROUP /end SUB_GROUP /begin FUNCTION_LIST /end FUNCTION_LIST /begin REF_CHARACTERISTIC /end REF_CHARACTERISTIC /begin REF_MEASUREMENT MotRefMdl.CosDelta /end REF_MEASUREMENT /end GROUP
/begin GROUP MotRefMdl.DualEcuMotCtrlMtgtnEna.Logl "MICROSAR RTE" /begin SUB_GROUP /end SUB_GROUP /begin FUNCTION_LIST /end FUNCTION_LIST /begin REF_CHARACTERISTIC /end REF_CHARACTERISTIC /begin REF_MEASUREMENT MotRefMdl.DualEcuMotCtrlMtgtnEna.Logl /end REF_MEASUREMENT /end GROUP
/begin GROUP MotRefMdl.MotAndThermProtnLoaMod.Val "MICROSAR RTE" /begin SUB_GROUP /end SUB_GROUP /begin FUNCTION_LIST /end FUNCTION_LIST /begin REF_CHARACTERISTIC /end REF_CHARACTERISTIC /begin REF_MEASUREMENT MotRefMdl.MotAndThermProtnLoaMod.Val /end REF_MEASUREMENT /end GROUP
/begin GROUP MotRefMdl.MotBackEmfConEstimd.Val "MICROSAR RTE" /begin SUB_GROUP /end SUB_GROUP /begin FUNCTION_LIST /end FUNCTION_LIST /begin REF_CHARACTERISTIC /end REF_CHARACTERISTIC /begin REF_MEASUREMENT MotRefMdl.MotBackEmfConEstimd.Val /end REF_MEASUREMENT /end GROUP
/begin GROUP MotRefMdl.MotBackEmfVltg.Val "MICROSAR RTE" /begin SUB_GROUP /end SUB_GROUP /begin FUNCTION_LIST /end FUNCTION_LIST /begin REF_CHARACTERISTIC /end REF_CHARACTERISTIC /begin REF_MEASUREMENT MotRefMdl.MotBackEmfVltg.Val /end REF_MEASUREMENT /end GROUP
/begin GROUP MotRefMdl.MotCurrAg.Val "MICROSAR RTE" /begin SUB_GROUP /end SUB_GROUP /begin FUNCTION_LIST /end FUNCTION_LIST /begin REF_CHARACTERISTIC /end REF_CHARACTERISTIC /begin REF_MEASUREMENT MotRefMdl.MotCurrAg.Val /end REF_MEASUREMENT /end GROUP
/begin GROUP MotRefMdl.MotCurrDaxCmd.Val "MICROSAR RTE" /begin SUB_GROUP /end SUB_GROUP /begin FUNCTION_LIST /end FUNCTION_LIST /begin REF_CHARACTERISTIC /end REF_CHARACTERISTIC /begin REF_MEASUREMENT MotRefMdl.MotCurrDaxCmd.Val /end REF_MEASUREMENT /end GROUP
/begin GROUP MotRefMdl.MotCurrDaxCmdPrev "MICROSAR RTE" /begin SUB_GROUP /end SUB_GROUP /begin FUNCTION_LIST /end FUNCTION_LIST /begin REF_CHARACTERISTIC /end REF_CHARACTERISTIC /begin REF_MEASUREMENT MotRefMdl.MotCurrDaxCmdPrev /end REF_MEASUREMENT /end GROUP
/begin GROUP MotRefMdl.MotCurrDaxMax.Val "MICROSAR RTE" /begin SUB_GROUP /end SUB_GROUP /begin FUNCTION_LIST /end FUNCTION_LIST /begin REF_CHARACTERISTIC /end REF_CHARACTERISTIC /begin REF_MEASUREMENT MotRefMdl.MotCurrDaxMax.Val /end REF_MEASUREMENT /end GROUP
/begin GROUP MotRefMdl.MotCurrQaxCmd.Val "MICROSAR RTE" /begin SUB_GROUP /end SUB_GROUP /begin FUNCTION_LIST /end FUNCTION_LIST /begin REF_CHARACTERISTIC /end REF_CHARACTERISTIC /begin REF_MEASUREMENT MotRefMdl.MotCurrQaxCmd.Val /end REF_MEASUREMENT /end GROUP
/begin GROUP MotRefMdl.MotCurrQaxCmdPrev "MICROSAR RTE" /begin SUB_GROUP /end SUB_GROUP /begin FUNCTION_LIST /end FUNCTION_LIST /begin REF_CHARACTERISTIC /end REF_CHARACTERISTIC /begin REF_MEASUREMENT MotRefMdl.MotCurrQaxCmdPrev /end REF_MEASUREMENT /end GROUP
/begin GROUP MotRefMdl.MotInduDaxEstimd.Val "MICROSAR RTE" /begin SUB_GROUP /end SUB_GROUP /begin FUNCTION_LIST /end FUNCTION_LIST /begin REF_CHARACTERISTIC /end REF_CHARACTERISTIC /begin REF_MEASUREMENT MotRefMdl.MotInduDaxEstimd.Val /end REF_MEASUREMENT /end GROUP
/begin GROUP MotRefMdl.MotInduQaxEstimd.Val "MICROSAR RTE" /begin SUB_GROUP /end SUB_GROUP /begin FUNCTION_LIST /end FUNCTION_LIST /begin REF_CHARACTERISTIC /end REF_CHARACTERISTIC /begin REF_MEASUREMENT MotRefMdl.MotInduQaxEstimd.Val /end REF_MEASUREMENT /end GROUP
/begin GROUP MotRefMdl.MotQuad.Val "MICROSAR RTE" /begin SUB_GROUP /end SUB_GROUP /begin FUNCTION_LIST /end FUNCTION_LIST /begin REF_CHARACTERISTIC /end REF_CHARACTERISTIC /begin REF_MEASUREMENT MotRefMdl.MotQuad.Val /end REF_MEASUREMENT /end GROUP
/begin GROUP MotRefMdl.MotREstimd.Val "MICROSAR RTE" /begin SUB_GROUP /end SUB_GROUP /begin FUNCTION_LIST /end FUNCTION_LIST /begin REF_CHARACTERISTIC /end REF_CHARACTERISTIC /begin REF_MEASUREMENT MotRefMdl.MotREstimd.Val /end REF_MEASUREMENT /end GROUP
/begin GROUP MotRefMdl.MotReacncDax.Val "MICROSAR RTE" /begin SUB_GROUP /end SUB_GROUP /begin FUNCTION_LIST /end FUNCTION_LIST /begin REF_CHARACTERISTIC /end REF_CHARACTERISTIC /begin REF_MEASUREMENT MotRefMdl.MotReacncDax.Val /end REF_MEASUREMENT /end GROUP
/begin GROUP MotRefMdl.MotReacncQax.Val "MICROSAR RTE" /begin SUB_GROUP /end SUB_GROUP /begin FUNCTION_LIST /end FUNCTION_LIST /begin REF_CHARACTERISTIC /end REF_CHARACTERISTIC /begin REF_MEASUREMENT MotRefMdl.MotReacncQax.Val /end REF_MEASUREMENT /end GROUP
/begin GROUP MotRefMdl.MotRefMdlCurrDaxBoostGain.Val "MICROSAR RTE" /begin SUB_GROUP /end SUB_GROUP /begin FUNCTION_LIST /end FUNCTION_LIST /begin REF_CHARACTERISTIC MotRefMdl.MotRefMdlCurrDaxBoostGain.Val /end REF_CHARACTERISTIC /begin REF_MEASUREMENT /end REF_MEASUREMENT /end GROUP
/begin GROUP MotRefMdl.MotRefMdlCurrDaxBoostTqScaX.Ary1D "MICROSAR RTE" /begin SUB_GROUP /end SUB_GROUP /begin FUNCTION_LIST /end FUNCTION_LIST /begin REF_CHARACTERISTIC MotRefMdl.MotRefMdlCurrDaxBoostTqScaX.Ary1D /end REF_CHARACTERISTIC /begin REF_MEASUREMENT /end REF_MEASUREMENT /end GROUP
/begin GROUP MotRefMdl.MotRefMdlCurrDaxBoostTqScaY.Ary1D "MICROSAR RTE" /begin SUB_GROUP /end SUB_GROUP /begin FUNCTION_LIST /end FUNCTION_LIST /begin REF_CHARACTERISTIC MotRefMdl.MotRefMdlCurrDaxBoostTqScaY.Ary1D /end REF_CHARACTERISTIC /begin REF_MEASUREMENT /end REF_MEASUREMENT /end GROUP
/begin GROUP MotRefMdl.MotRefMdlCurrDaxQaxRefDelta.Ary1D "MICROSAR RTE" /begin SUB_GROUP /end SUB_GROUP /begin FUNCTION_LIST /end FUNCTION_LIST /begin REF_CHARACTERISTIC MotRefMdl.MotRefMdlCurrDaxQaxRefDelta.Ary1D /end REF_CHARACTERISTIC /begin REF_MEASUREMENT /end REF_MEASUREMENT /end GROUP
/begin GROUP MotRefMdl.MotRefMdlCurrItrnTolr.Val "MICROSAR RTE" /begin SUB_GROUP /end SUB_GROUP /begin FUNCTION_LIST /end FUNCTION_LIST /begin REF_CHARACTERISTIC MotRefMdl.MotRefMdlCurrItrnTolr.Val /end REF_CHARACTERISTIC /begin REF_MEASUREMENT /end REF_MEASUREMENT /end GROUP
/begin GROUP MotRefMdl.MotRefMdlFbCtrlDi.Logl "MICROSAR RTE" /begin SUB_GROUP /end SUB_GROUP /begin FUNCTION_LIST /end FUNCTION_LIST /begin REF_CHARACTERISTIC MotRefMdl.MotRefMdlFbCtrlDi.Logl /end REF_CHARACTERISTIC /begin REF_MEASUREMENT /end REF_MEASUREMENT /end GROUP
/begin GROUP MotRefMdl.MotRefMdlIvtrDeadTiBrdgVltgSca.Val "MICROSAR RTE" /begin SUB_GROUP /end SUB_GROUP /begin FUNCTION_LIST /end FUNCTION_LIST /begin REF_CHARACTERISTIC MotRefMdl.MotRefMdlIvtrDeadTiBrdgVltgSca.Val /end REF_CHARACTERISTIC /begin REF_MEASUREMENT /end REF_MEASUREMENT /end GROUP
/begin GROUP MotRefMdl.MotRefMdlMinCurrItrnLim.Val "MICROSAR RTE" /begin SUB_GROUP /end SUB_GROUP /begin FUNCTION_LIST /end FUNCTION_LIST /begin REF_CHARACTERISTIC MotRefMdl.MotRefMdlMinCurrItrnLim.Val /end REF_CHARACTERISTIC /begin REF_MEASUREMENT /end REF_MEASUREMENT /end GROUP
/begin GROUP MotRefMdl.MotRefMdlMotCurrDaxMaxSca.Val "MICROSAR RTE" /begin SUB_GROUP /end SUB_GROUP /begin FUNCTION_LIST /end FUNCTION_LIST /begin REF_CHARACTERISTIC MotRefMdl.MotRefMdlMotCurrDaxMaxSca.Val /end REF_CHARACTERISTIC /begin REF_MEASUREMENT /end REF_MEASUREMENT /end GROUP
/begin GROUP MotRefMdl.MotRefMdlMotVelLpFilFrq.Val "MICROSAR RTE" /begin SUB_GROUP /end SUB_GROUP /begin FUNCTION_LIST /end FUNCTION_LIST /begin REF_CHARACTERISTIC MotRefMdl.MotRefMdlMotVelLpFilFrq.Val /end REF_CHARACTERISTIC /begin REF_MEASUREMENT /end REF_MEASUREMENT /end GROUP
/begin GROUP MotRefMdl.MotRefMdlMotVltgDerivtvTiCon.Val "MICROSAR RTE" /begin SUB_GROUP /end SUB_GROUP /begin FUNCTION_LIST /end FUNCTION_LIST /begin REF_CHARACTERISTIC MotRefMdl.MotRefMdlMotVltgDerivtvTiCon.Val /end REF_CHARACTERISTIC /begin REF_MEASUREMENT /end REF_MEASUREMENT /end GROUP
/begin GROUP MotRefMdl.MotRefMdlQuad13VltgSdlX.Ary1D "MICROSAR RTE" /begin SUB_GROUP /end SUB_GROUP /begin FUNCTION_LIST /end FUNCTION_LIST /begin REF_CHARACTERISTIC MotRefMdl.MotRefMdlQuad13VltgSdlX.Ary1D /end REF_CHARACTERISTIC /begin REF_MEASUREMENT /end REF_MEASUREMENT /end GROUP
/begin GROUP MotRefMdl.MotRefMdlQuad13VltgSdlY.Ary1D "MICROSAR RTE" /begin SUB_GROUP /end SUB_GROUP /begin FUNCTION_LIST /end FUNCTION_LIST /begin REF_CHARACTERISTIC MotRefMdl.MotRefMdlQuad13VltgSdlY.Ary1D /end REF_CHARACTERISTIC /begin REF_MEASUREMENT /end REF_MEASUREMENT /end GROUP
/begin GROUP MotRefMdl.MotRefMdlQuad24VltgSdlX.Ary1D "MICROSAR RTE" /begin SUB_GROUP /end SUB_GROUP /begin FUNCTION_LIST /end FUNCTION_LIST /begin REF_CHARACTERISTIC MotRefMdl.MotRefMdlQuad24VltgSdlX.Ary1D /end REF_CHARACTERISTIC /begin REF_MEASUREMENT /end REF_MEASUREMENT /end GROUP
/begin GROUP MotRefMdl.MotRefMdlQuad24VltgSdlY.Ary1D "MICROSAR RTE" /begin SUB_GROUP /end SUB_GROUP /begin FUNCTION_LIST /end FUNCTION_LIST /begin REF_CHARACTERISTIC MotRefMdl.MotRefMdlQuad24VltgSdlY.Ary1D /end REF_CHARACTERISTIC /begin REF_MEASUREMENT /end REF_MEASUREMENT /end GROUP
/begin GROUP MotRefMdl.MotRefMdlRefLocnItrnLim.Val "MICROSAR RTE" /begin SUB_GROUP /end SUB_GROUP /begin FUNCTION_LIST /end FUNCTION_LIST /begin REF_CHARACTERISTIC MotRefMdl.MotRefMdlRefLocnItrnLim.Val /end REF_CHARACTERISTIC /begin REF_MEASUREMENT /end REF_MEASUREMENT /end GROUP
/begin GROUP MotRefMdl.MotRefMdlTqItrnLim.Val "MICROSAR RTE" /begin SUB_GROUP /end SUB_GROUP /begin FUNCTION_LIST /end FUNCTION_LIST /begin REF_CHARACTERISTIC MotRefMdl.MotRefMdlTqItrnLim.Val /end REF_CHARACTERISTIC /begin REF_MEASUREMENT /end REF_MEASUREMENT /end GROUP
/begin GROUP MotRefMdl.MotRefMdlTqItrnTolr.Val "MICROSAR RTE" /begin SUB_GROUP /end SUB_GROUP /begin FUNCTION_LIST /end FUNCTION_LIST /begin REF_CHARACTERISTIC MotRefMdl.MotRefMdlTqItrnTolr.Val /end REF_CHARACTERISTIC /begin REF_MEASUREMENT /end REF_MEASUREMENT /end GROUP
/begin GROUP MotRefMdl.MotRefMdlVltgModDynCmpEna.Logl "MICROSAR RTE" /begin SUB_GROUP /end SUB_GROUP /begin FUNCTION_LIST /end FUNCTION_LIST /begin REF_CHARACTERISTIC MotRefMdl.MotRefMdlVltgModDynCmpEna.Logl /end REF_CHARACTERISTIC /begin REF_MEASUREMENT /end REF_MEASUREMENT /end GROUP
/begin GROUP MotRefMdl.MotRefMdlVltgOverRThdSca.Val "MICROSAR RTE" /begin SUB_GROUP /end SUB_GROUP /begin FUNCTION_LIST /end FUNCTION_LIST /begin REF_CHARACTERISTIC MotRefMdl.MotRefMdlVltgOverRThdSca.Val /end REF_CHARACTERISTIC /begin REF_MEASUREMENT /end REF_MEASUREMENT /end GROUP
/begin GROUP MotRefMdl.MotTqCmdMrfScad.Val "MICROSAR RTE" /begin SUB_GROUP /end SUB_GROUP /begin FUNCTION_LIST /end FUNCTION_LIST /begin REF_CHARACTERISTIC /end REF_CHARACTERISTIC /begin REF_MEASUREMENT MotRefMdl.MotTqCmdMrfScad.Val /end REF_MEASUREMENT /end GROUP
/begin GROUP MotRefMdl.MotVelLpFil "MICROSAR RTE" /begin SUB_GROUP /end SUB_GROUP /begin FUNCTION_LIST /end FUNCTION_LIST /begin REF_CHARACTERISTIC /end REF_CHARACTERISTIC /begin REF_MEASUREMENT MotRefMdl.MotVelLpFil.FilGain MotRefMdl.MotVelLpFil.FilSt /end REF_MEASUREMENT /end GROUP
/begin GROUP MotRefMdl.MotVelMrf.Val "MICROSAR RTE" /begin SUB_GROUP /end SUB_GROUP /begin FUNCTION_LIST /end FUNCTION_LIST /begin REF_CHARACTERISTIC /end REF_CHARACTERISTIC /begin REF_MEASUREMENT MotRefMdl.MotVelMrf.Val /end REF_MEASUREMENT /end GROUP
/begin GROUP MotRefMdl.MotVltgDaxFf.Val "MICROSAR RTE" /begin SUB_GROUP /end SUB_GROUP /begin FUNCTION_LIST /end FUNCTION_LIST /begin REF_CHARACTERISTIC /end REF_CHARACTERISTIC /begin REF_MEASUREMENT MotRefMdl.MotVltgDaxFf.Val /end REF_MEASUREMENT /end GROUP
/begin GROUP MotRefMdl.MotVltgDaxFfStat.Val "MICROSAR RTE" /begin SUB_GROUP /end SUB_GROUP /begin FUNCTION_LIST /end FUNCTION_LIST /begin REF_CHARACTERISTIC /end REF_CHARACTERISTIC /begin REF_MEASUREMENT MotRefMdl.MotVltgDaxFfStat.Val /end REF_MEASUREMENT /end GROUP
/begin GROUP MotRefMdl.MotVltgQaxFf.Val "MICROSAR RTE" /begin SUB_GROUP /end SUB_GROUP /begin FUNCTION_LIST /end FUNCTION_LIST /begin REF_CHARACTERISTIC /end REF_CHARACTERISTIC /begin REF_MEASUREMENT MotRefMdl.MotVltgQaxFf.Val /end REF_MEASUREMENT /end GROUP
/begin GROUP MotRefMdl.MotVltgQaxFfStat.Val "MICROSAR RTE" /begin SUB_GROUP /end SUB_GROUP /begin FUNCTION_LIST /end FUNCTION_LIST /begin REF_CHARACTERISTIC /end REF_CHARACTERISTIC /begin REF_MEASUREMENT MotRefMdl.MotVltgQaxFfStat.Val /end REF_MEASUREMENT /end GROUP
/begin GROUP MotRefMdl.MotVltgSatnIndFf.Val "MICROSAR RTE" /begin SUB_GROUP /end SUB_GROUP /begin FUNCTION_LIST /end FUNCTION_LIST /begin REF_CHARACTERISTIC /end REF_CHARACTERISTIC /begin REF_MEASUREMENT MotRefMdl.MotVltgSatnIndFf.Val /end REF_MEASUREMENT /end GROUP
/begin GROUP MotRefMdl.PerInstanceMemories "MICROSAR RTE"
 /begin SUB_GROUP MotRefMdl.CosDelta MotRefMdl.MotCurrDaxCmdPrev MotRefMdl.MotCurrQaxCmdPrev MotRefMdl.MotVelLpFil MotRefMdl.SinDelta MotRefMdl.VltgDaxFfTermPrev MotRefMdl.VltgQaxFfTermPrev MotRefMdl.dMotRefMdlCurrDaxAtPeakTq MotRefMdl.dMotRefMdlCurrDaxMin MotRefMdl.dMotRefMdlCurrQaxMin MotRefMdl.dMotRefMdlCurrSqdMin MotRefMdl.dMotRefMdlInterCalcnCurrDaxMax MotRefMdl.dMotRefMdlMinCurrNrItrn MotRefMdl.dMotRefMdlMotCurrDaxBoost MotRefMdl.dMotRefMdlMotTqCmdLimd MotRefMdl.dMotRefMdlMotVelFildFf MotRefMdl.dMotRefMdlMotVltgDaxFfDyn MotRefMdl.dMotRefMdlMotVltgDaxFfDynTerm MotRefMdl.dMotRefMdlMotVltgDaxFfStat MotRefMdl.dMotRefMdlMotVltgQaxFfDyn MotRefMdl.dMotRefMdlMotVltgQaxFfDynTerm MotRefMdl.dMotRefMdlMotVltgQaxFfStat MotRefMdl.dMotRefMdlPeakTq MotRefMdl.dMotRefMdlPeakTqNrItrn MotRefMdl.dMotRefMdlPhaAdvAtPeakTq MotRefMdl.dMotRefMdlReacncDaxOverR MotRefMdl.dMotRefMdlReacncQaxOverR MotRefMdl.dMotRefMdlRelncTqCoeff /end SUB_GROUP
 /begin FUNCTION_LIST /end FUNCTION_LIST
 /begin REF_CHARACTERISTIC /end REF_CHARACTERISTIC
 /begin REF_MEASUREMENT /end REF_MEASUREMENT
/end GROUP
/begin GROUP MotRefMdl.ReceiverPorts "MICROSAR RTE"
 /begin SUB_GROUP MotRefMdl.BrdgVltg.Val MotRefMdl.DualEcuMotCtrlMtgtnEna.Logl MotRefMdl.MotAndThermProtnLoaMod.Val MotRefMdl.MotBackEmfConEstimd.Val MotRefMdl.MotInduDaxEstimd.Val MotRefMdl.MotInduQaxEstimd.Val MotRefMdl.MotQuad.Val MotRefMdl.MotREstimd.Val MotRefMdl.MotTqCmdMrfScad.Val MotRefMdl.MotVelMrf.Val /end SUB_GROUP
 /begin FUNCTION_LIST /end FUNCTION_LIST
 /begin REF_CHARACTERISTIC /end REF_CHARACTERISTIC
 /begin REF_MEASUREMENT /end REF_MEASUREMENT
/end GROUP
/begin GROUP MotRefMdl.SenderPorts "MICROSAR RTE"
 /begin SUB_GROUP MotRefMdl.MotBackEmfVltg.Val MotRefMdl.MotCurrAg.Val MotRefMdl.MotCurrDaxCmd.Val MotRefMdl.MotCurrDaxMax.Val MotRefMdl.MotCurrQaxCmd.Val MotRefMdl.MotReacncDax.Val MotRefMdl.MotReacncQax.Val MotRefMdl.MotVltgDaxFf.Val MotRefMdl.MotVltgDaxFfStat.Val MotRefMdl.MotVltgQaxFf.Val MotRefMdl.MotVltgQaxFfStat.Val MotRefMdl.MotVltgSatnIndFf.Val /end SUB_GROUP
 /begin FUNCTION_LIST /end FUNCTION_LIST
 /begin REF_CHARACTERISTIC /end REF_CHARACTERISTIC
 /begin REF_MEASUREMENT /end REF_MEASUREMENT
/end GROUP
/begin GROUP MotRefMdl.SinDelta "MICROSAR RTE" /begin SUB_GROUP /end SUB_GROUP /begin FUNCTION_LIST /end FUNCTION_LIST /begin REF_CHARACTERISTIC /end REF_CHARACTERISTIC /begin REF_MEASUREMENT MotRefMdl.SinDelta /end REF_MEASUREMENT /end GROUP
/begin GROUP MotRefMdl.SysGlbPrmMotPoleCnt.Val "MICROSAR RTE" /begin SUB_GROUP /end SUB_GROUP /begin FUNCTION_LIST /end FUNCTION_LIST /begin REF_CHARACTERISTIC MotRefMdl.SysGlbPrmMotPoleCnt.Val /end REF_CHARACTERISTIC /begin REF_MEASUREMENT /end REF_MEASUREMENT /end GROUP
/begin GROUP MotRefMdl.VltgDaxFfTermPrev "MICROSAR RTE" /begin SUB_GROUP /end SUB_GROUP /begin FUNCTION_LIST /end FUNCTION_LIST /begin REF_CHARACTERISTIC /end REF_CHARACTERISTIC /begin REF_MEASUREMENT MotRefMdl.VltgDaxFfTermPrev /end REF_MEASUREMENT /end GROUP
/begin GROUP MotRefMdl.VltgQaxFfTermPrev "MICROSAR RTE" /begin SUB_GROUP /end SUB_GROUP /begin FUNCTION_LIST /end FUNCTION_LIST /begin REF_CHARACTERISTIC /end REF_CHARACTERISTIC /begin REF_MEASUREMENT MotRefMdl.VltgQaxFfTermPrev /end REF_MEASUREMENT /end GROUP
/begin GROUP MotRefMdl.dMotRefMdlCurrDaxAtPeakTq "MICROSAR RTE" /begin SUB_GROUP /end SUB_GROUP /begin FUNCTION_LIST /end FUNCTION_LIST /begin REF_CHARACTERISTIC /end REF_CHARACTERISTIC /begin REF_MEASUREMENT MotRefMdl.dMotRefMdlCurrDaxAtPeakTq /end REF_MEASUREMENT /end GROUP
/begin GROUP MotRefMdl.dMotRefMdlCurrDaxMin "MICROSAR RTE" /begin SUB_GROUP /end SUB_GROUP /begin FUNCTION_LIST /end FUNCTION_LIST /begin REF_CHARACTERISTIC /end REF_CHARACTERISTIC /begin REF_MEASUREMENT MotRefMdl.dMotRefMdlCurrDaxMin /end REF_MEASUREMENT /end GROUP
/begin GROUP MotRefMdl.dMotRefMdlCurrQaxMin "MICROSAR RTE" /begin SUB_GROUP /end SUB_GROUP /begin FUNCTION_LIST /end FUNCTION_LIST /begin REF_CHARACTERISTIC /end REF_CHARACTERISTIC /begin REF_MEASUREMENT MotRefMdl.dMotRefMdlCurrQaxMin /end REF_MEASUREMENT /end GROUP
/begin GROUP MotRefMdl.dMotRefMdlCurrSqdMin "MICROSAR RTE" /begin SUB_GROUP /end SUB_GROUP /begin FUNCTION_LIST /end FUNCTION_LIST /begin REF_CHARACTERISTIC /end REF_CHARACTERISTIC /begin REF_MEASUREMENT MotRefMdl.dMotRefMdlCurrSqdMin /end REF_MEASUREMENT /end GROUP
/begin GROUP MotRefMdl.dMotRefMdlInterCalcnCurrDaxMax "MICROSAR RTE" /begin SUB_GROUP /end SUB_GROUP /begin FUNCTION_LIST /end FUNCTION_LIST /begin REF_CHARACTERISTIC /end REF_CHARACTERISTIC /begin REF_MEASUREMENT MotRefMdl.dMotRefMdlInterCalcnCurrDaxMax /end REF_MEASUREMENT /end GROUP
/begin GROUP MotRefMdl.dMotRefMdlMinCurrNrItrn "MICROSAR RTE" /begin SUB_GROUP /end SUB_GROUP /begin FUNCTION_LIST /end FUNCTION_LIST /begin REF_CHARACTERISTIC /end REF_CHARACTERISTIC /begin REF_MEASUREMENT MotRefMdl.dMotRefMdlMinCurrNrItrn /end REF_MEASUREMENT /end GROUP
/begin GROUP MotRefMdl.dMotRefMdlMotCurrDaxBoost "MICROSAR RTE" /begin SUB_GROUP /end SUB_GROUP /begin FUNCTION_LIST /end FUNCTION_LIST /begin REF_CHARACTERISTIC /end REF_CHARACTERISTIC /begin REF_MEASUREMENT MotRefMdl.dMotRefMdlMotCurrDaxBoost /end REF_MEASUREMENT /end GROUP
/begin GROUP MotRefMdl.dMotRefMdlMotTqCmdLimd "MICROSAR RTE" /begin SUB_GROUP /end SUB_GROUP /begin FUNCTION_LIST /end FUNCTION_LIST /begin REF_CHARACTERISTIC /end REF_CHARACTERISTIC /begin REF_MEASUREMENT MotRefMdl.dMotRefMdlMotTqCmdLimd /end REF_MEASUREMENT /end GROUP
/begin GROUP MotRefMdl.dMotRefMdlMotVelFildFf "MICROSAR RTE" /begin SUB_GROUP /end SUB_GROUP /begin FUNCTION_LIST /end FUNCTION_LIST /begin REF_CHARACTERISTIC /end REF_CHARACTERISTIC /begin REF_MEASUREMENT MotRefMdl.dMotRefMdlMotVelFildFf /end REF_MEASUREMENT /end GROUP
/begin GROUP MotRefMdl.dMotRefMdlMotVltgDaxFfDyn "MICROSAR RTE" /begin SUB_GROUP /end SUB_GROUP /begin FUNCTION_LIST /end FUNCTION_LIST /begin REF_CHARACTERISTIC /end REF_CHARACTERISTIC /begin REF_MEASUREMENT MotRefMdl.dMotRefMdlMotVltgDaxFfDyn /end REF_MEASUREMENT /end GROUP
/begin GROUP MotRefMdl.dMotRefMdlMotVltgDaxFfDynTerm "MICROSAR RTE" /begin SUB_GROUP /end SUB_GROUP /begin FUNCTION_LIST /end FUNCTION_LIST /begin REF_CHARACTERISTIC /end REF_CHARACTERISTIC /begin REF_MEASUREMENT MotRefMdl.dMotRefMdlMotVltgDaxFfDynTerm /end REF_MEASUREMENT /end GROUP
/begin GROUP MotRefMdl.dMotRefMdlMotVltgDaxFfStat "MICROSAR RTE" /begin SUB_GROUP /end SUB_GROUP /begin FUNCTION_LIST /end FUNCTION_LIST /begin REF_CHARACTERISTIC /end REF_CHARACTERISTIC /begin REF_MEASUREMENT MotRefMdl.dMotRefMdlMotVltgDaxFfStat /end REF_MEASUREMENT /end GROUP
/begin GROUP MotRefMdl.dMotRefMdlMotVltgQaxFfDyn "MICROSAR RTE" /begin SUB_GROUP /end SUB_GROUP /begin FUNCTION_LIST /end FUNCTION_LIST /begin REF_CHARACTERISTIC /end REF_CHARACTERISTIC /begin REF_MEASUREMENT MotRefMdl.dMotRefMdlMotVltgQaxFfDyn /end REF_MEASUREMENT /end GROUP
/begin GROUP MotRefMdl.dMotRefMdlMotVltgQaxFfDynTerm "MICROSAR RTE" /begin SUB_GROUP /end SUB_GROUP /begin FUNCTION_LIST /end FUNCTION_LIST /begin REF_CHARACTERISTIC /end REF_CHARACTERISTIC /begin REF_MEASUREMENT MotRefMdl.dMotRefMdlMotVltgQaxFfDynTerm /end REF_MEASUREMENT /end GROUP
/begin GROUP MotRefMdl.dMotRefMdlMotVltgQaxFfStat "MICROSAR RTE" /begin SUB_GROUP /end SUB_GROUP /begin FUNCTION_LIST /end FUNCTION_LIST /begin REF_CHARACTERISTIC /end REF_CHARACTERISTIC /begin REF_MEASUREMENT MotRefMdl.dMotRefMdlMotVltgQaxFfStat /end REF_MEASUREMENT /end GROUP
/begin GROUP MotRefMdl.dMotRefMdlPeakTq "MICROSAR RTE" /begin SUB_GROUP /end SUB_GROUP /begin FUNCTION_LIST /end FUNCTION_LIST /begin REF_CHARACTERISTIC /end REF_CHARACTERISTIC /begin REF_MEASUREMENT MotRefMdl.dMotRefMdlPeakTq /end REF_MEASUREMENT /end GROUP
/begin GROUP MotRefMdl.dMotRefMdlPeakTqNrItrn "MICROSAR RTE" /begin SUB_GROUP /end SUB_GROUP /begin FUNCTION_LIST /end FUNCTION_LIST /begin REF_CHARACTERISTIC /end REF_CHARACTERISTIC /begin REF_MEASUREMENT MotRefMdl.dMotRefMdlPeakTqNrItrn /end REF_MEASUREMENT /end GROUP
/begin GROUP MotRefMdl.dMotRefMdlPhaAdvAtPeakTq "MICROSAR RTE" /begin SUB_GROUP /end SUB_GROUP /begin FUNCTION_LIST /end FUNCTION_LIST /begin REF_CHARACTERISTIC /end REF_CHARACTERISTIC /begin REF_MEASUREMENT MotRefMdl.dMotRefMdlPhaAdvAtPeakTq /end REF_MEASUREMENT /end GROUP
/**********************************************************************************************************************
* RECORD_LAYOUT
*********************************************************************************************************************/
/begin RECORD_LAYOUT RTE_RL_UBYTE FNC_VALUES 1 UBYTE ROW_DIR DIRECT /end RECORD_LAYOUT
/begin RECORD_LAYOUT RTE_RL_UWORD FNC_VALUES 1 UWORD ROW_DIR DIRECT /end RECORD_LAYOUT
/begin RECORD_LAYOUT RTE_RL_SLONG FNC_VALUES 1 SLONG ROW_DIR DIRECT /end RECORD_LAYOUT
/begin RECORD_LAYOUT RTE_RL_FLOAT32_IEEE FNC_VALUES 1 FLOAT32_IEEE ROW_DIR DIRECT /end RECORD_LAYOUT
/begin RECORD_LAYOUT RTE_RL_BOOLEAN FNC_VALUES 1 UBYTE ROW_DIR DIRECT /end RECORD_LAYOUT
/**********************************************************************************************************************
* COMPU_METHOD / COMPU_VTAB_RANGE
*********************************************************************************************************************/
/begin COMPU_METHOD RTE_CM_BOOLEAN "" TAB_VERB "%3.1" "" COMPU_TAB_REF RTE_CM_BOOLEAN /end COMPU_METHOD
/begin COMPU_VTAB_RANGE RTE_CM_BOOLEAN "" 2 0 0 "false" 1 255 "true" /end COMPU_VTAB_RANGE
/begin COMPU_METHOD RTE_CM_ENUM_SigQlfr1 "" TAB_VERB "%.1" "" COMPU_TAB_REF RTE_CM_ENUM_SigQlfr1 /end COMPU_METHOD
/begin COMPU_VTAB_RANGE RTE_CM_ENUM_SigQlfr1 "" 3 0 0 "SIGQLFR_NORES" 1 1 "SIGQLFR_PASSD" 2 2 "SIGQLFR_FAILD" /end COMPU_VTAB_RANGE
/begin COMPU_METHOD RTE_CM_ENUM_MotCurrEolCalSt2 "" TAB_VERB "%.1" "" COMPU_TAB_REF RTE_CM_ENUM_MotCurrEolCalSt2 /end COMPU_METHOD
/begin COMPU_VTAB_RANGE RTE_CM_ENUM_MotCurrEolCalSt2 "" 9 0 0 "MCECS_OFFSCMDSTRT" 1 1 "MCECS_OFFSCMDHI" 2 2 "MCECS_OFFSCMDLO" 3 3 "MCECS_OFFSCMDZERO" 4 4 "MCECS_OFFSCMDEND" 5 5 "MCECS_GAINCMDAD" 6 6 "MCECS_GAINCMDBE" 7 7 "MCECS_GAINCMDCF" 8 8 "MCECS_CMDSAFEST" /end COMPU_VTAB_RANGE
/begin COMPU_METHOD RTE_CM_Ag5 "" RAT_FUNC "%.1" "MotRev" COEFFS 0 65536 0 0 0 1 /end COMPU_METHOD
/begin COMPU_METHOD RTE_CM_ENUM_LoaSt1 "" TAB_VERB "%.1" "" COMPU_TAB_REF RTE_CM_ENUM_LoaSt1 /end COMPU_METHOD
/begin COMPU_VTAB_RANGE RTE_CM_ENUM_LoaSt1 "" 6 0 0 "LOAST_NORM" 1 1 "LOAST_LIMD" 2 2 "LOAST_SWBASDMTGTN" 3 3 "LOAST_FADEOUT" 4 4 "LOAST_CTRLDSHTDWNREQD" 5 5 "LOAST_IMDTSHTDWNREQD" /end COMPU_VTAB_RANGE
/begin COMPU_METHOD RTE_CM_ENUM_SteerMod1 "" TAB_VERB "%.1" "" COMPU_TAB_REF RTE_CM_ENUM_SteerMod1 /end COMPU_METHOD
/begin COMPU_VTAB_RANGE RTE_CM_ENUM_SteerMod1 "" 3 0 0 "STEERMOD_BASEPS" 1 1 "STEERMOD_SEMIATNMS" 2 2 "STEERMOD_FULLYATNMS" /end COMPU_VTAB_RANGE
/begin COMPU_METHOD RTE_CM_ENUM_MotQuad1 "" TAB_VERB "%.1" "" COMPU_TAB_REF RTE_CM_ENUM_MotQuad1 /end COMPU_METHOD
/begin COMPU_VTAB_RANGE RTE_CM_ENUM_MotQuad1 "" 4 1 1 "MOTQUAD_QUAD1" 2 2 "MOTQUAD_QUAD2" 3 3 "MOTQUAD_QUAD3" 4 4 "MOTQUAD_QUAD4" /end COMPU_VTAB_RANGE
/begin COMPU_METHOD RTE_CM_Curr8 "" RAT_FUNC "%.1" "Amp" COEFFS 0 128 0 0 0 1 /end COMPU_METHOD
/begin COMPU_METHOD RTE_CM_Uls11 "" RAT_FUNC "%.1" "Uls" COEFFS 0 16384 0 0 0 1 /end COMPU_METHOD
/begin COMPU_METHOD RTE_CM_Tq13 "" RAT_FUNC "%.1" "MotNm" COEFFS 0 0.000244140625 0 0 0 1 /end COMPU_METHOD
/begin COMPU_METHOD RTE_CM_Uls15 "" RAT_FUNC "%.1" "Uls" COEFFS 0 3.0517578125e-005 0 0 0 1 /end COMPU_METHOD
/begin COMPU_METHOD RTE_CM_Vel4 "" RAT_FUNC "%.1" "MotRad/s" COEFFS 0 32 0 0 0 1 /end COMPU_METHOD
/begin COMPU_METHOD RTE_CM_Volt18 "" RAT_FUNC "%.1" "V" COEFFS 0 8192 0 0 0 1 /end COMPU_METHOD
