/begin CHARACTERISTIC FordCanDtcInhb.FordCanDtcInhbFactryModThd.Val "MICROSAR RTE" VALUE 0x0 RTE_RL_UWORD 0 NO_COMPU_METHOD 0 65535 SYMBOL_LINK "Rte_CalprmRom_CalRegn02Cmn_DEFAULT_RTE_CALPRM_GROUP.FordCanDtcInhbFactryModThd_Val" 0 DISPLAY_IDENTIFIER FordCanDtcInhb.CalibrationPorts.FordCanDtcInhbFactryModThd.Val /end CHARACTERISTIC
/begin CHARACTERISTIC FordCanDtcInhb.FordCanDtcInhbTransptModThd.Val "MICROSAR RTE" VALUE 0x0 RTE_RL_UWORD 0 NO_COMPU_METHOD 0 65535 SYMBOL_LINK "Rte_CalprmRom_CalRegn02Cmn_DEFAULT_RTE_CALPRM_GROUP.FordCanDtcInhbTransptModThd_Val" 0 DISPLAY_IDENTIFIER FordCanDtcInhb.CalibrationPorts.FordCanDtcInhbTransptModThd.Val /end CHARACTERISTIC
/begin CHARACTERISTIC FordCmdArbn.FordCmdArbnActvNiblCtrlDeactvn.Ary1D "MICROSAR RTE" VAL_BLK 0x0 RTE_RL_BOOLEAN 0 RTE_CM_BOOLEAN 0 255 MATRIX_DIM 13 1 1 SYMBOL_LINK "Rte_CalprmRom_CalRegn02Cmn_DEFAULT_RTE_CALPRM_GROUP.FordCmdArbnActvNiblCtrlDeactvn_Ary1D" 0 DISPLAY_IDENTIFIER FordCmdArbn.CalibrationPorts.FordCmdArbnActvNiblCtrlDeactvn.Ary1D /end CHARACTERISTIC
/begin CHARACTERISTIC FordCmdArbn.FordCmdArbnActvNiblCtrlDeniedActvnReq.Ary1D "MICROSAR RTE" VAL_BLK 0x0 RTE_RL_BOOLEAN 0 RTE_CM_BOOLEAN 0 255 MATRIX_DIM 13 1 1 SYMBOL_LINK "Rte_CalprmRom_CalRegn02Cmn_DEFAULT_RTE_CALPRM_GROUP.FordCmdArbnActvNiblCtrlDeniedActvnReq_Ary1D" 0 DISPLAY_IDENTIFIER FordCmdArbn.CalibrationPorts.FordCmdArbnActvNiblCtrlDeniedActvnReq.Ary1D /end CHARACTERISTIC
/begin CHARACTERISTIC FordCmdArbn.FordCmdArbnDrvrSteerDeniedActvnReq.Ary1D "MICROSAR RTE" VAL_BLK 0x0 RTE_RL_BOOLEAN 0 RTE_CM_BOOLEAN 0 255 MATRIX_DIM 13 1 1 SYMBOL_LINK "Rte_CalprmRom_CalRegn02Cmn_DEFAULT_RTE_CALPRM_GROUP.FordCmdArbnDrvrSteerDeniedActvnReq_Ary1D" 0 DISPLAY_IDENTIFIER FordCmdArbn.CalibrationPorts.FordCmdArbnDrvrSteerDeniedActvnReq.Ary1D /end CHARACTERISTIC
/begin CHARACTERISTIC FordCmdArbn.FordCmdArbnDrvrSteerRcmdnDeactvn.Ary1D "MICROSAR RTE" VAL_BLK 0x0 RTE_RL_BOOLEAN 0 RTE_CM_BOOLEAN 0 255 MATRIX_DIM 13 1 1 SYMBOL_LINK "Rte_CalprmRom_CalRegn02Cmn_DEFAULT_RTE_CALPRM_GROUP.FordCmdArbnDrvrSteerRcmdnDeactvn_Ary1D" 0 DISPLAY_IDENTIFIER FordCmdArbn.CalibrationPorts.FordCmdArbnDrvrSteerRcmdnDeactvn.Ary1D /end CHARACTERISTIC
/begin CHARACTERISTIC FordCmdArbn.FordCmdArbnEvasSteerAssiDeactvn.Ary1D "MICROSAR RTE" VAL_BLK 0x0 RTE_RL_BOOLEAN 0 RTE_CM_BOOLEAN 0 255 MATRIX_DIM 13 1 1 SYMBOL_LINK "Rte_CalprmRom_CalRegn02Cmn_DEFAULT_RTE_CALPRM_GROUP.FordCmdArbnEvasSteerAssiDeactvn_Ary1D" 0 DISPLAY_IDENTIFIER FordCmdArbn.CalibrationPorts.FordCmdArbnEvasSteerAssiDeactvn.Ary1D /end CHARACTERISTIC
/begin CHARACTERISTIC FordCmdArbn.FordCmdArbnEvasSteerDeniedActvnReq.Ary1D "MICROSAR RTE" VAL_BLK 0x0 RTE_RL_BOOLEAN 0 RTE_CM_BOOLEAN 0 255 MATRIX_DIM 13 1 1 SYMBOL_LINK "Rte_CalprmRom_CalRegn02Cmn_DEFAULT_RTE_CALPRM_GROUP.FordCmdArbnEvasSteerDeniedActvnReq_Ary1D" 0 DISPLAY_IDENTIFIER FordCmdArbn.CalibrationPorts.FordCmdArbnEvasSteerDeniedActvnReq.Ary1D /end CHARACTERISTIC
/begin CHARACTERISTIC FordCmdArbn.FordCmdArbnExtAgCtrlDeactvn.Ary1D "MICROSAR RTE" VAL_BLK 0x0 RTE_RL_BOOLEAN 0 RTE_CM_BOOLEAN 0 255 MATRIX_DIM 13 1 1 SYMBOL_LINK "Rte_CalprmRom_CalRegn02Cmn_DEFAULT_RTE_CALPRM_GROUP.FordCmdArbnExtAgCtrlDeactvn_Ary1D" 0 DISPLAY_IDENTIFIER FordCmdArbn.CalibrationPorts.FordCmdArbnExtAgCtrlDeactvn.Ary1D /end CHARACTERISTIC
/begin CHARACTERISTIC FordCmdArbn.FordCmdArbnExtAgDeniedActvnReq.Ary1D "MICROSAR RTE" VAL_BLK 0x0 RTE_RL_BOOLEAN 0 RTE_CM_BOOLEAN 0 255 MATRIX_DIM 13 1 1 SYMBOL_LINK "Rte_CalprmRom_CalRegn02Cmn_DEFAULT_RTE_CALPRM_GROUP.FordCmdArbnExtAgDeniedActvnReq_Ary1D" 0 DISPLAY_IDENTIFIER FordCmdArbn.CalibrationPorts.FordCmdArbnExtAgDeniedActvnReq.Ary1D /end CHARACTERISTIC
/begin CHARACTERISTIC FordCmdArbn.FordCmdArbnLaneDprtrWarnDeactvn.Ary1D "MICROSAR RTE" VAL_BLK 0x0 RTE_RL_BOOLEAN 0 RTE_CM_BOOLEAN 0 255 MATRIX_DIM 13 1 1 SYMBOL_LINK "Rte_CalprmRom_CalRegn02Cmn_DEFAULT_RTE_CALPRM_GROUP.FordCmdArbnLaneDprtrWarnDeactvn_Ary1D" 0 DISPLAY_IDENTIFIER FordCmdArbn.CalibrationPorts.FordCmdArbnLaneDprtrWarnDeactvn.Ary1D /end CHARACTERISTIC
/begin CHARACTERISTIC FordCmdArbn.FordCmdArbnLaneDprtrWarnDeniedActvnReq.Ary1D "MICROSAR RTE" VAL_BLK 0x0 RTE_RL_BOOLEAN 0 RTE_CM_BOOLEAN 0 255 MATRIX_DIM 13 1 1 SYMBOL_LINK "Rte_CalprmRom_CalRegn02Cmn_DEFAULT_RTE_CALPRM_GROUP.FordCmdArbnLaneDprtrWarnDeniedActvnReq_Ary1D" 0 DISPLAY_IDENTIFIER FordCmdArbn.CalibrationPorts.FordCmdArbnLaneDprtrWarnDeniedActvnReq.Ary1D /end CHARACTERISTIC
/begin CHARACTERISTIC FordCmdArbn.FordCmdArbnLaneKeepAssiDeactvn.Ary1D "MICROSAR RTE" VAL_BLK 0x0 RTE_RL_BOOLEAN 0 RTE_CM_BOOLEAN 0 255 MATRIX_DIM 13 1 1 SYMBOL_LINK "Rte_CalprmRom_CalRegn02Cmn_DEFAULT_RTE_CALPRM_GROUP.FordCmdArbnLaneKeepAssiDeactvn_Ary1D" 0 DISPLAY_IDENTIFIER FordCmdArbn.CalibrationPorts.FordCmdArbnLaneKeepAssiDeactvn.Ary1D /end CHARACTERISTIC
/begin CHARACTERISTIC FordCmdArbn.FordCmdArbnLaneKeepAssiDeniedActvnReq.Ary1D "MICROSAR RTE" VAL_BLK 0x0 RTE_RL_BOOLEAN 0 RTE_CM_BOOLEAN 0 255 MATRIX_DIM 13 1 1 SYMBOL_LINK "Rte_CalprmRom_CalRegn02Cmn_DEFAULT_RTE_CALPRM_GROUP.FordCmdArbnLaneKeepAssiDeniedActvnReq_Ary1D" 0 DISPLAY_IDENTIFIER FordCmdArbn.CalibrationPorts.FordCmdArbnLaneKeepAssiDeniedActvnReq.Ary1D /end CHARACTERISTIC
/begin CHARACTERISTIC FordCmdArbn.FordCmdArbnLatCtrlDeactvn.Ary1D "MICROSAR RTE" VAL_BLK 0x0 RTE_RL_BOOLEAN 0 RTE_CM_BOOLEAN 0 255 MATRIX_DIM 13 1 1 SYMBOL_LINK "Rte_CalprmRom_CalRegn02Cmn_DEFAULT_RTE_CALPRM_GROUP.FordCmdArbnLatCtrlDeactvn_Ary1D" 0 DISPLAY_IDENTIFIER FordCmdArbn.CalibrationPorts.FordCmdArbnLatCtrlDeactvn.Ary1D /end CHARACTERISTIC
/begin CHARACTERISTIC FordCmdArbn.FordCmdArbnLatCtrlDeniedActvnReq.Ary1D "MICROSAR RTE" VAL_BLK 0x0 RTE_RL_BOOLEAN 0 RTE_CM_BOOLEAN 0 255 MATRIX_DIM 13 1 1 SYMBOL_LINK "Rte_CalprmRom_CalRegn02Cmn_DEFAULT_RTE_CALPRM_GROUP.FordCmdArbnLatCtrlDeniedActvnReq_Ary1D" 0 DISPLAY_IDENTIFIER FordCmdArbn.CalibrationPorts.FordCmdArbnLatCtrlDeniedActvnReq.Ary1D /end CHARACTERISTIC
/begin CHARACTERISTIC FordCmdArbn.FordCmdArbnNonStMask.Ary1D "MICROSAR RTE" VAL_BLK 0x0 RTE_RL_BOOLEAN 0 RTE_CM_BOOLEAN 0 255 MATRIX_DIM 13 1 1 SYMBOL_LINK "Rte_CalprmRom_CalRegn02Cmn_DEFAULT_RTE_CALPRM_GROUP.FordCmdArbnNonStMask_Ary1D" 0 DISPLAY_IDENTIFIER FordCmdArbn.CalibrationPorts.FordCmdArbnNonStMask.Ary1D /end CHARACTERISTIC
/begin CHARACTERISTIC FordCmdArbn.FordCmdArbnNormAssiTqThd.Val "MICROSAR RTE" VALUE 0x0 RTE_RL_FLOAT32_IEEE 0 NO_COMPU_METHOD -3.402823466e+38 3.402823466e+38 SYMBOL_LINK "Rte_CalprmRom_CalRegn02Cmn_DEFAULT_RTE_CALPRM_GROUP.FordCmdArbnNormAssiTqThd_Val" 0 DISPLAY_IDENTIFIER FordCmdArbn.CalibrationPorts.FordCmdArbnNormAssiTqThd.Val /end CHARACTERISTIC
/begin CHARACTERISTIC FordCmdArbn.FordCmdArbnPullDriftCmpDeactvn.Ary1D "MICROSAR RTE" VAL_BLK 0x0 RTE_RL_BOOLEAN 0 RTE_CM_BOOLEAN 0 255 MATRIX_DIM 13 1 1 SYMBOL_LINK "Rte_CalprmRom_CalRegn02Cmn_DEFAULT_RTE_CALPRM_GROUP.FordCmdArbnPullDriftCmpDeactvn_Ary1D" 0 DISPLAY_IDENTIFIER FordCmdArbn.CalibrationPorts.FordCmdArbnPullDriftCmpDeactvn.Ary1D /end CHARACTERISTIC
/begin CHARACTERISTIC FordCmdArbn.FordCmdArbnPullDriftCmpDeniedActvnReq.Ary1D "MICROSAR RTE" VAL_BLK 0x0 RTE_RL_BOOLEAN 0 RTE_CM_BOOLEAN 0 255 MATRIX_DIM 13 1 1 SYMBOL_LINK "Rte_CalprmRom_CalRegn02Cmn_DEFAULT_RTE_CALPRM_GROUP.FordCmdArbnPullDriftCmpDeniedActvnReq_Ary1D" 0 DISPLAY_IDENTIFIER FordCmdArbn.CalibrationPorts.FordCmdArbnPullDriftCmpDeniedActvnReq.Ary1D /end CHARACTERISTIC
/begin CHARACTERISTIC FordCmdArbn.FordCmdArbnPullDriftCmpLrngDeactvn.Ary1D "MICROSAR RTE" VAL_BLK 0x0 RTE_RL_BOOLEAN 0 RTE_CM_BOOLEAN 0 255 MATRIX_DIM 13 1 1 SYMBOL_LINK "Rte_CalprmRom_CalRegn02Cmn_DEFAULT_RTE_CALPRM_GROUP.FordCmdArbnPullDriftCmpLrngDeactvn_Ary1D" 0 DISPLAY_IDENTIFIER FordCmdArbn.CalibrationPorts.FordCmdArbnPullDriftCmpLrngDeactvn.Ary1D /end CHARACTERISTIC
/begin CHARACTERISTIC FordCmdArbn.FordCmdArbnPullDriftCmpLrngDeniedActvnReq.Ary1D "MICROSAR RTE" VAL_BLK 0x0 RTE_RL_BOOLEAN 0 RTE_CM_BOOLEAN 0 255 MATRIX_DIM 13 1 1 SYMBOL_LINK "Rte_CalprmRom_CalRegn02Cmn_DEFAULT_RTE_CALPRM_GROUP.FordCmdArbnPullDriftCmpLrngDeniedActvnReq_Ary1D" 0 DISPLAY_IDENTIFIER FordCmdArbn.CalibrationPorts.FordCmdArbnPullDriftCmpLrngDeniedActvnReq.Ary1D /end CHARACTERISTIC
/begin CHARACTERISTIC FordCmdArbn.FordCmdArbnSpare1Deactvn.Ary1D "MICROSAR RTE" VAL_BLK 0x0 RTE_RL_BOOLEAN 0 RTE_CM_BOOLEAN 0 255 MATRIX_DIM 13 1 1 SYMBOL_LINK "Rte_CalprmRom_CalRegn02Cmn_DEFAULT_RTE_CALPRM_GROUP.FordCmdArbnSpare1Deactvn_Ary1D" 0 DISPLAY_IDENTIFIER FordCmdArbn.CalibrationPorts.FordCmdArbnSpare1Deactvn.Ary1D /end CHARACTERISTIC
/begin CHARACTERISTIC FordCmdArbn.FordCmdArbnSpare1DeniedActvnReq.Ary1D "MICROSAR RTE" VAL_BLK 0x0 RTE_RL_BOOLEAN 0 RTE_CM_BOOLEAN 0 255 MATRIX_DIM 13 1 1 SYMBOL_LINK "Rte_CalprmRom_CalRegn02Cmn_DEFAULT_RTE_CALPRM_GROUP.FordCmdArbnSpare1DeniedActvnReq_Ary1D" 0 DISPLAY_IDENTIFIER FordCmdArbn.CalibrationPorts.FordCmdArbnSpare1DeniedActvnReq.Ary1D /end CHARACTERISTIC
/begin CHARACTERISTIC FordCmdArbn.FordCmdArbnSpare2Deactvn.Ary1D "MICROSAR RTE" VAL_BLK 0x0 RTE_RL_BOOLEAN 0 RTE_CM_BOOLEAN 0 255 MATRIX_DIM 13 1 1 SYMBOL_LINK "Rte_CalprmRom_CalRegn02Cmn_DEFAULT_RTE_CALPRM_GROUP.FordCmdArbnSpare2Deactvn_Ary1D" 0 DISPLAY_IDENTIFIER FordCmdArbn.CalibrationPorts.FordCmdArbnSpare2Deactvn.Ary1D /end CHARACTERISTIC
/begin CHARACTERISTIC FordCmdArbn.FordCmdArbnSpare2DeniedActvnReq.Ary1D "MICROSAR RTE" VAL_BLK 0x0 RTE_RL_BOOLEAN 0 RTE_CM_BOOLEAN 0 255 MATRIX_DIM 13 1 1 SYMBOL_LINK "Rte_CalprmRom_CalRegn02Cmn_DEFAULT_RTE_CALPRM_GROUP.FordCmdArbnSpare2DeniedActvnReq_Ary1D" 0 DISPLAY_IDENTIFIER FordCmdArbn.CalibrationPorts.FordCmdArbnSpare2DeniedActvnReq.Ary1D /end CHARACTERISTIC
/begin CHARACTERISTIC FordCmdArbn.FordCmdArbnSpare3Deactvn.Ary1D "MICROSAR RTE" VAL_BLK 0x0 RTE_RL_BOOLEAN 0 RTE_CM_BOOLEAN 0 255 MATRIX_DIM 13 1 1 SYMBOL_LINK "Rte_CalprmRom_CalRegn02Cmn_DEFAULT_RTE_CALPRM_GROUP.FordCmdArbnSpare3Deactvn_Ary1D" 0 DISPLAY_IDENTIFIER FordCmdArbn.CalibrationPorts.FordCmdArbnSpare3Deactvn.Ary1D /end CHARACTERISTIC
/begin CHARACTERISTIC FordCmdArbn.FordCmdArbnSpare3DeniedActvnReq.Ary1D "MICROSAR RTE" VAL_BLK 0x0 RTE_RL_BOOLEAN 0 RTE_CM_BOOLEAN 0 255 MATRIX_DIM 13 1 1 SYMBOL_LINK "Rte_CalprmRom_CalRegn02Cmn_DEFAULT_RTE_CALPRM_GROUP.FordCmdArbnSpare3DeniedActvnReq_Ary1D" 0 DISPLAY_IDENTIFIER FordCmdArbn.CalibrationPorts.FordCmdArbnSpare3DeniedActvnReq.Ary1D /end CHARACTERISTIC
/begin CHARACTERISTIC FordCmdArbn.FordCmdArbnSteerDstbcDeactvn.Ary1D "MICROSAR RTE" VAL_BLK 0x0 RTE_RL_BOOLEAN 0 RTE_CM_BOOLEAN 0 255 MATRIX_DIM 13 1 1 SYMBOL_LINK "Rte_CalprmRom_CalRegn02Cmn_DEFAULT_RTE_CALPRM_GROUP.FordCmdArbnSteerDstbcDeactvn_Ary1D" 0 DISPLAY_IDENTIFIER FordCmdArbn.CalibrationPorts.FordCmdArbnSteerDstbcDeactvn.Ary1D /end CHARACTERISTIC
/begin CHARACTERISTIC FordCmdArbn.FordCmdArbnSteerDstbcDeniedActvnReq.Ary1D "MICROSAR RTE" VAL_BLK 0x0 RTE_RL_BOOLEAN 0 RTE_CM_BOOLEAN 0 255 MATRIX_DIM 13 1 1 SYMBOL_LINK "Rte_CalprmRom_CalRegn02Cmn_DEFAULT_RTE_CALPRM_GROUP.FordCmdArbnSteerDstbcDeniedActvnReq_Ary1D" 0 DISPLAY_IDENTIFIER FordCmdArbn.CalibrationPorts.FordCmdArbnSteerDstbcDeniedActvnReq.Ary1D /end CHARACTERISTIC
/begin CHARACTERISTIC FordHwAgArbn.FordHwAgArbnMotVelVldFlgRcvrTiThd.Val "MICROSAR RTE" VALUE 0x0 RTE_RL_UWORD 0 NO_COMPU_METHOD 0 65535 SYMBOL_LINK "Rte_CalprmRom_CalRegn02Cmn_DEFAULT_RTE_CALPRM_GROUP.FordHwAgArbnMotVelVldFlgRcvrTiThd_Val" 0 DISPLAY_IDENTIFIER FordHwAgArbn.CalibrationPorts.FordHwAgArbnMotVelVldFlgRcvrTiThd.Val /end CHARACTERISTIC
/begin CHARACTERISTIC FordHwAgArbn.FordHwAgArbnNonAbsCentrNotDetdTiThd.Val "MICROSAR RTE" VALUE 0x0 RTE_RL_UWORD 0 NO_COMPU_METHOD 0 65535 SYMBOL_LINK "Rte_CalprmRom_CalRegn02Cmn_DEFAULT_RTE_CALPRM_GROUP.FordHwAgArbnNonAbsCentrNotDetdTiThd_Val" 0 DISPLAY_IDENTIFIER FordHwAgArbn.CalibrationPorts.FordHwAgArbnNonAbsCentrNotDetdTiThd.Val /end CHARACTERISTIC
/begin CHARACTERISTIC FordHwAgArbn.FordHwAgArbnPhyRackTrvlThd.Val "MICROSAR RTE" VALUE 0x0 RTE_RL_FLOAT32_IEEE 0 NO_COMPU_METHOD -3.402823466e+38 3.402823466e+38 SYMBOL_LINK "Rte_CalprmRom_CalRegn02Cmn_DEFAULT_RTE_CALPRM_GROUP.FordHwAgArbnPhyRackTrvlThd_Val" 0 DISPLAY_IDENTIFIER FordHwAgArbn.CalibrationPorts.FordHwAgArbnPhyRackTrvlThd.Val /end CHARACTERISTIC
/begin CHARACTERISTIC FordHwAgArbn.FordHwAgArbnRelPosnVldFlgRcvryTiThd.Val "MICROSAR RTE" VALUE 0x0 RTE_RL_UWORD 0 NO_COMPU_METHOD 0 65535 SYMBOL_LINK "Rte_CalprmRom_CalRegn02Cmn_DEFAULT_RTE_CALPRM_GROUP.FordHwAgArbnRelPosnVldFlgRcvryTiThd_Val" 0 DISPLAY_IDENTIFIER FordHwAgArbn.CalibrationPorts.FordHwAgArbnRelPosnVldFlgRcvryTiThd.Val /end CHARACTERISTIC
/begin CHARACTERISTIC FordHwAgArbn.PrevIgnCycValDft "MICROSAR RTE" VALUE 0x0 RTE_RL_FLOAT32_IEEE 0 NO_COMPU_METHOD -3.402823466e+38 3.402823466e+38 SYMBOL_LINK "Rte_CalprmRom_FordHwAgArbn_DEFAULT_RTE_CDATA_GROUP.PrevIgnCycValDft" 0 DISPLAY_IDENTIFIER FordHwAgArbn.CalibrationParameters.PrevIgnCycValDft /end CHARACTERISTIC
/begin CHARACTERISTIC FordHwAgArbn.SysGlbPrmSysKineRat.Val "MICROSAR RTE" VALUE 0x0 RTE_RL_FLOAT32_IEEE 0 NO_COMPU_METHOD -3.402823466e+38 3.402823466e+38 SYMBOL_LINK "Rte_CalprmRom_CalRegn02Inin00_DEFAULT_RTE_CALPRM_GROUP.SysGlbPrmSysKineRat_Val" 0 DISPLAY_IDENTIFIER FordHwAgArbn.CalibrationPorts.SysGlbPrmSysKineRat.Val /end CHARACTERISTIC
/begin CHARACTERISTIC FordHwTqCdng.FordHwTqCdngAppldFinalMotTqVldTiThd.Val "MICROSAR RTE" VALUE 0x0 RTE_RL_UWORD 0 NO_COMPU_METHOD 0 65535 SYMBOL_LINK "Rte_CalprmRom_CalRegn02Cmn_DEFAULT_RTE_CALPRM_GROUP.FordHwTqCdngAppldFinalMotTqVldTiThd_Val" 0 DISPLAY_IDENTIFIER FordHwTqCdng.CalibrationPorts.FordHwTqCdngAppldFinalMotTqVldTiThd.Val /end CHARACTERISTIC
/begin CHARACTERISTIC FordHwTqCdng.FordHwTqCdngInpTqRawVldTiThd.Val "MICROSAR RTE" VALUE 0x0 RTE_RL_UWORD 0 NO_COMPU_METHOD 0 65535 SYMBOL_LINK "Rte_CalprmRom_CalRegn02Cmn_DEFAULT_RTE_CALPRM_GROUP.FordHwTqCdngInpTqRawVldTiThd_Val" 0 DISPLAY_IDENTIFIER FordHwTqCdng.CalibrationPorts.FordHwTqCdngInpTqRawVldTiThd.Val /end CHARACTERISTIC
/begin CHARACTERISTIC FordHwTqCdng.PwrLimrStdOperMotEnvlpY.Ary1D "MICROSAR RTE" VAL_BLK 0x0 RTE_RL_UWORD 0 NO_COMPU_METHOD 0 65535 MATRIX_DIM 6 1 1 SYMBOL_LINK "Rte_CalprmRom_CalRegn01Cmn_DEFAULT_RTE_CALPRM_GROUP.PwrLimrStdOperMotEnvlpY_Ary1D" 0 DISPLAY_IDENTIFIER FordHwTqCdng.CalibrationPorts.PwrLimrStdOperMotEnvlpY.Ary1D /end CHARACTERISTIC
/begin CHARACTERISTIC FordHwTqCdng.SysGlbPrmSysKineRat.Val "MICROSAR RTE" VALUE 0x0 RTE_RL_FLOAT32_IEEE 0 NO_COMPU_METHOD -3.402823466e+38 3.402823466e+38 SYMBOL_LINK "Rte_CalprmRom_CalRegn02Inin00_DEFAULT_RTE_CALPRM_GROUP.SysGlbPrmSysKineRat_Val" 0 DISPLAY_IDENTIFIER FordHwTqCdng.CalibrationPorts.SysGlbPrmSysKineRat.Val /end CHARACTERISTIC
/begin CHARACTERISTIC FordHwTqCmdOvrlLimr.FordHwTqCmdOvrlLimrCombdBwY.Ary1D "MICROSAR RTE" VAL_BLK 0x0 RTE_RL_UWORD 0 NO_COMPU_METHOD 0 65535 MATRIX_DIM 8 1 1 SYMBOL_LINK "Rte_CalprmRom_CalRegn02Cmn_DEFAULT_RTE_CALPRM_GROUP.FordHwTqCmdOvrlLimrCombdBwY_Ary1D" 0 DISPLAY_IDENTIFIER FordHwTqCmdOvrlLimr.CalibrationPorts.FordHwTqCmdOvrlLimrCombdBwY.Ary1D /end CHARACTERISTIC
/begin CHARACTERISTIC FordHwTqCmdOvrlLimr.FordHwTqCmdOvrlLimrCombdTqRateY.Ary1D "MICROSAR RTE" VAL_BLK 0x0 RTE_RL_UWORD 0 NO_COMPU_METHOD 0 65535 MATRIX_DIM 8 1 1 SYMBOL_LINK "Rte_CalprmRom_CalRegn02Cmn_DEFAULT_RTE_CALPRM_GROUP.FordHwTqCmdOvrlLimrCombdTqRateY_Ary1D" 0 DISPLAY_IDENTIFIER FordHwTqCmdOvrlLimr.CalibrationPorts.FordHwTqCmdOvrlLimrCombdTqRateY.Ary1D /end CHARACTERISTIC
/begin CHARACTERISTIC FordHwTqCmdOvrlLimr.FordHwTqCmdOvrlLimrCombdTqSatnY.Ary1D "MICROSAR RTE" VAL_BLK 0x0 RTE_RL_UWORD 0 NO_COMPU_METHOD 0 65535 MATRIX_DIM 8 1 1 SYMBOL_LINK "Rte_CalprmRom_CalRegn02Cmn_DEFAULT_RTE_CALPRM_GROUP.FordHwTqCmdOvrlLimrCombdTqSatnY_Ary1D" 0 DISPLAY_IDENTIFIER FordHwTqCmdOvrlLimr.CalibrationPorts.FordHwTqCmdOvrlLimrCombdTqSatnY.Ary1D /end CHARACTERISTIC
/begin CHARACTERISTIC FordHwTqCmdOvrlLimr.FordHwTqCmdOvrlLimrCombdVehSpdBreakPtX.Ary1D "MICROSAR RTE" VAL_BLK 0x0 RTE_RL_UWORD 0 NO_COMPU_METHOD 0 65535 MATRIX_DIM 8 1 1 SYMBOL_LINK "Rte_CalprmRom_CalRegn02Cmn_DEFAULT_RTE_CALPRM_GROUP.FordHwTqCmdOvrlLimrCombdVehSpdBreakPtX_Ary1D" 0 DISPLAY_IDENTIFIER FordHwTqCmdOvrlLimr.CalibrationPorts.FordHwTqCmdOvrlLimrCombdVehSpdBreakPtX.Ary1D /end CHARACTERISTIC
/begin CHARACTERISTIC FordHwTqCmdOvrlLimr.FordHwTqCmdOvrlLimrDftSpdRate.Val "MICROSAR RTE" VALUE 0x0 RTE_RL_FLOAT32_IEEE 0 NO_COMPU_METHOD -3.402823466e+38 3.402823466e+38 SYMBOL_LINK "Rte_CalprmRom_CalRegn02Cmn_DEFAULT_RTE_CALPRM_GROUP.FordHwTqCmdOvrlLimrDftSpdRate_Val" 0 DISPLAY_IDENTIFIER FordHwTqCmdOvrlLimr.CalibrationPorts.FordHwTqCmdOvrlLimrDftSpdRate.Val /end CHARACTERISTIC
/begin CHARACTERISTIC FordHwTqCmdOvrlLimr.FordHwTqCmdOvrlLimrDftSpdRcvrRate.Val "MICROSAR RTE" VALUE 0x0 RTE_RL_FLOAT32_IEEE 0 NO_COMPU_METHOD -3.402823466e+38 3.402823466e+38 SYMBOL_LINK "Rte_CalprmRom_CalRegn02Cmn_DEFAULT_RTE_CALPRM_GROUP.FordHwTqCmdOvrlLimrDftSpdRcvrRate_Val" 0 DISPLAY_IDENTIFIER FordHwTqCmdOvrlLimr.CalibrationPorts.FordHwTqCmdOvrlLimrDftSpdRcvrRate.Val /end CHARACTERISTIC
/begin CHARACTERISTIC FordHwTqCmdOvrlLimr.FordHwTqCmdOvrlLimrLkaBwY.Ary1D "MICROSAR RTE" VAL_BLK 0x0 RTE_RL_UWORD 0 NO_COMPU_METHOD 0 65535 MATRIX_DIM 8 1 1 SYMBOL_LINK "Rte_CalprmRom_CalRegn02Cmn_DEFAULT_RTE_CALPRM_GROUP.FordHwTqCmdOvrlLimrLkaBwY_Ary1D" 0 DISPLAY_IDENTIFIER FordHwTqCmdOvrlLimr.CalibrationPorts.FordHwTqCmdOvrlLimrLkaBwY.Ary1D /end CHARACTERISTIC
/begin CHARACTERISTIC FordHwTqCmdOvrlLimr.FordHwTqCmdOvrlLimrLkaTqRateY.Ary1D "MICROSAR RTE" VAL_BLK 0x0 RTE_RL_UWORD 0 NO_COMPU_METHOD 0 65535 MATRIX_DIM 8 1 1 SYMBOL_LINK "Rte_CalprmRom_CalRegn02Cmn_DEFAULT_RTE_CALPRM_GROUP.FordHwTqCmdOvrlLimrLkaTqRateY_Ary1D" 0 DISPLAY_IDENTIFIER FordHwTqCmdOvrlLimr.CalibrationPorts.FordHwTqCmdOvrlLimrLkaTqRateY.Ary1D /end CHARACTERISTIC
/begin CHARACTERISTIC FordHwTqCmdOvrlLimr.FordHwTqCmdOvrlLimrLkaTqSatnY.Ary1D "MICROSAR RTE" VAL_BLK 0x0 RTE_RL_UWORD 0 NO_COMPU_METHOD 0 65535 MATRIX_DIM 8 1 1 SYMBOL_LINK "Rte_CalprmRom_CalRegn02Cmn_DEFAULT_RTE_CALPRM_GROUP.FordHwTqCmdOvrlLimrLkaTqSatnY_Ary1D" 0 DISPLAY_IDENTIFIER FordHwTqCmdOvrlLimr.CalibrationPorts.FordHwTqCmdOvrlLimrLkaTqSatnY.Ary1D /end CHARACTERISTIC
/begin CHARACTERISTIC FordHwTqCmdOvrlLimr.FordHwTqCmdOvrlLimrVehSpdBreakPtX.Ary1D "MICROSAR RTE" VAL_BLK 0x0 RTE_RL_UWORD 0 NO_COMPU_METHOD 0 65535 MATRIX_DIM 8 1 1 SYMBOL_LINK "Rte_CalprmRom_CalRegn02Cmn_DEFAULT_RTE_CALPRM_GROUP.FordHwTqCmdOvrlLimrVehSpdBreakPtX_Ary1D" 0 DISPLAY_IDENTIFIER FordHwTqCmdOvrlLimr.CalibrationPorts.FordHwTqCmdOvrlLimrVehSpdBreakPtX.Ary1D /end CHARACTERISTIC
/begin CHARACTERISTIC FordMotTqCmdOvrlLimr.FordMotTqCmdOvrlLimrDftSpdRate.Val "MICROSAR RTE" VALUE 0x0 RTE_RL_FLOAT32_IEEE 0 NO_COMPU_METHOD -3.402823466e+38 3.402823466e+38 SYMBOL_LINK "Rte_CalprmRom_CalRegn02Cmn_DEFAULT_RTE_CALPRM_GROUP.FordMotTqCmdOvrlLimrDftSpdRate_Val" 0 DISPLAY_IDENTIFIER FordMotTqCmdOvrlLimr.CalibrationPorts.FordMotTqCmdOvrlLimrDftSpdRate.Val /end CHARACTERISTIC
/begin CHARACTERISTIC FordMotTqCmdOvrlLimr.FordMotTqCmdOvrlLimrDftSpdRcvrRate.Val "MICROSAR RTE" VALUE 0x0 RTE_RL_FLOAT32_IEEE 0 NO_COMPU_METHOD -3.402823466e+38 3.402823466e+38 SYMBOL_LINK "Rte_CalprmRom_CalRegn02Cmn_DEFAULT_RTE_CALPRM_GROUP.FordMotTqCmdOvrlLimrDftSpdRcvrRate_Val" 0 DISPLAY_IDENTIFIER FordMotTqCmdOvrlLimr.CalibrationPorts.FordMotTqCmdOvrlLimrDftSpdRcvrRate.Val /end CHARACTERISTIC
/begin CHARACTERISTIC FordMotTqCmdOvrlLimr.FordMotTqCmdOvrlLimrHiFrqMonrActvNiblCtrlDcTqTrendThd.Val "MICROSAR RTE" VALUE 0x0 RTE_RL_FLOAT32_IEEE 0 NO_COMPU_METHOD -3.402823466e+38 3.402823466e+38 SYMBOL_LINK "Rte_CalprmRom_CalRegn02Cmn_DEFAULT_RTE_CALPRM_GROUP.FordMotTqCmdOvrlLimrHiFrqMonrActvNiblCtrlDcTqTrendThd_Val" 0 DISPLAY_IDENTIFIER FordMotTqCmdOvrlLimr.CalibrationPorts.FordMotTqCmdOvrlLimrHiFrqMonrActvNiblCtrlDcTqTrendThd.Val /end CHARACTERISTIC
/begin CHARACTERISTIC FordMotTqCmdOvrlLimr.FordMotTqCmdOvrlLimrHiFrqMonrActvNiblCtrlLoFrqTiThd.Val "MICROSAR RTE" VALUE 0x0 RTE_RL_FLOAT32_IEEE 0 NO_COMPU_METHOD -3.402823466e+38 3.402823466e+38 SYMBOL_LINK "Rte_CalprmRom_CalRegn02Cmn_DEFAULT_RTE_CALPRM_GROUP.FordMotTqCmdOvrlLimrHiFrqMonrActvNiblCtrlLoFrqTiThd_Val" 0 DISPLAY_IDENTIFIER FordMotTqCmdOvrlLimr.CalibrationPorts.FordMotTqCmdOvrlLimrHiFrqMonrActvNiblCtrlLoFrqTiThd.Val /end CHARACTERISTIC
/begin CHARACTERISTIC FordMotTqCmdOvrlLimr.FordMotTqCmdOvrlLimrHiFrqMonrActvNiblCtrlMaxMotTq.Val "MICROSAR RTE" VALUE 0x0 RTE_RL_FLOAT32_IEEE 0 NO_COMPU_METHOD -3.402823466e+38 3.402823466e+38 SYMBOL_LINK "Rte_CalprmRom_CalRegn02Cmn_DEFAULT_RTE_CALPRM_GROUP.FordMotTqCmdOvrlLimrHiFrqMonrActvNiblCtrlMaxMotTq_Val" 0 DISPLAY_IDENTIFIER FordMotTqCmdOvrlLimr.CalibrationPorts.FordMotTqCmdOvrlLimrHiFrqMonrActvNiblCtrlMaxMotTq.Val /end CHARACTERISTIC
/begin CHARACTERISTIC FordMotTqCmdOvrlLimr.FordMotTqCmdOvrlLimrHiFrqMonrLaneDprtrWarnDcTqTrendThd.Val "MICROSAR RTE" VALUE 0x0 RTE_RL_FLOAT32_IEEE 0 NO_COMPU_METHOD -3.402823466e+38 3.402823466e+38 SYMBOL_LINK "Rte_CalprmRom_CalRegn02Cmn_DEFAULT_RTE_CALPRM_GROUP.FordMotTqCmdOvrlLimrHiFrqMonrLaneDprtrWarnDcTqTrendThd_Val" 0 DISPLAY_IDENTIFIER FordMotTqCmdOvrlLimr.CalibrationPorts.FordMotTqCmdOvrlLimrHiFrqMonrLaneDprtrWarnDcTqTrendThd.Val /end CHARACTERISTIC
/begin CHARACTERISTIC FordMotTqCmdOvrlLimr.FordMotTqCmdOvrlLimrHiFrqMonrLaneDprtrWarnLoFrqTiThd.Val "MICROSAR RTE" VALUE 0x0 RTE_RL_FLOAT32_IEEE 0 NO_COMPU_METHOD -3.402823466e+38 3.402823466e+38 SYMBOL_LINK "Rte_CalprmRom_CalRegn02Cmn_DEFAULT_RTE_CALPRM_GROUP.FordMotTqCmdOvrlLimrHiFrqMonrLaneDprtrWarnLoFrqTiThd_Val" 0 DISPLAY_IDENTIFIER FordMotTqCmdOvrlLimr.CalibrationPorts.FordMotTqCmdOvrlLimrHiFrqMonrLaneDprtrWarnLoFrqTiThd.Val /end CHARACTERISTIC
/begin CHARACTERISTIC FordMotTqCmdOvrlLimr.FordMotTqCmdOvrlLimrHiFrqMonrLaneDprtrWarnMaxMotTq.Val "MICROSAR RTE" VALUE 0x0 RTE_RL_FLOAT32_IEEE 0 NO_COMPU_METHOD -3.402823466e+38 3.402823466e+38 SYMBOL_LINK "Rte_CalprmRom_CalRegn02Cmn_DEFAULT_RTE_CALPRM_GROUP.FordMotTqCmdOvrlLimrHiFrqMonrLaneDprtrWarnMaxMotTq_Val" 0 DISPLAY_IDENTIFIER FordMotTqCmdOvrlLimr.CalibrationPorts.FordMotTqCmdOvrlLimrHiFrqMonrLaneDprtrWarnMaxMotTq.Val /end CHARACTERISTIC
/begin CHARACTERISTIC FordMotTqCmdOvrlLimr.FordMotTqCmdOvrlLimrHiFrqMonrTqTrendAlpha.Val "MICROSAR RTE" VALUE 0x0 RTE_RL_FLOAT32_IEEE 0 NO_COMPU_METHOD -3.402823466e+38 3.402823466e+38 SYMBOL_LINK "Rte_CalprmRom_CalRegn02Cmn_DEFAULT_RTE_CALPRM_GROUP.FordMotTqCmdOvrlLimrHiFrqMonrTqTrendAlpha_Val" 0 DISPLAY_IDENTIFIER FordMotTqCmdOvrlLimr.CalibrationPorts.FordMotTqCmdOvrlLimrHiFrqMonrTqTrendAlpha.Val /end CHARACTERISTIC
/begin CHARACTERISTIC FordMotTqCmdOvrlLimr.FordMotTqCmdOvrlLimrHiFrqMonrZeroBandTq.Val "MICROSAR RTE" VALUE 0x0 RTE_RL_FLOAT32_IEEE 0 NO_COMPU_METHOD -3.402823466e+38 3.402823466e+38 SYMBOL_LINK "Rte_CalprmRom_CalRegn02Cmn_DEFAULT_RTE_CALPRM_GROUP.FordMotTqCmdOvrlLimrHiFrqMonrZeroBandTq_Val" 0 DISPLAY_IDENTIFIER FordMotTqCmdOvrlLimr.CalibrationPorts.FordMotTqCmdOvrlLimrHiFrqMonrZeroBandTq.Val /end CHARACTERISTIC
/begin CHARACTERISTIC FordMotTqCmdOvrlLimr.FordMotTqCmdOvrlLimrHwVelLoPassFrq.Val "MICROSAR RTE" VALUE 0x0 RTE_RL_FLOAT32_IEEE 0 NO_COMPU_METHOD -3.402823466e+38 3.402823466e+38 SYMBOL_LINK "Rte_CalprmRom_CalRegn02Cmn_DEFAULT_RTE_CALPRM_GROUP.FordMotTqCmdOvrlLimrHwVelLoPassFrq_Val" 0 DISPLAY_IDENTIFIER FordMotTqCmdOvrlLimr.CalibrationPorts.FordMotTqCmdOvrlLimrHwVelLoPassFrq.Val /end CHARACTERISTIC
/begin CHARACTERISTIC FordMotTqCmdOvrlLimr.FordMotTqCmdOvrlLimrLatCtrlBwY.Val "MICROSAR RTE" VAL_BLK 0x0 RTE_RL_SWORD 0 NO_COMPU_METHOD -32768 32767 MATRIX_DIM 8 1 1 SYMBOL_LINK "Rte_CalprmRom_CalRegn02Cmn_DEFAULT_RTE_CALPRM_GROUP.FordMotTqCmdOvrlLimrLatCtrlBwY_Val" 0 DISPLAY_IDENTIFIER FordMotTqCmdOvrlLimr.CalibrationPorts.FordMotTqCmdOvrlLimrLatCtrlBwY.Val /end CHARACTERISTIC
/begin CHARACTERISTIC FordMotTqCmdOvrlLimr.FordMotTqCmdOvrlLimrLatCtrlTqRateY.Ary1D "MICROSAR RTE" VAL_BLK 0x0 RTE_RL_SWORD 0 NO_COMPU_METHOD -32768 32767 MATRIX_DIM 8 1 1 SYMBOL_LINK "Rte_CalprmRom_CalRegn02Cmn_DEFAULT_RTE_CALPRM_GROUP.FordMotTqCmdOvrlLimrLatCtrlTqRateY_Ary1D" 0 DISPLAY_IDENTIFIER FordMotTqCmdOvrlLimr.CalibrationPorts.FordMotTqCmdOvrlLimrLatCtrlTqRateY.Ary1D /end CHARACTERISTIC
/begin CHARACTERISTIC FordMotTqCmdOvrlLimr.FordMotTqCmdOvrlLimrLatCtrlTqSatnY.Ary1D "MICROSAR RTE" VAL_BLK 0x0 RTE_RL_SWORD 0 NO_COMPU_METHOD -32768 32767 MATRIX_DIM 8 1 1 SYMBOL_LINK "Rte_CalprmRom_CalRegn02Cmn_DEFAULT_RTE_CALPRM_GROUP.FordMotTqCmdOvrlLimrLatCtrlTqSatnY_Ary1D" 0 DISPLAY_IDENTIFIER FordMotTqCmdOvrlLimr.CalibrationPorts.FordMotTqCmdOvrlLimrLatCtrlTqSatnY.Ary1D /end CHARACTERISTIC
/begin CHARACTERISTIC FordMotTqCmdOvrlLimr.FordMotTqCmdOvrlLimrLatCtrlVehSpdBreakPtX.Ary1D "MICROSAR RTE" VAL_BLK 0x0 RTE_RL_UWORD 0 NO_COMPU_METHOD 0 65535 MATRIX_DIM 8 1 1 SYMBOL_LINK "Rte_CalprmRom_CalRegn02Cmn_DEFAULT_RTE_CALPRM_GROUP.FordMotTqCmdOvrlLimrLatCtrlVehSpdBreakPtX_Ary1D" 0 DISPLAY_IDENTIFIER FordMotTqCmdOvrlLimr.CalibrationPorts.FordMotTqCmdOvrlLimrLatCtrlVehSpdBreakPtX.Ary1D /end CHARACTERISTIC
/begin CHARACTERISTIC FordMotTqCmdOvrlLimr.FordMotTqCmdOvrlLimrPullDriftCmpTqRateY.Ary1D "MICROSAR RTE" VAL_BLK 0x0 RTE_RL_SWORD 0 NO_COMPU_METHOD -32768 32767 MATRIX_DIM 8 1 1 SYMBOL_LINK "Rte_CalprmRom_CalRegn02Cmn_DEFAULT_RTE_CALPRM_GROUP.FordMotTqCmdOvrlLimrPullDriftCmpTqRateY_Ary1D" 0 DISPLAY_IDENTIFIER FordMotTqCmdOvrlLimr.CalibrationPorts.FordMotTqCmdOvrlLimrPullDriftCmpTqRateY.Ary1D /end CHARACTERISTIC
/begin CHARACTERISTIC FordMotTqCmdOvrlLimr.FordMotTqCmdOvrlLimrPullDriftCmpTqSatnY.Ary1D "MICROSAR RTE" VAL_BLK 0x0 RTE_RL_SWORD 0 NO_COMPU_METHOD -32768 32767 MATRIX_DIM 8 1 1 SYMBOL_LINK "Rte_CalprmRom_CalRegn02Cmn_DEFAULT_RTE_CALPRM_GROUP.FordMotTqCmdOvrlLimrPullDriftCmpTqSatnY_Ary1D" 0 DISPLAY_IDENTIFIER FordMotTqCmdOvrlLimr.CalibrationPorts.FordMotTqCmdOvrlLimrPullDriftCmpTqSatnY.Ary1D /end CHARACTERISTIC
/begin CHARACTERISTIC FordMotTqCmdOvrlLimr.FordMotTqCmdOvrlLimrPullDriftCmpVehSpdBreakPtX.Ary1D "MICROSAR RTE" VAL_BLK 0x0 RTE_RL_UWORD 0 NO_COMPU_METHOD 0 65535 MATRIX_DIM 8 1 1 SYMBOL_LINK "Rte_CalprmRom_CalRegn02Cmn_DEFAULT_RTE_CALPRM_GROUP.FordMotTqCmdOvrlLimrPullDriftCmpVehSpdBreakPtX_Ary1D" 0 DISPLAY_IDENTIFIER FordMotTqCmdOvrlLimr.CalibrationPorts.FordMotTqCmdOvrlLimrPullDriftCmpVehSpdBreakPtX.Ary1D /end CHARACTERISTIC
/begin CHARACTERISTIC FordMotTqCmdOvrlLimr.FordMotTqCmdOvrlLimrSteerReactnLimrCombAmpVehSpdLimX.Ary1D "MICROSAR RTE" VAL_BLK 0x0 RTE_RL_UWORD 0 NO_COMPU_METHOD 0 65535 MATRIX_DIM 8 1 1 SYMBOL_LINK "Rte_CalprmRom_CalRegn02Cmn_DEFAULT_RTE_CALPRM_GROUP.FordMotTqCmdOvrlLimrSteerReactnLimrCombAmpVehSpdLimX_Ary1D" 0 DISPLAY_IDENTIFIER FordMotTqCmdOvrlLimr.CalibrationPorts.FordMotTqCmdOvrlLimrSteerReactnLimrCombAmpVehSpdLimX.Ary1D /end CHARACTERISTIC
/begin CHARACTERISTIC FordMotTqCmdOvrlLimr.FordMotTqCmdOvrlLimrSteerReactnLimrCombAmpVehSpdLimY.Ary1D "MICROSAR RTE" VAL_BLK 0x0 RTE_RL_UWORD 0 NO_COMPU_METHOD 0 65535 MATRIX_DIM 8 1 1 SYMBOL_LINK "Rte_CalprmRom_CalRegn02Cmn_DEFAULT_RTE_CALPRM_GROUP.FordMotTqCmdOvrlLimrSteerReactnLimrCombAmpVehSpdLimY_Ary1D" 0 DISPLAY_IDENTIFIER FordMotTqCmdOvrlLimr.CalibrationPorts.FordMotTqCmdOvrlLimrSteerReactnLimrCombAmpVehSpdLimY.Ary1D /end CHARACTERISTIC
/begin CHARACTERISTIC FordMotTqCmdOvrlLimr.FordMotTqCmdOvrlLimrSteerReactnLimrCombOvrrunRampRateHwVelErrX.Ary1D "MICROSAR RTE" VAL_BLK 0x0 RTE_RL_UWORD 0 NO_COMPU_METHOD 0 65535 MATRIX_DIM 6 1 1 SYMBOL_LINK "Rte_CalprmRom_CalRegn02Cmn_DEFAULT_RTE_CALPRM_GROUP.FordMotTqCmdOvrlLimrSteerReactnLimrCombOvrrunRampRateHwVelErrX_Ary1D" 0 DISPLAY_IDENTIFIER FordMotTqCmdOvrlLimr.CalibrationPorts.FordMotTqCmdOvrlLimrSteerReactnLimrCombOvrrunRampRateHwVelErrX.Ary1D /end CHARACTERISTIC
/begin CHARACTERISTIC FordMotTqCmdOvrlLimr.FordMotTqCmdOvrlLimrSteerReactnLimrCombOvrrunRampRateOutY.Ary1D "MICROSAR RTE" VAL_BLK 0x0 RTE_RL_UWORD 0 NO_COMPU_METHOD 0 65535 MATRIX_DIM 6 1 1 SYMBOL_LINK "Rte_CalprmRom_CalRegn02Cmn_DEFAULT_RTE_CALPRM_GROUP.FordMotTqCmdOvrlLimrSteerReactnLimrCombOvrrunRampRateOutY_Ary1D" 0 DISPLAY_IDENTIFIER FordMotTqCmdOvrlLimr.CalibrationPorts.FordMotTqCmdOvrlLimrSteerReactnLimrCombOvrrunRampRateOutY.Ary1D /end CHARACTERISTIC
/begin CHARACTERISTIC FordMotTqCmdOvrlLimr.FordMotTqCmdOvrlLimrSteerReactnLimrCombdAmpOvrrun.Val "MICROSAR RTE" VALUE 0x0 RTE_RL_FLOAT32_IEEE 0 NO_COMPU_METHOD -3.402823466e+38 3.402823466e+38 SYMBOL_LINK "Rte_CalprmRom_CalRegn02Cmn_DEFAULT_RTE_CALPRM_GROUP.FordMotTqCmdOvrlLimrSteerReactnLimrCombdAmpOvrrun_Val" 0 DISPLAY_IDENTIFIER FordMotTqCmdOvrlLimr.CalibrationPorts.FordMotTqCmdOvrlLimrSteerReactnLimrCombdAmpOvrrun.Val /end CHARACTERISTIC
/begin CHARACTERISTIC FordMotTqCmdOvrlLimr.FordMotTqCmdOvrlLimrSteerReactnLimrCombdAmpRcvry.Val "MICROSAR RTE" VALUE 0x0 RTE_RL_FLOAT32_IEEE 0 NO_COMPU_METHOD -3.402823466e+38 3.402823466e+38 SYMBOL_LINK "Rte_CalprmRom_CalRegn02Cmn_DEFAULT_RTE_CALPRM_GROUP.FordMotTqCmdOvrlLimrSteerReactnLimrCombdAmpRcvry_Val" 0 DISPLAY_IDENTIFIER FordMotTqCmdOvrlLimr.CalibrationPorts.FordMotTqCmdOvrlLimrSteerReactnLimrCombdAmpRcvry.Val /end CHARACTERISTIC
/begin CHARACTERISTIC FordMotTqCmdOvrlLimr.FordMotTqCmdOvrlLimrSteerReactnLimrCombdFixdOvrrunRampRate.Val "MICROSAR RTE" VALUE 0x0 RTE_RL_FLOAT32_IEEE 0 NO_COMPU_METHOD -3.402823466e+38 3.402823466e+38 SYMBOL_LINK "Rte_CalprmRom_CalRegn02Cmn_DEFAULT_RTE_CALPRM_GROUP.FordMotTqCmdOvrlLimrSteerReactnLimrCombdFixdOvrrunRampRate_Val" 0 DISPLAY_IDENTIFIER FordMotTqCmdOvrlLimr.CalibrationPorts.FordMotTqCmdOvrlLimrSteerReactnLimrCombdFixdOvrrunRampRate.Val /end CHARACTERISTIC
/begin CHARACTERISTIC FordMotTqCmdOvrlLimr.FordMotTqCmdOvrlLimrSteerReactnLimrCombdLimHys.Val "MICROSAR RTE" VALUE 0x0 RTE_RL_FLOAT32_IEEE 0 NO_COMPU_METHOD -3.402823466e+38 3.402823466e+38 SYMBOL_LINK "Rte_CalprmRom_CalRegn02Cmn_DEFAULT_RTE_CALPRM_GROUP.FordMotTqCmdOvrlLimrSteerReactnLimrCombdLimHys_Val" 0 DISPLAY_IDENTIFIER FordMotTqCmdOvrlLimr.CalibrationPorts.FordMotTqCmdOvrlLimrSteerReactnLimrCombdLimHys.Val /end CHARACTERISTIC
/begin CHARACTERISTIC FordMotTqCmdOvrlLimr.FordMotTqCmdOvrlLimrSteerReactnLimrCombdLimTqX.Ary2D "MICROSAR RTE" VAL_BLK 0x0 RTE_RL_SWORD 0 NO_COMPU_METHOD -32768 32767 MATRIX_DIM 9 8 1 SYMBOL_LINK "Rte_CalprmRom_CalRegn02Cmn_DEFAULT_RTE_CALPRM_GROUP.FordMotTqCmdOvrlLimrSteerReactnLimrCombdLimTqX_Ary2D" 0 DISPLAY_IDENTIFIER FordMotTqCmdOvrlLimr.CalibrationPorts.FordMotTqCmdOvrlLimrSteerReactnLimrCombdLimTqX.Ary2D /end CHARACTERISTIC
/begin CHARACTERISTIC FordMotTqCmdOvrlLimr.FordMotTqCmdOvrlLimrSteerReactnLimrCombdLimrHwVelY.Ary2D "MICROSAR RTE" VAL_BLK 0x0 RTE_RL_SWORD 0 NO_COMPU_METHOD -32768 32767 MATRIX_DIM 9 8 1 SYMBOL_LINK "Rte_CalprmRom_CalRegn02Cmn_DEFAULT_RTE_CALPRM_GROUP.FordMotTqCmdOvrlLimrSteerReactnLimrCombdLimrHwVelY_Ary2D" 0 DISPLAY_IDENTIFIER FordMotTqCmdOvrlLimr.CalibrationPorts.FordMotTqCmdOvrlLimrSteerReactnLimrCombdLimrHwVelY.Ary2D /end CHARACTERISTIC
/begin CHARACTERISTIC FordMotTqCmdOvrlLimr.FordMotTqCmdOvrlLimrSteerReactnLimrCombdLimrVehSpd.Ary1D "MICROSAR RTE" VAL_BLK 0x0 RTE_RL_UWORD 0 NO_COMPU_METHOD 0 65535 MATRIX_DIM 8 1 1 SYMBOL_LINK "Rte_CalprmRom_CalRegn02Cmn_DEFAULT_RTE_CALPRM_GROUP.FordMotTqCmdOvrlLimrSteerReactnLimrCombdLimrVehSpd_Ary1D" 0 DISPLAY_IDENTIFIER FordMotTqCmdOvrlLimr.CalibrationPorts.FordMotTqCmdOvrlLimrSteerReactnLimrCombdLimrVehSpd.Ary1D /end CHARACTERISTIC
/begin CHARACTERISTIC FordMotTqCmdOvrlLimr.FordMotTqCmdOvrlLimrSteerReactnLimrCombdRcvryIdealRampRate.Val "MICROSAR RTE" VALUE 0x0 RTE_RL_FLOAT32_IEEE 0 NO_COMPU_METHOD -3.402823466e+38 3.402823466e+38 SYMBOL_LINK "Rte_CalprmRom_CalRegn02Cmn_DEFAULT_RTE_CALPRM_GROUP.FordMotTqCmdOvrlLimrSteerReactnLimrCombdRcvryIdealRampRate_Val" 0 DISPLAY_IDENTIFIER FordMotTqCmdOvrlLimr.CalibrationPorts.FordMotTqCmdOvrlLimrSteerReactnLimrCombdRcvryIdealRampRate.Val /end CHARACTERISTIC
/begin CHARACTERISTIC FordMotTqCmdOvrlLimr.FordMotTqCmdOvrlLimrSteerReactnLimrCombdRcvryRampRateStg1.Val "MICROSAR RTE" VALUE 0x0 RTE_RL_FLOAT32_IEEE 0 NO_COMPU_METHOD -3.402823466e+38 3.402823466e+38 SYMBOL_LINK "Rte_CalprmRom_CalRegn02Cmn_DEFAULT_RTE_CALPRM_GROUP.FordMotTqCmdOvrlLimrSteerReactnLimrCombdRcvryRampRateStg1_Val" 0 DISPLAY_IDENTIFIER FordMotTqCmdOvrlLimr.CalibrationPorts.FordMotTqCmdOvrlLimrSteerReactnLimrCombdRcvryRampRateStg1.Val /end CHARACTERISTIC
/begin CHARACTERISTIC FordMotTqCmdOvrlLimr.FordMotTqCmdOvrlLimrSteerReactnLimrCombdRcvryRampRateStg2.Val "MICROSAR RTE" VALUE 0x0 RTE_RL_FLOAT32_IEEE 0 NO_COMPU_METHOD -3.402823466e+38 3.402823466e+38 SYMBOL_LINK "Rte_CalprmRom_CalRegn02Cmn_DEFAULT_RTE_CALPRM_GROUP.FordMotTqCmdOvrlLimrSteerReactnLimrCombdRcvryRampRateStg2_Val" 0 DISPLAY_IDENTIFIER FordMotTqCmdOvrlLimr.CalibrationPorts.FordMotTqCmdOvrlLimrSteerReactnLimrCombdRcvryRampRateStg2.Val /end CHARACTERISTIC
/begin CHARACTERISTIC FordMsg077BusHiSpd.FordMsg077BusHiSpdCanDtcInhbThd.Val "MICROSAR RTE" VALUE 0x0 RTE_RL_UWORD 0 NO_COMPU_METHOD 0 65535 SYMBOL_LINK "Rte_CalprmRom_CalRegn01Cmn_DEFAULT_RTE_CALPRM_GROUP.FordMsg077BusHiSpdCanDtcInhbThd_Val" 0 DISPLAY_IDENTIFIER FordMsg077BusHiSpd.CalibrationPorts.FordMsg077BusHiSpdCanDtcInhbThd.Val /end CHARACTERISTIC
/begin CHARACTERISTIC FordMsg077BusHiSpd.FordMsg077BusHiSpdLatACmpdInvldSigFaildThd.Val "MICROSAR RTE" VALUE 0x0 RTE_RL_UWORD 0 NO_COMPU_METHOD 0 65535 SYMBOL_LINK "Rte_CalprmRom_CalRegn01Cmn_DEFAULT_RTE_CALPRM_GROUP.FordMsg077BusHiSpdLatACmpdInvldSigFaildThd_Val" 0 DISPLAY_IDENTIFIER FordMsg077BusHiSpd.CalibrationPorts.FordMsg077BusHiSpdLatACmpdInvldSigFaildThd.Val /end CHARACTERISTIC
/begin CHARACTERISTIC FordMsg077BusHiSpd.FordMsg077BusHiSpdLatACmpdInvldSigPassdThd.Val "MICROSAR RTE" VALUE 0x0 RTE_RL_UWORD 0 NO_COMPU_METHOD 0 65535 SYMBOL_LINK "Rte_CalprmRom_CalRegn01Cmn_DEFAULT_RTE_CALPRM_GROUP.FordMsg077BusHiSpdLatACmpdInvldSigPassdThd_Val" 0 DISPLAY_IDENTIFIER FordMsg077BusHiSpd.CalibrationPorts.FordMsg077BusHiSpdLatACmpdInvldSigPassdThd.Val /end CHARACTERISTIC
/begin CHARACTERISTIC FordMsg077BusHiSpd.FordMsg077BusHiSpdLatACmpdVldMissThd.Val "MICROSAR RTE" VALUE 0x0 RTE_RL_UWORD 0 NO_COMPU_METHOD 0 65535 SYMBOL_LINK "Rte_CalprmRom_CalRegn01Cmn_DEFAULT_RTE_CALPRM_GROUP.FordMsg077BusHiSpdLatACmpdVldMissThd_Val" 0 DISPLAY_IDENTIFIER FordMsg077BusHiSpd.CalibrationPorts.FordMsg077BusHiSpdLatACmpdVldMissThd.Val /end CHARACTERISTIC
/begin CHARACTERISTIC FordMsg077BusHiSpd.FordMsg077BusHiSpdLgtACmpdInvldSigFaildThd.Val "MICROSAR RTE" VALUE 0x0 RTE_RL_UWORD 0 NO_COMPU_METHOD 0 65535 SYMBOL_LINK "Rte_CalprmRom_CalRegn01Cmn_DEFAULT_RTE_CALPRM_GROUP.FordMsg077BusHiSpdLgtACmpdInvldSigFaildThd_Val" 0 DISPLAY_IDENTIFIER FordMsg077BusHiSpd.CalibrationPorts.FordMsg077BusHiSpdLgtACmpdInvldSigFaildThd.Val /end CHARACTERISTIC
/begin CHARACTERISTIC FordMsg077BusHiSpd.FordMsg077BusHiSpdLgtACmpdInvldSigPassdThd.Val "MICROSAR RTE" VALUE 0x0 RTE_RL_UWORD 0 NO_COMPU_METHOD 0 65535 SYMBOL_LINK "Rte_CalprmRom_CalRegn01Cmn_DEFAULT_RTE_CALPRM_GROUP.FordMsg077BusHiSpdLgtACmpdInvldSigPassdThd_Val" 0 DISPLAY_IDENTIFIER FordMsg077BusHiSpd.CalibrationPorts.FordMsg077BusHiSpdLgtACmpdInvldSigPassdThd.Val /end CHARACTERISTIC
/begin CHARACTERISTIC FordMsg077BusHiSpd.FordMsg077BusHiSpdLgtACmpdVldMissThd.Val "MICROSAR RTE" VALUE 0x0 RTE_RL_UWORD 0 NO_COMPU_METHOD 0 65535 SYMBOL_LINK "Rte_CalprmRom_CalRegn01Cmn_DEFAULT_RTE_CALPRM_GROUP.FordMsg077BusHiSpdLgtACmpdVldMissThd_Val" 0 DISPLAY_IDENTIFIER FordMsg077BusHiSpd.CalibrationPorts.FordMsg077BusHiSpdLgtACmpdVldMissThd.Val /end CHARACTERISTIC
/begin CHARACTERISTIC FordMsg077BusHiSpd.FordMsg077BusHiSpdMissMsgFaildThd.Val "MICROSAR RTE" VALUE 0x0 RTE_RL_UWORD 0 NO_COMPU_METHOD 0 65535 SYMBOL_LINK "Rte_CalprmRom_CalRegn01Cmn_DEFAULT_RTE_CALPRM_GROUP.FordMsg077BusHiSpdMissMsgFaildThd_Val" 0 DISPLAY_IDENTIFIER FordMsg077BusHiSpd.CalibrationPorts.FordMsg077BusHiSpdMissMsgFaildThd.Val /end CHARACTERISTIC
/begin CHARACTERISTIC FordMsg077BusHiSpd.FordMsg077BusHiSpdMissMsgPassdThd.Val "MICROSAR RTE" VALUE 0x0 RTE_RL_UWORD 0 NO_COMPU_METHOD 0 65535 SYMBOL_LINK "Rte_CalprmRom_CalRegn01Cmn_DEFAULT_RTE_CALPRM_GROUP.FordMsg077BusHiSpdMissMsgPassdThd_Val" 0 DISPLAY_IDENTIFIER FordMsg077BusHiSpd.CalibrationPorts.FordMsg077BusHiSpdMissMsgPassdThd.Val /end CHARACTERISTIC
/begin CHARACTERISTIC FordMsg077BusHiSpd.FordMsg077BusHiSpdOverGndInvldSigFaildThd.Val "MICROSAR RTE" VALUE 0x0 RTE_RL_UWORD 0 NO_COMPU_METHOD 0 65535 SYMBOL_LINK "Rte_CalprmRom_CalRegn01Cmn_DEFAULT_RTE_CALPRM_GROUP.FordMsg077BusHiSpdOverGndInvldSigFaildThd_Val" 0 DISPLAY_IDENTIFIER FordMsg077BusHiSpd.CalibrationPorts.FordMsg077BusHiSpdOverGndInvldSigFaildThd.Val /end CHARACTERISTIC
/begin CHARACTERISTIC FordMsg077BusHiSpd.FordMsg077BusHiSpdOverGndInvldSigPassdThd.Val "MICROSAR RTE" VALUE 0x0 RTE_RL_UWORD 0 NO_COMPU_METHOD 0 65535 SYMBOL_LINK "Rte_CalprmRom_CalRegn01Cmn_DEFAULT_RTE_CALPRM_GROUP.FordMsg077BusHiSpdOverGndInvldSigPassdThd_Val" 0 DISPLAY_IDENTIFIER FordMsg077BusHiSpd.CalibrationPorts.FordMsg077BusHiSpdOverGndInvldSigPassdThd.Val /end CHARACTERISTIC
/begin CHARACTERISTIC FordMsg077BusHiSpd.FordMsg077BusHiSpdVehLatACmpdVldFaildThd.Val "MICROSAR RTE" VALUE 0x0 RTE_RL_UWORD 0 NO_COMPU_METHOD 0 65535 SYMBOL_LINK "Rte_CalprmRom_CalRegn01Cmn_DEFAULT_RTE_CALPRM_GROUP.FordMsg077BusHiSpdVehLatACmpdVldFaildThd_Val" 0 DISPLAY_IDENTIFIER FordMsg077BusHiSpd.CalibrationPorts.FordMsg077BusHiSpdVehLatACmpdVldFaildThd.Val /end CHARACTERISTIC
/begin CHARACTERISTIC FordMsg077BusHiSpd.FordMsg077BusHiSpdVehLatACmpdVldPassdThd.Val "MICROSAR RTE" VALUE 0x0 RTE_RL_UWORD 0 NO_COMPU_METHOD 0 65535 SYMBOL_LINK "Rte_CalprmRom_CalRegn01Cmn_DEFAULT_RTE_CALPRM_GROUP.FordMsg077BusHiSpdVehLatACmpdVldPassdThd_Val" 0 DISPLAY_IDENTIFIER FordMsg077BusHiSpd.CalibrationPorts.FordMsg077BusHiSpdVehLatACmpdVldPassdThd.Val /end CHARACTERISTIC
/begin CHARACTERISTIC FordMsg077BusHiSpd.FordMsg077BusHiSpdVehLgtACmpdVldFaildThd.Val "MICROSAR RTE" VALUE 0x0 RTE_RL_UWORD 0 NO_COMPU_METHOD 0 65535 SYMBOL_LINK "Rte_CalprmRom_CalRegn01Cmn_DEFAULT_RTE_CALPRM_GROUP.FordMsg077BusHiSpdVehLgtACmpdVldFaildThd_Val" 0 DISPLAY_IDENTIFIER FordMsg077BusHiSpd.CalibrationPorts.FordMsg077BusHiSpdVehLgtACmpdVldFaildThd.Val /end CHARACTERISTIC
/begin CHARACTERISTIC FordMsg077BusHiSpd.FordMsg077BusHiSpdVehLgtACmpdVldPassdThd.Val "MICROSAR RTE" VALUE 0x0 RTE_RL_UWORD 0 NO_COMPU_METHOD 0 65535 SYMBOL_LINK "Rte_CalprmRom_CalRegn01Cmn_DEFAULT_RTE_CALPRM_GROUP.FordMsg077BusHiSpdVehLgtACmpdVldPassdThd_Val" 0 DISPLAY_IDENTIFIER FordMsg077BusHiSpd.CalibrationPorts.FordMsg077BusHiSpdVehLgtACmpdVldPassdThd.Val /end CHARACTERISTIC
/begin CHARACTERISTIC FordMsg077BusHiSpd.FordMsg077BusHiSpdVehSpdOverGndVldFaildThd.Val "MICROSAR RTE" VALUE 0x0 RTE_RL_UWORD 0 NO_COMPU_METHOD 0 65535 SYMBOL_LINK "Rte_CalprmRom_CalRegn01Cmn_DEFAULT_RTE_CALPRM_GROUP.FordMsg077BusHiSpdVehSpdOverGndVldFaildThd_Val" 0 DISPLAY_IDENTIFIER FordMsg077BusHiSpd.CalibrationPorts.FordMsg077BusHiSpdVehSpdOverGndVldFaildThd.Val /end CHARACTERISTIC
/begin CHARACTERISTIC FordMsg077BusHiSpd.FordMsg077BusHiSpdVehSpdOverGndVldMissThd.Val "MICROSAR RTE" VALUE 0x0 RTE_RL_UWORD 0 NO_COMPU_METHOD 0 65535 SYMBOL_LINK "Rte_CalprmRom_CalRegn01Cmn_DEFAULT_RTE_CALPRM_GROUP.FordMsg077BusHiSpdVehSpdOverGndVldMissThd_Val" 0 DISPLAY_IDENTIFIER FordMsg077BusHiSpd.CalibrationPorts.FordMsg077BusHiSpdVehSpdOverGndVldMissThd.Val /end CHARACTERISTIC
/begin CHARACTERISTIC FordMsg077BusHiSpd.FordMsg077BusHiSpdVehSpdOverGndVldPassdThd.Val "MICROSAR RTE" VALUE 0x0 RTE_RL_UWORD 0 NO_COMPU_METHOD 0 65535 SYMBOL_LINK "Rte_CalprmRom_CalRegn01Cmn_DEFAULT_RTE_CALPRM_GROUP.FordMsg077BusHiSpdVehSpdOverGndVldPassdThd_Val" 0 DISPLAY_IDENTIFIER FordMsg077BusHiSpd.CalibrationPorts.FordMsg077BusHiSpdVehSpdOverGndVldPassdThd.Val /end CHARACTERISTIC
/begin CHARACTERISTIC FordMsg077BusHiSpd.FordMsg077BusHiSpdVehYawRateCmpdVldFaildThd.Val "MICROSAR RTE" VALUE 0x0 RTE_RL_UWORD 0 NO_COMPU_METHOD 0 65535 SYMBOL_LINK "Rte_CalprmRom_CalRegn01Cmn_DEFAULT_RTE_CALPRM_GROUP.FordMsg077BusHiSpdVehYawRateCmpdVldFaildThd_Val" 0 DISPLAY_IDENTIFIER FordMsg077BusHiSpd.CalibrationPorts.FordMsg077BusHiSpdVehYawRateCmpdVldFaildThd.Val /end CHARACTERISTIC
/begin MEASUREMENT FordCanDtcInhb.FordEpsLifeCycMod.Val "MICROSAR RTE" UBYTE NO_COMPU_METHOD 0 0 0 255 ECU_ADDRESS 0 SYMBOL_LINK "Rte_FordCanDtcInhb_FordEpsLifeCycMod_Val" 0 DISPLAY_IDENTIFIER FordCanDtcInhb.SenderPorts.FordEpsLifeCycMod.Val /end MEASUREMENT
/begin MEASUREMENT FordCanDtcInhb.FordReqdEpsLifeCycModPrev "MICROSAR RTE" UBYTE RTE_CM_ENUM_FordEpsLifeCycMod1 0 0 0 255 ECU_ADDRESS 0 SYMBOL_LINK "Rte_FordCanDtcInhb_FordReqdEpsLifeCycModPrev" 0 DISPLAY_IDENTIFIER FordCanDtcInhb.PerInstanceMemories.FordReqdEpsLifeCycModPrev /end MEASUREMENT
/begin MEASUREMENT FordCanDtcInhb.FordVehElecPwrSts.Ford_ElPw_D_Stat "MICROSAR RTE" UBYTE RTE_CM_ENUM_Ford_ElPw_D_Stat 0 0 0 7 ECU_ADDRESS 0 SYMBOL_LINK "Rte_FordMsg167BusHiSpd_FordVehElecPwrSts_Ford_ElPw_D_Stat" 0 DISPLAY_IDENTIFIER FordCanDtcInhb.ReceiverPorts.FordVehElecPwrSts.Ford_ElPw_D_Stat /end MEASUREMENT
/begin MEASUREMENT FordCanDtcInhb.FordVehIgnStsQly.Ford_Ignition_Status "MICROSAR RTE" UBYTE RTE_CM_ENUM_Ford_Ignition_Status 0 0 0 15 ECU_ADDRESS 0 SYMBOL_LINK "Rte_FordMsg3B3BusHiSpd_FordVehIgnSts_Ford_Ignition_Status" 0 DISPLAY_IDENTIFIER FordCanDtcInhb.ReceiverPorts.FordVehIgnStsQly.Ford_Ignition_Status /end MEASUREMENT
/begin MEASUREMENT FordCanDtcInhb.FordVehLifeCycModQly.Ford_LifeCycMde_D_Actl "MICROSAR RTE" UBYTE RTE_CM_ENUM_Ford_LifeCycMde_D_Actl 0 0 0 15 ECU_ADDRESS 0 SYMBOL_LINK "Rte_FordMsg3B3BusHiSpd_FordVehLifeCycMod_Ford_LifeCycMde_D_Actl" 0 DISPLAY_IDENTIFIER FordCanDtcInhb.ReceiverPorts.FordVehLifeCycModQly.Ford_LifeCycMde_D_Actl /end MEASUREMENT
/begin MEASUREMENT FordCanDtcInhb.FordVehPwrpkTqSts.Ford_PwPckTq_D_Stat "MICROSAR RTE" UBYTE RTE_CM_ENUM_Ford_PwPckTq_D_Stat 0 0 0 3 ECU_ADDRESS 0 SYMBOL_LINK "Rte_FordMsg167BusHiSpd_FordVehPwrpkTqSts_Ford_PwPckTq_D_Stat" 0 DISPLAY_IDENTIFIER FordCanDtcInhb.ReceiverPorts.FordVehPwrpkTqSts.Ford_PwPckTq_D_Stat /end MEASUREMENT
/begin MEASUREMENT FordCmdArbn.EcuId.Val "MICROSAR RTE" UBYTE NO_COMPU_METHOD 0 0 0 255 ECU_ADDRESS 0 SYMBOL_LINK "Rte_DualEcuIdn_EcuId_Val" 0 DISPLAY_IDENTIFIER FordCmdArbn.ReceiverPorts.EcuId.Val /end MEASUREMENT
/begin MEASUREMENT FordCmdArbn.FordActvNiblCtrlArbnCmd.Val "MICROSAR RTE" UBYTE NO_COMPU_METHOD 0 0 0 255 ECU_ADDRESS 0 SYMBOL_LINK "Rte_FordCmdArbn_FordActvNiblCtrlArbnCmd_Val" 0 DISPLAY_IDENTIFIER FordCmdArbn.SenderPorts.FordActvNiblCtrlArbnCmd.Val /end MEASUREMENT
/begin MEASUREMENT FordCmdArbn.FordActvNiblCtrlFeatSt.Val "MICROSAR RTE" UBYTE NO_COMPU_METHOD 0 0 0 255 ECU_ADDRESS 0 SYMBOL_LINK "Rte_CDD_FordBlaBoxIfCmp1_FordActvNiblCtrlFeatSt_Val" 0 DISPLAY_IDENTIFIER FordCmdArbn.ReceiverPorts.FordActvNiblCtrlFeatSt.Val /end MEASUREMENT
/begin MEASUREMENT FordCmdArbn.FordDrvrSteerRcmdnArbnCmd.Val "MICROSAR RTE" UBYTE NO_COMPU_METHOD 0 0 0 255 ECU_ADDRESS 0 SYMBOL_LINK "Rte_FordCmdArbn_FordDrvrSteerRcmdnArbnCmd_Val" 0 DISPLAY_IDENTIFIER FordCmdArbn.SenderPorts.FordDrvrSteerRcmdnArbnCmd.Val /end MEASUREMENT
/begin MEASUREMENT FordCmdArbn.FordDrvrSteerRcmdnFeatSt.Val "MICROSAR RTE" UBYTE NO_COMPU_METHOD 0 0 0 255 ECU_ADDRESS 0 SYMBOL_LINK "Rte_FordCmdArbn_FordDrvrSteerRcmdnFeatSt_Val" 0 DISPLAY_IDENTIFIER FordCmdArbn.ReceiverPorts.FordDrvrSteerRcmdnFeatSt.Val /end MEASUREMENT
/begin MEASUREMENT FordCmdArbn.FordEvasSteerAssiArbnCmd.Val "MICROSAR RTE" UBYTE NO_COMPU_METHOD 0 0 0 255 ECU_ADDRESS 0 SYMBOL_LINK "Rte_FordCmdArbn_FordEvasSteerAssiArbnCmd_Val" 0 DISPLAY_IDENTIFIER FordCmdArbn.SenderPorts.FordEvasSteerAssiArbnCmd.Val /end MEASUREMENT
/begin MEASUREMENT FordCmdArbn.FordEvasSteerAssiFeatSt.Val "MICROSAR RTE" UBYTE NO_COMPU_METHOD 0 0 0 255 ECU_ADDRESS 0 SYMBOL_LINK "Rte_CDD_FordBlaBoxIfCmp2_FordEvasSteerAssiFeatSt_Val" 0 DISPLAY_IDENTIFIER FordCmdArbn.ReceiverPorts.FordEvasSteerAssiFeatSt.Val /end MEASUREMENT
/begin MEASUREMENT FordCmdArbn.FordExtAgCtrlArbnCmd.Val "MICROSAR RTE" UBYTE NO_COMPU_METHOD 0 0 0 255 ECU_ADDRESS 0 SYMBOL_LINK "Rte_FordCmdArbn_FordExtAgCtrlArbnCmd_Val" 0 DISPLAY_IDENTIFIER FordCmdArbn.SenderPorts.FordExtAgCtrlArbnCmd.Val /end MEASUREMENT
/begin MEASUREMENT FordCmdArbn.FordExtAgCtrlFeatSt.Val "MICROSAR RTE" UBYTE NO_COMPU_METHOD 0 0 0 255 ECU_ADDRESS 0 SYMBOL_LINK "Rte_FordCmdArbn_FordExtAgCtrlFeatSt_Val" 0 DISPLAY_IDENTIFIER FordCmdArbn.ReceiverPorts.FordExtAgCtrlFeatSt.Val /end MEASUREMENT
/begin MEASUREMENT FordCmdArbn.FordLaneDprtrWarnArbnCmd.Val "MICROSAR RTE" UBYTE NO_COMPU_METHOD 0 0 0 255 ECU_ADDRESS 0 SYMBOL_LINK "Rte_FordCmdArbn_FordLaneDprtrWarnArbnCmd_Val" 0 DISPLAY_IDENTIFIER FordCmdArbn.SenderPorts.FordLaneDprtrWarnArbnCmd.Val /end MEASUREMENT
/begin MEASUREMENT FordCmdArbn.FordLaneDprtrWarnFeatSt.Val "MICROSAR RTE" UBYTE NO_COMPU_METHOD 0 0 0 255 ECU_ADDRESS 0 SYMBOL_LINK "Rte_CDD_FordBlaBoxIfCmp1_FordLaneDprtrWarnFeatSt_Val" 0 DISPLAY_IDENTIFIER FordCmdArbn.ReceiverPorts.FordLaneDprtrWarnFeatSt.Val /end MEASUREMENT
/begin MEASUREMENT FordCmdArbn.FordLaneKeepAssiArbnCmd.Val "MICROSAR RTE" UBYTE NO_COMPU_METHOD 0 0 0 255 ECU_ADDRESS 0 SYMBOL_LINK "Rte_FordCmdArbn_FordLaneKeepAssiArbnCmd_Val" 0 DISPLAY_IDENTIFIER FordCmdArbn.SenderPorts.FordLaneKeepAssiArbnCmd.Val /end MEASUREMENT
/begin MEASUREMENT FordCmdArbn.FordLaneKeepAssiFeatSt.Val "MICROSAR RTE" UBYTE NO_COMPU_METHOD 0 0 0 255 ECU_ADDRESS 0 SYMBOL_LINK "Rte_CDD_FordBlaBoxIfCmp1_FordLaneKeepAssiFeatSt_Val" 0 DISPLAY_IDENTIFIER FordCmdArbn.ReceiverPorts.FordLaneKeepAssiFeatSt.Val /end MEASUREMENT
/begin MEASUREMENT FordCmdArbn.FordLatCtrlArbnCmd.Val "MICROSAR RTE" UBYTE NO_COMPU_METHOD 0 0 0 255 ECU_ADDRESS 0 SYMBOL_LINK "Rte_FordCmdArbn_FordLatCtrlArbnCmd_Val" 0 DISPLAY_IDENTIFIER FordCmdArbn.SenderPorts.FordLatCtrlArbnCmd.Val /end MEASUREMENT
/begin MEASUREMENT FordCmdArbn.FordLatCtrlFeatSt.Val "MICROSAR RTE" UBYTE NO_COMPU_METHOD 0 0 0 255 ECU_ADDRESS 0 SYMBOL_LINK "Rte_CDD_FordBlaBoxIfCmp1_FordLatCtrlFeatSt_Val" 0 DISPLAY_IDENTIFIER FordCmdArbn.ReceiverPorts.FordLatCtrlFeatSt.Val /end MEASUREMENT
/begin MEASUREMENT FordCmdArbn.FordPullDriftCmpArbnCmd.Val "MICROSAR RTE" UBYTE NO_COMPU_METHOD 0 0 0 255 ECU_ADDRESS 0 SYMBOL_LINK "Rte_FordCmdArbn_FordPullDriftCmpArbnCmd_Val" 0 DISPLAY_IDENTIFIER FordCmdArbn.SenderPorts.FordPullDriftCmpArbnCmd.Val /end MEASUREMENT
/begin MEASUREMENT FordCmdArbn.FordPullDriftCmpFeatSt.Val "MICROSAR RTE" UBYTE NO_COMPU_METHOD 0 0 0 255 ECU_ADDRESS 0 SYMBOL_LINK "Rte_CDD_FordBlaBoxIfCmp1_FordPullDriftCmpFeatSt_Val" 0 DISPLAY_IDENTIFIER FordCmdArbn.ReceiverPorts.FordPullDriftCmpFeatSt.Val /end MEASUREMENT
/begin MEASUREMENT FordCmdArbn.FordPullDriftCmpLrngArbnCmd.Val "MICROSAR RTE" UBYTE NO_COMPU_METHOD 0 0 0 255 ECU_ADDRESS 0 SYMBOL_LINK "Rte_FordCmdArbn_FordPullDriftCmpLrngArbnCmd_Val" 0 DISPLAY_IDENTIFIER FordCmdArbn.SenderPorts.FordPullDriftCmpLrngArbnCmd.Val /end MEASUREMENT
/begin MEASUREMENT FordCmdArbn.FordPullDriftCmpLrngFeatSt.Val "MICROSAR RTE" UBYTE NO_COMPU_METHOD 0 0 0 255 ECU_ADDRESS 0 SYMBOL_LINK "Rte_CDD_FordBlaBoxIfCmp1_FordPullDriftCmpLrngFeatSt_Val" 0 DISPLAY_IDENTIFIER FordCmdArbn.ReceiverPorts.FordPullDriftCmpLrngFeatSt.Val /end MEASUREMENT
/begin MEASUREMENT FordCmdArbn.FordSpare1ArbnCmd.Val "MICROSAR RTE" UBYTE NO_COMPU_METHOD 0 0 0 255 ECU_ADDRESS 0 SYMBOL_LINK "Rte_FordCmdArbn_FordSpare1ArbnCmd_Val" 0 DISPLAY_IDENTIFIER FordCmdArbn.SenderPorts.FordSpare1ArbnCmd.Val /end MEASUREMENT
/begin MEASUREMENT FordCmdArbn.FordSpare1FeatSt.Val "MICROSAR RTE" UBYTE NO_COMPU_METHOD 0 0 0 255 ECU_ADDRESS 0 SYMBOL_LINK "Rte_FordCmdArbn_FordSpare1FeatSt_Val" 0 DISPLAY_IDENTIFIER FordCmdArbn.ReceiverPorts.FordSpare1FeatSt.Val /end MEASUREMENT
/begin MEASUREMENT FordCmdArbn.FordSpare2ArbnCmd.Val "MICROSAR RTE" UBYTE NO_COMPU_METHOD 0 0 0 255 ECU_ADDRESS 0 SYMBOL_LINK "Rte_FordCmdArbn_FordSpare2ArbnCmd_Val" 0 DISPLAY_IDENTIFIER FordCmdArbn.SenderPorts.FordSpare2ArbnCmd.Val /end MEASUREMENT
/begin MEASUREMENT FordCmdArbn.FordSpare2FeatSt.Val "MICROSAR RTE" UBYTE NO_COMPU_METHOD 0 0 0 255 ECU_ADDRESS 0 SYMBOL_LINK "Rte_FordCmdArbn_FordSpare2FeatSt_Val" 0 DISPLAY_IDENTIFIER FordCmdArbn.ReceiverPorts.FordSpare2FeatSt.Val /end MEASUREMENT
/begin MEASUREMENT FordCmdArbn.FordSpare3ArbnCmd.Val "MICROSAR RTE" UBYTE NO_COMPU_METHOD 0 0 0 255 ECU_ADDRESS 0 SYMBOL_LINK "Rte_FordCmdArbn_FordSpare3ArbnCmd_Val" 0 DISPLAY_IDENTIFIER FordCmdArbn.SenderPorts.FordSpare3ArbnCmd.Val /end MEASUREMENT
/begin MEASUREMENT FordCmdArbn.FordSpare3FeatSt.Val "MICROSAR RTE" UBYTE NO_COMPU_METHOD 0 0 0 255 ECU_ADDRESS 0 SYMBOL_LINK "Rte_FordCmdArbn_FordSpare3FeatSt_Val" 0 DISPLAY_IDENTIFIER FordCmdArbn.ReceiverPorts.FordSpare3FeatSt.Val /end MEASUREMENT
/begin MEASUREMENT FordCmdArbn.FordSteerModlSts.Val "MICROSAR RTE" UBYTE NO_COMPU_METHOD 0 0 0 255 ECU_ADDRESS 0 SYMBOL_LINK "Rte_FordCmdArbn_FordSteerModlSts_Val" 0 DISPLAY_IDENTIFIER FordCmdArbn.ReceiverPorts.FordSteerModlSts.Val /end MEASUREMENT
/begin MEASUREMENT FordCmdArbn.FordSteerTqDstbcRejctnArbnCmd.Val "MICROSAR RTE" UBYTE NO_COMPU_METHOD 0 0 0 255 ECU_ADDRESS 0 SYMBOL_LINK "Rte_FordCmdArbn_FordSteerTqDstbcRejctnArbnCmd_Val" 0 DISPLAY_IDENTIFIER FordCmdArbn.SenderPorts.FordSteerTqDstbcRejctnArbnCmd.Val /end MEASUREMENT
/begin MEASUREMENT FordCmdArbn.FordSteerTqDstbcRejctnFeatSt.Val "MICROSAR RTE" UBYTE NO_COMPU_METHOD 0 0 0 255 ECU_ADDRESS 0 SYMBOL_LINK "Rte_CDD_FordBlaBoxIfCmp2_FordSteerTqDstbcRejctnFeatSt_Val" 0 DISPLAY_IDENTIFIER FordCmdArbn.ReceiverPorts.FordSteerTqDstbcRejctnFeatSt.Val /end MEASUREMENT
/begin MEASUREMENT FordCmdArbn.FordSysOperMotTqCmdSca.Val "MICROSAR RTE" FLOAT32_IEEE NO_COMPU_METHOD 0 0 -3.402823466e+38 3.402823466e+38 ECU_ADDRESS 0 SYMBOL_LINK "Rte_FordCmdArbn_FordSysOperMotTqCmdSca_Val" 0 DISPLAY_IDENTIFIER FordCmdArbn.ReceiverPorts.FordSysOperMotTqCmdSca.Val /end MEASUREMENT
/begin MEASUREMENT FordDualEcuFltDiagcCom.EcuId.Val "MICROSAR RTE" UBYTE NO_COMPU_METHOD 0 0 0 255 ECU_ADDRESS 0 SYMBOL_LINK "Rte_DualEcuIdn_EcuId_Val" 0 DISPLAY_IDENTIFIER FordDualEcuFltDiagcCom.ReceiverPorts.EcuId.Val /end MEASUREMENT
/begin MEASUREMENT FordDualEcuFltDiagcCom.FordCTCLoopIdx "MICROSAR RTE" UBYTE NO_COMPU_METHOD 0 0 0 255 ECU_ADDRESS 0 SYMBOL_LINK "Rte_FordDualEcuFltDiagcCom_FordCTCLoopIdx" 0 DISPLAY_IDENTIFIER FordDualEcuFltDiagcCom.PerInstanceMemories.FordCTCLoopIdx /end MEASUREMENT
/begin MEASUREMENT FordDualEcuFltDiagcCom.FordCtcIdx.Val "MICROSAR RTE" UBYTE NO_COMPU_METHOD 0 0 0 255 ECU_ADDRESS 0 SYMBOL_LINK "Rte_FordDualEcuFltDiagcCom_FordCtcIdx_Val" 0 DISPLAY_IDENTIFIER FordDualEcuFltDiagcCom.SenderPorts.FordCtcIdx.Val /end MEASUREMENT
/begin MEASUREMENT FordDualEcuFltDiagcCom.FordCtcSts.Val "MICROSAR RTE" UBYTE NO_COMPU_METHOD 0 0 0 255 ECU_ADDRESS 0 SYMBOL_LINK "Rte_FordDualEcuFltDiagcCom_FordCtcSts_Val" 0 DISPLAY_IDENTIFIER FordDualEcuFltDiagcCom.SenderPorts.FordCtcSts.Val /end MEASUREMENT
/begin MEASUREMENT FordHwAgArbn.FirstTranVldFlg "MICROSAR RTE" UBYTE RTE_CM_BOOLEAN 0 0 0 255 ECU_ADDRESS 0 SYMBOL_LINK "Rte_FordHwAgArbn_FirstTranVldFlg" 0 DISPLAY_IDENTIFIER FordHwAgArbn.PerInstanceMemories.FirstTranVldFlg /end MEASUREMENT
/begin MEASUREMENT FordHwAgArbn.FordAbsPrsnt.Logl "MICROSAR RTE" UBYTE RTE_CM_BOOLEAN 0 0 0 255 ECU_ADDRESS 0 SYMBOL_LINK "Rte_CustDiag_FordAbsPrsnt_Logl" 0 DISPLAY_IDENTIFIER FordHwAgArbn.ReceiverPorts.FordAbsPrsnt.Logl /end MEASUREMENT
/begin MEASUREMENT FordHwAgArbn.FordCmpdHwPosn.Val "MICROSAR RTE" FLOAT32_IEEE NO_COMPU_METHOD 0 0 -3.402823466e+38 3.402823466e+38 ECU_ADDRESS 0 SYMBOL_LINK "Rte_FordHwAgArbn_FordCmpdHwPosn_Val" 0 DISPLAY_IDENTIFIER FordHwAgArbn.SenderPorts.FordCmpdHwPosn.Val /end MEASUREMENT
/begin MEASUREMENT FordHwAgArbn.FordCmpdHwPosnPrev "MICROSAR RTE" FLOAT32_IEEE NO_COMPU_METHOD 0 0 -3.402823466e+38 3.402823466e+38 ECU_ADDRESS 0 SYMBOL_LINK "Rte_FordHwAgArbn_FordCmpdHwPosnPrev" 0 DISPLAY_IDENTIFIER FordHwAgArbn.PerInstanceMemories.FordCmpdHwPosnPrev /end MEASUREMENT
/begin MEASUREMENT FordHwAgArbn.FordCmpdHwPosnQlyFac.Ford_StePinCompAnEst_D_Qf "MICROSAR RTE" UBYTE RTE_CM_ENUM_Ford_StePinCompAnEst_D_Qf 0 0 0 3 ECU_ADDRESS 0 SYMBOL_LINK "Rte_FordHwAgArbn_FordCmpdHwPosnQlyFac_Ford_StePinCompAnEst_D_Qf" 0 DISPLAY_IDENTIFIER FordHwAgArbn.SenderPorts.FordCmpdHwPosnQlyFac.Ford_StePinCompAnEst_D_Qf /end MEASUREMENT
/begin MEASUREMENT FordHwAgArbn.FordCmpdHwPosnQlyFac8.Val "MICROSAR RTE" UBYTE NO_COMPU_METHOD 0 0 0 255 ECU_ADDRESS 0 SYMBOL_LINK "Rte_FordHwAgArbn_FordCmpdHwPosnQlyFac8_Val" 0 DISPLAY_IDENTIFIER FordHwAgArbn.SenderPorts.FordCmpdHwPosnQlyFac8.Val /end MEASUREMENT
/begin MEASUREMENT FordHwAgArbn.FordCmpdHwPosnQlyFacPrev "MICROSAR RTE" UBYTE RTE_CM_ENUM_Ford_StePinCompAnEst_D_Qf 0 0 0 3 ECU_ADDRESS 0 SYMBOL_LINK "Rte_FordHwAgArbn_FordCmpdHwPosnQlyFacPrev" 0 DISPLAY_IDENTIFIER FordHwAgArbn.PerInstanceMemories.FordCmpdHwPosnQlyFacPrev /end MEASUREMENT
/begin MEASUREMENT FordHwAgArbn.FordCmpdHwPosntoSerlCom.Val "MICROSAR RTE" FLOAT32_IEEE NO_COMPU_METHOD 0 0 -3.402823466e+38 3.402823466e+38 ECU_ADDRESS 0 SYMBOL_LINK "Rte_FordHwAgArbn_FordCmpdHwPosntoSerlCom_Val" 0 DISPLAY_IDENTIFIER FordHwAgArbn.SenderPorts.FordCmpdHwPosntoSerlCom.Val /end MEASUREMENT
/begin MEASUREMENT FordHwAgArbn.FordEngVehSpd.Val "MICROSAR RTE" FLOAT32_IEEE NO_COMPU_METHOD 0 0 -3.402823466e+38 3.402823466e+38 ECU_ADDRESS 0 SYMBOL_LINK "Rte_FordMsg202BusHiSpd_FordVehSpdEngModl_Val" 0 DISPLAY_IDENTIFIER FordHwAgArbn.ReceiverPorts.FordEngVehSpd.Val /end MEASUREMENT
/begin MEASUREMENT FordHwAgArbn.FordHwVelVld.Logl "MICROSAR RTE" UBYTE RTE_CM_BOOLEAN 0 0 0 255 ECU_ADDRESS 0 SYMBOL_LINK "Rte_FordHwAgArbn_FordHwVelVld_Logl" 0 DISPLAY_IDENTIFIER FordHwAgArbn.SenderPorts.FordHwVelVld.Logl /end MEASUREMENT
/begin MEASUREMENT FordHwAgArbn.FordInpTq.Val "MICROSAR RTE" FLOAT32_IEEE NO_COMPU_METHOD 0 0 -3.402823466e+38 3.402823466e+38 ECU_ADDRESS 0 SYMBOL_LINK "Rte_ImcSigArbn_HwTqImcCorrd_Val" 0 DISPLAY_IDENTIFIER FordHwAgArbn.ReceiverPorts.FordInpTq.Val /end MEASUREMENT
/begin MEASUREMENT FordHwAgArbn.FordMotPosn.Val "MICROSAR RTE" SLONG NO_COMPU_METHOD 0 0 -2147483648 2147483647 ECU_ADDRESS 0 SYMBOL_LINK "Rte_CDD_MotAgCmp_MotAgCumvAlgndMrf_Val" 0 DISPLAY_IDENTIFIER FordHwAgArbn.ReceiverPorts.FordMotPosn.Val /end MEASUREMENT
/begin MEASUREMENT FordHwAgArbn.FordMotVelVld.Logl "MICROSAR RTE" UBYTE RTE_CM_BOOLEAN 0 0 0 255 ECU_ADDRESS 0 SYMBOL_LINK "Rte_CDD_MotVel_MotVelVld_Logl" 0 DISPLAY_IDENTIFIER FordHwAgArbn.ReceiverPorts.FordMotVelVld.Logl /end MEASUREMENT
/begin MEASUREMENT FordHwAgArbn.FordPosnOffsVld.Logl "MICROSAR RTE" UBYTE RTE_CM_BOOLEAN 0 0 0 255 ECU_ADDRESS 0 SYMBOL_LINK "Rte_FordHwAgArbn_FordPosnOffsVld_Logl" 0 DISPLAY_IDENTIFIER FordHwAgArbn.SenderPorts.FordPosnOffsVld.Logl /end MEASUREMENT
/begin MEASUREMENT FordHwAgArbn.FordRelHwPosn.Val "MICROSAR RTE" FLOAT32_IEEE NO_COMPU_METHOD 0 0 -3.402823466e+38 3.402823466e+38 ECU_ADDRESS 0 SYMBOL_LINK "Rte_FordHwAgArbn_FordRelHwPosn_Val" 0 DISPLAY_IDENTIFIER FordHwAgArbn.SenderPorts.FordRelHwPosn.Val /end MEASUREMENT
/begin MEASUREMENT FordHwAgArbn.FordRelHwPosnVld.Logl "MICROSAR RTE" UBYTE RTE_CM_BOOLEAN 0 0 0 255 ECU_ADDRESS 0 SYMBOL_LINK "Rte_FordHwAgArbn_FordRelHwPosnVld_Logl" 0 DISPLAY_IDENTIFIER FordHwAgArbn.SenderPorts.FordRelHwPosnVld.Logl /end MEASUREMENT
/begin MEASUREMENT FordHwAgArbn.FordRelHwPosntoSerlCom.Val "MICROSAR RTE" FLOAT32_IEEE NO_COMPU_METHOD 0 0 -3.402823466e+38 3.402823466e+38 ECU_ADDRESS 0 SYMBOL_LINK "Rte_FordHwAgArbn_FordRelHwPosntoSerlCom_Val" 0 DISPLAY_IDENTIFIER FordHwAgArbn.SenderPorts.FordRelHwPosntoSerlCom.Val /end MEASUREMENT
/begin MEASUREMENT FordHwAgArbn.FordSnsrInp.Val "MICROSAR RTE" FLOAT32_IEEE NO_COMPU_METHOD 0 0 -3.402823466e+38 3.402823466e+38 ECU_ADDRESS 0 SYMBOL_LINK "Rte_HwAgSysArbn_HwAgNotCorrd_Val" 0 DISPLAY_IDENTIFIER FordHwAgArbn.ReceiverPorts.FordSnsrInp.Val /end MEASUREMENT
/begin MEASUREMENT FordHwAgArbn.FordSteerAgClrFlg.Logl "MICROSAR RTE" UBYTE RTE_CM_BOOLEAN 0 0 0 255 ECU_ADDRESS 0 SYMBOL_LINK "Rte_FordHwAgArbn_FordSteerAgClrFlg_Logl" 0 DISPLAY_IDENTIFIER FordHwAgArbn.ReceiverPorts.FordSteerAgClrFlg.Logl /end MEASUREMENT
/begin MEASUREMENT FordHwAgArbn.FordSteerPinionOffs.Val "MICROSAR RTE" FLOAT32_IEEE NO_COMPU_METHOD 0 0 -3.402823466e+38 3.402823466e+38 ECU_ADDRESS 0 SYMBOL_LINK "Rte_FordMsg414BusHiSpd_FordVehSteerPinionAgOffs_Val" 0 DISPLAY_IDENTIFIER FordHwAgArbn.ReceiverPorts.FordSteerPinionOffs.Val /end MEASUREMENT
/begin MEASUREMENT FordHwAgArbn.FordSteerPinionOffsSts.Ford_StePinOffst_D_Stat "MICROSAR RTE" UBYTE RTE_CM_ENUM_Ford_StePinOffst_D_Stat 0 0 0 3 ECU_ADDRESS 0 SYMBOL_LINK "Rte_FordMsg414BusHiSpd_FordVehSteerPinionOffsSts_Ford_StePinOffst_D_Stat" 0 DISPLAY_IDENTIFIER FordHwAgArbn.ReceiverPorts.FordSteerPinionOffsSts.Ford_StePinOffst_D_Stat /end MEASUREMENT
/begin MEASUREMENT FordHwAgArbn.FordSteerPinionOffsStsPrev "MICROSAR RTE" UBYTE RTE_CM_ENUM_Ford_StePinOffst_D_Stat 0 0 0 3 ECU_ADDRESS 0 SYMBOL_LINK "Rte_FordHwAgArbn_FordSteerPinionOffsStsPrev" 0 DISPLAY_IDENTIFIER FordHwAgArbn.PerInstanceMemories.FordSteerPinionOffsStsPrev /end MEASUREMENT
/begin MEASUREMENT FordHwAgArbn.HwAgIdptSig.Val "MICROSAR RTE" UBYTE NO_COMPU_METHOD 0 0 0 255 ECU_ADDRESS 0 SYMBOL_LINK "Rte_HwAgCorrln_HwAgIdptSig_Val" 0 DISPLAY_IDENTIFIER FordHwAgArbn.ReceiverPorts.HwAgIdptSig.Val /end MEASUREMENT
/begin MEASUREMENT FordHwAgArbn.MotVelVldTrueTi "MICROSAR RTE" ULONG NO_COMPU_METHOD 0 0 0 4294967295 ECU_ADDRESS 0 SYMBOL_LINK "Rte_FordHwAgArbn_MotVelVldTrueTi" 0 DISPLAY_IDENTIFIER FordHwAgArbn.PerInstanceMemories.MotVelVldTrueTi /end MEASUREMENT
/begin MEASUREMENT FordHwAgArbn.NoDataExistFlg "MICROSAR RTE" UBYTE RTE_CM_BOOLEAN 0 0 0 255 ECU_ADDRESS 0 SYMBOL_LINK "Rte_FordHwAgArbn_NoDataExistFlg" 0 DISPLAY_IDENTIFIER FordHwAgArbn.PerInstanceMemories.NoDataExistFlg /end MEASUREMENT
/begin MEASUREMENT FordHwAgArbn.NonAbsCentrNotDetdTi "MICROSAR RTE" ULONG NO_COMPU_METHOD 0 0 0 4294967295 ECU_ADDRESS 0 SYMBOL_LINK "Rte_FordHwAgArbn_NonAbsCentrNotDetdTi" 0 DISPLAY_IDENTIFIER FordHwAgArbn.PerInstanceMemories.NonAbsCentrNotDetdTi /end MEASUREMENT
/begin MEASUREMENT FordHwAgArbn.NonAbsOffs "MICROSAR RTE" FLOAT32_IEEE NO_COMPU_METHOD 0 0 -3.402823466e+38 3.402823466e+38 ECU_ADDRESS 0 SYMBOL_LINK "Rte_FordHwAgArbn_NonAbsOffs" 0 DISPLAY_IDENTIFIER FordHwAgArbn.PerInstanceMemories.NonAbsOffs /end MEASUREMENT
/begin MEASUREMENT FordHwAgArbn.NonAbsOffsVldFlg "MICROSAR RTE" UBYTE RTE_CM_BOOLEAN 0 0 0 255 ECU_ADDRESS 0 SYMBOL_LINK "Rte_FordHwAgArbn_NonAbsOffsVldFlg" 0 DISPLAY_IDENTIFIER FordHwAgArbn.PerInstanceMemories.NonAbsOffsVldFlg /end MEASUREMENT
/begin MEASUREMENT FordHwAgArbn.PrevIgnCycVal "MICROSAR RTE" FLOAT32_IEEE NO_COMPU_METHOD 0 0 -3.402823466e+38 3.402823466e+38 ECU_ADDRESS 0 SYMBOL_LINK "Rte_FordHwAgArbn_PrevIgnCycVal" 0 DISPLAY_IDENTIFIER FordHwAgArbn.PerInstanceMemories.PrevIgnCycVal /end MEASUREMENT
/begin MEASUREMENT FordHwAgArbn.RelHwPosnPrev "MICROSAR RTE" FLOAT32_IEEE NO_COMPU_METHOD 0 0 -3.402823466e+38 3.402823466e+38 ECU_ADDRESS 0 SYMBOL_LINK "Rte_FordHwAgArbn_RelHwPosnPrev" 0 DISPLAY_IDENTIFIER FordHwAgArbn.PerInstanceMemories.RelHwPosnPrev /end MEASUREMENT
/begin MEASUREMENT FordHwAgArbn.RelHwPosnVld "MICROSAR RTE" UBYTE RTE_CM_BOOLEAN 0 0 0 255 ECU_ADDRESS 0 SYMBOL_LINK "Rte_FordHwAgArbn_RelHwPosnVld" 0 DISPLAY_IDENTIFIER FordHwAgArbn.PerInstanceMemories.RelHwPosnVld /end MEASUREMENT
/begin MEASUREMENT FordHwAgArbn.RelPosnLossFlg "MICROSAR RTE" UBYTE RTE_CM_BOOLEAN 0 0 0 255 ECU_ADDRESS 0 SYMBOL_LINK "Rte_FordHwAgArbn_RelPosnLossFlg" 0 DISPLAY_IDENTIFIER FordHwAgArbn.PerInstanceMemories.RelPosnLossFlg /end MEASUREMENT
/begin MEASUREMENT FordHwAgArbn.RelPosnVldFlgRcvryTi "MICROSAR RTE" ULONG NO_COMPU_METHOD 0 0 0 4294967295 ECU_ADDRESS 0 SYMBOL_LINK "Rte_FordHwAgArbn_RelPosnVldFlgRcvryTi" 0 DISPLAY_IDENTIFIER FordHwAgArbn.PerInstanceMemories.RelPosnVldFlgRcvryTi /end MEASUREMENT
/begin MEASUREMENT FordHwTqCdng.AppldFinalMotTqVldRefTi "Timer for Valid Reference Time will increment or reset based on the conditions" ULONG NO_COMPU_METHOD 0 0 0 4294967295 ECU_ADDRESS 0 SYMBOL_LINK "Rte_FordHwTqCdng_AppldFinalMotTqVldRefTi" 0 DISPLAY_IDENTIFIER FordHwTqCdng.PerInstanceMemories.AppldFinalMotTqVldRefTi /end MEASUREMENT
/begin MEASUREMENT FordHwTqCdng.AssiCmd.Val "MICROSAR RTE" FLOAT32_IEEE NO_COMPU_METHOD 0 0 -3.402823466e+38 3.402823466e+38 ECU_ADDRESS 0 SYMBOL_LINK "Rte_StabyCmp_AssiCmd_Val" 0 DISPLAY_IDENTIFIER FordHwTqCdng.ReceiverPorts.AssiCmd.Val /end MEASUREMENT
/begin MEASUREMENT FordHwTqCdng.AssiCmdBas.Val "MICROSAR RTE" FLOAT32_IEEE NO_COMPU_METHOD 0 0 -3.402823466e+38 3.402823466e+38 ECU_ADDRESS 0 SYMBOL_LINK "Rte_Assi_AssiCmdBas_Val" 0 DISPLAY_IDENTIFIER FordHwTqCdng.ReceiverPorts.AssiCmdBas.Val /end MEASUREMENT
/begin MEASUREMENT FordHwTqCdng.AvlMotTq.Val "MICROSAR RTE" FLOAT32_IEEE NO_COMPU_METHOD 0 0 -3.402823466e+38 3.402823466e+38 ECU_ADDRESS 0 SYMBOL_LINK "Rte_FordHwTqCdng_AvlMotTq_Val" 0 DISPLAY_IDENTIFIER FordHwTqCdng.ReceiverPorts.AvlMotTq.Val /end MEASUREMENT
/begin MEASUREMENT FordHwTqCdng.EcuId.Val "MICROSAR RTE" UBYTE NO_COMPU_METHOD 0 0 0 255 ECU_ADDRESS 0 SYMBOL_LINK "Rte_DualEcuIdn_EcuId_Val" 0 DISPLAY_IDENTIFIER FordHwTqCdng.ReceiverPorts.EcuId.Val /end MEASUREMENT
/begin MEASUREMENT FordHwTqCdng.FordAppldFinalMotTq.Val "MICROSAR RTE" SLONG NO_COMPU_METHOD 0 0 -2147483648 2147483647 ECU_ADDRESS 0 SYMBOL_LINK "Rte_FordHwTqCdng_FordAppldFinalMotTq_Val" 0 DISPLAY_IDENTIFIER FordHwTqCdng.SenderPorts.FordAppldFinalMotTq.Val /end MEASUREMENT
/begin MEASUREMENT FordHwTqCdng.FordAppldFinalMotTqVld.Logl "MICROSAR RTE" UBYTE RTE_CM_BOOLEAN 0 0 0 255 ECU_ADDRESS 0 SYMBOL_LINK "Rte_FordHwTqCdng_FordAppldFinalMotTqVld_Logl" 0 DISPLAY_IDENTIFIER FordHwTqCdng.SenderPorts.FordAppldFinalMotTqVld.Logl /end MEASUREMENT
/begin MEASUREMENT FordHwTqCdng.FordBoostCrvAssiTq.Val "MICROSAR RTE" SWORD NO_COMPU_METHOD 0 0 -32768 32767 ECU_ADDRESS 0 SYMBOL_LINK "Rte_FordHwTqCdng_FordBoostCrvAssiTq_Val" 0 DISPLAY_IDENTIFIER FordHwTqCdng.SenderPorts.FordBoostCrvAssiTq.Val /end MEASUREMENT
/begin MEASUREMENT FordHwTqCdng.FordBoostCrvInpTq.Val "MICROSAR RTE" SWORD NO_COMPU_METHOD 0 0 -32768 32767 ECU_ADDRESS 0 SYMBOL_LINK "Rte_FordHwTqCdng_FordBoostCrvInpTq_Val" 0 DISPLAY_IDENTIFIER FordHwTqCdng.SenderPorts.FordBoostCrvInpTq.Val /end MEASUREMENT
/begin MEASUREMENT FordHwTqCdng.FordInpTqRaw.Val "MICROSAR RTE" SWORD NO_COMPU_METHOD 0 0 -32768 32767 ECU_ADDRESS 0 SYMBOL_LINK "Rte_FordHwTqCdng_FordInpTqRaw_Val" 0 DISPLAY_IDENTIFIER FordHwTqCdng.SenderPorts.FordInpTqRaw.Val /end MEASUREMENT
/begin MEASUREMENT FordHwTqCdng.FordInpTqRawVld.Logl "MICROSAR RTE" UBYTE RTE_CM_BOOLEAN 0 0 0 255 ECU_ADDRESS 0 SYMBOL_LINK "Rte_FordHwTqCdng_FordInpTqRawVld_Logl" 0 DISPLAY_IDENTIFIER FordHwTqCdng.SenderPorts.FordInpTqRawVld.Logl /end MEASUREMENT
/begin MEASUREMENT FordHwTqCdng.FordMaxAsscTq.Val "MICROSAR RTE" FLOAT32_IEEE NO_COMPU_METHOD 0 0 -3.402823466e+38 3.402823466e+38 ECU_ADDRESS 0 SYMBOL_LINK "Rte_FordHwTqCdng_FordMaxAsscTq_Val" 0 DISPLAY_IDENTIFIER FordHwTqCdng.SenderPorts.FordMaxAsscTq.Val /end MEASUREMENT
/begin MEASUREMENT FordHwTqCdng.FordReqdFinalMotTq.Val "MICROSAR RTE" SLONG NO_COMPU_METHOD 0 0 -2147483648 2147483647 ECU_ADDRESS 0 SYMBOL_LINK "Rte_FordHwTqCdng_FordReqdFinalMotTq_Val" 0 DISPLAY_IDENTIFIER FordHwTqCdng.SenderPorts.FordReqdFinalMotTq.Val /end MEASUREMENT
/begin MEASUREMENT FordHwTqCdng.FordSumBoostCrvInpTq.Val "MICROSAR RTE" SWORD NO_COMPU_METHOD 0 0 -32768 32767 ECU_ADDRESS 0 SYMBOL_LINK "Rte_FordHwTqCdng_FordSumBoostCrvInpTq_Val" 0 DISPLAY_IDENTIFIER FordHwTqCdng.SenderPorts.FordSumBoostCrvInpTq.Val /end MEASUREMENT
/begin MEASUREMENT FordHwTqCdng.FordVehSpd.Val "MICROSAR RTE" FLOAT32_IEEE NO_COMPU_METHOD 0 0 -3.402823466e+38 3.402823466e+38 ECU_ADDRESS 0 SYMBOL_LINK "Rte_ImcSigArbn_VehSpdImcCorrd_Val" 0 DISPLAY_IDENTIFIER FordHwTqCdng.ReceiverPorts.FordVehSpd.Val /end MEASUREMENT
/begin MEASUREMENT FordHwTqCdng.HwTq.Val "MICROSAR RTE" FLOAT32_IEEE NO_COMPU_METHOD 0 0 -3.402823466e+38 3.402823466e+38 ECU_ADDRESS 0 SYMBOL_LINK "Rte_ImcSigArbn_HwTqImcCorrd_Val" 0 DISPLAY_IDENTIFIER FordHwTqCdng.ReceiverPorts.HwTq.Val /end MEASUREMENT
/begin MEASUREMENT FordHwTqCdng.HwTqHysOvrl.Val "MICROSAR RTE" FLOAT32_IEEE NO_COMPU_METHOD 0 0 -3.402823466e+38 3.402823466e+38 ECU_ADDRESS 0 SYMBOL_LINK "Rte_FordHwTqCdng_HwTqHysOvrl_Val" 0 DISPLAY_IDENTIFIER FordHwTqCdng.ReceiverPorts.HwTqHysOvrl.Val /end MEASUREMENT
/begin MEASUREMENT FordHwTqCdng.HwTqOvrl.Val "MICROSAR RTE" FLOAT32_IEEE NO_COMPU_METHOD 0 0 -3.402823466e+38 3.402823466e+38 ECU_ADDRESS 0 SYMBOL_LINK "Rte_FordHwTqCmdOvrlLimr_FordColTqOvrl_Val" 0 DISPLAY_IDENTIFIER FordHwTqCdng.ReceiverPorts.HwTqOvrl.Val /end MEASUREMENT
/begin MEASUREMENT FordHwTqCdng.InpTqRawVldRefTi "Timer for Valid Reference Time will increment or reset based on the conditions" ULONG NO_COMPU_METHOD 0 0 0 4294967295 ECU_ADDRESS 0 SYMBOL_LINK "Rte_FordHwTqCdng_InpTqRawVldRefTi" 0 DISPLAY_IDENTIFIER FordHwTqCdng.PerInstanceMemories.InpTqRawVldRefTi /end MEASUREMENT
/begin MEASUREMENT FordHwTqCdng.MotTqCmd.Val "MICROSAR RTE" FLOAT32_IEEE NO_COMPU_METHOD 0 0 -3.402823466e+38 3.402823466e+38 ECU_ADDRESS 0 SYMBOL_LINK "Rte_Swp_MotTqCmdSwp_Val" 0 DISPLAY_IDENTIFIER FordHwTqCdng.ReceiverPorts.MotTqCmd.Val /end MEASUREMENT
/begin MEASUREMENT FordHwTqCdng.MotTqCmdPwrLimd.Val "MICROSAR RTE" FLOAT32_IEEE NO_COMPU_METHOD 0 0 -3.402823466e+38 3.402823466e+38 ECU_ADDRESS 0 SYMBOL_LINK "Rte_PwrLimr_MotTqCmdPwrLimd_Val" 0 DISPLAY_IDENTIFIER FordHwTqCdng.ReceiverPorts.MotTqCmdPwrLimd.Val /end MEASUREMENT
/begin MEASUREMENT FordHwTqCdng.dFordHwTqCdngFildBoostCrvAssiTq "Display Ford Handwheel Torque Conditioning Filtered Boost Curve Assist Torque" FLOAT32_IEEE NO_COMPU_METHOD 0 0 -3.402823466e+38 3.402823466e+38 ECU_ADDRESS 0 SYMBOL_LINK "Rte_FordHwTqCdng_dFordHwTqCdngFildBoostCrvAssiTq" 0 DISPLAY_IDENTIFIER FordHwTqCdng.PerInstanceMemories.dFordHwTqCdngFildBoostCrvAssiTq /end MEASUREMENT
/begin MEASUREMENT FordHwTqCmdOvrlLimr.EcuId.Val "MICROSAR RTE" UBYTE NO_COMPU_METHOD 0 0 0 255 ECU_ADDRESS 0 SYMBOL_LINK "Rte_DualEcuIdn_EcuId_Val" 0 DISPLAY_IDENTIFIER FordHwTqCmdOvrlLimr.ReceiverPorts.EcuId.Val /end MEASUREMENT
/begin MEASUREMENT FordHwTqCmdOvrlLimr.FildVehSpd.Val "MICROSAR RTE" FLOAT32_IEEE NO_COMPU_METHOD 0 0 -3.402823466e+38 3.402823466e+38 ECU_ADDRESS 0 SYMBOL_LINK "Rte_ImcSigArbn_VehSpdImcCorrd_Val" 0 DISPLAY_IDENTIFIER FordHwTqCmdOvrlLimr.ReceiverPorts.FildVehSpd.Val /end MEASUREMENT
/begin MEASUREMENT FordHwTqCmdOvrlLimr.FordColTqOvrl.Val "MICROSAR RTE" FLOAT32_IEEE NO_COMPU_METHOD 0 0 -3.402823466e+38 3.402823466e+38 ECU_ADDRESS 0 SYMBOL_LINK "Rte_FordHwTqCmdOvrlLimr_FordColTqOvrl_Val" 0 DISPLAY_IDENTIFIER FordHwTqCmdOvrlLimr.SenderPorts.FordColTqOvrl.Val /end MEASUREMENT
/begin MEASUREMENT FordHwTqCmdOvrlLimr.FordDrvrSteerRcmdnFctCallSts.Logl "MICROSAR RTE" UBYTE RTE_CM_BOOLEAN 0 0 0 255 ECU_ADDRESS 0 SYMBOL_LINK "Rte_FordHwTqCmdOvrlLimr_FordDrvrSteerRcmdnFctCallSts_Logl" 0 DISPLAY_IDENTIFIER FordHwTqCmdOvrlLimr.ReceiverPorts.FordDrvrSteerRcmdnFctCallSts.Logl /end MEASUREMENT
/begin MEASUREMENT FordHwTqCmdOvrlLimr.FordDrvrSteerRcmdnTqReq.Val "MICROSAR RTE" FLOAT32_IEEE NO_COMPU_METHOD 0 0 -3.402823466e+38 3.402823466e+38 ECU_ADDRESS 0 SYMBOL_LINK "Rte_FordHwTqCmdOvrlLimr_FordDrvrSteerRcmdnTqReq_Val" 0 DISPLAY_IDENTIFIER FordHwTqCmdOvrlLimr.ReceiverPorts.FordDrvrSteerRcmdnTqReq.Val /end MEASUREMENT
/begin MEASUREMENT FordHwTqCmdOvrlLimr.FordEvasSteerAssiFctCallSts.Logl "MICROSAR RTE" UBYTE RTE_CM_BOOLEAN 0 0 0 255 ECU_ADDRESS 0 SYMBOL_LINK "Rte_FordHwTqCmdOvrlLimr_FordEvasSteerAssiFctCallSts_Logl" 0 DISPLAY_IDENTIFIER FordHwTqCmdOvrlLimr.ReceiverPorts.FordEvasSteerAssiFctCallSts.Logl /end MEASUREMENT
/begin MEASUREMENT FordHwTqCmdOvrlLimr.FordEvasSteerAssiTqReq.Val "MICROSAR RTE" FLOAT32_IEEE NO_COMPU_METHOD 0 0 -3.402823466e+38 3.402823466e+38 ECU_ADDRESS 0 SYMBOL_LINK "Rte_CDD_FordBlaBoxIfCmp2_FordEvasSteerAssiTqReq_Val" 0 DISPLAY_IDENTIFIER FordHwTqCmdOvrlLimr.ReceiverPorts.FordEvasSteerAssiTqReq.Val /end MEASUREMENT
/begin MEASUREMENT FordHwTqCmdOvrlLimr.FordLaneKeepAssiFctCallSts.Logl "MICROSAR RTE" UBYTE RTE_CM_BOOLEAN 0 0 0 255 ECU_ADDRESS 0 SYMBOL_LINK "Rte_FordHwTqCmdOvrlLimr_FordLaneKeepAssiFctCallSts_Logl" 0 DISPLAY_IDENTIFIER FordHwTqCmdOvrlLimr.ReceiverPorts.FordLaneKeepAssiFctCallSts.Logl /end MEASUREMENT
/begin MEASUREMENT FordHwTqCmdOvrlLimr.FordLaneKeepAssiTqReq.Val "MICROSAR RTE" FLOAT32_IEEE NO_COMPU_METHOD 0 0 -3.402823466e+38 3.402823466e+38 ECU_ADDRESS 0 SYMBOL_LINK "Rte_CDD_FordBlaBoxIfCmp1_FordLaneKeepAssiTqReq_Val" 0 DISPLAY_IDENTIFIER FordHwTqCmdOvrlLimr.ReceiverPorts.FordLaneKeepAssiTqReq.Val /end MEASUREMENT
/begin MEASUREMENT FordHwTqCmdOvrlLimr.LimrDftVehSpd "MICROSAR RTE" UBYTE RTE_CM_BOOLEAN 0 0 0 255 ECU_ADDRESS 0 SYMBOL_LINK "Rte_FordHwTqCmdOvrlLimr_LimrDftVehSpd" 0 DISPLAY_IDENTIFIER FordHwTqCmdOvrlLimr.PerInstanceMemories.LimrDftVehSpd /end MEASUREMENT
/begin MEASUREMENT FordHwTqCmdOvrlLimr.LimrVehSpdPrev "MICROSAR RTE" FLOAT32_IEEE NO_COMPU_METHOD 0 0 -3.402823466e+38 3.402823466e+38 ECU_ADDRESS 0 SYMBOL_LINK "Rte_FordHwTqCmdOvrlLimr_LimrVehSpdPrev" 0 DISPLAY_IDENTIFIER FordHwTqCmdOvrlLimr.PerInstanceMemories.LimrVehSpdPrev /end MEASUREMENT
/begin MEASUREMENT FordHwTqCmdOvrlLimr.LkaTqReqPrev "MICROSAR RTE" FLOAT32_IEEE NO_COMPU_METHOD 0 0 -3.402823466e+38 3.402823466e+38 ECU_ADDRESS 0 SYMBOL_LINK "Rte_FordHwTqCmdOvrlLimr_LkaTqReqPrev" 0 DISPLAY_IDENTIFIER FordHwTqCmdOvrlLimr.PerInstanceMemories.LkaTqReqPrev /end MEASUREMENT
/begin MEASUREMENT FordHwTqCmdOvrlLimr.PrevDftVehSpd "MICROSAR RTE" FLOAT32_IEEE NO_COMPU_METHOD 0 0 -3.402823466e+38 3.402823466e+38 ECU_ADDRESS 0 SYMBOL_LINK "Rte_FordHwTqCmdOvrlLimr_PrevDftVehSpd" 0 DISPLAY_IDENTIFIER FordHwTqCmdOvrlLimr.PerInstanceMemories.PrevDftVehSpd /end MEASUREMENT
/begin MEASUREMENT FordHwTqCmdOvrlLimr.PrevVehSpd "MICROSAR RTE" FLOAT32_IEEE NO_COMPU_METHOD 0 0 -3.402823466e+38 3.402823466e+38 ECU_ADDRESS 0 SYMBOL_LINK "Rte_FordHwTqCmdOvrlLimr_PrevVehSpd" 0 DISPLAY_IDENTIFIER FordHwTqCmdOvrlLimr.PerInstanceMemories.PrevVehSpd /end MEASUREMENT
/begin MEASUREMENT FordHwTqCmdOvrlLimr.TqReqPrev "MICROSAR RTE" FLOAT32_IEEE NO_COMPU_METHOD 0 0 -3.402823466e+38 3.402823466e+38 ECU_ADDRESS 0 SYMBOL_LINK "Rte_FordHwTqCmdOvrlLimr_TqReqPrev" 0 DISPLAY_IDENTIFIER FordHwTqCmdOvrlLimr.PerInstanceMemories.TqReqPrev /end MEASUREMENT
/begin MEASUREMENT FordHwTqCmdOvrlLimr.VehSpdVld.Logl "MICROSAR RTE" UBYTE RTE_CM_BOOLEAN 0 0 0 255 ECU_ADDRESS 0 SYMBOL_LINK "Rte_VehSigCdng_VehSpdVld_Logl" 0 DISPLAY_IDENTIFIER FordHwTqCmdOvrlLimr.ReceiverPorts.VehSpdVld.Logl /end MEASUREMENT
/begin MEASUREMENT FordMotTqCmdOvrlLimr.ActvNiblCtrlLoFrqElpdTiVari "MICROSAR RTE" ULONG NO_COMPU_METHOD 0 0 0 4294967295 ECU_ADDRESS 0 SYMBOL_LINK "Rte_FordMotTqCmdOvrlLimr_ActvNiblCtrlLoFrqElpdTiVari" 0 DISPLAY_IDENTIFIER FordMotTqCmdOvrlLimr.PerInstanceMemories.ActvNiblCtrlLoFrqElpdTiVari /end MEASUREMENT
/begin MEASUREMENT FordMotTqCmdOvrlLimr.ActvNiblCtrlLoFrqFlt "MICROSAR RTE" UBYTE NO_COMPU_METHOD 0 0 0 255 ECU_ADDRESS 0 SYMBOL_LINK "Rte_FordMotTqCmdOvrlLimr_ActvNiblCtrlLoFrqFlt" 0 DISPLAY_IDENTIFIER FordMotTqCmdOvrlLimr.PerInstanceMemories.ActvNiblCtrlLoFrqFlt /end MEASUREMENT
/begin MEASUREMENT FordMotTqCmdOvrlLimr.ActvNiblCtrlLoFrqSt "MICROSAR RTE" UBYTE NO_COMPU_METHOD 0 0 0 255 ECU_ADDRESS 0 SYMBOL_LINK "Rte_FordMotTqCmdOvrlLimr_ActvNiblCtrlLoFrqSt" 0 DISPLAY_IDENTIFIER FordMotTqCmdOvrlLimr.PerInstanceMemories.ActvNiblCtrlLoFrqSt /end MEASUREMENT
/begin MEASUREMENT FordMotTqCmdOvrlLimr.ActvNiblCtrlLoFrqTmrFlgVari "MICROSAR RTE" UBYTE RTE_CM_BOOLEAN 0 0 0 255 ECU_ADDRESS 0 SYMBOL_LINK "Rte_FordMotTqCmdOvrlLimr_ActvNiblCtrlLoFrqTmrFlgVari" 0 DISPLAY_IDENTIFIER FordMotTqCmdOvrlLimr.PerInstanceMemories.ActvNiblCtrlLoFrqTmrFlgVari /end MEASUREMENT
/begin MEASUREMENT FordMotTqCmdOvrlLimr.ActvNiblCtrlLoFrqTmrVari "MICROSAR RTE" ULONG NO_COMPU_METHOD 0 0 0 4294967295 ECU_ADDRESS 0 SYMBOL_LINK "Rte_FordMotTqCmdOvrlLimr_ActvNiblCtrlLoFrqTmrVari" 0 DISPLAY_IDENTIFIER FordMotTqCmdOvrlLimr.PerInstanceMemories.ActvNiblCtrlLoFrqTmrVari /end MEASUREMENT
/begin MEASUREMENT FordMotTqCmdOvrlLimr.DftVehSpd "MICROSAR RTE" FLOAT32_IEEE NO_COMPU_METHOD 0 0 -3.402823466e+38 3.402823466e+38 ECU_ADDRESS 0 SYMBOL_LINK "Rte_FordMotTqCmdOvrlLimr_DftVehSpd" 0 DISPLAY_IDENTIFIER FordMotTqCmdOvrlLimr.PerInstanceMemories.DftVehSpd /end MEASUREMENT
/begin MEASUREMENT FordMotTqCmdOvrlLimr.EcuId.Val "MICROSAR RTE" UBYTE NO_COMPU_METHOD 0 0 0 255 ECU_ADDRESS 0 SYMBOL_LINK "Rte_DualEcuIdn_EcuId_Val" 0 DISPLAY_IDENTIFIER FordMotTqCmdOvrlLimr.ReceiverPorts.EcuId.Val /end MEASUREMENT
/begin MEASUREMENT FordMotTqCmdOvrlLimr.FildHwTq.Val "MICROSAR RTE" FLOAT32_IEEE NO_COMPU_METHOD 0 0 -3.402823466e+38 3.402823466e+38 ECU_ADDRESS 0 SYMBOL_LINK "Rte_ImcSigArbn_HwTqImcCorrd_Val" 0 DISPLAY_IDENTIFIER FordMotTqCmdOvrlLimr.ReceiverPorts.FildHwTq.Val /end MEASUREMENT
/begin MEASUREMENT FordMotTqCmdOvrlLimr.FildVehSpd.Val "MICROSAR RTE" FLOAT32_IEEE NO_COMPU_METHOD 0 0 -3.402823466e+38 3.402823466e+38 ECU_ADDRESS 0 SYMBOL_LINK "Rte_ImcSigArbn_VehSpdImcCorrd_Val" 0 DISPLAY_IDENTIFIER FordMotTqCmdOvrlLimr.ReceiverPorts.FildVehSpd.Val /end MEASUREMENT
/begin MEASUREMENT FordMotTqCmdOvrlLimr.FordActvNiblCtrlFctCallSts.Logl "MICROSAR RTE" UBYTE RTE_CM_BOOLEAN 0 0 0 255 ECU_ADDRESS 0 SYMBOL_LINK "Rte_FordMotTqCmdOvrlLimr_FordActvNiblCtrlFctCallSts_Logl" 0 DISPLAY_IDENTIFIER FordMotTqCmdOvrlLimr.ReceiverPorts.FordActvNiblCtrlFctCallSts.Logl /end MEASUREMENT
/begin MEASUREMENT FordMotTqCmdOvrlLimr.FordActvNiblCtrlTqReq.Val "MICROSAR RTE" FLOAT32_IEEE NO_COMPU_METHOD 0 0 -3.402823466e+38 3.402823466e+38 ECU_ADDRESS 0 SYMBOL_LINK "Rte_CDD_FordBlaBoxIfCmp1_FordActvNiblCtrlTqReq_Val" 0 DISPLAY_IDENTIFIER FordMotTqCmdOvrlLimr.ReceiverPorts.FordActvNiblCtrlTqReq.Val /end MEASUREMENT
/begin MEASUREMENT FordMotTqCmdOvrlLimr.FordLaneDprtrWarnFctCallSts.Logl "MICROSAR RTE" UBYTE RTE_CM_BOOLEAN 0 0 0 255 ECU_ADDRESS 0 SYMBOL_LINK "Rte_FordMotTqCmdOvrlLimr_FordLaneDprtrWarnFctCallSts_Logl" 0 DISPLAY_IDENTIFIER FordMotTqCmdOvrlLimr.ReceiverPorts.FordLaneDprtrWarnFctCallSts.Logl /end MEASUREMENT
/begin MEASUREMENT FordMotTqCmdOvrlLimr.FordLaneDprtrWarnTqReq.Val "MICROSAR RTE" FLOAT32_IEEE NO_COMPU_METHOD 0 0 -3.402823466e+38 3.402823466e+38 ECU_ADDRESS 0 SYMBOL_LINK "Rte_CDD_FordBlaBoxIfCmp1_FordLaneDprtrWarnTqReq_Val" 0 DISPLAY_IDENTIFIER FordMotTqCmdOvrlLimr.ReceiverPorts.FordLaneDprtrWarnTqReq.Val /end MEASUREMENT
/begin MEASUREMENT FordMotTqCmdOvrlLimr.FordLatCtrlFctCallSts.Logl "MICROSAR RTE" UBYTE RTE_CM_BOOLEAN 0 0 0 255 ECU_ADDRESS 0 SYMBOL_LINK "Rte_FordMotTqCmdOvrlLimr_FordLatCtrlFctCallSts_Logl" 0 DISPLAY_IDENTIFIER FordMotTqCmdOvrlLimr.ReceiverPorts.FordLatCtrlFctCallSts.Logl /end MEASUREMENT
/begin MEASUREMENT FordMotTqCmdOvrlLimr.FordLatCtrlTqReq.Val "MICROSAR RTE" FLOAT32_IEEE NO_COMPU_METHOD 0 0 -3.402823466e+38 3.402823466e+38 ECU_ADDRESS 0 SYMBOL_LINK "Rte_CDD_FordBlaBoxIfCmp1_FordLatCtrlTqReq_Val" 0 DISPLAY_IDENTIFIER FordMotTqCmdOvrlLimr.ReceiverPorts.FordLatCtrlTqReq.Val /end MEASUREMENT
/begin MEASUREMENT FordMotTqCmdOvrlLimr.FordMotTqCmdOvrl.Val "MICROSAR RTE" FLOAT32_IEEE NO_COMPU_METHOD 0 0 -3.402823466e+38 3.402823466e+38 ECU_ADDRESS 0 SYMBOL_LINK "Rte_FordMotTqCmdOvrlLimr_FordMotTqCmdOvrl_Val" 0 DISPLAY_IDENTIFIER FordMotTqCmdOvrlLimr.SenderPorts.FordMotTqCmdOvrl.Val /end MEASUREMENT
/begin MEASUREMENT FordMotTqCmdOvrlLimr.FordPullDriftCmpFctCallSts.Logl "MICROSAR RTE" UBYTE RTE_CM_BOOLEAN 0 0 0 255 ECU_ADDRESS 0 SYMBOL_LINK "Rte_FordMotTqCmdOvrlLimr_FordPullDriftCmpFctCallSts_Logl" 0 DISPLAY_IDENTIFIER FordMotTqCmdOvrlLimr.ReceiverPorts.FordPullDriftCmpFctCallSts.Logl /end MEASUREMENT
/begin MEASUREMENT FordMotTqCmdOvrlLimr.FordPullDriftCmpTqReq.Val "MICROSAR RTE" FLOAT32_IEEE NO_COMPU_METHOD 0 0 -3.402823466e+38 3.402823466e+38 ECU_ADDRESS 0 SYMBOL_LINK "Rte_CDD_FordBlaBoxIfCmp1_FordPullDriftCmpTqReq_Val" 0 DISPLAY_IDENTIFIER FordMotTqCmdOvrlLimr.ReceiverPorts.FordPullDriftCmpTqReq.Val /end MEASUREMENT
/begin MEASUREMENT FordMotTqCmdOvrlLimr.FordSteerTqDstbcRejctnFctCallSts.Logl "MICROSAR RTE" UBYTE RTE_CM_BOOLEAN 0 0 0 255 ECU_ADDRESS 0 SYMBOL_LINK "Rte_FordMotTqCmdOvrlLimr_FordSteerTqDstbcRejctnFctCallSts_Logl" 0 DISPLAY_IDENTIFIER FordMotTqCmdOvrlLimr.ReceiverPorts.FordSteerTqDstbcRejctnFctCallSts.Logl /end MEASUREMENT
/begin MEASUREMENT FordMotTqCmdOvrlLimr.FordSteerTqDstbcRejctnTqReq.Val "MICROSAR RTE" FLOAT32_IEEE NO_COMPU_METHOD 0 0 -3.402823466e+38 3.402823466e+38 ECU_ADDRESS 0 SYMBOL_LINK "Rte_CDD_FordBlaBoxIfCmp2_FordSteerTqDstbcRejctnTqReq_Val" 0 DISPLAY_IDENTIFIER FordMotTqCmdOvrlLimr.ReceiverPorts.FordSteerTqDstbcRejctnTqReq.Val /end MEASUREMENT
/begin MEASUREMENT FordMotTqCmdOvrlLimr.HwVel.Val "MICROSAR RTE" FLOAT32_IEEE NO_COMPU_METHOD 0 0 -3.402823466e+38 3.402823466e+38 ECU_ADDRESS 0 SYMBOL_LINK "Rte_HwAgSysArbn_HwVel_Val" 0 DISPLAY_IDENTIFIER FordMotTqCmdOvrlLimr.ReceiverPorts.HwVel.Val /end MEASUREMENT
/begin MEASUREMENT FordMotTqCmdOvrlLimr.HwVelFil.FilGain "MICROSAR RTE" FLOAT32_IEEE NO_COMPU_METHOD 0 0 -3.402823466e+38 3.402823466e+38 ECU_ADDRESS 0 SYMBOL_LINK "Rte_FordMotTqCmdOvrlLimr_HwVelFil.FilGain" 0 DISPLAY_IDENTIFIER FordMotTqCmdOvrlLimr.PerInstanceMemories.HwVelFil.FilGain /end MEASUREMENT
/begin MEASUREMENT FordMotTqCmdOvrlLimr.HwVelFil.FilSt "MICROSAR RTE" FLOAT32_IEEE NO_COMPU_METHOD 0 0 -3.402823466e+38 3.402823466e+38 ECU_ADDRESS 0 SYMBOL_LINK "Rte_FordMotTqCmdOvrlLimr_HwVelFil.FilSt" 0 DISPLAY_IDENTIFIER FordMotTqCmdOvrlLimr.PerInstanceMemories.HwVelFil.FilSt /end MEASUREMENT
/begin MEASUREMENT FordMotTqCmdOvrlLimr.LaneDprtrWarnLoFrqElpdTiVari "MICROSAR RTE" ULONG NO_COMPU_METHOD 0 0 0 4294967295 ECU_ADDRESS 0 SYMBOL_LINK "Rte_FordMotTqCmdOvrlLimr_LaneDprtrWarnLoFrqElpdTiVari" 0 DISPLAY_IDENTIFIER FordMotTqCmdOvrlLimr.PerInstanceMemories.LaneDprtrWarnLoFrqElpdTiVari /end MEASUREMENT
/begin MEASUREMENT FordMotTqCmdOvrlLimr.LaneDprtrWarnLoFrqFlt "MICROSAR RTE" UBYTE NO_COMPU_METHOD 0 0 0 255 ECU_ADDRESS 0 SYMBOL_LINK "Rte_FordMotTqCmdOvrlLimr_LaneDprtrWarnLoFrqFlt" 0 DISPLAY_IDENTIFIER FordMotTqCmdOvrlLimr.PerInstanceMemories.LaneDprtrWarnLoFrqFlt /end MEASUREMENT
/begin MEASUREMENT FordMotTqCmdOvrlLimr.LaneDprtrWarnLoFrqSt "MICROSAR RTE" UBYTE NO_COMPU_METHOD 0 0 0 255 ECU_ADDRESS 0 SYMBOL_LINK "Rte_FordMotTqCmdOvrlLimr_LaneDprtrWarnLoFrqSt" 0 DISPLAY_IDENTIFIER FordMotTqCmdOvrlLimr.PerInstanceMemories.LaneDprtrWarnLoFrqSt /end MEASUREMENT
/begin MEASUREMENT FordMotTqCmdOvrlLimr.LaneDprtrWarnLoFrqTmrFlgVari "MICROSAR RTE" UBYTE RTE_CM_BOOLEAN 0 0 0 255 ECU_ADDRESS 0 SYMBOL_LINK "Rte_FordMotTqCmdOvrlLimr_LaneDprtrWarnLoFrqTmrFlgVari" 0 DISPLAY_IDENTIFIER FordMotTqCmdOvrlLimr.PerInstanceMemories.LaneDprtrWarnLoFrqTmrFlgVari /end MEASUREMENT
/begin MEASUREMENT FordMotTqCmdOvrlLimr.LaneDprtrWarnLoFrqTmrVari "MICROSAR RTE" ULONG NO_COMPU_METHOD 0 0 0 4294967295 ECU_ADDRESS 0 SYMBOL_LINK "Rte_FordMotTqCmdOvrlLimr_LaneDprtrWarnLoFrqTmrVari" 0 DISPLAY_IDENTIFIER FordMotTqCmdOvrlLimr.PerInstanceMemories.LaneDprtrWarnLoFrqTmrVari /end MEASUREMENT
/begin MEASUREMENT FordMotTqCmdOvrlLimr.LimrDftVehSpd "MICROSAR RTE" UBYTE RTE_CM_BOOLEAN 0 0 0 255 ECU_ADDRESS 0 SYMBOL_LINK "Rte_FordMotTqCmdOvrlLimr_LimrDftVehSpd" 0 DISPLAY_IDENTIFIER FordMotTqCmdOvrlLimr.PerInstanceMemories.LimrDftVehSpd /end MEASUREMENT
/begin MEASUREMENT FordMotTqCmdOvrlLimr.PrevAmpLim "MICROSAR RTE" FLOAT32_IEEE NO_COMPU_METHOD 0 0 -3.402823466e+38 3.402823466e+38 ECU_ADDRESS 0 SYMBOL_LINK "Rte_FordMotTqCmdOvrlLimr_PrevAmpLim" 0 DISPLAY_IDENTIFIER FordMotTqCmdOvrlLimr.PerInstanceMemories.PrevAmpLim /end MEASUREMENT
/begin MEASUREMENT FordMotTqCmdOvrlLimr.PrevDftVehSpd "MICROSAR RTE" FLOAT32_IEEE NO_COMPU_METHOD 0 0 -3.402823466e+38 3.402823466e+38 ECU_ADDRESS 0 SYMBOL_LINK "Rte_FordMotTqCmdOvrlLimr_PrevDftVehSpd" 0 DISPLAY_IDENTIFIER FordMotTqCmdOvrlLimr.PerInstanceMemories.PrevDftVehSpd /end MEASUREMENT
/begin MEASUREMENT FordMotTqCmdOvrlLimr.PrevLimdTqReq "MICROSAR RTE" FLOAT32_IEEE NO_COMPU_METHOD 0 0 -3.402823466e+38 3.402823466e+38 ECU_ADDRESS 0 SYMBOL_LINK "Rte_FordMotTqCmdOvrlLimr_PrevLimdTqReq" 0 DISPLAY_IDENTIFIER FordMotTqCmdOvrlLimr.PerInstanceMemories.PrevLimdTqReq /end MEASUREMENT
/begin MEASUREMENT FordMotTqCmdOvrlLimr.PrevLimrVehSpd "MICROSAR RTE" FLOAT32_IEEE NO_COMPU_METHOD 0 0 -3.402823466e+38 3.402823466e+38 ECU_ADDRESS 0 SYMBOL_LINK "Rte_FordMotTqCmdOvrlLimr_PrevLimrVehSpd" 0 DISPLAY_IDENTIFIER FordMotTqCmdOvrlLimr.PerInstanceMemories.PrevLimrVehSpd /end MEASUREMENT
/begin MEASUREMENT FordMotTqCmdOvrlLimr.PrevTqTrend "MICROSAR RTE" FLOAT32_IEEE NO_COMPU_METHOD 0 0 -3.402823466e+38 3.402823466e+38 ECU_ADDRESS 0 SYMBOL_LINK "Rte_FordMotTqCmdOvrlLimr_PrevTqTrend" 0 DISPLAY_IDENTIFIER FordMotTqCmdOvrlLimr.PerInstanceMemories.PrevTqTrend /end MEASUREMENT
/begin MEASUREMENT FordMotTqCmdOvrlLimr.VehSpdVld.Logl "MICROSAR RTE" UBYTE RTE_CM_BOOLEAN 0 0 0 255 ECU_ADDRESS 0 SYMBOL_LINK "Rte_VehSigCdng_VehSpdVld_Logl" 0 DISPLAY_IDENTIFIER FordMotTqCmdOvrlLimr.ReceiverPorts.VehSpdVld.Logl /end MEASUREMENT
/begin MEASUREMENT FordMsg077BusHiSpd.CanDtcInhbRefTi "MICROSAR RTE" ULONG NO_COMPU_METHOD 0 0 0 4294967295 ECU_ADDRESS 0 SYMBOL_LINK "Rte_FordMsg077BusHiSpd_CanDtcInhbRefTi" 0 DISPLAY_IDENTIFIER FordMsg077BusHiSpd.PerInstanceMemories.CanDtcInhbRefTi /end MEASUREMENT
/begin MEASUREMENT FordMsg077BusHiSpd.DiagcClrProxyFlgPrev "MICROSAR RTE" UBYTE RTE_CM_BOOLEAN 0 0 0 255 ECU_ADDRESS 0 SYMBOL_LINK "Rte_FordMsg077BusHiSpd_DiagcClrProxyFlgPrev" 0 DISPLAY_IDENTIFIER FordMsg077BusHiSpd.PerInstanceMemories.DiagcClrProxyFlgPrev /end MEASUREMENT
/begin MEASUREMENT FordMsg077BusHiSpd.FirstTranVldFlg "MICROSAR RTE" UBYTE RTE_CM_BOOLEAN 0 0 0 255 ECU_ADDRESS 0 SYMBOL_LINK "Rte_FordMsg077BusHiSpd_FirstTranVldFlg" 0 DISPLAY_IDENTIFIER FordMsg077BusHiSpd.PerInstanceMemories.FirstTranVldFlg /end MEASUREMENT
/begin MEASUREMENT FordMsg077BusHiSpd.FordBrkOscnRednEnad.Logl "MICROSAR RTE" UBYTE RTE_CM_BOOLEAN 0 0 0 255 ECU_ADDRESS 0 SYMBOL_LINK "Rte_CustDiag_FordBrkPlsRejctnEnad_Logl" 0 DISPLAY_IDENTIFIER FordMsg077BusHiSpd.ReceiverPorts.FordBrkOscnRednEnad.Logl /end MEASUREMENT
/begin MEASUREMENT FordMsg077BusHiSpd.FordCanDtcInhb.Logl "MICROSAR RTE" UBYTE RTE_CM_BOOLEAN 0 0 0 255 ECU_ADDRESS 0 SYMBOL_LINK "Rte_FordCanDtcInhb_FordCanDtcInhb_Logl" 0 DISPLAY_IDENTIFIER FordMsg077BusHiSpd.ReceiverPorts.FordCanDtcInhb.Logl /end MEASUREMENT
/begin MEASUREMENT FordMsg077BusHiSpd.FordClrDiagcFlgProxy.Logl "MICROSAR RTE" UBYTE RTE_CM_BOOLEAN 0 0 0 255 ECU_ADDRESS 0 SYMBOL_LINK "Rte_FordMsg077BusHiSpd_FordClrDiagcFlgProxy_Logl" 0 DISPLAY_IDENTIFIER FordMsg077BusHiSpd.ReceiverPorts.FordClrDiagcFlgProxy.Logl /end MEASUREMENT
/begin MEASUREMENT FordMsg077BusHiSpd.FordEpsLifeCycMod.Val "MICROSAR RTE" UBYTE NO_COMPU_METHOD 0 0 0 255 ECU_ADDRESS 0 SYMBOL_LINK "Rte_FordCanDtcInhb_FordEpsLifeCycMod_Val" 0 DISPLAY_IDENTIFIER FordMsg077BusHiSpd.ReceiverPorts.FordEpsLifeCycMod.Val /end MEASUREMENT
/begin MEASUREMENT FordMsg077BusHiSpd.FordEvasSteerAssiEnad.Logl "MICROSAR RTE" UBYTE RTE_CM_BOOLEAN 0 0 0 255 ECU_ADDRESS 0 SYMBOL_LINK "Rte_CustDiag_FordEvasSteerAssiEnad_Logl" 0 DISPLAY_IDENTIFIER FordMsg077BusHiSpd.ReceiverPorts.FordEvasSteerAssiEnad.Logl /end MEASUREMENT
/begin MEASUREMENT FordMsg077BusHiSpd.FordLaneCentrAssiEnad.Logl "MICROSAR RTE" UBYTE RTE_CM_BOOLEAN 0 0 0 255 ECU_ADDRESS 0 SYMBOL_LINK "Rte_CustDiag_FordLaneCentrAssiEnad_Logl" 0 DISPLAY_IDENTIFIER FordMsg077BusHiSpd.ReceiverPorts.FordLaneCentrAssiEnad.Logl /end MEASUREMENT
/begin MEASUREMENT FordMsg077BusHiSpd.FordLaneKeepAssiEnad.Logl "MICROSAR RTE" UBYTE RTE_CM_BOOLEAN 0 0 0 255 ECU_ADDRESS 0 SYMBOL_LINK "Rte_CustDiag_FordLaneKeepAssiEnad_Logl" 0 DISPLAY_IDENTIFIER FordMsg077BusHiSpd.ReceiverPorts.FordLaneKeepAssiEnad.Logl /end MEASUREMENT
/begin GROUP FordCanDtcInhb.FordCanDtcInhbFactryModThd.Val "MICROSAR RTE" /begin SUB_GROUP /end SUB_GROUP /begin FUNCTION_LIST /end FUNCTION_LIST /begin REF_CHARACTERISTIC FordCanDtcInhb.FordCanDtcInhbFactryModThd.Val /end REF_CHARACTERISTIC /begin REF_MEASUREMENT /end REF_MEASUREMENT /end GROUP
/begin GROUP FordCanDtcInhb.FordCanDtcInhbTransptModThd.Val "MICROSAR RTE" /begin SUB_GROUP /end SUB_GROUP /begin FUNCTION_LIST /end FUNCTION_LIST /begin REF_CHARACTERISTIC FordCanDtcInhb.FordCanDtcInhbTransptModThd.Val /end REF_CHARACTERISTIC /begin REF_MEASUREMENT /end REF_MEASUREMENT /end GROUP
/begin GROUP FordCanDtcInhb.FordEpsLifeCycMod.Val "MICROSAR RTE" /begin SUB_GROUP /end SUB_GROUP /begin FUNCTION_LIST /end FUNCTION_LIST /begin REF_CHARACTERISTIC /end REF_CHARACTERISTIC /begin REF_MEASUREMENT FordCanDtcInhb.FordEpsLifeCycMod.Val /end REF_MEASUREMENT /end GROUP
/begin GROUP FordCanDtcInhb.FordReqdEpsLifeCycModPrev "MICROSAR RTE" /begin SUB_GROUP /end SUB_GROUP /begin FUNCTION_LIST /end FUNCTION_LIST /begin REF_CHARACTERISTIC /end REF_CHARACTERISTIC /begin REF_MEASUREMENT FordCanDtcInhb.FordReqdEpsLifeCycModPrev /end REF_MEASUREMENT /end GROUP
/begin GROUP FordCanDtcInhb.FordVehElecPwrSts.Ford_ElPw_D_Stat "MICROSAR RTE" /begin SUB_GROUP /end SUB_GROUP /begin FUNCTION_LIST /end FUNCTION_LIST /begin REF_CHARACTERISTIC /end REF_CHARACTERISTIC /begin REF_MEASUREMENT FordCanDtcInhb.FordVehElecPwrSts.Ford_ElPw_D_Stat /end REF_MEASUREMENT /end GROUP
/begin GROUP FordCanDtcInhb.FordVehIgnStsQly.Ford_Ignition_Status "MICROSAR RTE" /begin SUB_GROUP /end SUB_GROUP /begin FUNCTION_LIST /end FUNCTION_LIST /begin REF_CHARACTERISTIC /end REF_CHARACTERISTIC /begin REF_MEASUREMENT FordCanDtcInhb.FordVehIgnStsQly.Ford_Ignition_Status /end REF_MEASUREMENT /end GROUP
/begin GROUP FordCanDtcInhb.FordVehLifeCycModQly.Ford_LifeCycMde_D_Actl "MICROSAR RTE" /begin SUB_GROUP /end SUB_GROUP /begin FUNCTION_LIST /end FUNCTION_LIST /begin REF_CHARACTERISTIC /end REF_CHARACTERISTIC /begin REF_MEASUREMENT FordCanDtcInhb.FordVehLifeCycModQly.Ford_LifeCycMde_D_Actl /end REF_MEASUREMENT /end GROUP
/begin GROUP FordCanDtcInhb.FordVehPwrpkTqSts.Ford_PwPckTq_D_Stat "MICROSAR RTE" /begin SUB_GROUP /end SUB_GROUP /begin FUNCTION_LIST /end FUNCTION_LIST /begin REF_CHARACTERISTIC /end REF_CHARACTERISTIC /begin REF_MEASUREMENT FordCanDtcInhb.FordVehPwrpkTqSts.Ford_PwPckTq_D_Stat /end REF_MEASUREMENT /end GROUP
/begin GROUP FordCanDtcInhb.PerInstanceMemories "MICROSAR RTE"
 /begin SUB_GROUP FordCanDtcInhb.CanDtcInhbRefTi FordCanDtcInhb.EpsFactryModRefTi FordCanDtcInhb.EpsLifeCycModPrev FordCanDtcInhb.EpsLifeCycModRefTi FordCanDtcInhb.EpsTransptModRefTi FordCanDtcInhb.FordReqdEpsLifeCycModPrev /end SUB_GROUP
 /begin FUNCTION_LIST /end FUNCTION_LIST
 /begin REF_CHARACTERISTIC /end REF_CHARACTERISTIC
 /begin REF_MEASUREMENT /end REF_MEASUREMENT
/end GROUP
/begin GROUP FordCanDtcInhb.ReceiverPorts "MICROSAR RTE"
 /begin SUB_GROUP FordCanDtcInhb.FordBattVltgEstimn.Val FordCanDtcInhb.FordVehElecPwrSts.Ford_ElPw_D_Stat FordCanDtcInhb.FordVehIgnStsQly.Ford_Ignition_Status FordCanDtcInhb.FordVehLifeCycModQly.Ford_LifeCycMde_D_Actl FordCanDtcInhb.FordVehPwrpkTqSts.Ford_PwPckTq_D_Stat /end SUB_GROUP
 /begin FUNCTION_LIST /end FUNCTION_LIST
 /begin REF_CHARACTERISTIC /end REF_CHARACTERISTIC
 /begin REF_MEASUREMENT /end REF_MEASUREMENT
/end GROUP
/begin GROUP FordCanDtcInhb.SenderPorts "MICROSAR RTE"
 /begin SUB_GROUP FordCanDtcInhb.FordCanDtcInhb8.Val FordCanDtcInhb.FordEpsLifeCycMod.Val /end SUB_GROUP
 /begin FUNCTION_LIST /end FUNCTION_LIST
 /begin REF_CHARACTERISTIC /end REF_CHARACTERISTIC
 /begin REF_MEASUREMENT /end REF_MEASUREMENT
/end GROUP
/begin GROUP FordCmdArbn "MICROSAR RTE"
 /begin SUB_GROUP FordCmdArbn.CalibrationPorts FordCmdArbn.ReceiverPorts FordCmdArbn.SenderPorts /end SUB_GROUP
 /begin FUNCTION_LIST /end FUNCTION_LIST
 /begin REF_CHARACTERISTIC /end REF_CHARACTERISTIC
 /begin REF_MEASUREMENT /end REF_MEASUREMENT
/end GROUP
/begin GROUP FordCmdArbn.CalibrationPorts "MICROSAR RTE"
 /begin SUB_GROUP FordCmdArbn.FordCmdArbnActvNiblCtrlDeactvn.Ary1D FordCmdArbn.FordCmdArbnActvNiblCtrlDeniedActvnReq.Ary1D FordCmdArbn.FordCmdArbnDrvrSteerDeniedActvnReq.Ary1D FordCmdArbn.FordCmdArbnDrvrSteerRcmdnDeactvn.Ary1D FordCmdArbn.FordCmdArbnEvasSteerAssiDeactvn.Ary1D FordCmdArbn.FordCmdArbnEvasSteerDeniedActvnReq.Ary1D FordCmdArbn.FordCmdArbnExtAgCtrlDeactvn.Ary1D FordCmdArbn.FordCmdArbnExtAgDeniedActvnReq.Ary1D FordCmdArbn.FordCmdArbnLaneDprtrWarnDeactvn.Ary1D FordCmdArbn.FordCmdArbnLaneDprtrWarnDeniedActvnReq.Ary1D FordCmdArbn.FordCmdArbnLaneKeepAssiDeactvn.Ary1D FordCmdArbn.FordCmdArbnLaneKeepAssiDeniedActvnReq.Ary1D FordCmdArbn.FordCmdArbnLatCtrlDeactvn.Ary1D FordCmdArbn.FordCmdArbnLatCtrlDeniedActvnReq.Ary1D FordCmdArbn.FordCmdArbnNonStMask.Ary1D FordCmdArbn.FordCmdArbnNormAssiTqThd.Val FordCmdArbn.FordCmdArbnPullDriftCmpDeactvn.Ary1D FordCmdArbn.FordCmdArbnPullDriftCmpDeniedActvnReq.Ary1D FordCmdArbn.FordCmdArbnPullDriftCmpLrngDeactvn.Ary1D FordCmdArbn.FordCmdArbnPullDriftCmpLrngDeniedActvnReq.Ary1D FordCmdArbn.FordCmdArbnSpare1Deactvn.Ary1D FordCmdArbn.FordCmdArbnSpare1DeniedActvnReq.Ary1D FordCmdArbn.FordCmdArbnSpare2Deactvn.Ary1D FordCmdArbn.FordCmdArbnSpare2DeniedActvnReq.Ary1D FordCmdArbn.FordCmdArbnSpare3Deactvn.Ary1D FordCmdArbn.FordCmdArbnSpare3DeniedActvnReq.Ary1D FordCmdArbn.FordCmdArbnSteerDstbcDeactvn.Ary1D FordCmdArbn.FordCmdArbnSteerDstbcDeniedActvnReq.Ary1D /end SUB_GROUP
 /begin FUNCTION_LIST /end FUNCTION_LIST
 /begin REF_CHARACTERISTIC /end REF_CHARACTERISTIC
 /begin REF_MEASUREMENT /end REF_MEASUREMENT
/end GROUP
/begin GROUP FordCmdArbn.EcuId.Val "MICROSAR RTE" /begin SUB_GROUP /end SUB_GROUP /begin FUNCTION_LIST /end FUNCTION_LIST /begin REF_CHARACTERISTIC /end REF_CHARACTERISTIC /begin REF_MEASUREMENT FordCmdArbn.EcuId.Val /end REF_MEASUREMENT /end GROUP
/begin GROUP FordCmdArbn.FordActvNiblCtrlArbnCmd.Val "MICROSAR RTE" /begin SUB_GROUP /end SUB_GROUP /begin FUNCTION_LIST /end FUNCTION_LIST /begin REF_CHARACTERISTIC /end REF_CHARACTERISTIC /begin REF_MEASUREMENT FordCmdArbn.FordActvNiblCtrlArbnCmd.Val /end REF_MEASUREMENT /end GROUP
/begin GROUP FordCmdArbn.FordActvNiblCtrlFeatSt.Val "MICROSAR RTE" /begin SUB_GROUP /end SUB_GROUP /begin FUNCTION_LIST /end FUNCTION_LIST /begin REF_CHARACTERISTIC /end REF_CHARACTERISTIC /begin REF_MEASUREMENT FordCmdArbn.FordActvNiblCtrlFeatSt.Val /end REF_MEASUREMENT /end GROUP
/begin GROUP FordCmdArbn.FordCmdArbnActvNiblCtrlDeactvn.Ary1D "MICROSAR RTE" /begin SUB_GROUP /end SUB_GROUP /begin FUNCTION_LIST /end FUNCTION_LIST /begin REF_CHARACTERISTIC FordCmdArbn.FordCmdArbnActvNiblCtrlDeactvn.Ary1D /end REF_CHARACTERISTIC /begin REF_MEASUREMENT /end REF_MEASUREMENT /end GROUP
/begin GROUP FordCmdArbn.FordCmdArbnActvNiblCtrlDeniedActvnReq.Ary1D "MICROSAR RTE" /begin SUB_GROUP /end SUB_GROUP /begin FUNCTION_LIST /end FUNCTION_LIST /begin REF_CHARACTERISTIC FordCmdArbn.FordCmdArbnActvNiblCtrlDeniedActvnReq.Ary1D /end REF_CHARACTERISTIC /begin REF_MEASUREMENT /end REF_MEASUREMENT /end GROUP
/begin GROUP FordCmdArbn.FordCmdArbnDrvrSteerDeniedActvnReq.Ary1D "MICROSAR RTE" /begin SUB_GROUP /end SUB_GROUP /begin FUNCTION_LIST /end FUNCTION_LIST /begin REF_CHARACTERISTIC FordCmdArbn.FordCmdArbnDrvrSteerDeniedActvnReq.Ary1D /end REF_CHARACTERISTIC /begin REF_MEASUREMENT /end REF_MEASUREMENT /end GROUP
/begin GROUP FordCmdArbn.FordCmdArbnDrvrSteerRcmdnDeactvn.Ary1D "MICROSAR RTE" /begin SUB_GROUP /end SUB_GROUP /begin FUNCTION_LIST /end FUNCTION_LIST /begin REF_CHARACTERISTIC FordCmdArbn.FordCmdArbnDrvrSteerRcmdnDeactvn.Ary1D /end REF_CHARACTERISTIC /begin REF_MEASUREMENT /end REF_MEASUREMENT /end GROUP
/begin GROUP FordCmdArbn.FordCmdArbnEvasSteerAssiDeactvn.Ary1D "MICROSAR RTE" /begin SUB_GROUP /end SUB_GROUP /begin FUNCTION_LIST /end FUNCTION_LIST /begin REF_CHARACTERISTIC FordCmdArbn.FordCmdArbnEvasSteerAssiDeactvn.Ary1D /end REF_CHARACTERISTIC /begin REF_MEASUREMENT /end REF_MEASUREMENT /end GROUP
/begin GROUP FordCmdArbn.FordCmdArbnEvasSteerDeniedActvnReq.Ary1D "MICROSAR RTE" /begin SUB_GROUP /end SUB_GROUP /begin FUNCTION_LIST /end FUNCTION_LIST /begin REF_CHARACTERISTIC FordCmdArbn.FordCmdArbnEvasSteerDeniedActvnReq.Ary1D /end REF_CHARACTERISTIC /begin REF_MEASUREMENT /end REF_MEASUREMENT /end GROUP
/begin GROUP FordCmdArbn.FordCmdArbnExtAgCtrlDeactvn.Ary1D "MICROSAR RTE" /begin SUB_GROUP /end SUB_GROUP /begin FUNCTION_LIST /end FUNCTION_LIST /begin REF_CHARACTERISTIC FordCmdArbn.FordCmdArbnExtAgCtrlDeactvn.Ary1D /end REF_CHARACTERISTIC /begin REF_MEASUREMENT /end REF_MEASUREMENT /end GROUP
/begin GROUP FordCmdArbn.FordCmdArbnExtAgDeniedActvnReq.Ary1D "MICROSAR RTE" /begin SUB_GROUP /end SUB_GROUP /begin FUNCTION_LIST /end FUNCTION_LIST /begin REF_CHARACTERISTIC FordCmdArbn.FordCmdArbnExtAgDeniedActvnReq.Ary1D /end REF_CHARACTERISTIC /begin REF_MEASUREMENT /end REF_MEASUREMENT /end GROUP
/begin GROUP FordCmdArbn.FordCmdArbnLaneDprtrWarnDeactvn.Ary1D "MICROSAR RTE" /begin SUB_GROUP /end SUB_GROUP /begin FUNCTION_LIST /end FUNCTION_LIST /begin REF_CHARACTERISTIC FordCmdArbn.FordCmdArbnLaneDprtrWarnDeactvn.Ary1D /end REF_CHARACTERISTIC /begin REF_MEASUREMENT /end REF_MEASUREMENT /end GROUP
/begin GROUP FordCmdArbn.FordCmdArbnLaneDprtrWarnDeniedActvnReq.Ary1D "MICROSAR RTE" /begin SUB_GROUP /end SUB_GROUP /begin FUNCTION_LIST /end FUNCTION_LIST /begin REF_CHARACTERISTIC FordCmdArbn.FordCmdArbnLaneDprtrWarnDeniedActvnReq.Ary1D /end REF_CHARACTERISTIC /begin REF_MEASUREMENT /end REF_MEASUREMENT /end GROUP
/begin GROUP FordCmdArbn.FordCmdArbnLaneKeepAssiDeactvn.Ary1D "MICROSAR RTE" /begin SUB_GROUP /end SUB_GROUP /begin FUNCTION_LIST /end FUNCTION_LIST /begin REF_CHARACTERISTIC FordCmdArbn.FordCmdArbnLaneKeepAssiDeactvn.Ary1D /end REF_CHARACTERISTIC /begin REF_MEASUREMENT /end REF_MEASUREMENT /end GROUP
/begin GROUP FordCmdArbn.FordCmdArbnLaneKeepAssiDeniedActvnReq.Ary1D "MICROSAR RTE" /begin SUB_GROUP /end SUB_GROUP /begin FUNCTION_LIST /end FUNCTION_LIST /begin REF_CHARACTERISTIC FordCmdArbn.FordCmdArbnLaneKeepAssiDeniedActvnReq.Ary1D /end REF_CHARACTERISTIC /begin REF_MEASUREMENT /end REF_MEASUREMENT /end GROUP
/begin GROUP FordCmdArbn.FordCmdArbnLatCtrlDeactvn.Ary1D "MICROSAR RTE" /begin SUB_GROUP /end SUB_GROUP /begin FUNCTION_LIST /end FUNCTION_LIST /begin REF_CHARACTERISTIC FordCmdArbn.FordCmdArbnLatCtrlDeactvn.Ary1D /end REF_CHARACTERISTIC /begin REF_MEASUREMENT /end REF_MEASUREMENT /end GROUP
/begin GROUP FordCmdArbn.FordCmdArbnLatCtrlDeniedActvnReq.Ary1D "MICROSAR RTE" /begin SUB_GROUP /end SUB_GROUP /begin FUNCTION_LIST /end FUNCTION_LIST /begin REF_CHARACTERISTIC FordCmdArbn.FordCmdArbnLatCtrlDeniedActvnReq.Ary1D /end REF_CHARACTERISTIC /begin REF_MEASUREMENT /end REF_MEASUREMENT /end GROUP
/begin GROUP FordCmdArbn.FordCmdArbnNonStMask.Ary1D "MICROSAR RTE" /begin SUB_GROUP /end SUB_GROUP /begin FUNCTION_LIST /end FUNCTION_LIST /begin REF_CHARACTERISTIC FordCmdArbn.FordCmdArbnNonStMask.Ary1D /end REF_CHARACTERISTIC /begin REF_MEASUREMENT /end REF_MEASUREMENT /end GROUP
/begin GROUP FordCmdArbn.FordCmdArbnNormAssiTqThd.Val "MICROSAR RTE" /begin SUB_GROUP /end SUB_GROUP /begin FUNCTION_LIST /end FUNCTION_LIST /begin REF_CHARACTERISTIC FordCmdArbn.FordCmdArbnNormAssiTqThd.Val /end REF_CHARACTERISTIC /begin REF_MEASUREMENT /end REF_MEASUREMENT /end GROUP
/begin GROUP FordCmdArbn.FordCmdArbnPullDriftCmpDeactvn.Ary1D "MICROSAR RTE" /begin SUB_GROUP /end SUB_GROUP /begin FUNCTION_LIST /end FUNCTION_LIST /begin REF_CHARACTERISTIC FordCmdArbn.FordCmdArbnPullDriftCmpDeactvn.Ary1D /end REF_CHARACTERISTIC /begin REF_MEASUREMENT /end REF_MEASUREMENT /end GROUP
/begin GROUP FordCmdArbn.FordCmdArbnPullDriftCmpDeniedActvnReq.Ary1D "MICROSAR RTE" /begin SUB_GROUP /end SUB_GROUP /begin FUNCTION_LIST /end FUNCTION_LIST /begin REF_CHARACTERISTIC FordCmdArbn.FordCmdArbnPullDriftCmpDeniedActvnReq.Ary1D /end REF_CHARACTERISTIC /begin REF_MEASUREMENT /end REF_MEASUREMENT /end GROUP
/begin GROUP FordCmdArbn.FordCmdArbnPullDriftCmpLrngDeactvn.Ary1D "MICROSAR RTE" /begin SUB_GROUP /end SUB_GROUP /begin FUNCTION_LIST /end FUNCTION_LIST /begin REF_CHARACTERISTIC FordCmdArbn.FordCmdArbnPullDriftCmpLrngDeactvn.Ary1D /end REF_CHARACTERISTIC /begin REF_MEASUREMENT /end REF_MEASUREMENT /end GROUP
/begin GROUP FordCmdArbn.FordCmdArbnPullDriftCmpLrngDeniedActvnReq.Ary1D "MICROSAR RTE" /begin SUB_GROUP /end SUB_GROUP /begin FUNCTION_LIST /end FUNCTION_LIST
 /begin REF_CHARACTERISTIC FordCmdArbn.FordCmdArbnPullDriftCmpLrngDeniedActvnReq.Ary1D /end REF_CHARACTERISTIC
 /begin REF_MEASUREMENT /end REF_MEASUREMENT
/end GROUP
/begin GROUP FordCmdArbn.FordCmdArbnSpare1Deactvn.Ary1D "MICROSAR RTE" /begin SUB_GROUP /end SUB_GROUP /begin FUNCTION_LIST /end FUNCTION_LIST /begin REF_CHARACTERISTIC FordCmdArbn.FordCmdArbnSpare1Deactvn.Ary1D /end REF_CHARACTERISTIC /begin REF_MEASUREMENT /end REF_MEASUREMENT /end GROUP
/begin GROUP FordCmdArbn.FordCmdArbnSpare1DeniedActvnReq.Ary1D "MICROSAR RTE" /begin SUB_GROUP /end SUB_GROUP /begin FUNCTION_LIST /end FUNCTION_LIST /begin REF_CHARACTERISTIC FordCmdArbn.FordCmdArbnSpare1DeniedActvnReq.Ary1D /end REF_CHARACTERISTIC /begin REF_MEASUREMENT /end REF_MEASUREMENT /end GROUP
/begin GROUP FordCmdArbn.FordCmdArbnSpare2Deactvn.Ary1D "MICROSAR RTE" /begin SUB_GROUP /end SUB_GROUP /begin FUNCTION_LIST /end FUNCTION_LIST /begin REF_CHARACTERISTIC FordCmdArbn.FordCmdArbnSpare2Deactvn.Ary1D /end REF_CHARACTERISTIC /begin REF_MEASUREMENT /end REF_MEASUREMENT /end GROUP
/begin GROUP FordCmdArbn.FordCmdArbnSpare2DeniedActvnReq.Ary1D "MICROSAR RTE" /begin SUB_GROUP /end SUB_GROUP /begin FUNCTION_LIST /end FUNCTION_LIST /begin REF_CHARACTERISTIC FordCmdArbn.FordCmdArbnSpare2DeniedActvnReq.Ary1D /end REF_CHARACTERISTIC /begin REF_MEASUREMENT /end REF_MEASUREMENT /end GROUP
/begin GROUP FordCmdArbn.FordCmdArbnSpare3Deactvn.Ary1D "MICROSAR RTE" /begin SUB_GROUP /end SUB_GROUP /begin FUNCTION_LIST /end FUNCTION_LIST /begin REF_CHARACTERISTIC FordCmdArbn.FordCmdArbnSpare3Deactvn.Ary1D /end REF_CHARACTERISTIC /begin REF_MEASUREMENT /end REF_MEASUREMENT /end GROUP
/begin GROUP FordCmdArbn.FordCmdArbnSpare3DeniedActvnReq.Ary1D "MICROSAR RTE" /begin SUB_GROUP /end SUB_GROUP /begin FUNCTION_LIST /end FUNCTION_LIST /begin REF_CHARACTERISTIC FordCmdArbn.FordCmdArbnSpare3DeniedActvnReq.Ary1D /end REF_CHARACTERISTIC /begin REF_MEASUREMENT /end REF_MEASUREMENT /end GROUP
/begin GROUP FordCmdArbn.FordCmdArbnSteerDstbcDeactvn.Ary1D "MICROSAR RTE" /begin SUB_GROUP /end SUB_GROUP /begin FUNCTION_LIST /end FUNCTION_LIST /begin REF_CHARACTERISTIC FordCmdArbn.FordCmdArbnSteerDstbcDeactvn.Ary1D /end REF_CHARACTERISTIC /begin REF_MEASUREMENT /end REF_MEASUREMENT /end GROUP
/begin GROUP FordCmdArbn.FordCmdArbnSteerDstbcDeniedActvnReq.Ary1D "MICROSAR RTE" /begin SUB_GROUP /end SUB_GROUP /begin FUNCTION_LIST /end FUNCTION_LIST /begin REF_CHARACTERISTIC FordCmdArbn.FordCmdArbnSteerDstbcDeniedActvnReq.Ary1D /end REF_CHARACTERISTIC /begin REF_MEASUREMENT /end REF_MEASUREMENT /end GROUP
/begin GROUP FordCmdArbn.FordDrvrSteerRcmdnArbnCmd.Val "MICROSAR RTE" /begin SUB_GROUP /end SUB_GROUP /begin FUNCTION_LIST /end FUNCTION_LIST /begin REF_CHARACTERISTIC /end REF_CHARACTERISTIC /begin REF_MEASUREMENT FordCmdArbn.FordDrvrSteerRcmdnArbnCmd.Val /end REF_MEASUREMENT /end GROUP
/begin GROUP FordCmdArbn.FordDrvrSteerRcmdnFeatSt.Val "MICROSAR RTE" /begin SUB_GROUP /end SUB_GROUP /begin FUNCTION_LIST /end FUNCTION_LIST /begin REF_CHARACTERISTIC /end REF_CHARACTERISTIC /begin REF_MEASUREMENT FordCmdArbn.FordDrvrSteerRcmdnFeatSt.Val /end REF_MEASUREMENT /end GROUP
/begin GROUP FordCmdArbn.FordEvasSteerAssiArbnCmd.Val "MICROSAR RTE" /begin SUB_GROUP /end SUB_GROUP /begin FUNCTION_LIST /end FUNCTION_LIST /begin REF_CHARACTERISTIC /end REF_CHARACTERISTIC /begin REF_MEASUREMENT FordCmdArbn.FordEvasSteerAssiArbnCmd.Val /end REF_MEASUREMENT /end GROUP
/begin GROUP FordCmdArbn.FordEvasSteerAssiFeatSt.Val "MICROSAR RTE" /begin SUB_GROUP /end SUB_GROUP /begin FUNCTION_LIST /end FUNCTION_LIST /begin REF_CHARACTERISTIC /end REF_CHARACTERISTIC /begin REF_MEASUREMENT FordCmdArbn.FordEvasSteerAssiFeatSt.Val /end REF_MEASUREMENT /end GROUP
/begin GROUP FordCmdArbn.FordExtAgCtrlArbnCmd.Val "MICROSAR RTE" /begin SUB_GROUP /end SUB_GROUP /begin FUNCTION_LIST /end FUNCTION_LIST /begin REF_CHARACTERISTIC /end REF_CHARACTERISTIC /begin REF_MEASUREMENT FordCmdArbn.FordExtAgCtrlArbnCmd.Val /end REF_MEASUREMENT /end GROUP
/begin GROUP FordCmdArbn.FordExtAgCtrlFeatSt.Val "MICROSAR RTE" /begin SUB_GROUP /end SUB_GROUP /begin FUNCTION_LIST /end FUNCTION_LIST /begin REF_CHARACTERISTIC /end REF_CHARACTERISTIC /begin REF_MEASUREMENT FordCmdArbn.FordExtAgCtrlFeatSt.Val /end REF_MEASUREMENT /end GROUP
/begin GROUP FordCmdArbn.FordLaneDprtrWarnArbnCmd.Val "MICROSAR RTE" /begin SUB_GROUP /end SUB_GROUP /begin FUNCTION_LIST /end FUNCTION_LIST /begin REF_CHARACTERISTIC /end REF_CHARACTERISTIC /begin REF_MEASUREMENT FordCmdArbn.FordLaneDprtrWarnArbnCmd.Val /end REF_MEASUREMENT /end GROUP
/begin GROUP FordCmdArbn.FordLaneDprtrWarnFeatSt.Val "MICROSAR RTE" /begin SUB_GROUP /end SUB_GROUP /begin FUNCTION_LIST /end FUNCTION_LIST /begin REF_CHARACTERISTIC /end REF_CHARACTERISTIC /begin REF_MEASUREMENT FordCmdArbn.FordLaneDprtrWarnFeatSt.Val /end REF_MEASUREMENT /end GROUP
/begin GROUP FordCmdArbn.FordLaneKeepAssiArbnCmd.Val "MICROSAR RTE" /begin SUB_GROUP /end SUB_GROUP /begin FUNCTION_LIST /end FUNCTION_LIST /begin REF_CHARACTERISTIC /end REF_CHARACTERISTIC /begin REF_MEASUREMENT FordCmdArbn.FordLaneKeepAssiArbnCmd.Val /end REF_MEASUREMENT /end GROUP
/begin GROUP FordCmdArbn.FordLaneKeepAssiFeatSt.Val "MICROSAR RTE" /begin SUB_GROUP /end SUB_GROUP /begin FUNCTION_LIST /end FUNCTION_LIST /begin REF_CHARACTERISTIC /end REF_CHARACTERISTIC /begin REF_MEASUREMENT FordCmdArbn.FordLaneKeepAssiFeatSt.Val /end REF_MEASUREMENT /end GROUP
/begin GROUP FordCmdArbn.FordLatCtrlArbnCmd.Val "MICROSAR RTE" /begin SUB_GROUP /end SUB_GROUP /begin FUNCTION_LIST /end FUNCTION_LIST /begin REF_CHARACTERISTIC /end REF_CHARACTERISTIC /begin REF_MEASUREMENT FordCmdArbn.FordLatCtrlArbnCmd.Val /end REF_MEASUREMENT /end GROUP
/begin GROUP FordCmdArbn.FordLatCtrlFeatSt.Val "MICROSAR RTE" /begin SUB_GROUP /end SUB_GROUP /begin FUNCTION_LIST /end FUNCTION_LIST /begin REF_CHARACTERISTIC /end REF_CHARACTERISTIC /begin REF_MEASUREMENT FordCmdArbn.FordLatCtrlFeatSt.Val /end REF_MEASUREMENT /end GROUP
/begin GROUP FordCmdArbn.FordPullDriftCmpArbnCmd.Val "MICROSAR RTE" /begin SUB_GROUP /end SUB_GROUP /begin FUNCTION_LIST /end FUNCTION_LIST /begin REF_CHARACTERISTIC /end REF_CHARACTERISTIC /begin REF_MEASUREMENT FordCmdArbn.FordPullDriftCmpArbnCmd.Val /end REF_MEASUREMENT /end GROUP
/begin GROUP FordCmdArbn.FordPullDriftCmpFeatSt.Val "MICROSAR RTE" /begin SUB_GROUP /end SUB_GROUP /begin FUNCTION_LIST /end FUNCTION_LIST /begin REF_CHARACTERISTIC /end REF_CHARACTERISTIC /begin REF_MEASUREMENT FordCmdArbn.FordPullDriftCmpFeatSt.Val /end REF_MEASUREMENT /end GROUP
/begin GROUP FordCmdArbn.FordPullDriftCmpLrngArbnCmd.Val "MICROSAR RTE" /begin SUB_GROUP /end SUB_GROUP /begin FUNCTION_LIST /end FUNCTION_LIST /begin REF_CHARACTERISTIC /end REF_CHARACTERISTIC /begin REF_MEASUREMENT FordCmdArbn.FordPullDriftCmpLrngArbnCmd.Val /end REF_MEASUREMENT /end GROUP
/begin GROUP FordCmdArbn.FordPullDriftCmpLrngFeatSt.Val "MICROSAR RTE" /begin SUB_GROUP /end SUB_GROUP /begin FUNCTION_LIST /end FUNCTION_LIST /begin REF_CHARACTERISTIC /end REF_CHARACTERISTIC /begin REF_MEASUREMENT FordCmdArbn.FordPullDriftCmpLrngFeatSt.Val /end REF_MEASUREMENT /end GROUP
/begin GROUP FordCmdArbn.FordSpare1ArbnCmd.Val "MICROSAR RTE" /begin SUB_GROUP /end SUB_GROUP /begin FUNCTION_LIST /end FUNCTION_LIST /begin REF_CHARACTERISTIC /end REF_CHARACTERISTIC /begin REF_MEASUREMENT FordCmdArbn.FordSpare1ArbnCmd.Val /end REF_MEASUREMENT /end GROUP
/begin GROUP FordCmdArbn.FordSpare1FeatSt.Val "MICROSAR RTE" /begin SUB_GROUP /end SUB_GROUP /begin FUNCTION_LIST /end FUNCTION_LIST /begin REF_CHARACTERISTIC /end REF_CHARACTERISTIC /begin REF_MEASUREMENT FordCmdArbn.FordSpare1FeatSt.Val /end REF_MEASUREMENT /end GROUP
/begin GROUP FordCmdArbn.FordSpare2ArbnCmd.Val "MICROSAR RTE" /begin SUB_GROUP /end SUB_GROUP /begin FUNCTION_LIST /end FUNCTION_LIST /begin REF_CHARACTERISTIC /end REF_CHARACTERISTIC /begin REF_MEASUREMENT FordCmdArbn.FordSpare2ArbnCmd.Val /end REF_MEASUREMENT /end GROUP
/begin GROUP FordCmdArbn.FordSpare2FeatSt.Val "MICROSAR RTE" /begin SUB_GROUP /end SUB_GROUP /begin FUNCTION_LIST /end FUNCTION_LIST /begin REF_CHARACTERISTIC /end REF_CHARACTERISTIC /begin REF_MEASUREMENT FordCmdArbn.FordSpare2FeatSt.Val /end REF_MEASUREMENT /end GROUP
/begin GROUP FordCmdArbn.FordSpare3ArbnCmd.Val "MICROSAR RTE" /begin SUB_GROUP /end SUB_GROUP /begin FUNCTION_LIST /end FUNCTION_LIST /begin REF_CHARACTERISTIC /end REF_CHARACTERISTIC /begin REF_MEASUREMENT FordCmdArbn.FordSpare3ArbnCmd.Val /end REF_MEASUREMENT /end GROUP
/begin GROUP FordCmdArbn.FordSpare3FeatSt.Val "MICROSAR RTE" /begin SUB_GROUP /end SUB_GROUP /begin FUNCTION_LIST /end FUNCTION_LIST /begin REF_CHARACTERISTIC /end REF_CHARACTERISTIC /begin REF_MEASUREMENT FordCmdArbn.FordSpare3FeatSt.Val /end REF_MEASUREMENT /end GROUP
/begin GROUP FordCmdArbn.FordSteerModlSts.Val "MICROSAR RTE" /begin SUB_GROUP /end SUB_GROUP /begin FUNCTION_LIST /end FUNCTION_LIST /begin REF_CHARACTERISTIC /end REF_CHARACTERISTIC /begin REF_MEASUREMENT FordCmdArbn.FordSteerModlSts.Val /end REF_MEASUREMENT /end GROUP
/begin GROUP FordCmdArbn.FordSteerTqDstbcRejctnArbnCmd.Val "MICROSAR RTE" /begin SUB_GROUP /end SUB_GROUP /begin FUNCTION_LIST /end FUNCTION_LIST /begin REF_CHARACTERISTIC /end REF_CHARACTERISTIC /begin REF_MEASUREMENT FordCmdArbn.FordSteerTqDstbcRejctnArbnCmd.Val /end REF_MEASUREMENT /end GROUP
/begin GROUP FordCmdArbn.FordSteerTqDstbcRejctnFeatSt.Val "MICROSAR RTE" /begin SUB_GROUP /end SUB_GROUP /begin FUNCTION_LIST /end FUNCTION_LIST /begin REF_CHARACTERISTIC /end REF_CHARACTERISTIC /begin REF_MEASUREMENT FordCmdArbn.FordSteerTqDstbcRejctnFeatSt.Val /end REF_MEASUREMENT /end GROUP
/begin GROUP FordCmdArbn.FordSysOperMotTqCmdSca.Val "MICROSAR RTE" /begin SUB_GROUP /end SUB_GROUP /begin FUNCTION_LIST /end FUNCTION_LIST /begin REF_CHARACTERISTIC /end REF_CHARACTERISTIC /begin REF_MEASUREMENT FordCmdArbn.FordSysOperMotTqCmdSca.Val /end REF_MEASUREMENT /end GROUP
/begin GROUP FordCmdArbn.ReceiverPorts "MICROSAR RTE"
 /begin SUB_GROUP FordCmdArbn.EcuId.Val FordCmdArbn.FordActvNiblCtrlFeatSt.Val FordCmdArbn.FordDrvrSteerRcmdnFeatSt.Val FordCmdArbn.FordEvasSteerAssiFeatSt.Val FordCmdArbn.FordExtAgCtrlFeatSt.Val FordCmdArbn.FordLaneDprtrWarnFeatSt.Val FordCmdArbn.FordLaneKeepAssiFeatSt.Val FordCmdArbn.FordLatCtrlFeatSt.Val FordCmdArbn.FordPullDriftCmpFeatSt.Val FordCmdArbn.FordPullDriftCmpLrngFeatSt.Val FordCmdArbn.FordSpare1FeatSt.Val FordCmdArbn.FordSpare2FeatSt.Val FordCmdArbn.FordSpare3FeatSt.Val FordCmdArbn.FordSteerModlSts.Val FordCmdArbn.FordSteerTqDstbcRejctnFeatSt.Val FordCmdArbn.FordSysOperMotTqCmdSca.Val /end SUB_GROUP
 /begin FUNCTION_LIST /end FUNCTION_LIST
 /begin REF_CHARACTERISTIC /end REF_CHARACTERISTIC
 /begin REF_MEASUREMENT /end REF_MEASUREMENT
/end GROUP
/begin GROUP FordCmdArbn.SenderPorts "MICROSAR RTE"
 /begin SUB_GROUP FordCmdArbn.FordActvNiblCtrlArbnCmd.Val FordCmdArbn.FordDrvrSteerRcmdnArbnCmd.Val FordCmdArbn.FordEvasSteerAssiArbnCmd.Val FordCmdArbn.FordExtAgCtrlArbnCmd.Val FordCmdArbn.FordLaneDprtrWarnArbnCmd.Val FordCmdArbn.FordLaneKeepAssiArbnCmd.Val FordCmdArbn.FordLatCtrlArbnCmd.Val FordCmdArbn.FordPullDriftCmpArbnCmd.Val FordCmdArbn.FordPullDriftCmpLrngArbnCmd.Val FordCmdArbn.FordSpare1ArbnCmd.Val FordCmdArbn.FordSpare2ArbnCmd.Val FordCmdArbn.FordSpare3ArbnCmd.Val FordCmdArbn.FordSteerTqDstbcRejctnArbnCmd.Val /end SUB_GROUP
 /begin FUNCTION_LIST /end FUNCTION_LIST
 /begin REF_CHARACTERISTIC /end REF_CHARACTERISTIC
 /begin REF_MEASUREMENT /end REF_MEASUREMENT
/end GROUP
/begin GROUP FordDualEcuFltDiagcCom "MICROSAR RTE"
 /begin SUB_GROUP FordDualEcuFltDiagcCom.PerInstanceMemories FordDualEcuFltDiagcCom.ReceiverPorts FordDualEcuFltDiagcCom.SenderPorts /end SUB_GROUP
 /begin FUNCTION_LIST /end FUNCTION_LIST
 /begin REF_CHARACTERISTIC /end REF_CHARACTERISTIC
 /begin REF_MEASUREMENT /end REF_MEASUREMENT
/end GROUP
/begin GROUP FordDualEcuFltDiagcCom.EcuId.Val "MICROSAR RTE" /begin SUB_GROUP /end SUB_GROUP /begin FUNCTION_LIST /end FUNCTION_LIST /begin REF_CHARACTERISTIC /end REF_CHARACTERISTIC /begin REF_MEASUREMENT FordDualEcuFltDiagcCom.EcuId.Val /end REF_MEASUREMENT /end GROUP
/begin GROUP FordDualEcuFltDiagcCom.FordCTCLoopIdx "MICROSAR RTE" /begin SUB_GROUP /end SUB_GROUP /begin FUNCTION_LIST /end FUNCTION_LIST /begin REF_CHARACTERISTIC /end REF_CHARACTERISTIC /begin REF_MEASUREMENT FordDualEcuFltDiagcCom.FordCTCLoopIdx /end REF_MEASUREMENT /end GROUP
/begin GROUP FordDualEcuFltDiagcCom.FordCtcIdx.Val "MICROSAR RTE" /begin SUB_GROUP /end SUB_GROUP /begin FUNCTION_LIST /end FUNCTION_LIST /begin REF_CHARACTERISTIC /end REF_CHARACTERISTIC /begin REF_MEASUREMENT FordDualEcuFltDiagcCom.FordCtcIdx.Val /end REF_MEASUREMENT /end GROUP
/begin GROUP FordDualEcuFltDiagcCom.FordCtcSts.Val "MICROSAR RTE" /begin SUB_GROUP /end SUB_GROUP /begin FUNCTION_LIST /end FUNCTION_LIST /begin REF_CHARACTERISTIC /end REF_CHARACTERISTIC /begin REF_MEASUREMENT FordDualEcuFltDiagcCom.FordCtcSts.Val /end REF_MEASUREMENT /end GROUP
/begin GROUP FordDualEcuFltDiagcCom.PerInstanceMemories "MICROSAR RTE" /begin SUB_GROUP FordDualEcuFltDiagcCom.FordCTCLoopIdx /end SUB_GROUP /begin FUNCTION_LIST /end FUNCTION_LIST /begin REF_CHARACTERISTIC /end REF_CHARACTERISTIC /begin REF_MEASUREMENT /end REF_MEASUREMENT /end GROUP
/begin GROUP FordDualEcuFltDiagcCom.ReceiverPorts "MICROSAR RTE" /begin SUB_GROUP FordDualEcuFltDiagcCom.EcuId.Val /end SUB_GROUP /begin FUNCTION_LIST /end FUNCTION_LIST /begin REF_CHARACTERISTIC /end REF_CHARACTERISTIC /begin REF_MEASUREMENT /end REF_MEASUREMENT /end GROUP
/begin GROUP FordDualEcuFltDiagcCom.SenderPorts "MICROSAR RTE"
 /begin SUB_GROUP FordDualEcuFltDiagcCom.FordCtcIdx.Val FordDualEcuFltDiagcCom.FordCtcSts.Val /end SUB_GROUP
 /begin FUNCTION_LIST /end FUNCTION_LIST
 /begin REF_CHARACTERISTIC /end REF_CHARACTERISTIC
 /begin REF_MEASUREMENT /end REF_MEASUREMENT
/end GROUP
/begin GROUP FordHwAgArbn "MICROSAR RTE"
 /begin SUB_GROUP FordHwAgArbn.CalibrationParameters FordHwAgArbn.CalibrationPorts FordHwAgArbn.PerInstanceMemories FordHwAgArbn.ReceiverPorts FordHwAgArbn.SenderPorts /end SUB_GROUP
 /begin FUNCTION_LIST /end FUNCTION_LIST
 /begin REF_CHARACTERISTIC /end REF_CHARACTERISTIC
 /begin REF_MEASUREMENT /end REF_MEASUREMENT
/end GROUP
/begin GROUP FordHwAgArbn.CalibrationParameters "MICROSAR RTE" /begin SUB_GROUP FordHwAgArbn.PrevIgnCycValDft /end SUB_GROUP /begin FUNCTION_LIST /end FUNCTION_LIST /begin REF_CHARACTERISTIC /end REF_CHARACTERISTIC /begin REF_MEASUREMENT /end REF_MEASUREMENT /end GROUP
/begin GROUP FordHwAgArbn.CalibrationPorts "MICROSAR RTE"
 /begin SUB_GROUP FordHwAgArbn.FordHwAgArbnMotVelVldFlgRcvrTiThd.Val FordHwAgArbn.FordHwAgArbnNonAbsCentrNotDetdTiThd.Val FordHwAgArbn.FordHwAgArbnPhyRackTrvlThd.Val FordHwAgArbn.FordHwAgArbnRelPosnVldFlgRcvryTiThd.Val FordHwAgArbn.SysGlbPrmSysKineRat.Val /end SUB_GROUP
 /begin FUNCTION_LIST /end FUNCTION_LIST
 /begin REF_CHARACTERISTIC /end REF_CHARACTERISTIC
 /begin REF_MEASUREMENT /end REF_MEASUREMENT
/end GROUP
/begin GROUP FordHwAgArbn.FirstTranVldFlg "MICROSAR RTE" /begin SUB_GROUP /end SUB_GROUP /begin FUNCTION_LIST /end FUNCTION_LIST /begin REF_CHARACTERISTIC /end REF_CHARACTERISTIC /begin REF_MEASUREMENT FordHwAgArbn.FirstTranVldFlg /end REF_MEASUREMENT /end GROUP
/begin GROUP FordHwAgArbn.FordAbsPrsnt.Logl "MICROSAR RTE" /begin SUB_GROUP /end SUB_GROUP /begin FUNCTION_LIST /end FUNCTION_LIST /begin REF_CHARACTERISTIC /end REF_CHARACTERISTIC /begin REF_MEASUREMENT FordHwAgArbn.FordAbsPrsnt.Logl /end REF_MEASUREMENT /end GROUP
/begin GROUP FordHwAgArbn.FordCmpdHwPosn.Val "MICROSAR RTE" /begin SUB_GROUP /end SUB_GROUP /begin FUNCTION_LIST /end FUNCTION_LIST /begin REF_CHARACTERISTIC /end REF_CHARACTERISTIC /begin REF_MEASUREMENT FordHwAgArbn.FordCmpdHwPosn.Val /end REF_MEASUREMENT /end GROUP
/begin GROUP FordHwAgArbn.FordCmpdHwPosnPrev "MICROSAR RTE" /begin SUB_GROUP /end SUB_GROUP /begin FUNCTION_LIST /end FUNCTION_LIST /begin REF_CHARACTERISTIC /end REF_CHARACTERISTIC /begin REF_MEASUREMENT FordHwAgArbn.FordCmpdHwPosnPrev /end REF_MEASUREMENT /end GROUP
/begin GROUP FordHwAgArbn.FordCmpdHwPosnQlyFac.Ford_StePinCompAnEst_D_Qf "MICROSAR RTE" /begin SUB_GROUP /end SUB_GROUP /begin FUNCTION_LIST /end FUNCTION_LIST /begin REF_CHARACTERISTIC /end REF_CHARACTERISTIC
 /begin REF_MEASUREMENT FordHwAgArbn.FordCmpdHwPosnQlyFac.Ford_StePinCompAnEst_D_Qf /end REF_MEASUREMENT
/end GROUP
/begin GROUP FordHwAgArbn.FordCmpdHwPosnQlyFac8.Val "MICROSAR RTE" /begin SUB_GROUP /end SUB_GROUP /begin FUNCTION_LIST /end FUNCTION_LIST /begin REF_CHARACTERISTIC /end REF_CHARACTERISTIC /begin REF_MEASUREMENT FordHwAgArbn.FordCmpdHwPosnQlyFac8.Val /end REF_MEASUREMENT /end GROUP
/begin GROUP FordHwAgArbn.FordCmpdHwPosnQlyFacPrev "MICROSAR RTE" /begin SUB_GROUP /end SUB_GROUP /begin FUNCTION_LIST /end FUNCTION_LIST /begin REF_CHARACTERISTIC /end REF_CHARACTERISTIC /begin REF_MEASUREMENT FordHwAgArbn.FordCmpdHwPosnQlyFacPrev /end REF_MEASUREMENT /end GROUP
/begin GROUP FordHwAgArbn.FordCmpdHwPosntoSerlCom.Val "MICROSAR RTE" /begin SUB_GROUP /end SUB_GROUP /begin FUNCTION_LIST /end FUNCTION_LIST /begin REF_CHARACTERISTIC /end REF_CHARACTERISTIC /begin REF_MEASUREMENT FordHwAgArbn.FordCmpdHwPosntoSerlCom.Val /end REF_MEASUREMENT /end GROUP
/begin GROUP FordHwAgArbn.FordEngVehSpd.Val "MICROSAR RTE" /begin SUB_GROUP /end SUB_GROUP /begin FUNCTION_LIST /end FUNCTION_LIST /begin REF_CHARACTERISTIC /end REF_CHARACTERISTIC /begin REF_MEASUREMENT FordHwAgArbn.FordEngVehSpd.Val /end REF_MEASUREMENT /end GROUP
/begin GROUP FordHwAgArbn.FordHwAgArbnMotVelVldFlgRcvrTiThd.Val "MICROSAR RTE" /begin SUB_GROUP /end SUB_GROUP /begin FUNCTION_LIST /end FUNCTION_LIST /begin REF_CHARACTERISTIC FordHwAgArbn.FordHwAgArbnMotVelVldFlgRcvrTiThd.Val /end REF_CHARACTERISTIC /begin REF_MEASUREMENT /end REF_MEASUREMENT /end GROUP
/begin GROUP FordHwAgArbn.FordHwAgArbnNonAbsCentrNotDetdTiThd.Val "MICROSAR RTE" /begin SUB_GROUP /end SUB_GROUP /begin FUNCTION_LIST /end FUNCTION_LIST /begin REF_CHARACTERISTIC FordHwAgArbn.FordHwAgArbnNonAbsCentrNotDetdTiThd.Val /end REF_CHARACTERISTIC /begin REF_MEASUREMENT /end REF_MEASUREMENT /end GROUP
/begin GROUP FordHwAgArbn.FordHwAgArbnPhyRackTrvlThd.Val "MICROSAR RTE" /begin SUB_GROUP /end SUB_GROUP /begin FUNCTION_LIST /end FUNCTION_LIST /begin REF_CHARACTERISTIC FordHwAgArbn.FordHwAgArbnPhyRackTrvlThd.Val /end REF_CHARACTERISTIC /begin REF_MEASUREMENT /end REF_MEASUREMENT /end GROUP
/begin GROUP FordHwAgArbn.FordHwAgArbnRelPosnVldFlgRcvryTiThd.Val "MICROSAR RTE" /begin SUB_GROUP /end SUB_GROUP /begin FUNCTION_LIST /end FUNCTION_LIST /begin REF_CHARACTERISTIC FordHwAgArbn.FordHwAgArbnRelPosnVldFlgRcvryTiThd.Val /end REF_CHARACTERISTIC /begin REF_MEASUREMENT /end REF_MEASUREMENT /end GROUP
/begin GROUP FordHwAgArbn.FordHwVelVld.Logl "MICROSAR RTE" /begin SUB_GROUP /end SUB_GROUP /begin FUNCTION_LIST /end FUNCTION_LIST /begin REF_CHARACTERISTIC /end REF_CHARACTERISTIC /begin REF_MEASUREMENT FordHwAgArbn.FordHwVelVld.Logl /end REF_MEASUREMENT /end GROUP
/begin GROUP FordHwAgArbn.FordInpTq.Val "MICROSAR RTE" /begin SUB_GROUP /end SUB_GROUP /begin FUNCTION_LIST /end FUNCTION_LIST /begin REF_CHARACTERISTIC /end REF_CHARACTERISTIC /begin REF_MEASUREMENT FordHwAgArbn.FordInpTq.Val /end REF_MEASUREMENT /end GROUP
/begin GROUP FordHwAgArbn.FordMotPosn.Val "MICROSAR RTE" /begin SUB_GROUP /end SUB_GROUP /begin FUNCTION_LIST /end FUNCTION_LIST /begin REF_CHARACTERISTIC /end REF_CHARACTERISTIC /begin REF_MEASUREMENT FordHwAgArbn.FordMotPosn.Val /end REF_MEASUREMENT /end GROUP
/begin GROUP FordHwAgArbn.FordMotVelVld.Logl "MICROSAR RTE" /begin SUB_GROUP /end SUB_GROUP /begin FUNCTION_LIST /end FUNCTION_LIST /begin REF_CHARACTERISTIC /end REF_CHARACTERISTIC /begin REF_MEASUREMENT FordHwAgArbn.FordMotVelVld.Logl /end REF_MEASUREMENT /end GROUP
/begin GROUP FordHwAgArbn.FordPosnOffsVld.Logl "MICROSAR RTE" /begin SUB_GROUP /end SUB_GROUP /begin FUNCTION_LIST /end FUNCTION_LIST /begin REF_CHARACTERISTIC /end REF_CHARACTERISTIC /begin REF_MEASUREMENT FordHwAgArbn.FordPosnOffsVld.Logl /end REF_MEASUREMENT /end GROUP
/begin GROUP FordHwAgArbn.FordRelHwPosn.Val "MICROSAR RTE" /begin SUB_GROUP /end SUB_GROUP /begin FUNCTION_LIST /end FUNCTION_LIST /begin REF_CHARACTERISTIC /end REF_CHARACTERISTIC /begin REF_MEASUREMENT FordHwAgArbn.FordRelHwPosn.Val /end REF_MEASUREMENT /end GROUP
/begin GROUP FordHwAgArbn.FordRelHwPosnVld.Logl "MICROSAR RTE" /begin SUB_GROUP /end SUB_GROUP /begin FUNCTION_LIST /end FUNCTION_LIST /begin REF_CHARACTERISTIC /end REF_CHARACTERISTIC /begin REF_MEASUREMENT FordHwAgArbn.FordRelHwPosnVld.Logl /end REF_MEASUREMENT /end GROUP
/begin GROUP FordHwAgArbn.FordRelHwPosntoSerlCom.Val "MICROSAR RTE" /begin SUB_GROUP /end SUB_GROUP /begin FUNCTION_LIST /end FUNCTION_LIST /begin REF_CHARACTERISTIC /end REF_CHARACTERISTIC /begin REF_MEASUREMENT FordHwAgArbn.FordRelHwPosntoSerlCom.Val /end REF_MEASUREMENT /end GROUP
/begin GROUP FordHwAgArbn.FordSnsrInp.Val "MICROSAR RTE" /begin SUB_GROUP /end SUB_GROUP /begin FUNCTION_LIST /end FUNCTION_LIST /begin REF_CHARACTERISTIC /end REF_CHARACTERISTIC /begin REF_MEASUREMENT FordHwAgArbn.FordSnsrInp.Val /end REF_MEASUREMENT /end GROUP
/begin GROUP FordHwAgArbn.FordSteerAgClrFlg.Logl "MICROSAR RTE" /begin SUB_GROUP /end SUB_GROUP /begin FUNCTION_LIST /end FUNCTION_LIST /begin REF_CHARACTERISTIC /end REF_CHARACTERISTIC /begin REF_MEASUREMENT FordHwAgArbn.FordSteerAgClrFlg.Logl /end REF_MEASUREMENT /end GROUP
/begin GROUP FordHwAgArbn.FordSteerPinionOffs.Val "MICROSAR RTE" /begin SUB_GROUP /end SUB_GROUP /begin FUNCTION_LIST /end FUNCTION_LIST /begin REF_CHARACTERISTIC /end REF_CHARACTERISTIC /begin REF_MEASUREMENT FordHwAgArbn.FordSteerPinionOffs.Val /end REF_MEASUREMENT /end GROUP
/begin GROUP FordHwAgArbn.FordSteerPinionOffsSts.Ford_StePinOffst_D_Stat "MICROSAR RTE" /begin SUB_GROUP /end SUB_GROUP /begin FUNCTION_LIST /end FUNCTION_LIST /begin REF_CHARACTERISTIC /end REF_CHARACTERISTIC
 /begin REF_MEASUREMENT FordHwAgArbn.FordSteerPinionOffsSts.Ford_StePinOffst_D_Stat /end REF_MEASUREMENT
/end GROUP
/begin GROUP FordHwAgArbn.FordSteerPinionOffsStsPrev "MICROSAR RTE" /begin SUB_GROUP /end SUB_GROUP /begin FUNCTION_LIST /end FUNCTION_LIST /begin REF_CHARACTERISTIC /end REF_CHARACTERISTIC /begin REF_MEASUREMENT FordHwAgArbn.FordSteerPinionOffsStsPrev /end REF_MEASUREMENT /end GROUP
/begin GROUP FordHwAgArbn.HwAgIdptSig.Val "MICROSAR RTE" /begin SUB_GROUP /end SUB_GROUP /begin FUNCTION_LIST /end FUNCTION_LIST /begin REF_CHARACTERISTIC /end REF_CHARACTERISTIC /begin REF_MEASUREMENT FordHwAgArbn.HwAgIdptSig.Val /end REF_MEASUREMENT /end GROUP
/begin GROUP FordHwAgArbn.MotVelVldTrueTi "MICROSAR RTE" /begin SUB_GROUP /end SUB_GROUP /begin FUNCTION_LIST /end FUNCTION_LIST /begin REF_CHARACTERISTIC /end REF_CHARACTERISTIC /begin REF_MEASUREMENT FordHwAgArbn.MotVelVldTrueTi /end REF_MEASUREMENT /end GROUP
/begin GROUP FordHwAgArbn.NoDataExistFlg "MICROSAR RTE" /begin SUB_GROUP /end SUB_GROUP /begin FUNCTION_LIST /end FUNCTION_LIST /begin REF_CHARACTERISTIC /end REF_CHARACTERISTIC /begin REF_MEASUREMENT FordHwAgArbn.NoDataExistFlg /end REF_MEASUREMENT /end GROUP
/begin GROUP FordHwAgArbn.NonAbsCentrNotDetdTi "MICROSAR RTE" /begin SUB_GROUP /end SUB_GROUP /begin FUNCTION_LIST /end FUNCTION_LIST /begin REF_CHARACTERISTIC /end REF_CHARACTERISTIC /begin REF_MEASUREMENT FordHwAgArbn.NonAbsCentrNotDetdTi /end REF_MEASUREMENT /end GROUP
/begin GROUP FordHwAgArbn.NonAbsOffs "MICROSAR RTE" /begin SUB_GROUP /end SUB_GROUP /begin FUNCTION_LIST /end FUNCTION_LIST /begin REF_CHARACTERISTIC /end REF_CHARACTERISTIC /begin REF_MEASUREMENT FordHwAgArbn.NonAbsOffs /end REF_MEASUREMENT /end GROUP
/begin GROUP FordHwAgArbn.NonAbsOffsVldFlg "MICROSAR RTE" /begin SUB_GROUP /end SUB_GROUP /begin FUNCTION_LIST /end FUNCTION_LIST /begin REF_CHARACTERISTIC /end REF_CHARACTERISTIC /begin REF_MEASUREMENT FordHwAgArbn.NonAbsOffsVldFlg /end REF_MEASUREMENT /end GROUP
/begin GROUP FordHwAgArbn.PerInstanceMemories "MICROSAR RTE"
 /begin SUB_GROUP FordHwAgArbn.FirstTranVldFlg FordHwAgArbn.FordCmpdHwPosnPrev FordHwAgArbn.FordCmpdHwPosnQlyFacPrev FordHwAgArbn.FordSteerPinionOffsStsPrev FordHwAgArbn.MotVelVldTrueTi FordHwAgArbn.NoDataExistFlg FordHwAgArbn.NonAbsCentrNotDetdTi FordHwAgArbn.NonAbsOffs FordHwAgArbn.NonAbsOffsVldFlg FordHwAgArbn.PrevIgnCycVal FordHwAgArbn.RelHwPosnPrev FordHwAgArbn.RelHwPosnVld FordHwAgArbn.RelPosnLossFlg FordHwAgArbn.RelPosnVldFlgRcvryTi /end SUB_GROUP
 /begin FUNCTION_LIST /end FUNCTION_LIST
 /begin REF_CHARACTERISTIC /end REF_CHARACTERISTIC
 /begin REF_MEASUREMENT /end REF_MEASUREMENT
/end GROUP
/begin GROUP FordHwAgArbn.PrevIgnCycVal "MICROSAR RTE" /begin SUB_GROUP /end SUB_GROUP /begin FUNCTION_LIST /end FUNCTION_LIST /begin REF_CHARACTERISTIC /end REF_CHARACTERISTIC /begin REF_MEASUREMENT FordHwAgArbn.PrevIgnCycVal /end REF_MEASUREMENT /end GROUP
/begin GROUP FordHwAgArbn.PrevIgnCycValDft "MICROSAR RTE" /begin SUB_GROUP /end SUB_GROUP /begin FUNCTION_LIST /end FUNCTION_LIST /begin REF_CHARACTERISTIC FordHwAgArbn.PrevIgnCycValDft /end REF_CHARACTERISTIC /begin REF_MEASUREMENT /end REF_MEASUREMENT /end GROUP
/begin GROUP FordHwAgArbn.ReceiverPorts "MICROSAR RTE"
 /begin SUB_GROUP FordHwAgArbn.FordAbsPrsnt.Logl FordHwAgArbn.FordEngVehSpd.Val FordHwAgArbn.FordInpTq.Val FordHwAgArbn.FordMotPosn.Val FordHwAgArbn.FordMotVelVld.Logl FordHwAgArbn.FordSnsrInp.Val FordHwAgArbn.FordSteerAgClrFlg.Logl FordHwAgArbn.FordSteerPinionOffs.Val FordHwAgArbn.FordSteerPinionOffsSts.Ford_StePinOffst_D_Stat FordHwAgArbn.HwAgIdptSig.Val /end SUB_GROUP
 /begin FUNCTION_LIST /end FUNCTION_LIST
 /begin REF_CHARACTERISTIC /end REF_CHARACTERISTIC
 /begin REF_MEASUREMENT /end REF_MEASUREMENT
/end GROUP
/begin GROUP FordHwAgArbn.RelHwPosnPrev "MICROSAR RTE" /begin SUB_GROUP /end SUB_GROUP /begin FUNCTION_LIST /end FUNCTION_LIST /begin REF_CHARACTERISTIC /end REF_CHARACTERISTIC /begin REF_MEASUREMENT FordHwAgArbn.RelHwPosnPrev /end REF_MEASUREMENT /end GROUP
/begin GROUP FordHwAgArbn.RelHwPosnVld "MICROSAR RTE" /begin SUB_GROUP /end SUB_GROUP /begin FUNCTION_LIST /end FUNCTION_LIST /begin REF_CHARACTERISTIC /end REF_CHARACTERISTIC /begin REF_MEASUREMENT FordHwAgArbn.RelHwPosnVld /end REF_MEASUREMENT /end GROUP
/begin GROUP FordHwAgArbn.RelPosnLossFlg "MICROSAR RTE" /begin SUB_GROUP /end SUB_GROUP /begin FUNCTION_LIST /end FUNCTION_LIST /begin REF_CHARACTERISTIC /end REF_CHARACTERISTIC /begin REF_MEASUREMENT FordHwAgArbn.RelPosnLossFlg /end REF_MEASUREMENT /end GROUP
/begin GROUP FordHwAgArbn.RelPosnVldFlgRcvryTi "MICROSAR RTE" /begin SUB_GROUP /end SUB_GROUP /begin FUNCTION_LIST /end FUNCTION_LIST /begin REF_CHARACTERISTIC /end REF_CHARACTERISTIC /begin REF_MEASUREMENT FordHwAgArbn.RelPosnVldFlgRcvryTi /end REF_MEASUREMENT /end GROUP
/begin GROUP FordHwAgArbn.SenderPorts "MICROSAR RTE"
 /begin SUB_GROUP FordHwAgArbn.FordCmpdHwPosn.Val FordHwAgArbn.FordCmpdHwPosnQlyFac.Ford_StePinCompAnEst_D_Qf FordHwAgArbn.FordCmpdHwPosnQlyFac8.Val FordHwAgArbn.FordCmpdHwPosntoSerlCom.Val FordHwAgArbn.FordHwVelVld.Logl FordHwAgArbn.FordPosnOffsVld.Logl FordHwAgArbn.FordRelHwPosn.Val FordHwAgArbn.FordRelHwPosnVld.Logl FordHwAgArbn.FordRelHwPosntoSerlCom.Val /end SUB_GROUP
 /begin FUNCTION_LIST /end FUNCTION_LIST
 /begin REF_CHARACTERISTIC /end REF_CHARACTERISTIC
 /begin REF_MEASUREMENT /end REF_MEASUREMENT
/end GROUP
/begin GROUP FordHwAgArbn.SysGlbPrmSysKineRat.Val "MICROSAR RTE" /begin SUB_GROUP /end SUB_GROUP /begin FUNCTION_LIST /end FUNCTION_LIST /begin REF_CHARACTERISTIC FordHwAgArbn.SysGlbPrmSysKineRat.Val /end REF_CHARACTERISTIC /begin REF_MEASUREMENT /end REF_MEASUREMENT /end GROUP
/begin GROUP FordHwTqCdng "MICROSAR RTE"
 /begin SUB_GROUP FordHwTqCdng.CalibrationPorts FordHwTqCdng.PerInstanceMemories FordHwTqCdng.ReceiverPorts FordHwTqCdng.SenderPorts /end SUB_GROUP
 /begin FUNCTION_LIST /end FUNCTION_LIST
 /begin REF_CHARACTERISTIC /end REF_CHARACTERISTIC
 /begin REF_MEASUREMENT /end REF_MEASUREMENT
/end GROUP
/begin GROUP FordHwTqCdng.AppldFinalMotTqVldRefTi "MICROSAR RTE" /begin SUB_GROUP /end SUB_GROUP /begin FUNCTION_LIST /end FUNCTION_LIST /begin REF_CHARACTERISTIC /end REF_CHARACTERISTIC /begin REF_MEASUREMENT FordHwTqCdng.AppldFinalMotTqVldRefTi /end REF_MEASUREMENT /end GROUP
/begin GROUP FordHwTqCdng.AssiCmd.Val "MICROSAR RTE" /begin SUB_GROUP /end SUB_GROUP /begin FUNCTION_LIST /end FUNCTION_LIST /begin REF_CHARACTERISTIC /end REF_CHARACTERISTIC /begin REF_MEASUREMENT FordHwTqCdng.AssiCmd.Val /end REF_MEASUREMENT /end GROUP
/begin GROUP FordHwTqCdng.AssiCmdBas.Val "MICROSAR RTE" /begin SUB_GROUP /end SUB_GROUP /begin FUNCTION_LIST /end FUNCTION_LIST /begin REF_CHARACTERISTIC /end REF_CHARACTERISTIC /begin REF_MEASUREMENT FordHwTqCdng.AssiCmdBas.Val /end REF_MEASUREMENT /end GROUP
/begin GROUP FordHwTqCdng.AvlMotTq.Val "MICROSAR RTE" /begin SUB_GROUP /end SUB_GROUP /begin FUNCTION_LIST /end FUNCTION_LIST /begin REF_CHARACTERISTIC /end REF_CHARACTERISTIC /begin REF_MEASUREMENT FordHwTqCdng.AvlMotTq.Val /end REF_MEASUREMENT /end GROUP
/begin GROUP FordHwTqCdng.CalibrationPorts "MICROSAR RTE"
 /begin SUB_GROUP FordHwTqCdng.FordHwTqCdngAppldFinalMotTqVldTiThd.Val FordHwTqCdng.FordHwTqCdngInpTqRawVldTiThd.Val FordHwTqCdng.PwrLimrStdOperMotEnvlpY.Ary1D FordHwTqCdng.SysGlbPrmSysKineRat.Val /end SUB_GROUP
 /begin FUNCTION_LIST /end FUNCTION_LIST
 /begin REF_CHARACTERISTIC /end REF_CHARACTERISTIC
 /begin REF_MEASUREMENT /end REF_MEASUREMENT
/end GROUP
/begin GROUP FordHwTqCdng.EcuId.Val "MICROSAR RTE" /begin SUB_GROUP /end SUB_GROUP /begin FUNCTION_LIST /end FUNCTION_LIST /begin REF_CHARACTERISTIC /end REF_CHARACTERISTIC /begin REF_MEASUREMENT FordHwTqCdng.EcuId.Val /end REF_MEASUREMENT /end GROUP
/begin GROUP FordHwTqCdng.FordAppldFinalMotTq.Val "MICROSAR RTE" /begin SUB_GROUP /end SUB_GROUP /begin FUNCTION_LIST /end FUNCTION_LIST /begin REF_CHARACTERISTIC /end REF_CHARACTERISTIC /begin REF_MEASUREMENT FordHwTqCdng.FordAppldFinalMotTq.Val /end REF_MEASUREMENT /end GROUP
/begin GROUP FordHwTqCdng.FordAppldFinalMotTqVld.Logl "MICROSAR RTE" /begin SUB_GROUP /end SUB_GROUP /begin FUNCTION_LIST /end FUNCTION_LIST /begin REF_CHARACTERISTIC /end REF_CHARACTERISTIC /begin REF_MEASUREMENT FordHwTqCdng.FordAppldFinalMotTqVld.Logl /end REF_MEASUREMENT /end GROUP
/begin GROUP FordHwTqCdng.FordBoostCrvAssiTq.Val "MICROSAR RTE" /begin SUB_GROUP /end SUB_GROUP /begin FUNCTION_LIST /end FUNCTION_LIST /begin REF_CHARACTERISTIC /end REF_CHARACTERISTIC /begin REF_MEASUREMENT FordHwTqCdng.FordBoostCrvAssiTq.Val /end REF_MEASUREMENT /end GROUP
/begin GROUP FordHwTqCdng.FordBoostCrvInpTq.Val "MICROSAR RTE" /begin SUB_GROUP /end SUB_GROUP /begin FUNCTION_LIST /end FUNCTION_LIST /begin REF_CHARACTERISTIC /end REF_CHARACTERISTIC /begin REF_MEASUREMENT FordHwTqCdng.FordBoostCrvInpTq.Val /end REF_MEASUREMENT /end GROUP
/begin GROUP FordHwTqCdng.FordHwTqCdngAppldFinalMotTqVldTiThd.Val "MICROSAR RTE" /begin SUB_GROUP /end SUB_GROUP /begin FUNCTION_LIST /end FUNCTION_LIST /begin REF_CHARACTERISTIC FordHwTqCdng.FordHwTqCdngAppldFinalMotTqVldTiThd.Val /end REF_CHARACTERISTIC /begin REF_MEASUREMENT /end REF_MEASUREMENT /end GROUP
/begin GROUP FordHwTqCdng.FordHwTqCdngInpTqRawVldTiThd.Val "MICROSAR RTE" /begin SUB_GROUP /end SUB_GROUP /begin FUNCTION_LIST /end FUNCTION_LIST /begin REF_CHARACTERISTIC FordHwTqCdng.FordHwTqCdngInpTqRawVldTiThd.Val /end REF_CHARACTERISTIC /begin REF_MEASUREMENT /end REF_MEASUREMENT /end GROUP
/begin GROUP FordHwTqCdng.FordInpTqRaw.Val "MICROSAR RTE" /begin SUB_GROUP /end SUB_GROUP /begin FUNCTION_LIST /end FUNCTION_LIST /begin REF_CHARACTERISTIC /end REF_CHARACTERISTIC /begin REF_MEASUREMENT FordHwTqCdng.FordInpTqRaw.Val /end REF_MEASUREMENT /end GROUP
/begin GROUP FordHwTqCdng.FordInpTqRawVld.Logl "MICROSAR RTE" /begin SUB_GROUP /end SUB_GROUP /begin FUNCTION_LIST /end FUNCTION_LIST /begin REF_CHARACTERISTIC /end REF_CHARACTERISTIC /begin REF_MEASUREMENT FordHwTqCdng.FordInpTqRawVld.Logl /end REF_MEASUREMENT /end GROUP
/begin GROUP FordHwTqCdng.FordMaxAsscTq.Val "MICROSAR RTE" /begin SUB_GROUP /end SUB_GROUP /begin FUNCTION_LIST /end FUNCTION_LIST /begin REF_CHARACTERISTIC /end REF_CHARACTERISTIC /begin REF_MEASUREMENT FordHwTqCdng.FordMaxAsscTq.Val /end REF_MEASUREMENT /end GROUP
/begin GROUP FordHwTqCdng.FordReqdFinalMotTq.Val "MICROSAR RTE" /begin SUB_GROUP /end SUB_GROUP /begin FUNCTION_LIST /end FUNCTION_LIST /begin REF_CHARACTERISTIC /end REF_CHARACTERISTIC /begin REF_MEASUREMENT FordHwTqCdng.FordReqdFinalMotTq.Val /end REF_MEASUREMENT /end GROUP
/begin GROUP FordHwTqCdng.FordSumBoostCrvInpTq.Val "MICROSAR RTE" /begin SUB_GROUP /end SUB_GROUP /begin FUNCTION_LIST /end FUNCTION_LIST /begin REF_CHARACTERISTIC /end REF_CHARACTERISTIC /begin REF_MEASUREMENT FordHwTqCdng.FordSumBoostCrvInpTq.Val /end REF_MEASUREMENT /end GROUP
/begin GROUP FordHwTqCdng.FordVehSpd.Val "MICROSAR RTE" /begin SUB_GROUP /end SUB_GROUP /begin FUNCTION_LIST /end FUNCTION_LIST /begin REF_CHARACTERISTIC /end REF_CHARACTERISTIC /begin REF_MEASUREMENT FordHwTqCdng.FordVehSpd.Val /end REF_MEASUREMENT /end GROUP
/begin GROUP FordHwTqCdng.HwTq.Val "MICROSAR RTE" /begin SUB_GROUP /end SUB_GROUP /begin FUNCTION_LIST /end FUNCTION_LIST /begin REF_CHARACTERISTIC /end REF_CHARACTERISTIC /begin REF_MEASUREMENT FordHwTqCdng.HwTq.Val /end REF_MEASUREMENT /end GROUP
/begin GROUP FordHwTqCdng.HwTqHysOvrl.Val "MICROSAR RTE" /begin SUB_GROUP /end SUB_GROUP /begin FUNCTION_LIST /end FUNCTION_LIST /begin REF_CHARACTERISTIC /end REF_CHARACTERISTIC /begin REF_MEASUREMENT FordHwTqCdng.HwTqHysOvrl.Val /end REF_MEASUREMENT /end GROUP
/begin GROUP FordHwTqCdng.HwTqOvrl.Val "MICROSAR RTE" /begin SUB_GROUP /end SUB_GROUP /begin FUNCTION_LIST /end FUNCTION_LIST /begin REF_CHARACTERISTIC /end REF_CHARACTERISTIC /begin REF_MEASUREMENT FordHwTqCdng.HwTqOvrl.Val /end REF_MEASUREMENT /end GROUP
/begin GROUP FordHwTqCdng.InpTqRawVldRefTi "MICROSAR RTE" /begin SUB_GROUP /end SUB_GROUP /begin FUNCTION_LIST /end FUNCTION_LIST /begin REF_CHARACTERISTIC /end REF_CHARACTERISTIC /begin REF_MEASUREMENT FordHwTqCdng.InpTqRawVldRefTi /end REF_MEASUREMENT /end GROUP
/begin GROUP FordHwTqCdng.MotTqCmd.Val "MICROSAR RTE" /begin SUB_GROUP /end SUB_GROUP /begin FUNCTION_LIST /end FUNCTION_LIST /begin REF_CHARACTERISTIC /end REF_CHARACTERISTIC /begin REF_MEASUREMENT FordHwTqCdng.MotTqCmd.Val /end REF_MEASUREMENT /end GROUP
/begin GROUP FordHwTqCdng.MotTqCmdPwrLimd.Val "MICROSAR RTE" /begin SUB_GROUP /end SUB_GROUP /begin FUNCTION_LIST /end FUNCTION_LIST /begin REF_CHARACTERISTIC /end REF_CHARACTERISTIC /begin REF_MEASUREMENT FordHwTqCdng.MotTqCmdPwrLimd.Val /end REF_MEASUREMENT /end GROUP
/begin GROUP FordHwTqCdng.PerInstanceMemories "MICROSAR RTE"
 /begin SUB_GROUP FordHwTqCdng.AppldFinalMotTqVldRefTi FordHwTqCdng.InpTqRawVldRefTi FordHwTqCdng.dFordHwTqCdngFildBoostCrvAssiTq /end SUB_GROUP
 /begin FUNCTION_LIST /end FUNCTION_LIST
 /begin REF_CHARACTERISTIC /end REF_CHARACTERISTIC
 /begin REF_MEASUREMENT /end REF_MEASUREMENT
/end GROUP
/begin GROUP FordHwTqCdng.PwrLimrStdOperMotEnvlpY.Ary1D "MICROSAR RTE" /begin SUB_GROUP /end SUB_GROUP /begin FUNCTION_LIST /end FUNCTION_LIST /begin REF_CHARACTERISTIC FordHwTqCdng.PwrLimrStdOperMotEnvlpY.Ary1D /end REF_CHARACTERISTIC /begin REF_MEASUREMENT /end REF_MEASUREMENT /end GROUP
/begin GROUP FordHwTqCdng.ReceiverPorts "MICROSAR RTE"
 /begin SUB_GROUP FordHwTqCdng.AssiCmd.Val FordHwTqCdng.AssiCmdBas.Val FordHwTqCdng.AvlMotTq.Val FordHwTqCdng.EcuId.Val FordHwTqCdng.FordVehSpd.Val FordHwTqCdng.HwTq.Val FordHwTqCdng.HwTqHysOvrl.Val FordHwTqCdng.HwTqOvrl.Val FordHwTqCdng.MotTqCmd.Val FordHwTqCdng.MotTqCmdPwrLimd.Val /end SUB_GROUP
 /begin FUNCTION_LIST /end FUNCTION_LIST
 /begin REF_CHARACTERISTIC /end REF_CHARACTERISTIC
 /begin REF_MEASUREMENT /end REF_MEASUREMENT
/end GROUP
/begin GROUP FordHwTqCdng.SenderPorts "MICROSAR RTE"
 /begin SUB_GROUP FordHwTqCdng.FordAppldFinalMotTq.Val FordHwTqCdng.FordAppldFinalMotTqVld.Logl FordHwTqCdng.FordBoostCrvAssiTq.Val FordHwTqCdng.FordBoostCrvInpTq.Val FordHwTqCdng.FordInpTqRaw.Val FordHwTqCdng.FordInpTqRawVld.Logl FordHwTqCdng.FordMaxAsscTq.Val FordHwTqCdng.FordReqdFinalMotTq.Val FordHwTqCdng.FordSumBoostCrvInpTq.Val /end SUB_GROUP
 /begin FUNCTION_LIST /end FUNCTION_LIST
 /begin REF_CHARACTERISTIC /end REF_CHARACTERISTIC
 /begin REF_MEASUREMENT /end REF_MEASUREMENT
/end GROUP
/begin GROUP FordHwTqCdng.SysGlbPrmSysKineRat.Val "MICROSAR RTE" /begin SUB_GROUP /end SUB_GROUP /begin FUNCTION_LIST /end FUNCTION_LIST /begin REF_CHARACTERISTIC FordHwTqCdng.SysGlbPrmSysKineRat.Val /end REF_CHARACTERISTIC /begin REF_MEASUREMENT /end REF_MEASUREMENT /end GROUP
/begin GROUP FordHwTqCdng.dFordHwTqCdngFildBoostCrvAssiTq "MICROSAR RTE" /begin SUB_GROUP /end SUB_GROUP /begin FUNCTION_LIST /end FUNCTION_LIST /begin REF_CHARACTERISTIC /end REF_CHARACTERISTIC /begin REF_MEASUREMENT FordHwTqCdng.dFordHwTqCdngFildBoostCrvAssiTq /end REF_MEASUREMENT /end GROUP
/begin GROUP FordHwTqCmdOvrlLimr "MICROSAR RTE"
 /begin SUB_GROUP FordHwTqCmdOvrlLimr.CalibrationPorts FordHwTqCmdOvrlLimr.PerInstanceMemories FordHwTqCmdOvrlLimr.ReceiverPorts FordHwTqCmdOvrlLimr.SenderPorts /end SUB_GROUP
 /begin FUNCTION_LIST /end FUNCTION_LIST
 /begin REF_CHARACTERISTIC /end REF_CHARACTERISTIC
 /begin REF_MEASUREMENT /end REF_MEASUREMENT
/end GROUP
/begin GROUP FordHwTqCmdOvrlLimr.CalibrationPorts "MICROSAR RTE"
 /begin SUB_GROUP FordHwTqCmdOvrlLimr.FordHwTqCmdOvrlLimrCombdBwY.Ary1D FordHwTqCmdOvrlLimr.FordHwTqCmdOvrlLimrCombdTqRateY.Ary1D FordHwTqCmdOvrlLimr.FordHwTqCmdOvrlLimrCombdTqSatnY.Ary1D FordHwTqCmdOvrlLimr.FordHwTqCmdOvrlLimrCombdVehSpdBreakPtX.Ary1D FordHwTqCmdOvrlLimr.FordHwTqCmdOvrlLimrDftSpdRate.Val FordHwTqCmdOvrlLimr.FordHwTqCmdOvrlLimrDftSpdRcvrRate.Val FordHwTqCmdOvrlLimr.FordHwTqCmdOvrlLimrLkaBwY.Ary1D FordHwTqCmdOvrlLimr.FordHwTqCmdOvrlLimrLkaTqRateY.Ary1D FordHwTqCmdOvrlLimr.FordHwTqCmdOvrlLimrLkaTqSatnY.Ary1D FordHwTqCmdOvrlLimr.FordHwTqCmdOvrlLimrVehSpdBreakPtX.Ary1D /end SUB_GROUP
 /begin FUNCTION_LIST /end FUNCTION_LIST
 /begin REF_CHARACTERISTIC /end REF_CHARACTERISTIC
 /begin REF_MEASUREMENT /end REF_MEASUREMENT
/end GROUP
/begin GROUP FordHwTqCmdOvrlLimr.EcuId.Val "MICROSAR RTE" /begin SUB_GROUP /end SUB_GROUP /begin FUNCTION_LIST /end FUNCTION_LIST /begin REF_CHARACTERISTIC /end REF_CHARACTERISTIC /begin REF_MEASUREMENT FordHwTqCmdOvrlLimr.EcuId.Val /end REF_MEASUREMENT /end GROUP
/begin GROUP FordHwTqCmdOvrlLimr.FildVehSpd.Val "MICROSAR RTE" /begin SUB_GROUP /end SUB_GROUP /begin FUNCTION_LIST /end FUNCTION_LIST /begin REF_CHARACTERISTIC /end REF_CHARACTERISTIC /begin REF_MEASUREMENT FordHwTqCmdOvrlLimr.FildVehSpd.Val /end REF_MEASUREMENT /end GROUP
/begin GROUP FordHwTqCmdOvrlLimr.FordColTqOvrl.Val "MICROSAR RTE" /begin SUB_GROUP /end SUB_GROUP /begin FUNCTION_LIST /end FUNCTION_LIST /begin REF_CHARACTERISTIC /end REF_CHARACTERISTIC /begin REF_MEASUREMENT FordHwTqCmdOvrlLimr.FordColTqOvrl.Val /end REF_MEASUREMENT /end GROUP
/begin GROUP FordHwTqCmdOvrlLimr.FordDrvrSteerRcmdnFctCallSts.Logl "MICROSAR RTE" /begin SUB_GROUP /end SUB_GROUP /begin FUNCTION_LIST /end FUNCTION_LIST /begin REF_CHARACTERISTIC /end REF_CHARACTERISTIC /begin REF_MEASUREMENT FordHwTqCmdOvrlLimr.FordDrvrSteerRcmdnFctCallSts.Logl /end REF_MEASUREMENT /end GROUP
/begin GROUP FordHwTqCmdOvrlLimr.FordDrvrSteerRcmdnTqReq.Val "MICROSAR RTE" /begin SUB_GROUP /end SUB_GROUP /begin FUNCTION_LIST /end FUNCTION_LIST /begin REF_CHARACTERISTIC /end REF_CHARACTERISTIC /begin REF_MEASUREMENT FordHwTqCmdOvrlLimr.FordDrvrSteerRcmdnTqReq.Val /end REF_MEASUREMENT /end GROUP
/begin GROUP FordHwTqCmdOvrlLimr.FordEvasSteerAssiFctCallSts.Logl "MICROSAR RTE" /begin SUB_GROUP /end SUB_GROUP /begin FUNCTION_LIST /end FUNCTION_LIST /begin REF_CHARACTERISTIC /end REF_CHARACTERISTIC /begin REF_MEASUREMENT FordHwTqCmdOvrlLimr.FordEvasSteerAssiFctCallSts.Logl /end REF_MEASUREMENT /end GROUP
/begin GROUP FordHwTqCmdOvrlLimr.FordEvasSteerAssiTqReq.Val "MICROSAR RTE" /begin SUB_GROUP /end SUB_GROUP /begin FUNCTION_LIST /end FUNCTION_LIST /begin REF_CHARACTERISTIC /end REF_CHARACTERISTIC /begin REF_MEASUREMENT FordHwTqCmdOvrlLimr.FordEvasSteerAssiTqReq.Val /end REF_MEASUREMENT /end GROUP
/begin GROUP FordHwTqCmdOvrlLimr.FordHwTqCmdOvrlLimrCombdBwY.Ary1D "MICROSAR RTE" /begin SUB_GROUP /end SUB_GROUP /begin FUNCTION_LIST /end FUNCTION_LIST /begin REF_CHARACTERISTIC FordHwTqCmdOvrlLimr.FordHwTqCmdOvrlLimrCombdBwY.Ary1D /end REF_CHARACTERISTIC /begin REF_MEASUREMENT /end REF_MEASUREMENT /end GROUP
/begin GROUP FordHwTqCmdOvrlLimr.FordHwTqCmdOvrlLimrCombdTqRateY.Ary1D "MICROSAR RTE" /begin SUB_GROUP /end SUB_GROUP /begin FUNCTION_LIST /end FUNCTION_LIST /begin REF_CHARACTERISTIC FordHwTqCmdOvrlLimr.FordHwTqCmdOvrlLimrCombdTqRateY.Ary1D /end REF_CHARACTERISTIC /begin REF_MEASUREMENT /end REF_MEASUREMENT /end GROUP
/begin GROUP FordHwTqCmdOvrlLimr.FordHwTqCmdOvrlLimrCombdTqSatnY.Ary1D "MICROSAR RTE" /begin SUB_GROUP /end SUB_GROUP /begin FUNCTION_LIST /end FUNCTION_LIST /begin REF_CHARACTERISTIC FordHwTqCmdOvrlLimr.FordHwTqCmdOvrlLimrCombdTqSatnY.Ary1D /end REF_CHARACTERISTIC /begin REF_MEASUREMENT /end REF_MEASUREMENT /end GROUP
/begin GROUP FordHwTqCmdOvrlLimr.FordHwTqCmdOvrlLimrCombdVehSpdBreakPtX.Ary1D "MICROSAR RTE" /begin SUB_GROUP /end SUB_GROUP /begin FUNCTION_LIST /end FUNCTION_LIST
 /begin REF_CHARACTERISTIC FordHwTqCmdOvrlLimr.FordHwTqCmdOvrlLimrCombdVehSpdBreakPtX.Ary1D /end REF_CHARACTERISTIC
 /begin REF_MEASUREMENT /end REF_MEASUREMENT
/end GROUP
/begin GROUP FordHwTqCmdOvrlLimr.FordHwTqCmdOvrlLimrDftSpdRate.Val "MICROSAR RTE" /begin SUB_GROUP /end SUB_GROUP /begin FUNCTION_LIST /end FUNCTION_LIST /begin REF_CHARACTERISTIC FordHwTqCmdOvrlLimr.FordHwTqCmdOvrlLimrDftSpdRate.Val /end REF_CHARACTERISTIC /begin REF_MEASUREMENT /end REF_MEASUREMENT /end GROUP
/begin GROUP FordHwTqCmdOvrlLimr.FordHwTqCmdOvrlLimrDftSpdRcvrRate.Val "MICROSAR RTE" /begin SUB_GROUP /end SUB_GROUP /begin FUNCTION_LIST /end FUNCTION_LIST /begin REF_CHARACTERISTIC FordHwTqCmdOvrlLimr.FordHwTqCmdOvrlLimrDftSpdRcvrRate.Val /end REF_CHARACTERISTIC /begin REF_MEASUREMENT /end REF_MEASUREMENT /end GROUP
/begin GROUP FordHwTqCmdOvrlLimr.FordHwTqCmdOvrlLimrLkaBwY.Ary1D "MICROSAR RTE" /begin SUB_GROUP /end SUB_GROUP /begin FUNCTION_LIST /end FUNCTION_LIST /begin REF_CHARACTERISTIC FordHwTqCmdOvrlLimr.FordHwTqCmdOvrlLimrLkaBwY.Ary1D /end REF_CHARACTERISTIC /begin REF_MEASUREMENT /end REF_MEASUREMENT /end GROUP
/begin GROUP FordHwTqCmdOvrlLimr.FordHwTqCmdOvrlLimrLkaTqRateY.Ary1D "MICROSAR RTE" /begin SUB_GROUP /end SUB_GROUP /begin FUNCTION_LIST /end FUNCTION_LIST /begin REF_CHARACTERISTIC FordHwTqCmdOvrlLimr.FordHwTqCmdOvrlLimrLkaTqRateY.Ary1D /end REF_CHARACTERISTIC /begin REF_MEASUREMENT /end REF_MEASUREMENT /end GROUP
/begin GROUP FordHwTqCmdOvrlLimr.FordHwTqCmdOvrlLimrLkaTqSatnY.Ary1D "MICROSAR RTE" /begin SUB_GROUP /end SUB_GROUP /begin FUNCTION_LIST /end FUNCTION_LIST /begin REF_CHARACTERISTIC FordHwTqCmdOvrlLimr.FordHwTqCmdOvrlLimrLkaTqSatnY.Ary1D /end REF_CHARACTERISTIC /begin REF_MEASUREMENT /end REF_MEASUREMENT /end GROUP
/begin GROUP FordHwTqCmdOvrlLimr.FordHwTqCmdOvrlLimrVehSpdBreakPtX.Ary1D "MICROSAR RTE" /begin SUB_GROUP /end SUB_GROUP /begin FUNCTION_LIST /end FUNCTION_LIST
 /begin REF_CHARACTERISTIC FordHwTqCmdOvrlLimr.FordHwTqCmdOvrlLimrVehSpdBreakPtX.Ary1D /end REF_CHARACTERISTIC
 /begin REF_MEASUREMENT /end REF_MEASUREMENT
/end GROUP
/begin GROUP FordHwTqCmdOvrlLimr.FordLaneKeepAssiFctCallSts.Logl "MICROSAR RTE" /begin SUB_GROUP /end SUB_GROUP /begin FUNCTION_LIST /end FUNCTION_LIST /begin REF_CHARACTERISTIC /end REF_CHARACTERISTIC /begin REF_MEASUREMENT FordHwTqCmdOvrlLimr.FordLaneKeepAssiFctCallSts.Logl /end REF_MEASUREMENT /end GROUP
/begin GROUP FordHwTqCmdOvrlLimr.FordLaneKeepAssiTqReq.Val "MICROSAR RTE" /begin SUB_GROUP /end SUB_GROUP /begin FUNCTION_LIST /end FUNCTION_LIST /begin REF_CHARACTERISTIC /end REF_CHARACTERISTIC /begin REF_MEASUREMENT FordHwTqCmdOvrlLimr.FordLaneKeepAssiTqReq.Val /end REF_MEASUREMENT /end GROUP
/begin GROUP FordHwTqCmdOvrlLimr.LimrDftVehSpd "MICROSAR RTE" /begin SUB_GROUP /end SUB_GROUP /begin FUNCTION_LIST /end FUNCTION_LIST /begin REF_CHARACTERISTIC /end REF_CHARACTERISTIC /begin REF_MEASUREMENT FordHwTqCmdOvrlLimr.LimrDftVehSpd /end REF_MEASUREMENT /end GROUP
/begin GROUP FordHwTqCmdOvrlLimr.LimrVehSpdPrev "MICROSAR RTE" /begin SUB_GROUP /end SUB_GROUP /begin FUNCTION_LIST /end FUNCTION_LIST /begin REF_CHARACTERISTIC /end REF_CHARACTERISTIC /begin REF_MEASUREMENT FordHwTqCmdOvrlLimr.LimrVehSpdPrev /end REF_MEASUREMENT /end GROUP
/begin GROUP FordHwTqCmdOvrlLimr.LkaTqReqPrev "MICROSAR RTE" /begin SUB_GROUP /end SUB_GROUP /begin FUNCTION_LIST /end FUNCTION_LIST /begin REF_CHARACTERISTIC /end REF_CHARACTERISTIC /begin REF_MEASUREMENT FordHwTqCmdOvrlLimr.LkaTqReqPrev /end REF_MEASUREMENT /end GROUP
/begin GROUP FordHwTqCmdOvrlLimr.PerInstanceMemories "MICROSAR RTE"
 /begin SUB_GROUP FordHwTqCmdOvrlLimr.LimrDftVehSpd FordHwTqCmdOvrlLimr.LimrVehSpdPrev FordHwTqCmdOvrlLimr.LkaTqReqPrev FordHwTqCmdOvrlLimr.PrevDftVehSpd FordHwTqCmdOvrlLimr.PrevVehSpd FordHwTqCmdOvrlLimr.TqReqPrev /end SUB_GROUP
 /begin FUNCTION_LIST /end FUNCTION_LIST
 /begin REF_CHARACTERISTIC /end REF_CHARACTERISTIC
 /begin REF_MEASUREMENT /end REF_MEASUREMENT
/end GROUP
/begin GROUP FordHwTqCmdOvrlLimr.PrevDftVehSpd "MICROSAR RTE" /begin SUB_GROUP /end SUB_GROUP /begin FUNCTION_LIST /end FUNCTION_LIST /begin REF_CHARACTERISTIC /end REF_CHARACTERISTIC /begin REF_MEASUREMENT FordHwTqCmdOvrlLimr.PrevDftVehSpd /end REF_MEASUREMENT /end GROUP
/begin GROUP FordHwTqCmdOvrlLimr.PrevVehSpd "MICROSAR RTE" /begin SUB_GROUP /end SUB_GROUP /begin FUNCTION_LIST /end FUNCTION_LIST /begin REF_CHARACTERISTIC /end REF_CHARACTERISTIC /begin REF_MEASUREMENT FordHwTqCmdOvrlLimr.PrevVehSpd /end REF_MEASUREMENT /end GROUP
/begin GROUP FordHwTqCmdOvrlLimr.ReceiverPorts "MICROSAR RTE"
 /begin SUB_GROUP FordHwTqCmdOvrlLimr.EcuId.Val FordHwTqCmdOvrlLimr.FildVehSpd.Val FordHwTqCmdOvrlLimr.FordDrvrSteerRcmdnFctCallSts.Logl FordHwTqCmdOvrlLimr.FordDrvrSteerRcmdnTqReq.Val FordHwTqCmdOvrlLimr.FordEvasSteerAssiFctCallSts.Logl FordHwTqCmdOvrlLimr.FordEvasSteerAssiTqReq.Val FordHwTqCmdOvrlLimr.FordLaneKeepAssiFctCallSts.Logl FordHwTqCmdOvrlLimr.FordLaneKeepAssiTqReq.Val FordHwTqCmdOvrlLimr.VehSpdVld.Logl /end SUB_GROUP
 /begin FUNCTION_LIST /end FUNCTION_LIST
 /begin REF_CHARACTERISTIC /end REF_CHARACTERISTIC
 /begin REF_MEASUREMENT /end REF_MEASUREMENT
/end GROUP
/begin GROUP FordHwTqCmdOvrlLimr.SenderPorts "MICROSAR RTE" /begin SUB_GROUP FordHwTqCmdOvrlLimr.FordColTqOvrl.Val /end SUB_GROUP /begin FUNCTION_LIST /end FUNCTION_LIST /begin REF_CHARACTERISTIC /end REF_CHARACTERISTIC /begin REF_MEASUREMENT /end REF_MEASUREMENT /end GROUP
/begin GROUP FordHwTqCmdOvrlLimr.TqReqPrev "MICROSAR RTE" /begin SUB_GROUP /end SUB_GROUP /begin FUNCTION_LIST /end FUNCTION_LIST /begin REF_CHARACTERISTIC /end REF_CHARACTERISTIC /begin REF_MEASUREMENT FordHwTqCmdOvrlLimr.TqReqPrev /end REF_MEASUREMENT /end GROUP
/begin GROUP FordHwTqCmdOvrlLimr.VehSpdVld.Logl "MICROSAR RTE" /begin SUB_GROUP /end SUB_GROUP /begin FUNCTION_LIST /end FUNCTION_LIST /begin REF_CHARACTERISTIC /end REF_CHARACTERISTIC /begin REF_MEASUREMENT FordHwTqCmdOvrlLimr.VehSpdVld.Logl /end REF_MEASUREMENT /end GROUP
/begin GROUP FordMotTqCmdOvrlLimr "MICROSAR RTE"
 /begin SUB_GROUP FordMotTqCmdOvrlLimr.CalibrationPorts FordMotTqCmdOvrlLimr.PerInstanceMemories FordMotTqCmdOvrlLimr.ReceiverPorts FordMotTqCmdOvrlLimr.SenderPorts /end SUB_GROUP
 /begin FUNCTION_LIST /end FUNCTION_LIST
 /begin REF_CHARACTERISTIC /end REF_CHARACTERISTIC
 /begin REF_MEASUREMENT /end REF_MEASUREMENT
/end GROUP
/begin GROUP FordMotTqCmdOvrlLimr.ActvNiblCtrlLoFrqElpdTiVari "MICROSAR RTE" /begin SUB_GROUP /end SUB_GROUP /begin FUNCTION_LIST /end FUNCTION_LIST /begin REF_CHARACTERISTIC /end REF_CHARACTERISTIC /begin REF_MEASUREMENT FordMotTqCmdOvrlLimr.ActvNiblCtrlLoFrqElpdTiVari /end REF_MEASUREMENT /end GROUP
/begin GROUP FordMotTqCmdOvrlLimr.ActvNiblCtrlLoFrqFlt "MICROSAR RTE" /begin SUB_GROUP /end SUB_GROUP /begin FUNCTION_LIST /end FUNCTION_LIST /begin REF_CHARACTERISTIC /end REF_CHARACTERISTIC /begin REF_MEASUREMENT FordMotTqCmdOvrlLimr.ActvNiblCtrlLoFrqFlt /end REF_MEASUREMENT /end GROUP
/begin GROUP FordMotTqCmdOvrlLimr.ActvNiblCtrlLoFrqSt "MICROSAR RTE" /begin SUB_GROUP /end SUB_GROUP /begin FUNCTION_LIST /end FUNCTION_LIST /begin REF_CHARACTERISTIC /end REF_CHARACTERISTIC /begin REF_MEASUREMENT FordMotTqCmdOvrlLimr.ActvNiblCtrlLoFrqSt /end REF_MEASUREMENT /end GROUP
/begin GROUP FordMotTqCmdOvrlLimr.ActvNiblCtrlLoFrqTmrFlgVari "MICROSAR RTE" /begin SUB_GROUP /end SUB_GROUP /begin FUNCTION_LIST /end FUNCTION_LIST /begin REF_CHARACTERISTIC /end REF_CHARACTERISTIC /begin REF_MEASUREMENT FordMotTqCmdOvrlLimr.ActvNiblCtrlLoFrqTmrFlgVari /end REF_MEASUREMENT /end GROUP
/begin GROUP FordMotTqCmdOvrlLimr.ActvNiblCtrlLoFrqTmrVari "MICROSAR RTE" /begin SUB_GROUP /end SUB_GROUP /begin FUNCTION_LIST /end FUNCTION_LIST /begin REF_CHARACTERISTIC /end REF_CHARACTERISTIC /begin REF_MEASUREMENT FordMotTqCmdOvrlLimr.ActvNiblCtrlLoFrqTmrVari /end REF_MEASUREMENT /end GROUP
/begin GROUP FordMotTqCmdOvrlLimr.CalibrationPorts "MICROSAR RTE"
 /begin SUB_GROUP FordMotTqCmdOvrlLimr.FordMotTqCmdOvrlLimrDftSpdRate.Val FordMotTqCmdOvrlLimr.FordMotTqCmdOvrlLimrDftSpdRcvrRate.Val FordMotTqCmdOvrlLimr.FordMotTqCmdOvrlLimrHiFrqMonrActvNiblCtrlDcTqTrendThd.Val FordMotTqCmdOvrlLimr.FordMotTqCmdOvrlLimrHiFrqMonrActvNiblCtrlLoFrqTiThd.Val FordMotTqCmdOvrlLimr.FordMotTqCmdOvrlLimrHiFrqMonrActvNiblCtrlMaxMotTq.Val FordMotTqCmdOvrlLimr.FordMotTqCmdOvrlLimrHiFrqMonrLaneDprtrWarnDcTqTrendThd.Val FordMotTqCmdOvrlLimr.FordMotTqCmdOvrlLimrHiFrqMonrLaneDprtrWarnLoFrqTiThd.Val FordMotTqCmdOvrlLimr.FordMotTqCmdOvrlLimrHiFrqMonrLaneDprtrWarnMaxMotTq.Val FordMotTqCmdOvrlLimr.FordMotTqCmdOvrlLimrHiFrqMonrTqTrendAlpha.Val FordMotTqCmdOvrlLimr.FordMotTqCmdOvrlLimrHiFrqMonrZeroBandTq.Val FordMotTqCmdOvrlLimr.FordMotTqCmdOvrlLimrHwVelLoPassFrq.Val FordMotTqCmdOvrlLimr.FordMotTqCmdOvrlLimrLatCtrlBwY.Val FordMotTqCmdOvrlLimr.FordMotTqCmdOvrlLimrLatCtrlTqRateY.Ary1D FordMotTqCmdOvrlLimr.FordMotTqCmdOvrlLimrLatCtrlTqSatnY.Ary1D FordMotTqCmdOvrlLimr.FordMotTqCmdOvrlLimrLatCtrlVehSpdBreakPtX.Ary1D FordMotTqCmdOvrlLimr.FordMotTqCmdOvrlLimrPullDriftCmpTqRateY.Ary1D FordMotTqCmdOvrlLimr.FordMotTqCmdOvrlLimrPullDriftCmpTqSatnY.Ary1D FordMotTqCmdOvrlLimr.FordMotTqCmdOvrlLimrPullDriftCmpVehSpdBreakPtX.Ary1D FordMotTqCmdOvrlLimr.FordMotTqCmdOvrlLimrSteerReactnLimrCombAmpVehSpdLimX.Ary1D FordMotTqCmdOvrlLimr.FordMotTqCmdOvrlLimrSteerReactnLimrCombAmpVehSpdLimY.Ary1D FordMotTqCmdOvrlLimr.FordMotTqCmdOvrlLimrSteerReactnLimrCombOvrrunRampRateHwVelErrX.Ary1D FordMotTqCmdOvrlLimr.FordMotTqCmdOvrlLimrSteerReactnLimrCombOvrrunRampRateOutY.Ary1D FordMotTqCmdOvrlLimr.FordMotTqCmdOvrlLimrSteerReactnLimrCombdAmpOvrrun.Val FordMotTqCmdOvrlLimr.FordMotTqCmdOvrlLimrSteerReactnLimrCombdAmpRcvry.Val FordMotTqCmdOvrlLimr.FordMotTqCmdOvrlLimrSteerReactnLimrCombdFixdOvrrunRampRate.Val FordMotTqCmdOvrlLimr.FordMotTqCmdOvrlLimrSteerReactnLimrCombdLimHys.Val FordMotTqCmdOvrlLimr.FordMotTqCmdOvrlLimrSteerReactnLimrCombdLimTqX.Ary2D FordMotTqCmdOvrlLimr.FordMotTqCmdOvrlLimrSteerReactnLimrCombdLimrHwVelY.Ary2D FordMotTqCmdOvrlLimr.FordMotTqCmdOvrlLimrSteerReactnLimrCombdLimrVehSpd.Ary1D FordMotTqCmdOvrlLimr.FordMotTqCmdOvrlLimrSteerReactnLimrCombdRcvryIdealRampRate.Val FordMotTqCmdOvrlLimr.FordMotTqCmdOvrlLimrSteerReactnLimrCombdRcvryRampRateStg1.Val FordMotTqCmdOvrlLimr.FordMotTqCmdOvrlLimrSteerReactnLimrCombdRcvryRampRateStg2.Val /end SUB_GROUP
 /begin FUNCTION_LIST /end FUNCTION_LIST
 /begin REF_CHARACTERISTIC /end REF_CHARACTERISTIC
 /begin REF_MEASUREMENT /end REF_MEASUREMENT
/end GROUP
/begin GROUP FordMotTqCmdOvrlLimr.DftVehSpd "MICROSAR RTE" /begin SUB_GROUP /end SUB_GROUP /begin FUNCTION_LIST /end FUNCTION_LIST /begin REF_CHARACTERISTIC /end REF_CHARACTERISTIC /begin REF_MEASUREMENT FordMotTqCmdOvrlLimr.DftVehSpd /end REF_MEASUREMENT /end GROUP
/begin GROUP FordMotTqCmdOvrlLimr.EcuId.Val "MICROSAR RTE" /begin SUB_GROUP /end SUB_GROUP /begin FUNCTION_LIST /end FUNCTION_LIST /begin REF_CHARACTERISTIC /end REF_CHARACTERISTIC /begin REF_MEASUREMENT FordMotTqCmdOvrlLimr.EcuId.Val /end REF_MEASUREMENT /end GROUP
/begin GROUP FordMotTqCmdOvrlLimr.FildHwTq.Val "MICROSAR RTE" /begin SUB_GROUP /end SUB_GROUP /begin FUNCTION_LIST /end FUNCTION_LIST /begin REF_CHARACTERISTIC /end REF_CHARACTERISTIC /begin REF_MEASUREMENT FordMotTqCmdOvrlLimr.FildHwTq.Val /end REF_MEASUREMENT /end GROUP
/begin GROUP FordMotTqCmdOvrlLimr.FildVehSpd.Val "MICROSAR RTE" /begin SUB_GROUP /end SUB_GROUP /begin FUNCTION_LIST /end FUNCTION_LIST /begin REF_CHARACTERISTIC /end REF_CHARACTERISTIC /begin REF_MEASUREMENT FordMotTqCmdOvrlLimr.FildVehSpd.Val /end REF_MEASUREMENT /end GROUP
/begin GROUP FordMotTqCmdOvrlLimr.FordActvNiblCtrlFctCallSts.Logl "MICROSAR RTE" /begin SUB_GROUP /end SUB_GROUP /begin FUNCTION_LIST /end FUNCTION_LIST /begin REF_CHARACTERISTIC /end REF_CHARACTERISTIC /begin REF_MEASUREMENT FordMotTqCmdOvrlLimr.FordActvNiblCtrlFctCallSts.Logl /end REF_MEASUREMENT /end GROUP
/begin GROUP FordMotTqCmdOvrlLimr.FordActvNiblCtrlTqReq.Val "MICROSAR RTE" /begin SUB_GROUP /end SUB_GROUP /begin FUNCTION_LIST /end FUNCTION_LIST /begin REF_CHARACTERISTIC /end REF_CHARACTERISTIC /begin REF_MEASUREMENT FordMotTqCmdOvrlLimr.FordActvNiblCtrlTqReq.Val /end REF_MEASUREMENT /end GROUP
/begin GROUP FordMotTqCmdOvrlLimr.FordLaneDprtrWarnFctCallSts.Logl "MICROSAR RTE" /begin SUB_GROUP /end SUB_GROUP /begin FUNCTION_LIST /end FUNCTION_LIST /begin REF_CHARACTERISTIC /end REF_CHARACTERISTIC /begin REF_MEASUREMENT FordMotTqCmdOvrlLimr.FordLaneDprtrWarnFctCallSts.Logl /end REF_MEASUREMENT /end GROUP
/begin GROUP FordMotTqCmdOvrlLimr.FordLaneDprtrWarnTqReq.Val "MICROSAR RTE" /begin SUB_GROUP /end SUB_GROUP /begin FUNCTION_LIST /end FUNCTION_LIST /begin REF_CHARACTERISTIC /end REF_CHARACTERISTIC /begin REF_MEASUREMENT FordMotTqCmdOvrlLimr.FordLaneDprtrWarnTqReq.Val /end REF_MEASUREMENT /end GROUP
/begin GROUP FordMotTqCmdOvrlLimr.FordLatCtrlFctCallSts.Logl "MICROSAR RTE" /begin SUB_GROUP /end SUB_GROUP /begin FUNCTION_LIST /end FUNCTION_LIST /begin REF_CHARACTERISTIC /end REF_CHARACTERISTIC /begin REF_MEASUREMENT FordMotTqCmdOvrlLimr.FordLatCtrlFctCallSts.Logl /end REF_MEASUREMENT /end GROUP
/begin GROUP FordMotTqCmdOvrlLimr.FordLatCtrlTqReq.Val "MICROSAR RTE" /begin SUB_GROUP /end SUB_GROUP /begin FUNCTION_LIST /end FUNCTION_LIST /begin REF_CHARACTERISTIC /end REF_CHARACTERISTIC /begin REF_MEASUREMENT FordMotTqCmdOvrlLimr.FordLatCtrlTqReq.Val /end REF_MEASUREMENT /end GROUP
/begin GROUP FordMotTqCmdOvrlLimr.FordMotTqCmdOvrl.Val "MICROSAR RTE" /begin SUB_GROUP /end SUB_GROUP /begin FUNCTION_LIST /end FUNCTION_LIST /begin REF_CHARACTERISTIC /end REF_CHARACTERISTIC /begin REF_MEASUREMENT FordMotTqCmdOvrlLimr.FordMotTqCmdOvrl.Val /end REF_MEASUREMENT /end GROUP
/begin GROUP FordMotTqCmdOvrlLimr.FordMotTqCmdOvrlLimrDftSpdRate.Val "MICROSAR RTE" /begin SUB_GROUP /end SUB_GROUP /begin FUNCTION_LIST /end FUNCTION_LIST /begin REF_CHARACTERISTIC FordMotTqCmdOvrlLimr.FordMotTqCmdOvrlLimrDftSpdRate.Val /end REF_CHARACTERISTIC /begin REF_MEASUREMENT /end REF_MEASUREMENT /end GROUP
/begin GROUP FordMotTqCmdOvrlLimr.FordMotTqCmdOvrlLimrDftSpdRcvrRate.Val "MICROSAR RTE" /begin SUB_GROUP /end SUB_GROUP /begin FUNCTION_LIST /end FUNCTION_LIST
 /begin REF_CHARACTERISTIC FordMotTqCmdOvrlLimr.FordMotTqCmdOvrlLimrDftSpdRcvrRate.Val /end REF_CHARACTERISTIC
 /begin REF_MEASUREMENT /end REF_MEASUREMENT
/end GROUP
/begin GROUP FordMotTqCmdOvrlLimr.FordMotTqCmdOvrlLimrHiFrqMonrActvNiblCtrlDcTqTrendThd.Val "MICROSAR RTE" /begin SUB_GROUP /end SUB_GROUP /begin FUNCTION_LIST /end FUNCTION_LIST
 /begin REF_CHARACTERISTIC FordMotTqCmdOvrlLimr.FordMotTqCmdOvrlLimrHiFrqMonrActvNiblCtrlDcTqTrendThd.Val /end REF_CHARACTERISTIC
 /begin REF_MEASUREMENT /end REF_MEASUREMENT
/end GROUP
/begin GROUP FordMotTqCmdOvrlLimr.FordMotTqCmdOvrlLimrHiFrqMonrActvNiblCtrlLoFrqTiThd.Val "MICROSAR RTE" /begin SUB_GROUP /end SUB_GROUP /begin FUNCTION_LIST /end FUNCTION_LIST
 /begin REF_CHARACTERISTIC FordMotTqCmdOvrlLimr.FordMotTqCmdOvrlLimrHiFrqMonrActvNiblCtrlLoFrqTiThd.Val /end REF_CHARACTERISTIC
 /begin REF_MEASUREMENT /end REF_MEASUREMENT
/end GROUP
/begin GROUP FordMotTqCmdOvrlLimr.FordMotTqCmdOvrlLimrHiFrqMonrActvNiblCtrlMaxMotTq.Val "MICROSAR RTE" /begin SUB_GROUP /end SUB_GROUP /begin FUNCTION_LIST /end FUNCTION_LIST
 /begin REF_CHARACTERISTIC FordMotTqCmdOvrlLimr.FordMotTqCmdOvrlLimrHiFrqMonrActvNiblCtrlMaxMotTq.Val /end REF_CHARACTERISTIC
 /begin REF_MEASUREMENT /end REF_MEASUREMENT
/end GROUP
/begin GROUP FordMotTqCmdOvrlLimr.FordMotTqCmdOvrlLimrHiFrqMonrLaneDprtrWarnDcTqTrendThd.Val "MICROSAR RTE" /begin SUB_GROUP /end SUB_GROUP /begin FUNCTION_LIST /end FUNCTION_LIST
 /begin REF_CHARACTERISTIC FordMotTqCmdOvrlLimr.FordMotTqCmdOvrlLimrHiFrqMonrLaneDprtrWarnDcTqTrendThd.Val /end REF_CHARACTERISTIC
 /begin REF_MEASUREMENT /end REF_MEASUREMENT
/end GROUP
/begin GROUP FordMotTqCmdOvrlLimr.FordMotTqCmdOvrlLimrHiFrqMonrLaneDprtrWarnLoFrqTiThd.Val "MICROSAR RTE" /begin SUB_GROUP /end SUB_GROUP /begin FUNCTION_LIST /end FUNCTION_LIST
 /begin REF_CHARACTERISTIC FordMotTqCmdOvrlLimr.FordMotTqCmdOvrlLimrHiFrqMonrLaneDprtrWarnLoFrqTiThd.Val /end REF_CHARACTERISTIC
 /begin REF_MEASUREMENT /end REF_MEASUREMENT
/end GROUP
/begin GROUP FordMotTqCmdOvrlLimr.FordMotTqCmdOvrlLimrHiFrqMonrLaneDprtrWarnMaxMotTq.Val "MICROSAR RTE" /begin SUB_GROUP /end SUB_GROUP /begin FUNCTION_LIST /end FUNCTION_LIST
 /begin REF_CHARACTERISTIC FordMotTqCmdOvrlLimr.FordMotTqCmdOvrlLimrHiFrqMonrLaneDprtrWarnMaxMotTq.Val /end REF_CHARACTERISTIC
 /begin REF_MEASUREMENT /end REF_MEASUREMENT
/end GROUP
/begin GROUP FordMotTqCmdOvrlLimr.FordMotTqCmdOvrlLimrHiFrqMonrTqTrendAlpha.Val "MICROSAR RTE" /begin SUB_GROUP /end SUB_GROUP /begin FUNCTION_LIST /end FUNCTION_LIST
 /begin REF_CHARACTERISTIC FordMotTqCmdOvrlLimr.FordMotTqCmdOvrlLimrHiFrqMonrTqTrendAlpha.Val /end REF_CHARACTERISTIC
 /begin REF_MEASUREMENT /end REF_MEASUREMENT
/end GROUP
/begin GROUP FordMotTqCmdOvrlLimr.FordMotTqCmdOvrlLimrHiFrqMonrZeroBandTq.Val "MICROSAR RTE" /begin SUB_GROUP /end SUB_GROUP /begin FUNCTION_LIST /end FUNCTION_LIST
 /begin REF_CHARACTERISTIC FordMotTqCmdOvrlLimr.FordMotTqCmdOvrlLimrHiFrqMonrZeroBandTq.Val /end REF_CHARACTERISTIC
 /begin REF_MEASUREMENT /end REF_MEASUREMENT
/end GROUP
/begin GROUP FordMotTqCmdOvrlLimr.FordMotTqCmdOvrlLimrHwVelLoPassFrq.Val "MICROSAR RTE" /begin SUB_GROUP /end SUB_GROUP /begin FUNCTION_LIST /end FUNCTION_LIST
 /begin REF_CHARACTERISTIC FordMotTqCmdOvrlLimr.FordMotTqCmdOvrlLimrHwVelLoPassFrq.Val /end REF_CHARACTERISTIC
 /begin REF_MEASUREMENT /end REF_MEASUREMENT
/end GROUP
/begin GROUP FordMotTqCmdOvrlLimr.FordMotTqCmdOvrlLimrLatCtrlBwY.Val "MICROSAR RTE" /begin SUB_GROUP /end SUB_GROUP /begin FUNCTION_LIST /end FUNCTION_LIST /begin REF_CHARACTERISTIC FordMotTqCmdOvrlLimr.FordMotTqCmdOvrlLimrLatCtrlBwY.Val /end REF_CHARACTERISTIC /begin REF_MEASUREMENT /end REF_MEASUREMENT /end GROUP
/begin GROUP FordMotTqCmdOvrlLimr.FordMotTqCmdOvrlLimrLatCtrlTqRateY.Ary1D "MICROSAR RTE" /begin SUB_GROUP /end SUB_GROUP /begin FUNCTION_LIST /end FUNCTION_LIST
 /begin REF_CHARACTERISTIC FordMotTqCmdOvrlLimr.FordMotTqCmdOvrlLimrLatCtrlTqRateY.Ary1D /end REF_CHARACTERISTIC
 /begin REF_MEASUREMENT /end REF_MEASUREMENT
/end GROUP
/begin GROUP FordMotTqCmdOvrlLimr.FordMotTqCmdOvrlLimrLatCtrlTqSatnY.Ary1D "MICROSAR RTE" /begin SUB_GROUP /end SUB_GROUP /begin FUNCTION_LIST /end FUNCTION_LIST
 /begin REF_CHARACTERISTIC FordMotTqCmdOvrlLimr.FordMotTqCmdOvrlLimrLatCtrlTqSatnY.Ary1D /end REF_CHARACTERISTIC
 /begin REF_MEASUREMENT /end REF_MEASUREMENT
/end GROUP
/begin GROUP FordMotTqCmdOvrlLimr.FordMotTqCmdOvrlLimrLatCtrlVehSpdBreakPtX.Ary1D "MICROSAR RTE" /begin SUB_GROUP /end SUB_GROUP /begin FUNCTION_LIST /end FUNCTION_LIST
 /begin REF_CHARACTERISTIC FordMotTqCmdOvrlLimr.FordMotTqCmdOvrlLimrLatCtrlVehSpdBreakPtX.Ary1D /end REF_CHARACTERISTIC
 /begin REF_MEASUREMENT /end REF_MEASUREMENT
/end GROUP
/begin GROUP FordMotTqCmdOvrlLimr.FordMotTqCmdOvrlLimrPullDriftCmpTqRateY.Ary1D "MICROSAR RTE" /begin SUB_GROUP /end SUB_GROUP /begin FUNCTION_LIST /end FUNCTION_LIST
 /begin REF_CHARACTERISTIC FordMotTqCmdOvrlLimr.FordMotTqCmdOvrlLimrPullDriftCmpTqRateY.Ary1D /end REF_CHARACTERISTIC
 /begin REF_MEASUREMENT /end REF_MEASUREMENT
/end GROUP
/begin GROUP FordMotTqCmdOvrlLimr.FordMotTqCmdOvrlLimrPullDriftCmpTqSatnY.Ary1D "MICROSAR RTE" /begin SUB_GROUP /end SUB_GROUP /begin FUNCTION_LIST /end FUNCTION_LIST
 /begin REF_CHARACTERISTIC FordMotTqCmdOvrlLimr.FordMotTqCmdOvrlLimrPullDriftCmpTqSatnY.Ary1D /end REF_CHARACTERISTIC
 /begin REF_MEASUREMENT /end REF_MEASUREMENT
/end GROUP
/begin GROUP FordMotTqCmdOvrlLimr.FordMotTqCmdOvrlLimrPullDriftCmpVehSpdBreakPtX.Ary1D "MICROSAR RTE" /begin SUB_GROUP /end SUB_GROUP /begin FUNCTION_LIST /end FUNCTION_LIST
 /begin REF_CHARACTERISTIC FordMotTqCmdOvrlLimr.FordMotTqCmdOvrlLimrPullDriftCmpVehSpdBreakPtX.Ary1D /end REF_CHARACTERISTIC
 /begin REF_MEASUREMENT /end REF_MEASUREMENT
/end GROUP
/begin GROUP FordMotTqCmdOvrlLimr.FordMotTqCmdOvrlLimrSteerReactnLimrCombAmpVehSpdLimX.Ary1D "MICROSAR RTE" /begin SUB_GROUP /end SUB_GROUP /begin FUNCTION_LIST /end FUNCTION_LIST
 /begin REF_CHARACTERISTIC FordMotTqCmdOvrlLimr.FordMotTqCmdOvrlLimrSteerReactnLimrCombAmpVehSpdLimX.Ary1D /end REF_CHARACTERISTIC
 /begin REF_MEASUREMENT /end REF_MEASUREMENT
/end GROUP
/begin GROUP FordMotTqCmdOvrlLimr.FordMotTqCmdOvrlLimrSteerReactnLimrCombAmpVehSpdLimY.Ary1D "MICROSAR RTE" /begin SUB_GROUP /end SUB_GROUP /begin FUNCTION_LIST /end FUNCTION_LIST
 /begin REF_CHARACTERISTIC FordMotTqCmdOvrlLimr.FordMotTqCmdOvrlLimrSteerReactnLimrCombAmpVehSpdLimY.Ary1D /end REF_CHARACTERISTIC
 /begin REF_MEASUREMENT /end REF_MEASUREMENT
/end GROUP
/begin GROUP FordMotTqCmdOvrlLimr.FordMotTqCmdOvrlLimrSteerReactnLimrCombOvrrunRampRateHwVelErrX.Ary1D "MICROSAR RTE" /begin SUB_GROUP /end SUB_GROUP /begin FUNCTION_LIST /end FUNCTION_LIST
 /begin REF_CHARACTERISTIC FordMotTqCmdOvrlLimr.FordMotTqCmdOvrlLimrSteerReactnLimrCombOvrrunRampRateHwVelErrX.Ary1D /end REF_CHARACTERISTIC
 /begin REF_MEASUREMENT /end REF_MEASUREMENT
/end GROUP
/begin GROUP FordMotTqCmdOvrlLimr.FordMotTqCmdOvrlLimrSteerReactnLimrCombOvrrunRampRateOutY.Ary1D "MICROSAR RTE" /begin SUB_GROUP /end SUB_GROUP /begin FUNCTION_LIST /end FUNCTION_LIST
 /begin REF_CHARACTERISTIC FordMotTqCmdOvrlLimr.FordMotTqCmdOvrlLimrSteerReactnLimrCombOvrrunRampRateOutY.Ary1D /end REF_CHARACTERISTIC
 /begin REF_MEASUREMENT /end REF_MEASUREMENT
/end GROUP
/begin GROUP FordMotTqCmdOvrlLimr.FordMotTqCmdOvrlLimrSteerReactnLimrCombdAmpOvrrun.Val "MICROSAR RTE" /begin SUB_GROUP /end SUB_GROUP /begin FUNCTION_LIST /end FUNCTION_LIST
 /begin REF_CHARACTERISTIC FordMotTqCmdOvrlLimr.FordMotTqCmdOvrlLimrSteerReactnLimrCombdAmpOvrrun.Val /end REF_CHARACTERISTIC
 /begin REF_MEASUREMENT /end REF_MEASUREMENT
/end GROUP
/begin GROUP FordMotTqCmdOvrlLimr.FordMotTqCmdOvrlLimrSteerReactnLimrCombdAmpRcvry.Val "MICROSAR RTE" /begin SUB_GROUP /end SUB_GROUP /begin FUNCTION_LIST /end FUNCTION_LIST
 /begin REF_CHARACTERISTIC FordMotTqCmdOvrlLimr.FordMotTqCmdOvrlLimrSteerReactnLimrCombdAmpRcvry.Val /end REF_CHARACTERISTIC
 /begin REF_MEASUREMENT /end REF_MEASUREMENT
/end GROUP
/begin GROUP FordMotTqCmdOvrlLimr.FordMotTqCmdOvrlLimrSteerReactnLimrCombdFixdOvrrunRampRate.Val "MICROSAR RTE" /begin SUB_GROUP /end SUB_GROUP /begin FUNCTION_LIST /end FUNCTION_LIST
 /begin REF_CHARACTERISTIC FordMotTqCmdOvrlLimr.FordMotTqCmdOvrlLimrSteerReactnLimrCombdFixdOvrrunRampRate.Val /end REF_CHARACTERISTIC
 /begin REF_MEASUREMENT /end REF_MEASUREMENT
/end GROUP
/begin GROUP FordMotTqCmdOvrlLimr.FordMotTqCmdOvrlLimrSteerReactnLimrCombdLimHys.Val "MICROSAR RTE" /begin SUB_GROUP /end SUB_GROUP /begin FUNCTION_LIST /end FUNCTION_LIST
 /begin REF_CHARACTERISTIC FordMotTqCmdOvrlLimr.FordMotTqCmdOvrlLimrSteerReactnLimrCombdLimHys.Val /end REF_CHARACTERISTIC
 /begin REF_MEASUREMENT /end REF_MEASUREMENT
/end GROUP
/begin GROUP FordMotTqCmdOvrlLimr.FordMotTqCmdOvrlLimrSteerReactnLimrCombdLimTqX.Ary2D "MICROSAR RTE" /begin SUB_GROUP /end SUB_GROUP /begin FUNCTION_LIST /end FUNCTION_LIST
 /begin REF_CHARACTERISTIC FordMotTqCmdOvrlLimr.FordMotTqCmdOvrlLimrSteerReactnLimrCombdLimTqX.Ary2D /end REF_CHARACTERISTIC
 /begin REF_MEASUREMENT /end REF_MEASUREMENT
/end GROUP
/begin GROUP FordMotTqCmdOvrlLimr.FordMotTqCmdOvrlLimrSteerReactnLimrCombdLimrHwVelY.Ary2D "MICROSAR RTE" /begin SUB_GROUP /end SUB_GROUP /begin FUNCTION_LIST /end FUNCTION_LIST
 /begin REF_CHARACTERISTIC FordMotTqCmdOvrlLimr.FordMotTqCmdOvrlLimrSteerReactnLimrCombdLimrHwVelY.Ary2D /end REF_CHARACTERISTIC
 /begin REF_MEASUREMENT /end REF_MEASUREMENT
/end GROUP
/begin GROUP FordMotTqCmdOvrlLimr.FordMotTqCmdOvrlLimrSteerReactnLimrCombdLimrVehSpd.Ary1D "MICROSAR RTE" /begin SUB_GROUP /end SUB_GROUP /begin FUNCTION_LIST /end FUNCTION_LIST
 /begin REF_CHARACTERISTIC FordMotTqCmdOvrlLimr.FordMotTqCmdOvrlLimrSteerReactnLimrCombdLimrVehSpd.Ary1D /end REF_CHARACTERISTIC
 /begin REF_MEASUREMENT /end REF_MEASUREMENT
/end GROUP
/begin GROUP FordMotTqCmdOvrlLimr.FordMotTqCmdOvrlLimrSteerReactnLimrCombdRcvryIdealRampRate.Val "MICROSAR RTE" /begin SUB_GROUP /end SUB_GROUP /begin FUNCTION_LIST /end FUNCTION_LIST
 /begin REF_CHARACTERISTIC FordMotTqCmdOvrlLimr.FordMotTqCmdOvrlLimrSteerReactnLimrCombdRcvryIdealRampRate.Val /end REF_CHARACTERISTIC
 /begin REF_MEASUREMENT /end REF_MEASUREMENT
/end GROUP
/begin GROUP FordMotTqCmdOvrlLimr.FordMotTqCmdOvrlLimrSteerReactnLimrCombdRcvryRampRateStg1.Val "MICROSAR RTE" /begin SUB_GROUP /end SUB_GROUP /begin FUNCTION_LIST /end FUNCTION_LIST
 /begin REF_CHARACTERISTIC FordMotTqCmdOvrlLimr.FordMotTqCmdOvrlLimrSteerReactnLimrCombdRcvryRampRateStg1.Val /end REF_CHARACTERISTIC
 /begin REF_MEASUREMENT /end REF_MEASUREMENT
/end GROUP
/begin GROUP FordMotTqCmdOvrlLimr.FordMotTqCmdOvrlLimrSteerReactnLimrCombdRcvryRampRateStg2.Val "MICROSAR RTE" /begin SUB_GROUP /end SUB_GROUP /begin FUNCTION_LIST /end FUNCTION_LIST
 /begin REF_CHARACTERISTIC FordMotTqCmdOvrlLimr.FordMotTqCmdOvrlLimrSteerReactnLimrCombdRcvryRampRateStg2.Val /end REF_CHARACTERISTIC
 /begin REF_MEASUREMENT /end REF_MEASUREMENT
/end GROUP
/begin GROUP FordMotTqCmdOvrlLimr.FordPullDriftCmpFctCallSts.Logl "MICROSAR RTE" /begin SUB_GROUP /end SUB_GROUP /begin FUNCTION_LIST /end FUNCTION_LIST /begin REF_CHARACTERISTIC /end REF_CHARACTERISTIC /begin REF_MEASUREMENT FordMotTqCmdOvrlLimr.FordPullDriftCmpFctCallSts.Logl /end REF_MEASUREMENT /end GROUP
/begin GROUP FordMotTqCmdOvrlLimr.FordPullDriftCmpTqReq.Val "MICROSAR RTE" /begin SUB_GROUP /end SUB_GROUP /begin FUNCTION_LIST /end FUNCTION_LIST /begin REF_CHARACTERISTIC /end REF_CHARACTERISTIC /begin REF_MEASUREMENT FordMotTqCmdOvrlLimr.FordPullDriftCmpTqReq.Val /end REF_MEASUREMENT /end GROUP
/begin GROUP FordMotTqCmdOvrlLimr.FordSteerTqDstbcRejctnFctCallSts.Logl "MICROSAR RTE" /begin SUB_GROUP /end SUB_GROUP /begin FUNCTION_LIST /end FUNCTION_LIST /begin REF_CHARACTERISTIC /end REF_CHARACTERISTIC /begin REF_MEASUREMENT FordMotTqCmdOvrlLimr.FordSteerTqDstbcRejctnFctCallSts.Logl /end REF_MEASUREMENT /end GROUP
/begin GROUP FordMotTqCmdOvrlLimr.FordSteerTqDstbcRejctnTqReq.Val "MICROSAR RTE" /begin SUB_GROUP /end SUB_GROUP /begin FUNCTION_LIST /end FUNCTION_LIST /begin REF_CHARACTERISTIC /end REF_CHARACTERISTIC /begin REF_MEASUREMENT FordMotTqCmdOvrlLimr.FordSteerTqDstbcRejctnTqReq.Val /end REF_MEASUREMENT /end GROUP
/begin GROUP FordMotTqCmdOvrlLimr.HwVel.Val "MICROSAR RTE" /begin SUB_GROUP /end SUB_GROUP /begin FUNCTION_LIST /end FUNCTION_LIST /begin REF_CHARACTERISTIC /end REF_CHARACTERISTIC /begin REF_MEASUREMENT FordMotTqCmdOvrlLimr.HwVel.Val /end REF_MEASUREMENT /end GROUP
/begin GROUP FordMotTqCmdOvrlLimr.HwVelFil "MICROSAR RTE" /begin SUB_GROUP /end SUB_GROUP /begin FUNCTION_LIST /end FUNCTION_LIST /begin REF_CHARACTERISTIC /end REF_CHARACTERISTIC
 /begin REF_MEASUREMENT FordMotTqCmdOvrlLimr.HwVelFil.FilGain FordMotTqCmdOvrlLimr.HwVelFil.FilSt /end REF_MEASUREMENT
/end GROUP
/begin GROUP FordMotTqCmdOvrlLimr.LaneDprtrWarnLoFrqElpdTiVari "MICROSAR RTE" /begin SUB_GROUP /end SUB_GROUP /begin FUNCTION_LIST /end FUNCTION_LIST /begin REF_CHARACTERISTIC /end REF_CHARACTERISTIC /begin REF_MEASUREMENT FordMotTqCmdOvrlLimr.LaneDprtrWarnLoFrqElpdTiVari /end REF_MEASUREMENT /end GROUP
/begin GROUP FordMotTqCmdOvrlLimr.LaneDprtrWarnLoFrqFlt "MICROSAR RTE" /begin SUB_GROUP /end SUB_GROUP /begin FUNCTION_LIST /end FUNCTION_LIST /begin REF_CHARACTERISTIC /end REF_CHARACTERISTIC /begin REF_MEASUREMENT FordMotTqCmdOvrlLimr.LaneDprtrWarnLoFrqFlt /end REF_MEASUREMENT /end GROUP
/begin GROUP FordMotTqCmdOvrlLimr.LaneDprtrWarnLoFrqSt "MICROSAR RTE" /begin SUB_GROUP /end SUB_GROUP /begin FUNCTION_LIST /end FUNCTION_LIST /begin REF_CHARACTERISTIC /end REF_CHARACTERISTIC /begin REF_MEASUREMENT FordMotTqCmdOvrlLimr.LaneDprtrWarnLoFrqSt /end REF_MEASUREMENT /end GROUP
/begin GROUP FordMotTqCmdOvrlLimr.LaneDprtrWarnLoFrqTmrFlgVari "MICROSAR RTE" /begin SUB_GROUP /end SUB_GROUP /begin FUNCTION_LIST /end FUNCTION_LIST /begin REF_CHARACTERISTIC /end REF_CHARACTERISTIC /begin REF_MEASUREMENT FordMotTqCmdOvrlLimr.LaneDprtrWarnLoFrqTmrFlgVari /end REF_MEASUREMENT /end GROUP
/begin GROUP FordMotTqCmdOvrlLimr.LaneDprtrWarnLoFrqTmrVari "MICROSAR RTE" /begin SUB_GROUP /end SUB_GROUP /begin FUNCTION_LIST /end FUNCTION_LIST /begin REF_CHARACTERISTIC /end REF_CHARACTERISTIC /begin REF_MEASUREMENT FordMotTqCmdOvrlLimr.LaneDprtrWarnLoFrqTmrVari /end REF_MEASUREMENT /end GROUP
/begin GROUP FordMotTqCmdOvrlLimr.LimrDftVehSpd "MICROSAR RTE" /begin SUB_GROUP /end SUB_GROUP /begin FUNCTION_LIST /end FUNCTION_LIST /begin REF_CHARACTERISTIC /end REF_CHARACTERISTIC /begin REF_MEASUREMENT FordMotTqCmdOvrlLimr.LimrDftVehSpd /end REF_MEASUREMENT /end GROUP
/begin GROUP FordMotTqCmdOvrlLimr.PerInstanceMemories "MICROSAR RTE"
 /begin SUB_GROUP FordMotTqCmdOvrlLimr.ActvNiblCtrlLoFrqElpdTiVari FordMotTqCmdOvrlLimr.ActvNiblCtrlLoFrqFlt FordMotTqCmdOvrlLimr.ActvNiblCtrlLoFrqSt FordMotTqCmdOvrlLimr.ActvNiblCtrlLoFrqTmrFlgVari FordMotTqCmdOvrlLimr.ActvNiblCtrlLoFrqTmrVari FordMotTqCmdOvrlLimr.DftVehSpd FordMotTqCmdOvrlLimr.HwVelFil FordMotTqCmdOvrlLimr.LaneDprtrWarnLoFrqElpdTiVari FordMotTqCmdOvrlLimr.LaneDprtrWarnLoFrqFlt FordMotTqCmdOvrlLimr.LaneDprtrWarnLoFrqSt FordMotTqCmdOvrlLimr.LaneDprtrWarnLoFrqTmrFlgVari FordMotTqCmdOvrlLimr.LaneDprtrWarnLoFrqTmrVari FordMotTqCmdOvrlLimr.LimrDftVehSpd FordMotTqCmdOvrlLimr.PrevAmpLim FordMotTqCmdOvrlLimr.PrevDftVehSpd FordMotTqCmdOvrlLimr.PrevLimdTqReq FordMotTqCmdOvrlLimr.PrevLimrVehSpd FordMotTqCmdOvrlLimr.PrevTqTrend /end SUB_GROUP
 /begin FUNCTION_LIST /end FUNCTION_LIST
 /begin REF_CHARACTERISTIC /end REF_CHARACTERISTIC
 /begin REF_MEASUREMENT /end REF_MEASUREMENT
/end GROUP
/begin GROUP FordMotTqCmdOvrlLimr.PrevAmpLim "MICROSAR RTE" /begin SUB_GROUP /end SUB_GROUP /begin FUNCTION_LIST /end FUNCTION_LIST /begin REF_CHARACTERISTIC /end REF_CHARACTERISTIC /begin REF_MEASUREMENT FordMotTqCmdOvrlLimr.PrevAmpLim /end REF_MEASUREMENT /end GROUP
/begin GROUP FordMotTqCmdOvrlLimr.PrevDftVehSpd "MICROSAR RTE" /begin SUB_GROUP /end SUB_GROUP /begin FUNCTION_LIST /end FUNCTION_LIST /begin REF_CHARACTERISTIC /end REF_CHARACTERISTIC /begin REF_MEASUREMENT FordMotTqCmdOvrlLimr.PrevDftVehSpd /end REF_MEASUREMENT /end GROUP
/begin GROUP FordMotTqCmdOvrlLimr.PrevLimdTqReq "MICROSAR RTE" /begin SUB_GROUP /end SUB_GROUP /begin FUNCTION_LIST /end FUNCTION_LIST /begin REF_CHARACTERISTIC /end REF_CHARACTERISTIC /begin REF_MEASUREMENT FordMotTqCmdOvrlLimr.PrevLimdTqReq /end REF_MEASUREMENT /end GROUP
/begin GROUP FordMotTqCmdOvrlLimr.PrevLimrVehSpd "MICROSAR RTE" /begin SUB_GROUP /end SUB_GROUP /begin FUNCTION_LIST /end FUNCTION_LIST /begin REF_CHARACTERISTIC /end REF_CHARACTERISTIC /begin REF_MEASUREMENT FordMotTqCmdOvrlLimr.PrevLimrVehSpd /end REF_MEASUREMENT /end GROUP
/begin GROUP FordMotTqCmdOvrlLimr.PrevTqTrend "MICROSAR RTE" /begin SUB_GROUP /end SUB_GROUP /begin FUNCTION_LIST /end FUNCTION_LIST /begin REF_CHARACTERISTIC /end REF_CHARACTERISTIC /begin REF_MEASUREMENT FordMotTqCmdOvrlLimr.PrevTqTrend /end REF_MEASUREMENT /end GROUP
/begin GROUP FordMotTqCmdOvrlLimr.ReceiverPorts "MICROSAR RTE"
 /begin SUB_GROUP FordMotTqCmdOvrlLimr.EcuId.Val FordMotTqCmdOvrlLimr.FildHwTq.Val FordMotTqCmdOvrlLimr.FildVehSpd.Val FordMotTqCmdOvrlLimr.FordActvNiblCtrlFctCallSts.Logl FordMotTqCmdOvrlLimr.FordActvNiblCtrlTqReq.Val FordMotTqCmdOvrlLimr.FordLaneDprtrWarnFctCallSts.Logl FordMotTqCmdOvrlLimr.FordLaneDprtrWarnTqReq.Val FordMotTqCmdOvrlLimr.FordLatCtrlFctCallSts.Logl FordMotTqCmdOvrlLimr.FordLatCtrlTqReq.Val FordMotTqCmdOvrlLimr.FordPullDriftCmpFctCallSts.Logl FordMotTqCmdOvrlLimr.FordPullDriftCmpTqReq.Val FordMotTqCmdOvrlLimr.FordSteerTqDstbcRejctnFctCallSts.Logl FordMotTqCmdOvrlLimr.FordSteerTqDstbcRejctnTqReq.Val FordMotTqCmdOvrlLimr.HwVel.Val FordMotTqCmdOvrlLimr.VehSpdVld.Logl /end SUB_GROUP
 /begin FUNCTION_LIST /end FUNCTION_LIST
 /begin REF_CHARACTERISTIC /end REF_CHARACTERISTIC
 /begin REF_MEASUREMENT /end REF_MEASUREMENT
/end GROUP
/begin GROUP FordMotTqCmdOvrlLimr.SenderPorts "MICROSAR RTE" /begin SUB_GROUP FordMotTqCmdOvrlLimr.FordMotTqCmdOvrl.Val /end SUB_GROUP /begin FUNCTION_LIST /end FUNCTION_LIST /begin REF_CHARACTERISTIC /end REF_CHARACTERISTIC /begin REF_MEASUREMENT /end REF_MEASUREMENT /end GROUP
/begin GROUP FordMotTqCmdOvrlLimr.VehSpdVld.Logl "MICROSAR RTE" /begin SUB_GROUP /end SUB_GROUP /begin FUNCTION_LIST /end FUNCTION_LIST /begin REF_CHARACTERISTIC /end REF_CHARACTERISTIC /begin REF_MEASUREMENT FordMotTqCmdOvrlLimr.VehSpdVld.Logl /end REF_MEASUREMENT /end GROUP
/begin GROUP FordMsg077BusHiSpd "MICROSAR RTE"
 /begin SUB_GROUP FordMsg077BusHiSpd.CalibrationPorts FordMsg077BusHiSpd.PerInstanceMemories FordMsg077BusHiSpd.ReceiverPorts FordMsg077BusHiSpd.SenderPorts /end SUB_GROUP
 /begin FUNCTION_LIST /end FUNCTION_LIST
 /begin REF_CHARACTERISTIC /end REF_CHARACTERISTIC
 /begin REF_MEASUREMENT /end REF_MEASUREMENT
/end GROUP
/begin GROUP FordMsg077BusHiSpd.CalibrationPorts "MICROSAR RTE"
 /begin SUB_GROUP FordMsg077BusHiSpd.FordMsg077BusHiSpdCanDtcInhbThd.Val FordMsg077BusHiSpd.FordMsg077BusHiSpdLatACmpdInvldSigFaildThd.Val FordMsg077BusHiSpd.FordMsg077BusHiSpdLatACmpdInvldSigPassdThd.Val FordMsg077BusHiSpd.FordMsg077BusHiSpdLatACmpdVldMissThd.Val FordMsg077BusHiSpd.FordMsg077BusHiSpdLgtACmpdInvldSigFaildThd.Val FordMsg077BusHiSpd.FordMsg077BusHiSpdLgtACmpdInvldSigPassdThd.Val FordMsg077BusHiSpd.FordMsg077BusHiSpdLgtACmpdVldMissThd.Val FordMsg077BusHiSpd.FordMsg077BusHiSpdMissMsgFaildThd.Val FordMsg077BusHiSpd.FordMsg077BusHiSpdMissMsgPassdThd.Val FordMsg077BusHiSpd.FordMsg077BusHiSpdOverGndInvldSigFaildThd.Val FordMsg077BusHiSpd.FordMsg077BusHiSpdOverGndInvldSigPassdThd.Val FordMsg077BusHiSpd.FordMsg077BusHiSpdVehLatACmpdVldFaildThd.Val FordMsg077BusHiSpd.FordMsg077BusHiSpdVehLatACmpdVldPassdThd.Val FordMsg077BusHiSpd.FordMsg077BusHiSpdVehLgtACmpdVldFaildThd.Val FordMsg077BusHiSpd.FordMsg077BusHiSpdVehLgtACmpdVldPassdThd.Val FordMsg077BusHiSpd.FordMsg077BusHiSpdVehSpdOverGndVldFaildThd.Val FordMsg077BusHiSpd.FordMsg077BusHiSpdVehSpdOverGndVldMissThd.Val FordMsg077BusHiSpd.FordMsg077BusHiSpdVehSpdOverGndVldPassdThd.Val FordMsg077BusHiSpd.FordMsg077BusHiSpdVehYawRateCmpdVldFaildThd.Val FordMsg077BusHiSpd.FordMsg077BusHiSpdVehYawRateCmpdVldPassdThd.Val FordMsg077BusHiSpd.FordMsg077BusHiSpdYawRateCmpdInvldSigFaildThd.Val FordMsg077BusHiSpd.FordMsg077BusHiSpdYawRateCmpdInvldSigPassdThd.Val FordMsg077BusHiSpd.FordMsg077BusHiSpdYawRateCmpdVldMissThd.Val /end SUB_GROUP
 /begin FUNCTION_LIST /end FUNCTION_LIST
 /begin REF_CHARACTERISTIC /end REF_CHARACTERISTIC
 /begin REF_MEASUREMENT /end REF_MEASUREMENT
/end GROUP
/begin GROUP FordMsg077BusHiSpd.CanDtcInhbRefTi "MICROSAR RTE" /begin SUB_GROUP /end SUB_GROUP /begin FUNCTION_LIST /end FUNCTION_LIST /begin REF_CHARACTERISTIC /end REF_CHARACTERISTIC /begin REF_MEASUREMENT FordMsg077BusHiSpd.CanDtcInhbRefTi /end REF_MEASUREMENT /end GROUP
/begin GROUP FordMsg077BusHiSpd.DiagcClrProxyFlgPrev "MICROSAR RTE" /begin SUB_GROUP /end SUB_GROUP /begin FUNCTION_LIST /end FUNCTION_LIST /begin REF_CHARACTERISTIC /end REF_CHARACTERISTIC /begin REF_MEASUREMENT FordMsg077BusHiSpd.DiagcClrProxyFlgPrev /end REF_MEASUREMENT /end GROUP
/begin GROUP FordMsg077BusHiSpd.FirstTranVldFlg "MICROSAR RTE" /begin SUB_GROUP /end SUB_GROUP /begin FUNCTION_LIST /end FUNCTION_LIST /begin REF_CHARACTERISTIC /end REF_CHARACTERISTIC /begin REF_MEASUREMENT FordMsg077BusHiSpd.FirstTranVldFlg /end REF_MEASUREMENT /end GROUP
/begin GROUP FordMsg077BusHiSpd.FordBrkOscnRednEnad.Logl "MICROSAR RTE" /begin SUB_GROUP /end SUB_GROUP /begin FUNCTION_LIST /end FUNCTION_LIST /begin REF_CHARACTERISTIC /end REF_CHARACTERISTIC /begin REF_MEASUREMENT FordMsg077BusHiSpd.FordBrkOscnRednEnad.Logl /end REF_MEASUREMENT /end GROUP
/begin GROUP FordMsg077BusHiSpd.FordCanDtcInhb.Logl "MICROSAR RTE" /begin SUB_GROUP /end SUB_GROUP /begin FUNCTION_LIST /end FUNCTION_LIST /begin REF_CHARACTERISTIC /end REF_CHARACTERISTIC /begin REF_MEASUREMENT FordMsg077BusHiSpd.FordCanDtcInhb.Logl /end REF_MEASUREMENT /end GROUP
/begin GROUP FordMsg077BusHiSpd.FordClrDiagcFlgProxy.Logl "MICROSAR RTE" /begin SUB_GROUP /end SUB_GROUP /begin FUNCTION_LIST /end FUNCTION_LIST /begin REF_CHARACTERISTIC /end REF_CHARACTERISTIC /begin REF_MEASUREMENT FordMsg077BusHiSpd.FordClrDiagcFlgProxy.Logl /end REF_MEASUREMENT /end GROUP
/begin GROUP FordMsg077BusHiSpd.FordEpsLifeCycMod.Val "MICROSAR RTE" /begin SUB_GROUP /end SUB_GROUP /begin FUNCTION_LIST /end FUNCTION_LIST /begin REF_CHARACTERISTIC /end REF_CHARACTERISTIC /begin REF_MEASUREMENT FordMsg077BusHiSpd.FordEpsLifeCycMod.Val /end REF_MEASUREMENT /end GROUP
/begin GROUP FordMsg077BusHiSpd.FordEvasSteerAssiEnad.Logl "MICROSAR RTE" /begin SUB_GROUP /end SUB_GROUP /begin FUNCTION_LIST /end FUNCTION_LIST /begin REF_CHARACTERISTIC /end REF_CHARACTERISTIC /begin REF_MEASUREMENT FordMsg077BusHiSpd.FordEvasSteerAssiEnad.Logl /end REF_MEASUREMENT /end GROUP
/begin GROUP FordMsg077BusHiSpd.FordLaneCentrAssiEnad.Logl "MICROSAR RTE" /begin SUB_GROUP /end SUB_GROUP /begin FUNCTION_LIST /end FUNCTION_LIST /begin REF_CHARACTERISTIC /end REF_CHARACTERISTIC /begin REF_MEASUREMENT FordMsg077BusHiSpd.FordLaneCentrAssiEnad.Logl /end REF_MEASUREMENT /end GROUP
/begin GROUP FordMsg077BusHiSpd.FordLaneKeepAssiEnad.Logl "MICROSAR RTE" /begin SUB_GROUP /end SUB_GROUP /begin FUNCTION_LIST /end FUNCTION_LIST /begin REF_CHARACTERISTIC /end REF_CHARACTERISTIC /begin REF_MEASUREMENT FordMsg077BusHiSpd.FordLaneKeepAssiEnad.Logl /end REF_MEASUREMENT /end GROUP
/begin GROUP FordMsg077BusHiSpd.FordMsg077BusHiSpdCanDtcInhbThd.Val "MICROSAR RTE" /begin SUB_GROUP /end SUB_GROUP /begin FUNCTION_LIST /end FUNCTION_LIST /begin REF_CHARACTERISTIC FordMsg077BusHiSpd.FordMsg077BusHiSpdCanDtcInhbThd.Val /end REF_CHARACTERISTIC /begin REF_MEASUREMENT /end REF_MEASUREMENT /end GROUP
/begin GROUP FordMsg077BusHiSpd.FordMsg077BusHiSpdLatACmpdInvldSigFaildThd.Val "MICROSAR RTE" /begin SUB_GROUP /end SUB_GROUP /begin FUNCTION_LIST /end FUNCTION_LIST
 /begin REF_CHARACTERISTIC FordMsg077BusHiSpd.FordMsg077BusHiSpdLatACmpdInvldSigFaildThd.Val /end REF_CHARACTERISTIC
 /begin REF_MEASUREMENT /end REF_MEASUREMENT
/end GROUP
/begin GROUP FordMsg077BusHiSpd.FordMsg077BusHiSpdLatACmpdInvldSigPassdThd.Val "MICROSAR RTE" /begin SUB_GROUP /end SUB_GROUP /begin FUNCTION_LIST /end FUNCTION_LIST
 /begin REF_CHARACTERISTIC FordMsg077BusHiSpd.FordMsg077BusHiSpdLatACmpdInvldSigPassdThd.Val /end REF_CHARACTERISTIC
 /begin REF_MEASUREMENT /end REF_MEASUREMENT
/end GROUP
/begin GROUP FordMsg077BusHiSpd.FordMsg077BusHiSpdLatACmpdVldMissThd.Val "MICROSAR RTE" /begin SUB_GROUP /end SUB_GROUP /begin FUNCTION_LIST /end FUNCTION_LIST
 /begin REF_CHARACTERISTIC FordMsg077BusHiSpd.FordMsg077BusHiSpdLatACmpdVldMissThd.Val /end REF_CHARACTERISTIC
 /begin REF_MEASUREMENT /end REF_MEASUREMENT
/end GROUP
/begin GROUP FordMsg077BusHiSpd.FordMsg077BusHiSpdLgtACmpdInvldSigFaildThd.Val "MICROSAR RTE" /begin SUB_GROUP /end SUB_GROUP /begin FUNCTION_LIST /end FUNCTION_LIST
 /begin REF_CHARACTERISTIC FordMsg077BusHiSpd.FordMsg077BusHiSpdLgtACmpdInvldSigFaildThd.Val /end REF_CHARACTERISTIC
 /begin REF_MEASUREMENT /end REF_MEASUREMENT
/end GROUP
/begin GROUP FordMsg077BusHiSpd.FordMsg077BusHiSpdLgtACmpdInvldSigPassdThd.Val "MICROSAR RTE" /begin SUB_GROUP /end SUB_GROUP /begin FUNCTION_LIST /end FUNCTION_LIST
 /begin REF_CHARACTERISTIC FordMsg077BusHiSpd.FordMsg077BusHiSpdLgtACmpdInvldSigPassdThd.Val /end REF_CHARACTERISTIC
 /begin REF_MEASUREMENT /end REF_MEASUREMENT
/end GROUP
/begin GROUP FordMsg077BusHiSpd.FordMsg077BusHiSpdLgtACmpdVldMissThd.Val "MICROSAR RTE" /begin SUB_GROUP /end SUB_GROUP /begin FUNCTION_LIST /end FUNCTION_LIST
 /begin REF_CHARACTERISTIC FordMsg077BusHiSpd.FordMsg077BusHiSpdLgtACmpdVldMissThd.Val /end REF_CHARACTERISTIC
 /begin REF_MEASUREMENT /end REF_MEASUREMENT
/end GROUP
/begin GROUP FordMsg077BusHiSpd.FordMsg077BusHiSpdMissMsgFaildThd.Val "MICROSAR RTE" /begin SUB_GROUP /end SUB_GROUP /begin FUNCTION_LIST /end FUNCTION_LIST /begin REF_CHARACTERISTIC FordMsg077BusHiSpd.FordMsg077BusHiSpdMissMsgFaildThd.Val /end REF_CHARACTERISTIC /begin REF_MEASUREMENT /end REF_MEASUREMENT /end GROUP
/begin GROUP FordMsg077BusHiSpd.FordMsg077BusHiSpdMissMsgPassdThd.Val "MICROSAR RTE" /begin SUB_GROUP /end SUB_GROUP /begin FUNCTION_LIST /end FUNCTION_LIST /begin REF_CHARACTERISTIC FordMsg077BusHiSpd.FordMsg077BusHiSpdMissMsgPassdThd.Val /end REF_CHARACTERISTIC /begin REF_MEASUREMENT /end REF_MEASUREMENT /end GROUP
/begin GROUP FordMsg077BusHiSpd.FordMsg077BusHiSpdOverGndInvldSigFaildThd.Val "MICROSAR RTE" /begin SUB_GROUP /end SUB_GROUP /begin FUNCTION_LIST /end FUNCTION_LIST
 /begin REF_CHARACTERISTIC FordMsg077BusHiSpd.FordMsg077BusHiSpdOverGndInvldSigFaildThd.Val /end REF_CHARACTERISTIC
 /begin REF_MEASUREMENT /end REF_MEASUREMENT
/end GROUP
/begin GROUP FordMsg077BusHiSpd.FordMsg077BusHiSpdOverGndInvldSigPassdThd.Val "MICROSAR RTE" /begin SUB_GROUP /end SUB_GROUP /begin FUNCTION_LIST /end FUNCTION_LIST
 /begin REF_CHARACTERISTIC FordMsg077BusHiSpd.FordMsg077BusHiSpdOverGndInvldSigPassdThd.Val /end REF_CHARACTERISTIC
 /begin REF_MEASUREMENT /end REF_MEASUREMENT
/end GROUP
/begin GROUP FordMsg077BusHiSpd.FordMsg077BusHiSpdVehLatACmpdVldFaildThd.Val "MICROSAR RTE" /begin SUB_GROUP /end SUB_GROUP /begin FUNCTION_LIST /end FUNCTION_LIST
 /begin REF_CHARACTERISTIC FordMsg077BusHiSpd.FordMsg077BusHiSpdVehLatACmpdVldFaildThd.Val /end REF_CHARACTERISTIC
 /begin REF_MEASUREMENT /end REF_MEASUREMENT
/end GROUP
/begin GROUP FordMsg077BusHiSpd.FordMsg077BusHiSpdVehLatACmpdVldPassdThd.Val "MICROSAR RTE" /begin SUB_GROUP /end SUB_GROUP /begin FUNCTION_LIST /end FUNCTION_LIST
 /begin REF_CHARACTERISTIC FordMsg077BusHiSpd.FordMsg077BusHiSpdVehLatACmpdVldPassdThd.Val /end REF_CHARACTERISTIC
 /begin REF_MEASUREMENT /end REF_MEASUREMENT
/end GROUP
/begin GROUP FordMsg077BusHiSpd.FordMsg077BusHiSpdVehLgtACmpdVldFaildThd.Val "MICROSAR RTE" /begin SUB_GROUP /end SUB_GROUP /begin FUNCTION_LIST /end FUNCTION_LIST
 /begin REF_CHARACTERISTIC FordMsg077BusHiSpd.FordMsg077BusHiSpdVehLgtACmpdVldFaildThd.Val /end REF_CHARACTERISTIC
 /begin REF_MEASUREMENT /end REF_MEASUREMENT
/end GROUP
/begin GROUP FordMsg077BusHiSpd.FordMsg077BusHiSpdVehLgtACmpdVldPassdThd.Val "MICROSAR RTE" /begin SUB_GROUP /end SUB_GROUP /begin FUNCTION_LIST /end FUNCTION_LIST
 /begin REF_CHARACTERISTIC FordMsg077BusHiSpd.FordMsg077BusHiSpdVehLgtACmpdVldPassdThd.Val /end REF_CHARACTERISTIC
 /begin REF_MEASUREMENT /end REF_MEASUREMENT
/end GROUP
/begin GROUP FordMsg077BusHiSpd.FordMsg077BusHiSpdVehSpdOverGndVldFaildThd.Val "MICROSAR RTE" /begin SUB_GROUP /end SUB_GROUP /begin FUNCTION_LIST /end FUNCTION_LIST
 /begin REF_CHARACTERISTIC FordMsg077BusHiSpd.FordMsg077BusHiSpdVehSpdOverGndVldFaildThd.Val /end REF_CHARACTERISTIC
 /begin REF_MEASUREMENT /end REF_MEASUREMENT
/end GROUP
/begin GROUP FordMsg077BusHiSpd.FordMsg077BusHiSpdVehSpdOverGndVldMissThd.Val "MICROSAR RTE" /begin SUB_GROUP /end SUB_GROUP /begin FUNCTION_LIST /end FUNCTION_LIST
 /begin REF_CHARACTERISTIC FordMsg077BusHiSpd.FordMsg077BusHiSpdVehSpdOverGndVldMissThd.Val /end REF_CHARACTERISTIC
 /begin REF_MEASUREMENT /end REF_MEASUREMENT
/end GROUP
/begin GROUP FordMsg077BusHiSpd.FordMsg077BusHiSpdVehSpdOverGndVldPassdThd.Val "MICROSAR RTE" /begin SUB_GROUP /end SUB_GROUP /begin FUNCTION_LIST /end FUNCTION_LIST
 /begin REF_CHARACTERISTIC FordMsg077BusHiSpd.FordMsg077BusHiSpdVehSpdOverGndVldPassdThd.Val /end REF_CHARACTERISTIC
 /begin REF_MEASUREMENT /end REF_MEASUREMENT
/end GROUP
/begin GROUP FordMsg077BusHiSpd.FordMsg077BusHiSpdVehYawRateCmpdVldFaildThd.Val "MICROSAR RTE" /begin SUB_GROUP /end SUB_GROUP /begin FUNCTION_LIST /end FUNCTION_LIST
 /begin REF_CHARACTERISTIC FordMsg077BusHiSpd.FordMsg077BusHiSpdVehYawRateCmpdVldFaildThd.Val /end REF_CHARACTERISTIC
 /begin REF_MEASUREMENT /end REF_MEASUREMENT
/end GROUP
/begin RECORD_LAYOUT RTE_RL_UWORD FNC_VALUES 1 UWORD ROW_DIR DIRECT /end RECORD_LAYOUT
/begin RECORD_LAYOUT RTE_RL_SWORD FNC_VALUES 1 SWORD ROW_DIR DIRECT /end RECORD_LAYOUT
/begin RECORD_LAYOUT RTE_RL_FLOAT32_IEEE FNC_VALUES 1 FLOAT32_IEEE ROW_DIR DIRECT /end RECORD_LAYOUT
/begin RECORD_LAYOUT RTE_RL_BOOLEAN FNC_VALUES 1 UBYTE ROW_DIR DIRECT /end RECORD_LAYOUT
/**********************************************************************************************************************
* COMPU_METHOD / COMPU_VTAB_RANGE
*********************************************************************************************************************/
/begin COMPU_METHOD RTE_CM_BOOLEAN "" TAB_VERB "%3.1" "" COMPU_TAB_REF RTE_CM_BOOLEAN /end COMPU_METHOD
/begin COMPU_VTAB_RANGE RTE_CM_BOOLEAN "" 2 0 0 "false" 1 255 "true" /end COMPU_VTAB_RANGE
/begin COMPU_METHOD RTE_CM_ENUM_FordEpsLifeCycMod1 "" TAB_VERB "%.1" "" COMPU_TAB_REF RTE_CM_ENUM_FordEpsLifeCycMod1 /end COMPU_METHOD
/begin COMPU_VTAB_RANGE RTE_CM_ENUM_FordEpsLifeCycMod1 "" 3 0 0 "Norm" 1 1 "Factry" 2 2 "Transpt" /end COMPU_VTAB_RANGE
/begin COMPU_METHOD RTE_CM_ENUM_Ford_ElPw_D_Stat "" TAB_VERB "%.1" "" COMPU_TAB_REF RTE_CM_ENUM_Ford_ElPw_D_Stat /end COMPU_METHOD
/begin COMPU_VTAB_RANGE RTE_CM_ENUM_Ford_ElPw_D_Stat "" 9 0 7 "RANGE" 0 0 "Cx0_Not_Supported" 1 1 "Cx1_Supported" 2 2 "Cx2_Not_Supported_Imminent" 3 3 "Cx3_LV_Event_In_Progress" 4 4 "Cx4_Fault_Limited" 5 5 "Cx5_NotUsed_1" 6 6 "Cx6_NotUsed_2" 7 7 "Cx7_NotUsed_3" /end COMPU_VTAB_RANGE
/begin COMPU_METHOD RTE_CM_ENUM_Ford_Ignition_Status "" TAB_VERB "%.1" "" COMPU_TAB_REF RTE_CM_ENUM_Ford_Ignition_Status /end COMPU_METHOD
/begin COMPU_VTAB_RANGE RTE_CM_ENUM_Ford_Ignition_Status "" 7 0 15 "RANGE" 0 0 "Cx0_Unknown" 1 1 "Cx1_Off" 2 2 "Cx2_Accessory" 4 4 "Cx4_Run" 8 8 "Cx8_Start" 15 15 "CxF_Invalid" /end COMPU_VTAB_RANGE
/begin COMPU_METHOD RTE_CM_ENUM_Ford_LifeCycMde_D_Actl "" TAB_VERB "%.1" "" COMPU_TAB_REF RTE_CM_ENUM_Ford_LifeCycMde_D_Actl /end COMPU_METHOD
/begin COMPU_VTAB_RANGE RTE_CM_ENUM_Ford_LifeCycMde_D_Actl "" 5 0 15 "RANGE" 0 0 "Cx0_Normal" 1 1 "Cx1_Factory" 2 2 "Cx2_NotUsed" 3 3 "Cx3_Transport" /end COMPU_VTAB_RANGE
/begin COMPU_METHOD RTE_CM_ENUM_Ford_PwPckTq_D_Stat "" TAB_VERB "%.1" "" COMPU_TAB_REF RTE_CM_ENUM_Ford_PwPckTq_D_Stat /end COMPU_METHOD
/begin COMPU_VTAB_RANGE RTE_CM_ENUM_Ford_PwPckTq_D_Stat "" 5 0 3 "RANGE" 0 0 "Cx0_PwPckOff_TqNotAvailable" 1 1 "Cx1_PwPckOn_TqNotAvailable" 2 2 "Cx2_StartInPrgrss_TqNotAvail" 3 3 "Cx3_PwPckOn_TqAvailable" /end COMPU_VTAB_RANGE
/begin COMPU_METHOD RTE_CM_ENUM_Ford_StePinCompAnEst_D_Qf "" TAB_VERB "%.1" "" COMPU_TAB_REF RTE_CM_ENUM_Ford_StePinCompAnEst_D_Qf /end COMPU_METHOD
/begin COMPU_VTAB_RANGE RTE_CM_ENUM_Ford_StePinCompAnEst_D_Qf "" 5 0 3 "RANGE" 0 0 "Cx0_Faulty" 1 1 "Cx1_No_Data_Exists" 2 2 "Cx2_Degraded" 3 3 "Cx3_OK" /end COMPU_VTAB_RANGE
/begin COMPU_METHOD RTE_CM_ENUM_Ford_StePinOffst_D_Stat "" TAB_VERB "%.1" "" COMPU_TAB_REF RTE_CM_ENUM_Ford_StePinOffst_D_Stat /end COMPU_METHOD
/begin COMPU_VTAB_RANGE RTE_CM_ENUM_Ford_StePinOffst_D_Stat "" 5 0 3 "RANGE" 0 0 "Cx0_OffsetNotCalculated" 1 1 "Cx1_StoredOffset" 2 2 "Cx2_CoarseOffset" 3 3 "Cx3_FineOffset" /end COMPU_VTAB_RANGE
