/begin CHARACTERISTIC CDD_FordBlaBoxIfCmp1.ActvNiblCtrlDft "MICROSAR RTE" VAL_BLK 0x0 RTE_RL_UBYTE 0 NO_COMPU_METHOD 0 255 MATRIX_DIM 128 1 1 SYMBOL_LINK "Rte_CalprmRom_CDD_FordBlaBoxIfCmp1_DEFAULT_RTE_CDATA_GROUP.ActvNiblCtrlDft" 0 DISPLAY_IDENTIFIER CDD_FordBlaBoxIfCmp1.CalibrationParameters.ActvNiblCtrlDft /end CHARACTERISTIC
/begin CHARACTERISTIC CDD_FordBlaBoxIfCmp1.AssiMotTqWhlImbRejctnMinX.Ary2D "MICROSAR RTE" VAL_BLK 0x0 RTE_RL_UWORD 0 NO_COMPU_METHOD 0 65535 MATRIX_DIM 20 12 1 SYMBOL_LINK "Rte_CalprmRom_CalRegn02Rt00GroupA_DEFAULT_RTE_CALPRM_GROUP.AssiMotTqWhlImbRejctnMinX_Ary2D" 0 DISPLAY_IDENTIFIER CDD_FordBlaBoxIfCmp1.CalibrationPorts.AssiMotTqWhlImbRejctnMinX.Ary2D /end CHARACTERISTIC
/begin CHARACTERISTIC CDD_FordBlaBoxIfCmp1.AssiMotTqWhlImbRejctnMinY.Ary2D "MICROSAR RTE" VAL_BLK 0x0 RTE_RL_SWORD 0 NO_COMPU_METHOD -32768 32767 MATRIX_DIM 20 12 1 SYMBOL_LINK "Rte_CalprmRom_CalRegn02Rt00GroupA_DEFAULT_RTE_CALPRM_GROUP.AssiMotTqWhlImbRejctnMinY_Ary2D" 0 DISPLAY_IDENTIFIER CDD_FordBlaBoxIfCmp1.CalibrationPorts.AssiMotTqWhlImbRejctnMinY.Ary2D /end CHARACTERISTIC
/begin CHARACTERISTIC CDD_FordBlaBoxIfCmp1.LaneAssiDft "MICROSAR RTE" VAL_BLK 0x0 RTE_RL_UBYTE 0 NO_COMPU_METHOD 0 255 MATRIX_DIM 256 1 1 SYMBOL_LINK "Rte_CalprmRom_CDD_FordBlaBoxIfCmp1_DEFAULT_RTE_CDATA_GROUP.LaneAssiDft" 0 DISPLAY_IDENTIFIER CDD_FordBlaBoxIfCmp1.CalibrationParameters.LaneAssiDft /end CHARACTERISTIC
/begin CHARACTERISTIC CDD_FordBlaBoxIfCmp1.PullDriftCmpDft "MICROSAR RTE" VAL_BLK 0x0 RTE_RL_UBYTE 0 NO_COMPU_METHOD 0 255 MATRIX_DIM 128 1 1 SYMBOL_LINK "Rte_CalprmRom_CDD_FordBlaBoxIfCmp1_DEFAULT_RTE_CDATA_GROUP.PullDriftCmpDft" 0 DISPLAY_IDENTIFIER CDD_FordBlaBoxIfCmp1.CalibrationParameters.PullDriftCmpDft /end CHARACTERISTIC
/begin CHARACTERISTIC CDD_FordBlaBoxIfCmp1.SysGlbPrmSysKineRat.Val "MICROSAR RTE" VALUE 0x0 RTE_RL_FLOAT32_IEEE 0 NO_COMPU_METHOD -3.402823466e+38 3.402823466e+38 SYMBOL_LINK "Rte_CalprmRom_CalRegn02Inin00_DEFAULT_RTE_CALPRM_GROUP.SysGlbPrmSysKineRat_Val" 0 DISPLAY_IDENTIFIER CDD_FordBlaBoxIfCmp1.CalibrationPorts.SysGlbPrmSysKineRat.Val /end CHARACTERISTIC
/begin CHARACTERISTIC CDD_FordBlaBoxIfCmp1.SysGlbPrmVehSpdBilnrSeln.Ary1D "MICROSAR RTE" VAL_BLK 0x0 RTE_RL_UWORD 0 NO_COMPU_METHOD 0 65535 MATRIX_DIM 12 1 1 SYMBOL_LINK "Rte_CalprmRom_CalRegn01Inin00_DEFAULT_RTE_CALPRM_GROUP.SysGlbPrmVehSpdBilnrSeln_Ary1D" 0 DISPLAY_IDENTIFIER CDD_FordBlaBoxIfCmp1.CalibrationPorts.SysGlbPrmVehSpdBilnrSeln.Ary1D /end CHARACTERISTIC
/begin CHARACTERISTIC CDD_FordBlaBoxIfCmp1.TrlrBackupAssiDft "MICROSAR RTE" VAL_BLK 0x0 RTE_RL_UBYTE 0 NO_COMPU_METHOD 0 255 MATRIX_DIM 512 1 1 SYMBOL_LINK "Rte_CalprmRom_CDD_FordBlaBoxIfCmp1_DEFAULT_RTE_CDATA_GROUP.TrlrBackupAssiDft" 0 DISPLAY_IDENTIFIER CDD_FordBlaBoxIfCmp1.CalibrationParameters.TrlrBackupAssiDft /end CHARACTERISTIC
/begin CHARACTERISTIC CDD_GtmCfgAndUse.CurrMeasEolFixdPwmPerd.Val "MICROSAR RTE" VALUE 0x0 RTE_RL_ULONG 0 NO_COMPU_METHOD 0 4294967295 SYMBOL_LINK "Rte_CalprmRom_CalRegn01Cmn_DEFAULT_RTE_CALPRM_GROUP.CurrMeasEolFixdPwmPerd_Val" 0 DISPLAY_IDENTIFIER CDD_GtmCfgAndUse.CalibrationPorts.CurrMeasEolFixdPwmPerd.Val /end CHARACTERISTIC
/begin CHARACTERISTIC CDD_GtmCfgAndUse.CurrMeasEolOffsHiCmuOffs.Val "MICROSAR RTE" VALUE 0x0 RTE_RL_ULONG 0 NO_COMPU_METHOD 0 4294967295 SYMBOL_LINK "Rte_CalprmRom_CalRegn01Cmn_DEFAULT_RTE_CALPRM_GROUP.CurrMeasEolOffsHiCmuOffs_Val" 0 DISPLAY_IDENTIFIER CDD_GtmCfgAndUse.CalibrationPorts.CurrMeasEolOffsHiCmuOffs.Val /end CHARACTERISTIC
/begin CHARACTERISTIC CDD_GtmCfgAndUse.CurrMeasEolOffsLoCmuOffs.Val "MICROSAR RTE" VALUE 0x0 RTE_RL_ULONG 0 NO_COMPU_METHOD 0 4294967295 SYMBOL_LINK "Rte_CalprmRom_CalRegn01Cmn_DEFAULT_RTE_CALPRM_GROUP.CurrMeasEolOffsLoCmuOffs_Val" 0 DISPLAY_IDENTIFIER CDD_GtmCfgAndUse.CalibrationPorts.CurrMeasEolOffsLoCmuOffs.Val /end CHARACTERISTIC
/begin CHARACTERISTIC CDD_GtmCfgAndUse.GtmCfgAndUseAdcStrtOfCnvn2Offs.Val "MICROSAR RTE" VALUE 0x0 RTE_RL_ULONG 0 NO_COMPU_METHOD 0 4294967295 SYMBOL_LINK "Rte_CalprmRom_CalRegn01Cmn_DEFAULT_RTE_CALPRM_GROUP.GtmCfgAndUseAdcStrtOfCnvn2Offs_Val" 0 DISPLAY_IDENTIFIER CDD_GtmCfgAndUse.CalibrationPorts.GtmCfgAndUseAdcStrtOfCnvn2Offs.Val /end CHARACTERISTIC
/begin CHARACTERISTIC CDD_GtmCfgAndUse.GtmCfgAndUseAdcStrtOfCnvnPeakOffs.Val "MICROSAR RTE" VALUE 0x0 RTE_RL_ULONG 0 NO_COMPU_METHOD 0 4294967295 SYMBOL_LINK "Rte_CalprmRom_CalRegn01Cmn_DEFAULT_RTE_CALPRM_GROUP.GtmCfgAndUseAdcStrtOfCnvnPeakOffs_Val" 0 DISPLAY_IDENTIFIER CDD_GtmCfgAndUse.CalibrationPorts.GtmCfgAndUseAdcStrtOfCnvnPeakOffs.Val /end CHARACTERISTIC
/begin CHARACTERISTIC CDD_GtmCfgAndUse.GtmCfgAndUseDma2MilliSecToMotCtrlTrig.Val "MICROSAR RTE" VALUE 0x0 RTE_RL_ULONG 0 NO_COMPU_METHOD 0 4294967295 SYMBOL_LINK "Rte_CalprmRom_CalRegn01Cmn_DEFAULT_RTE_CALPRM_GROUP.GtmCfgAndUseDma2MilliSecToMotCtrlTrig_Val" 0 DISPLAY_IDENTIFIER CDD_GtmCfgAndUse.CalibrationPorts.GtmCfgAndUseDma2MilliSecToMotCtrlTrig.Val /end CHARACTERISTIC
/begin CHARACTERISTIC CDD_GtmCfgAndUse.GtmCfgAndUseDmaMotAgATrig.Val "MICROSAR RTE" VALUE 0x0 RTE_RL_ULONG 0 NO_COMPU_METHOD 0 4294967295 SYMBOL_LINK "Rte_CalprmRom_CalRegn01Cmn_DEFAULT_RTE_CALPRM_GROUP.GtmCfgAndUseDmaMotAgATrig_Val" 0 DISPLAY_IDENTIFIER CDD_GtmCfgAndUse.CalibrationPorts.GtmCfgAndUseDmaMotAgATrig.Val /end CHARACTERISTIC
/begin CHARACTERISTIC CDD_GtmCfgAndUse.GtmCfgAndUseDmaMotCtrlTo2MilliSecTrig.Val "MICROSAR RTE" VALUE 0x0 RTE_RL_ULONG 0 NO_COMPU_METHOD 0 4294967295 SYMBOL_LINK "Rte_CalprmRom_CalRegn01Cmn_DEFAULT_RTE_CALPRM_GROUP.GtmCfgAndUseDmaMotCtrlTo2MilliSecTrig_Val" 0 DISPLAY_IDENTIFIER CDD_GtmCfgAndUse.CalibrationPorts.GtmCfgAndUseDmaMotCtrlTo2MilliSecTrig.Val /end CHARACTERISTIC
/begin CHARACTERISTIC CDD_GtmCfgAndUse.GtmCfgAndUsePwmDbnd.Val "MICROSAR RTE" VALUE 0x0 RTE_RL_ULONG 0 NO_COMPU_METHOD 0 4294967295 SYMBOL_LINK "Rte_CalprmRom_CalRegn01Cmn_DEFAULT_RTE_CALPRM_GROUP.GtmCfgAndUsePwmDbnd_Val" 0 DISPLAY_IDENTIFIER CDD_GtmCfgAndUse.CalibrationPorts.GtmCfgAndUsePwmDbnd.Val /end CHARACTERISTIC
/begin CHARACTERISTIC CDD_HwTq1Meas.HwTq1MeasHwTq1PrtclFltFailStep.Val "MICROSAR RTE" VALUE 0x0 RTE_RL_UWORD 0 NO_COMPU_METHOD 0 65535 SYMBOL_LINK "Rte_CalprmRom_CalRegn01Inin00_DEFAULT_RTE_CALPRM_GROUP.HwTq1MeasHwTq1PrtclFltFailStep_Val" 0 DISPLAY_IDENTIFIER CDD_HwTq1Meas.CalibrationPorts.HwTq1MeasHwTq1PrtclFltFailStep.Val /end CHARACTERISTIC
/begin CHARACTERISTIC CDD_HwTq1Meas.HwTq1MeasHwTq1PrtclFltPassStep.Val "MICROSAR RTE" VALUE 0x0 RTE_RL_UWORD 0 NO_COMPU_METHOD 0 65535 SYMBOL_LINK "Rte_CalprmRom_CalRegn01Inin00_DEFAULT_RTE_CALPRM_GROUP.HwTq1MeasHwTq1PrtclFltPassStep_Val" 0 DISPLAY_IDENTIFIER CDD_HwTq1Meas.CalibrationPorts.HwTq1MeasHwTq1PrtclFltPassStep.Val /end CHARACTERISTIC
/begin CHARACTERISTIC CDD_HwTq1Meas.HwTq1OffsDft.OffsTrim "MICROSAR RTE" VALUE 0x0 RTE_RL_FLOAT32_IEEE 0 NO_COMPU_METHOD -3.402823466e+38 3.402823466e+38 SYMBOL_LINK "Rte_CalprmRom_CDD_HwTq1Meas_DEFAULT_RTE_CDATA_GROUP.HwTq1OffsDft.OffsTrim" 0 DISPLAY_IDENTIFIER CDD_HwTq1Meas.CalibrationParameters.HwTq1OffsDft.OffsTrim /end CHARACTERISTIC
/begin CHARACTERISTIC CDD_HwTq1Meas.HwTq1OffsDft.OffsTrimPrfmdSts "MICROSAR RTE" VALUE 0x0 RTE_RL_BOOLEAN 0 RTE_CM_BOOLEAN 0 255 SYMBOL_LINK "Rte_CalprmRom_CDD_HwTq1Meas_DEFAULT_RTE_CDATA_GROUP.HwTq1OffsDft.OffsTrimPrfmdSts" 0 DISPLAY_IDENTIFIER CDD_HwTq1Meas.CalibrationParameters.HwTq1OffsDft.OffsTrimPrfmdSts /end CHARACTERISTIC
/begin CHARACTERISTIC CDD_HwTq8Meas.HwTq8MeasHwTq8PrtclFltFailStep.Val "MICROSAR RTE" VALUE 0x0 RTE_RL_UWORD 0 NO_COMPU_METHOD 0 65535 SYMBOL_LINK "Rte_CalprmRom_CalRegn01Inin00_DEFAULT_RTE_CALPRM_GROUP.HwTq8MeasHwTq8PrtclFltFailStep_Val" 0 DISPLAY_IDENTIFIER CDD_HwTq8Meas.CalibrationPorts.HwTq8MeasHwTq8PrtclFltFailStep.Val /end CHARACTERISTIC
/begin CHARACTERISTIC CDD_HwTq8Meas.HwTq8MeasHwTq8PrtclFltPassStep.Val "MICROSAR RTE" VALUE 0x0 RTE_RL_UWORD 0 NO_COMPU_METHOD 0 65535 SYMBOL_LINK "Rte_CalprmRom_CalRegn01Inin00_DEFAULT_RTE_CALPRM_GROUP.HwTq8MeasHwTq8PrtclFltPassStep_Val" 0 DISPLAY_IDENTIFIER CDD_HwTq8Meas.CalibrationPorts.HwTq8MeasHwTq8PrtclFltPassStep.Val /end CHARACTERISTIC
/begin CHARACTERISTIC CDD_HwTq8Meas.HwTq8OffsDft.OffsTrim "MICROSAR RTE" VALUE 0x0 RTE_RL_FLOAT32_IEEE 0 NO_COMPU_METHOD -3.402823466e+38 3.402823466e+38 SYMBOL_LINK "Rte_CalprmRom_CDD_HwTq8Meas_DEFAULT_RTE_CDATA_GROUP.HwTq8OffsDft.OffsTrim" 0 DISPLAY_IDENTIFIER CDD_HwTq8Meas.CalibrationParameters.HwTq8OffsDft.OffsTrim /end CHARACTERISTIC
/begin CHARACTERISTIC CDD_HwTq8Meas.HwTq8OffsDft.OffsTrimPrfmdSts "MICROSAR RTE" VALUE 0x0 RTE_RL_BOOLEAN 0 RTE_CM_BOOLEAN 0 255 SYMBOL_LINK "Rte_CalprmRom_CDD_HwTq8Meas_DEFAULT_RTE_CDATA_GROUP.HwTq8OffsDft.OffsTrimPrfmdSts" 0 DISPLAY_IDENTIFIER CDD_HwTq8Meas.CalibrationParameters.HwTq8OffsDft.OffsTrimPrfmdSts /end CHARACTERISTIC
/begin CHARACTERISTIC CDD_McuDiagc.McuDiagc2MilliSecCntrCompThd.Val "MICROSAR RTE" VALUE 0x0 RTE_RL_UWORD 0 NO_COMPU_METHOD 0 65535 SYMBOL_LINK "Rte_CalprmRom_CalRegn01Inin00_DEFAULT_RTE_CALPRM_GROUP.McuDiagc2MilliSecCntrCompThd_Val" 0 DISPLAY_IDENTIFIER CDD_McuDiagc.CalibrationPorts.McuDiagc2MilliSecCntrCompThd.Val /end CHARACTERISTIC
/begin CHARACTERISTIC CDD_McuDiagc.McuDiagcFltFailStep.Val "MICROSAR RTE" VALUE 0x0 RTE_RL_UWORD 0 NO_COMPU_METHOD 0 65535 SYMBOL_LINK "Rte_CalprmRom_CalRegn01Inin00_DEFAULT_RTE_CALPRM_GROUP.McuDiagcFltFailStep_Val" 0 DISPLAY_IDENTIFIER CDD_McuDiagc.CalibrationPorts.McuDiagcFltFailStep.Val /end CHARACTERISTIC
/begin CHARACTERISTIC CDD_McuDiagc.McuDiagcFltPassStep.Val "MICROSAR RTE" VALUE 0x0 RTE_RL_UWORD 0 NO_COMPU_METHOD 0 65535 SYMBOL_LINK "Rte_CalprmRom_CalRegn01Inin00_DEFAULT_RTE_CALPRM_GROUP.McuDiagcFltPassStep_Val" 0 DISPLAY_IDENTIFIER CDD_McuDiagc.CalibrationPorts.McuDiagcFltPassStep.Val /end CHARACTERISTIC
/begin MEASUREMENT CDD_FordBlaBoxIfCmn.FordVehYawRateCmpdRaw.Val "MICROSAR RTE" UWORD NO_COMPU_METHOD 0 0 0 65535 ECU_ADDRESS 0 SYMBOL_LINK "Rte_FordMsg077BusHiSpd_FordVehYawRateCmpdRaw_Val" 0 DISPLAY_IDENTIFIER CDD_FordBlaBoxIfCmn.ReceiverPorts.FordVehYawRateCmpdRaw.Val /end MEASUREMENT
/begin MEASUREMENT CDD_FordBlaBoxIfCmn.FordVehYawRateRaw.Ford_VehYaw_W_Actl "MICROSAR RTE" UWORD RTE_CM_Ford_VehYaw_W_Actl 0 0 -6.5 6.607 ECU_ADDRESS 0 SYMBOL_LINK "Rte_FordMsg091BusHiSpd_FordVehYawRateRaw_Ford_VehYaw_W_Actl" 0 DISPLAY_IDENTIFIER CDD_FordBlaBoxIfCmn.ReceiverPorts.FordVehYawRateRaw.Ford_VehYaw_W_Actl /end MEASUREMENT
/begin MEASUREMENT CDD_FordBlaBoxIfCmn.FordVehYawRateRawVld.Logl "MICROSAR RTE" UBYTE RTE_CM_BOOLEAN 0 0 0 255 ECU_ADDRESS 0 SYMBOL_LINK "Rte_FordMsg091BusHiSpd_FordVehYawRateRawVld_Logl" 0 DISPLAY_IDENTIFIER CDD_FordBlaBoxIfCmn.ReceiverPorts.FordVehYawRateRawVld.Logl /end MEASUREMENT
/begin MEASUREMENT CDD_FordBlaBoxIfCmn.FordVehYawRateVld.Logl "MICROSAR RTE" UBYTE RTE_CM_BOOLEAN 0 0 0 255 ECU_ADDRESS 0 SYMBOL_LINK "Rte_CDD_FordBlaBoxIfCmn_FordVehYawRateVld_Logl" 0 DISPLAY_IDENTIFIER CDD_FordBlaBoxIfCmn.ReceiverPorts.FordVehYawRateVld.Logl /end MEASUREMENT
/begin MEASUREMENT CDD_FordBlaBoxIfCmn.FordVehYawStabyRaw.Val "MICROSAR RTE" UWORD NO_COMPU_METHOD 0 0 0 65535 ECU_ADDRESS 0 SYMBOL_LINK "Rte_FordMsg4B0BusHiSpd_FordVehYawStabyRaw_Val" 0 DISPLAY_IDENTIFIER CDD_FordBlaBoxIfCmn.ReceiverPorts.FordVehYawStabyRaw.Val /end MEASUREMENT
/begin MEASUREMENT CDD_FordBlaBoxIfCmn.FordVehYawStabyVld.Logl "MICROSAR RTE" UBYTE RTE_CM_BOOLEAN 0 0 0 255 ECU_ADDRESS 0 SYMBOL_LINK "Rte_FordMsg4B0BusHiSpd_FordVehYawStabyVld_Logl" 0 DISPLAY_IDENTIFIER CDD_FordBlaBoxIfCmn.ReceiverPorts.FordVehYawStabyVld.Logl /end MEASUREMENT
/begin MEASUREMENT CDD_FordBlaBoxIfCmn.FordYawRateSnsrIdHi.Val "MICROSAR RTE" ULONG NO_COMPU_METHOD 0 0 0 4294967295 ECU_ADDRESS 0 SYMBOL_LINK "Rte_CDD_FordBlaBoxIfCmn_FordYawRateSnsrIdHi_Val" 0 DISPLAY_IDENTIFIER CDD_FordBlaBoxIfCmn.ReceiverPorts.FordYawRateSnsrIdHi.Val /end MEASUREMENT
/begin MEASUREMENT CDD_FordBlaBoxIfCmn.FordYawRateSnsrIdLo.Val "MICROSAR RTE" ULONG NO_COMPU_METHOD 0 0 0 4294967295 ECU_ADDRESS 0 SYMBOL_LINK "Rte_CDD_FordBlaBoxIfCmn_FordYawRateSnsrIdLo_Val" 0 DISPLAY_IDENTIFIER CDD_FordBlaBoxIfCmn.ReceiverPorts.FordYawRateSnsrIdLo.Val /end MEASUREMENT
/begin MEASUREMENT CDD_FordBlaBoxIfCmn.HwVel.Val "MICROSAR RTE" FLOAT32_IEEE NO_COMPU_METHOD 0 0 -3.402823466e+38 3.402823466e+38 ECU_ADDRESS 0 SYMBOL_LINK "Rte_HwAgSysArbn_HwVel_Val" 0 DISPLAY_IDENTIFIER CDD_FordBlaBoxIfCmn.ReceiverPorts.HwVel.Val /end MEASUREMENT
/begin MEASUREMENT CDD_FordBlaBoxIfCmn.IntAgCtrlSt.Val "MICROSAR RTE" UBYTE NO_COMPU_METHOD 0 0 0 255 ECU_ADDRESS 0 SYMBOL_LINK "Rte_CDD_FordBlaBoxIfCmn_IntAgCtrlSt_Val" 0 DISPLAY_IDENTIFIER CDD_FordBlaBoxIfCmn.ReceiverPorts.IntAgCtrlSt.Val /end MEASUREMENT
/begin MEASUREMENT CDD_FordBlaBoxIfCmn.RackToPinionRat.Val "MICROSAR RTE" UWORD NO_COMPU_METHOD 0 0 0 65535 ECU_ADDRESS 0 SYMBOL_LINK "Rte_CDD_FordBlaBoxIfCmn_RackToPinionRat_Val" 0 DISPLAY_IDENTIFIER CDD_FordBlaBoxIfCmn.ReceiverPorts.RackToPinionRat.Val /end MEASUREMENT
/begin MEASUREMENT CDD_FordBlaBoxIfCmn.SelnDrvgModSteerModReq.Val "MICROSAR RTE" UBYTE NO_COMPU_METHOD 0 0 0 255 ECU_ADDRESS 0 SYMBOL_LINK "Rte_CDD_FordBlaBoxIfCmn_SelnDrvgModSteerModReq_Val" 0 DISPLAY_IDENTIFIER CDD_FordBlaBoxIfCmn.ReceiverPorts.SelnDrvgModSteerModReq.Val /end MEASUREMENT
/begin MEASUREMENT CDD_FordBlaBoxIfCmn.SemiAutParlParkAgCtrlSts1.Val "MICROSAR RTE" UBYTE NO_COMPU_METHOD 0 0 0 255 ECU_ADDRESS 0 SYMBOL_LINK "Rte_CDD_FordBlaBoxIfCmn_SemiAutParlParkAgCtrlSts1_Val" 0 DISPLAY_IDENTIFIER CDD_FordBlaBoxIfCmn.ReceiverPorts.SemiAutParlParkAgCtrlSts1.Val /end MEASUREMENT
/begin MEASUREMENT CDD_FordBlaBoxIfCmn.SemiAutParlParkAgCtrlSts2.Logl "MICROSAR RTE" UBYTE RTE_CM_BOOLEAN 0 0 0 255 ECU_ADDRESS 0 SYMBOL_LINK "Rte_CDD_FordBlaBoxIfCmn_SemiAutParlParkAgCtrlSts2_Logl" 0 DISPLAY_IDENTIFIER CDD_FordBlaBoxIfCmn.ReceiverPorts.SemiAutParlParkAgCtrlSts2.Logl /end MEASUREMENT
/begin MEASUREMENT CDD_FordBlaBoxIfCmn.SemiAutParlParkAgCtrlSts3.Logl "MICROSAR RTE" UBYTE RTE_CM_BOOLEAN 0 0 0 255 ECU_ADDRESS 0 SYMBOL_LINK "Rte_CDD_FordBlaBoxIfCmn_SemiAutParlParkAgCtrlSts3_Logl" 0 DISPLAY_IDENTIFIER CDD_FordBlaBoxIfCmn.ReceiverPorts.SemiAutParlParkAgCtrlSts3.Logl /end MEASUREMENT
/begin MEASUREMENT CDD_FordBlaBoxIfCmn.SemiAutParlParkAgCtrlSts4.Logl "MICROSAR RTE" UBYTE RTE_CM_BOOLEAN 0 0 0 255 ECU_ADDRESS 0 SYMBOL_LINK "Rte_CDD_FordBlaBoxIfCmn_SemiAutParlParkAgCtrlSts4_Logl" 0 DISPLAY_IDENTIFIER CDD_FordBlaBoxIfCmn.ReceiverPorts.SemiAutParlParkAgCtrlSts4.Logl /end MEASUREMENT
/begin MEASUREMENT CDD_FordBlaBoxIfCmn.SemiAutParlParkAgCtrlSts5.Logl "MICROSAR RTE" UBYTE RTE_CM_BOOLEAN 0 0 0 255 ECU_ADDRESS 0 SYMBOL_LINK "Rte_CDD_FordBlaBoxIfCmn_SemiAutParlParkAgCtrlSts5_Logl" 0 DISPLAY_IDENTIFIER CDD_FordBlaBoxIfCmn.ReceiverPorts.SemiAutParlParkAgCtrlSts5.Logl /end MEASUREMENT
/begin MEASUREMENT CDD_FordBlaBoxIfCmn.TrlrBackupAssiEnaVld.Logl "MICROSAR RTE" UBYTE RTE_CM_BOOLEAN 0 0 0 255 ECU_ADDRESS 0 SYMBOL_LINK "Rte_CDD_FordBlaBoxIfCmn_TrlrBackupAssiEnaVld_Logl" 0 DISPLAY_IDENTIFIER CDD_FordBlaBoxIfCmn.ReceiverPorts.TrlrBackupAssiEnaVld.Logl /end MEASUREMENT
/begin MEASUREMENT CDD_FordBlaBoxIfCmn.TrlrBackupAssiRvsVld.Logl "MICROSAR RTE" UBYTE RTE_CM_BOOLEAN 0 0 0 255 ECU_ADDRESS 0 SYMBOL_LINK "Rte_CDD_FordBlaBoxIfCmn_TrlrBackupAssiRvsVld_Logl" 0 DISPLAY_IDENTIFIER CDD_FordBlaBoxIfCmn.ReceiverPorts.TrlrBackupAssiRvsVld.Logl /end MEASUREMENT
/begin MEASUREMENT CDD_FordBlaBoxIfCmn.TrlrBackupAssiYawRateVld.Logl "MICROSAR RTE" UBYTE RTE_CM_BOOLEAN 0 0 0 255 ECU_ADDRESS 0 SYMBOL_LINK "Rte_CDD_FordBlaBoxIfCmn_TrlrBackupAssiYawRateVld_Logl" 0 DISPLAY_IDENTIFIER CDD_FordBlaBoxIfCmn.ReceiverPorts.TrlrBackupAssiYawRateVld.Logl /end MEASUREMENT
/begin MEASUREMENT CDD_FordBlaBoxIfCmn.VehSpd.Val "MICROSAR RTE" FLOAT32_IEEE NO_COMPU_METHOD 0 0 -3.402823466e+38 3.402823466e+38 ECU_ADDRESS 0 SYMBOL_LINK "Rte_ImcSigArbn_VehSpdImcCorrd_Val" 0 DISPLAY_IDENTIFIER CDD_FordBlaBoxIfCmn.ReceiverPorts.VehSpd.Val /end MEASUREMENT
/begin MEASUREMENT CDD_FordBlaBoxIfCmn.VehSpdVld.Logl "MICROSAR RTE" UBYTE RTE_CM_BOOLEAN 0 0 0 255 ECU_ADDRESS 0 SYMBOL_LINK "Rte_VehSigCdng_VehSpdVld_Logl" 0 DISPLAY_IDENTIFIER CDD_FordBlaBoxIfCmn.ReceiverPorts.VehSpdVld.Logl /end MEASUREMENT
/begin MEASUREMENT CDD_FordBlaBoxIfCmn.VehSteerRat.Val "MICROSAR RTE" UWORD NO_COMPU_METHOD 0 0 0 65535 ECU_ADDRESS 0 SYMBOL_LINK "Rte_CDD_FordBlaBoxIfCmn_VehSteerRat_Val" 0 DISPLAY_IDENTIFIER CDD_FordBlaBoxIfCmn.ReceiverPorts.VehSteerRat.Val /end MEASUREMENT
/begin MEASUREMENT CDD_FordBlaBoxIfCmn.VehWhlBas.Val "MICROSAR RTE" UWORD NO_COMPU_METHOD 0 0 0 65535 ECU_ADDRESS 0 SYMBOL_LINK "Rte_CDD_FordBlaBoxIfCmn_VehWhlBas_Val" 0 DISPLAY_IDENTIFIER CDD_FordBlaBoxIfCmn.ReceiverPorts.VehWhlBas.Val /end MEASUREMENT
/begin MEASUREMENT CDD_FordBlaBoxIfCmn.VertAVld.Logl "MICROSAR RTE" UBYTE RTE_CM_BOOLEAN 0 0 0 255 ECU_ADDRESS 0 SYMBOL_LINK "Rte_CDD_FordBlaBoxIfCmn_VertAVld_Logl" 0 DISPLAY_IDENTIFIER CDD_FordBlaBoxIfCmn.ReceiverPorts.VertAVld.Logl /end MEASUREMENT
/begin MEASUREMENT CDD_FordBlaBoxIfCmp1.ActvNiblCmpIntSts.Val "MICROSAR RTE" ULONG NO_COMPU_METHOD 0 0 0 4294967295 ECU_ADDRESS 0 SYMBOL_LINK "Rte_CDD_FordBlaBoxIfCmp1_ActvNiblCmpIntSts_Val" 0 DISPLAY_IDENTIFIER CDD_FordBlaBoxIfCmp1.SenderPorts.ActvNiblCmpIntSts.Val /end MEASUREMENT
/begin MEASUREMENT CDD_FordBlaBoxIfCmp1.ActvNiblCtrl "MICROSAR RTE" UBYTE NO_COMPU_METHOD 0 0 0 255 MATRIX_DIM 128 1 1 ECU_ADDRESS 0 SYMBOL_LINK "Rte_CDD_FordBlaBoxIfCmp1_ActvNiblCtrl" 0 DISPLAY_IDENTIFIER CDD_FordBlaBoxIfCmp1.PerInstanceMemories.ActvNiblCtrl /end MEASUREMENT
/begin MEASUREMENT CDD_FordBlaBoxIfCmp1.EcuId.Val "MICROSAR RTE" UBYTE NO_COMPU_METHOD 0 0 0 255 ECU_ADDRESS 0 SYMBOL_LINK "Rte_DualEcuIdn_EcuId_Val" 0 DISPLAY_IDENTIFIER CDD_FordBlaBoxIfCmp1.ReceiverPorts.EcuId.Val /end MEASUREMENT
/begin MEASUREMENT CDD_FordBlaBoxIfCmp1.FordActvNiblCtrlDiagcSts.Val "MICROSAR RTE" UBYTE NO_COMPU_METHOD 0 0 0 255 ECU_ADDRESS 0 SYMBOL_LINK "Rte_CDD_FordBlaBoxIfCmp1_FordActvNiblCtrlDiagcSts_Val" 0 DISPLAY_IDENTIFIER CDD_FordBlaBoxIfCmp1.ReceiverPorts.FordActvNiblCtrlDiagcSts.Val /end MEASUREMENT
/begin MEASUREMENT CDD_FordBlaBoxIfCmp1.FordActvNiblCtrlSwVers.Val "MICROSAR RTE" ULONG NO_COMPU_METHOD 0 0 0 4294967295 ECU_ADDRESS 0 SYMBOL_LINK "Rte_CDD_FordBlaBoxIfCmp1_FordActvNiblCtrlSwVers_Val" 0 DISPLAY_IDENTIFIER CDD_FordBlaBoxIfCmp1.SenderPorts.FordActvNiblCtrlSwVers.Val /end MEASUREMENT
/begin MEASUREMENT CDD_FordBlaBoxIfCmp1.FordActvNiblCtrlTqReq.Val "MICROSAR RTE" FLOAT32_IEEE NO_COMPU_METHOD 0 0 -3.402823466e+38 3.402823466e+38 ECU_ADDRESS 0 SYMBOL_LINK "Rte_CDD_FordBlaBoxIfCmp1_FordActvNiblCtrlTqReq_Val" 0 DISPLAY_IDENTIFIER CDD_FordBlaBoxIfCmp1.SenderPorts.FordActvNiblCtrlTqReq.Val /end MEASUREMENT
/begin MEASUREMENT CDD_FordBlaBoxIfCmp1.FordBlaBoxSwVers.Val "MICROSAR RTE" ULONG NO_COMPU_METHOD 0 0 0 4294967295 ECU_ADDRESS 0 SYMBOL_LINK "Rte_CDD_FordBlaBoxIfCmp1_FordBlaBoxSwVers_Val" 0 DISPLAY_IDENTIFIER CDD_FordBlaBoxIfCmp1.SenderPorts.FordBlaBoxSwVers.Val /end MEASUREMENT
/begin MEASUREMENT CDD_FordBlaBoxIfCmp1.FordLaneAssiSwVers.Val "MICROSAR RTE" ULONG NO_COMPU_METHOD 0 0 0 4294967295 ECU_ADDRESS 0 SYMBOL_LINK "Rte_CDD_FordBlaBoxIfCmp1_FordLaneAssiSwVers_Val" 0 DISPLAY_IDENTIFIER CDD_FordBlaBoxIfCmp1.SenderPorts.FordLaneAssiSwVers.Val /end MEASUREMENT
/begin MEASUREMENT CDD_FordBlaBoxIfCmp1.FordLaneDprtrWarnTqReq.Val "MICROSAR RTE" FLOAT32_IEEE NO_COMPU_METHOD 0 0 -3.402823466e+38 3.402823466e+38 ECU_ADDRESS 0 SYMBOL_LINK "Rte_CDD_FordBlaBoxIfCmp1_FordLaneDprtrWarnTqReq_Val" 0 DISPLAY_IDENTIFIER CDD_FordBlaBoxIfCmp1.SenderPorts.FordLaneDprtrWarnTqReq.Val /end MEASUREMENT
/begin MEASUREMENT CDD_FordBlaBoxIfCmp1.FordLaneKeepAssiTqReq.Val "MICROSAR RTE" FLOAT32_IEEE NO_COMPU_METHOD 0 0 -3.402823466e+38 3.402823466e+38 ECU_ADDRESS 0 SYMBOL_LINK "Rte_CDD_FordBlaBoxIfCmp1_FordLaneKeepAssiTqReq_Val" 0 DISPLAY_IDENTIFIER CDD_FordBlaBoxIfCmp1.SenderPorts.FordLaneKeepAssiTqReq.Val /end MEASUREMENT
/begin MEASUREMENT CDD_FordBlaBoxIfCmp1.FordLatCtrlTqReq.Val "MICROSAR RTE" FLOAT32_IEEE NO_COMPU_METHOD 0 0 -3.402823466e+38 3.402823466e+38 ECU_ADDRESS 0 SYMBOL_LINK "Rte_CDD_FordBlaBoxIfCmp1_FordLatCtrlTqReq_Val" 0 DISPLAY_IDENTIFIER CDD_FordBlaBoxIfCmp1.SenderPorts.FordLatCtrlTqReq.Val /end MEASUREMENT
/begin MEASUREMENT CDD_FordBlaBoxIfCmp1.FordPullDriftCmpSwVers.Val "MICROSAR RTE" ULONG NO_COMPU_METHOD 0 0 0 4294967295 ECU_ADDRESS 0 SYMBOL_LINK "Rte_CDD_FordBlaBoxIfCmp1_FordPullDriftCmpSwVers_Val" 0 DISPLAY_IDENTIFIER CDD_FordBlaBoxIfCmp1.SenderPorts.FordPullDriftCmpSwVers.Val /end MEASUREMENT
/begin MEASUREMENT CDD_FordBlaBoxIfCmp1.FordPullDriftCmpTqReq.Val "MICROSAR RTE" FLOAT32_IEEE NO_COMPU_METHOD 0 0 -3.402823466e+38 3.402823466e+38 ECU_ADDRESS 0 SYMBOL_LINK "Rte_CDD_FordBlaBoxIfCmp1_FordPullDriftCmpTqReq_Val" 0 DISPLAY_IDENTIFIER CDD_FordBlaBoxIfCmp1.SenderPorts.FordPullDriftCmpTqReq.Val /end MEASUREMENT
/begin MEASUREMENT CDD_FordBlaBoxIfCmp1.FordResrchFctSwVers.Val "MICROSAR RTE" ULONG NO_COMPU_METHOD 0 0 0 4294967295 ECU_ADDRESS 0 SYMBOL_LINK "Rte_CDD_FordBlaBoxIfCmp1_FordResrchFctSwVers_Val" 0 DISPLAY_IDENTIFIER CDD_FordBlaBoxIfCmp1.SenderPorts.FordResrchFctSwVers.Val /end MEASUREMENT
/begin MEASUREMENT CDD_FordBlaBoxIfCmp1.FordSrvLaneDprtrWarnDiagcSts.Val "MICROSAR RTE" UBYTE NO_COMPU_METHOD 0 0 0 255 ECU_ADDRESS 0 SYMBOL_LINK "Rte_CDD_FordBlaBoxIfCmp1_FordSrvLaneDprtrWarnDiagcSts_Val" 0 DISPLAY_IDENTIFIER CDD_FordBlaBoxIfCmp1.ReceiverPorts.FordSrvLaneDprtrWarnDiagcSts.Val /end MEASUREMENT
/begin MEASUREMENT CDD_FordBlaBoxIfCmp1.FordSrvPullDriftCmpRstVal.Val "MICROSAR RTE" SWORD NO_COMPU_METHOD 0 0 -32768 32767 ECU_ADDRESS 0 SYMBOL_LINK "Rte_CustDiag_FordSrvPullDriftCmpRstVal_Val" 0 DISPLAY_IDENTIFIER CDD_FordBlaBoxIfCmp1.ReceiverPorts.FordSrvPullDriftCmpRstVal.Val /end MEASUREMENT
/begin MEASUREMENT CDD_FordBlaBoxIfCmp1.FordTrlrBackupAssiSwVers.Val "MICROSAR RTE" ULONG NO_COMPU_METHOD 0 0 0 4294967295 ECU_ADDRESS 0 SYMBOL_LINK "Rte_CDD_FordBlaBoxIfCmp1_FordTrlrBackupAssiSwVers_Val" 0 DISPLAY_IDENTIFIER CDD_FordBlaBoxIfCmp1.SenderPorts.FordTrlrBackupAssiSwVers.Val /end MEASUREMENT
/begin MEASUREMENT CDD_FordBlaBoxIfCmp1.FordVehBBMsgOutp1HiPart.Val "MICROSAR RTE" ULONG NO_COMPU_METHOD 0 0 0 4294967295 ECU_ADDRESS 0 SYMBOL_LINK "Rte_CDD_FordBlaBoxIfCmp1_FordVehBBMsgOutp1HiPart_Val" 0 DISPLAY_IDENTIFIER CDD_FordBlaBoxIfCmp1.SenderPorts.FordVehBBMsgOutp1HiPart.Val /end MEASUREMENT
/begin MEASUREMENT CDD_FordBlaBoxIfCmp1.FordVehBBMsgOutp1LoPart.Val "MICROSAR RTE" ULONG NO_COMPU_METHOD 0 0 0 4294967295 ECU_ADDRESS 0 SYMBOL_LINK "Rte_CDD_FordBlaBoxIfCmp1_FordVehBBMsgOutp1LoPart_Val" 0 DISPLAY_IDENTIFIER CDD_FordBlaBoxIfCmp1.SenderPorts.FordVehBBMsgOutp1LoPart.Val /end MEASUREMENT
/begin MEASUREMENT CDD_FordBlaBoxIfCmp1.FordVehBBMsgOutp2HiPart.Val "MICROSAR RTE" ULONG NO_COMPU_METHOD 0 0 0 4294967295 ECU_ADDRESS 0 SYMBOL_LINK "Rte_CDD_FordBlaBoxIfCmp1_FordVehBBMsgOutp2HiPart_Val" 0 DISPLAY_IDENTIFIER CDD_FordBlaBoxIfCmp1.SenderPorts.FordVehBBMsgOutp2HiPart.Val /end MEASUREMENT
/begin MEASUREMENT CDD_FordBlaBoxIfCmp1.FordVehBBMsgOutp2LoPart.Val "MICROSAR RTE" ULONG NO_COMPU_METHOD 0 0 0 4294967295 ECU_ADDRESS 0 SYMBOL_LINK "Rte_CDD_FordBlaBoxIfCmp1_FordVehBBMsgOutp2LoPart_Val" 0 DISPLAY_IDENTIFIER CDD_FordBlaBoxIfCmp1.SenderPorts.FordVehBBMsgOutp2LoPart.Val /end MEASUREMENT
/begin MEASUREMENT CDD_FordBlaBoxIfCmp1.FordVehBBMsgOutp3HiPart.Val "MICROSAR RTE" ULONG NO_COMPU_METHOD 0 0 0 4294967295 ECU_ADDRESS 0 SYMBOL_LINK "Rte_CDD_FordBlaBoxIfCmp1_FordVehBBMsgOutp3HiPart_Val" 0 DISPLAY_IDENTIFIER CDD_FordBlaBoxIfCmp1.SenderPorts.FordVehBBMsgOutp3HiPart.Val /end MEASUREMENT
/begin MEASUREMENT CDD_FordBlaBoxIfCmp1.FordVehBBMsgOutp3LoPart.Val "MICROSAR RTE" ULONG NO_COMPU_METHOD 0 0 0 4294967295 ECU_ADDRESS 0 SYMBOL_LINK "Rte_CDD_FordBlaBoxIfCmp1_FordVehBBMsgOutp3LoPart_Val" 0 DISPLAY_IDENTIFIER CDD_FordBlaBoxIfCmp1.SenderPorts.FordVehBBMsgOutp3LoPart.Val /end MEASUREMENT
/begin MEASUREMENT CDD_FordBlaBoxIfCmp1.FordVehBBMsgOutp4HiPart.Val "MICROSAR RTE" ULONG NO_COMPU_METHOD 0 0 0 4294967295 ECU_ADDRESS 0 SYMBOL_LINK "Rte_CDD_FordBlaBoxIfCmp1_FordVehBBMsgOutp4HiPart_Val" 0 DISPLAY_IDENTIFIER CDD_FordBlaBoxIfCmp1.SenderPorts.FordVehBBMsgOutp4HiPart.Val /end MEASUREMENT
/begin MEASUREMENT CDD_FordBlaBoxIfCmp1.FordVehBBMsgOutp4LoPart.Val "MICROSAR RTE" ULONG NO_COMPU_METHOD 0 0 0 4294967295 ECU_ADDRESS 0 SYMBOL_LINK "Rte_CDD_FordBlaBoxIfCmp1_FordVehBBMsgOutp4LoPart_Val" 0 DISPLAY_IDENTIFIER CDD_FordBlaBoxIfCmp1.SenderPorts.FordVehBBMsgOutp4LoPart.Val /end MEASUREMENT
/begin MEASUREMENT CDD_FordBlaBoxIfCmp1.FordVehLaneAssiAvl.Val "MICROSAR RTE" UBYTE NO_COMPU_METHOD 0 0 0 255 ECU_ADDRESS 0 SYMBOL_LINK "Rte_CDD_FordBlaBoxIfCmp1_FordVehLaneAssiAvl_Val" 0 DISPLAY_IDENTIFIER CDD_FordBlaBoxIfCmp1.SenderPorts.FordVehLaneAssiAvl.Val /end MEASUREMENT
/begin MEASUREMENT CDD_FordBlaBoxIfCmp1.FordVehLaneAssiHandsOff.Val "MICROSAR RTE" UBYTE NO_COMPU_METHOD 0 0 0 255 ECU_ADDRESS 0 SYMBOL_LINK "Rte_CDD_FordBlaBoxIfCmp1_FordVehLaneAssiHandsOff_Val" 0 DISPLAY_IDENTIFIER CDD_FordBlaBoxIfCmp1.SenderPorts.FordVehLaneAssiHandsOff.Val /end MEASUREMENT
/begin MEASUREMENT CDD_FordBlaBoxIfCmp1.FordVehLaneAssiRejctn.Val "MICROSAR RTE" UBYTE NO_COMPU_METHOD 0 0 0 255 ECU_ADDRESS 0 SYMBOL_LINK "Rte_CDD_FordBlaBoxIfCmp1_FordVehLaneAssiRejctn_Val" 0 DISPLAY_IDENTIFIER CDD_FordBlaBoxIfCmp1.SenderPorts.FordVehLaneAssiRejctn.Val /end MEASUREMENT
/begin MEASUREMENT CDD_FordBlaBoxIfCmp1.FordVehLatCtrlLimSts.Ford_LatCtlLim_D_Stat "MICROSAR RTE" UBYTE RTE_CM_ENUM_Ford_LatCtlLim_D_Stat 0 0 0 3 ECU_ADDRESS 0 SYMBOL_LINK "Rte_CDD_FordBlaBoxIfCmp1_FordVehLatCtrlLimSts_Ford_LatCtlLim_D_Stat" 0 DISPLAY_IDENTIFIER CDD_FordBlaBoxIfCmp1.SenderPorts.FordVehLatCtrlLimSts.Ford_LatCtlLim_D_Stat /end MEASUREMENT
/begin MEASUREMENT CDD_FordBlaBoxIfCmp1.FordVehLatCtrlSteerSts.Ford_LatCtlSte_D_Stat "MICROSAR RTE" UBYTE RTE_CM_ENUM_Ford_LatCtlSte_D_Stat 0 0 0 7 ECU_ADDRESS 0 SYMBOL_LINK "Rte_CDD_FordBlaBoxIfCmp1_FordVehLatCtrlSteerSts_Ford_LatCtlSte_D_Stat" 0 DISPLAY_IDENTIFIER CDD_FordBlaBoxIfCmp1.SenderPorts.FordVehLatCtrlSteerSts.Ford_LatCtlSte_D_Stat /end MEASUREMENT
/begin MEASUREMENT CDD_FordBlaBoxIfCmp1.FordVehLoSpdMtnCtrlBrkDecelEnaReq.Val "MICROSAR RTE" UBYTE NO_COMPU_METHOD 0 0 0 255 ECU_ADDRESS 0 SYMBOL_LINK "Rte_CDD_FordBlaBoxIfCmp1_FordVehLoSpdMtnCtrlBrkDecelEnaReq_Val" 0 DISPLAY_IDENTIFIER CDD_FordBlaBoxIfCmp1.SenderPorts.FordVehLoSpdMtnCtrlBrkDecelEnaReq.Val /end MEASUREMENT
/begin MEASUREMENT CDD_FordBlaBoxIfCmp1.FordVehLoSpdMtnCtrlBrkTqReq.Val "MICROSAR RTE" UWORD NO_COMPU_METHOD 0 0 0 65535 ECU_ADDRESS 0 SYMBOL_LINK "Rte_CDD_FordBlaBoxIfCmp1_FordVehLoSpdMtnCtrlBrkTqReq_Val" 0 DISPLAY_IDENTIFIER CDD_FordBlaBoxIfCmp1.SenderPorts.FordVehLoSpdMtnCtrlBrkTqReq.Val /end MEASUREMENT
/begin MEASUREMENT CDD_FordBlaBoxIfCmp1.FordVehTrfcJamAvdHandsOnConf.Val "MICROSAR RTE" UBYTE NO_COMPU_METHOD 0 0 0 255 ECU_ADDRESS 0 SYMBOL_LINK "Rte_CDD_FordBlaBoxIfCmp1_FordVehTrfcJamAvdHandsOnConf_Val" 0 DISPLAY_IDENTIFIER CDD_FordBlaBoxIfCmp1.SenderPorts.FordVehTrfcJamAvdHandsOnConf.Val /end MEASUREMENT
/begin MEASUREMENT CDD_FordBlaBoxIfCmp1.FordVehTrlrAgTarCalcn.Val "MICROSAR RTE" UBYTE NO_COMPU_METHOD 0 0 0 255 ECU_ADDRESS 0 SYMBOL_LINK "Rte_CDD_FordBlaBoxIfCmp1_FordVehTrlrAgTarCalcn_Val" 0 DISPLAY_IDENTIFIER CDD_FordBlaBoxIfCmp1.SenderPorts.FordVehTrlrAgTarCalcn.Val /end MEASUREMENT
/begin MEASUREMENT CDD_FordBlaBoxIfCmp1.FordVehTrlrAidAgMax.Val "MICROSAR RTE" UBYTE NO_COMPU_METHOD 0 0 0 255 ECU_ADDRESS 0 SYMBOL_LINK "Rte_CDD_FordBlaBoxIfCmp1_FordVehTrlrAidAgMax_Val" 0 DISPLAY_IDENTIFIER CDD_FordBlaBoxIfCmp1.SenderPorts.FordVehTrlrAidAgMax.Val /end MEASUREMENT
/begin MEASUREMENT CDD_FordBlaBoxIfCmp1.FordVehTrlrAidAgOffs.Val "MICROSAR RTE" UBYTE NO_COMPU_METHOD 0 0 0 255 ECU_ADDRESS 0 SYMBOL_LINK "Rte_CDD_FordBlaBoxIfCmp1_FordVehTrlrAidAgOffs_Val" 0 DISPLAY_IDENTIFIER CDD_FordBlaBoxIfCmp1.SenderPorts.FordVehTrlrAidAgOffs.Val /end MEASUREMENT
/begin MEASUREMENT CDD_FordBlaBoxIfCmp1.FordVehTrlrAidAgWarn.Val "MICROSAR RTE" UBYTE NO_COMPU_METHOD 0 0 0 255 ECU_ADDRESS 0 SYMBOL_LINK "Rte_CDD_FordBlaBoxIfCmp1_FordVehTrlrAidAgWarn_Val" 0 DISPLAY_IDENTIFIER CDD_FordBlaBoxIfCmp1.SenderPorts.FordVehTrlrAidAgWarn.Val /end MEASUREMENT
/begin MEASUREMENT CDD_FordBlaBoxIfCmp1.FordVehTrlrAidEnaSts.Val "MICROSAR RTE" UBYTE NO_COMPU_METHOD 0 0 0 255 ECU_ADDRESS 0 SYMBOL_LINK "Rte_CDD_FordBlaBoxIfCmp1_FordVehTrlrAidEnaSts_Val" 0 DISPLAY_IDENTIFIER CDD_FordBlaBoxIfCmp1.SenderPorts.FordVehTrlrAidEnaSts.Val /end MEASUREMENT
/begin MEASUREMENT CDD_FordBlaBoxIfCmp1.FordVehTrlrAidHitchToAxle.Val "MICROSAR RTE" UWORD NO_COMPU_METHOD 0 0 0 65535 ECU_ADDRESS 0 SYMBOL_LINK "Rte_CDD_FordBlaBoxIfCmp1_FordVehTrlrAidHitchToAxle_Val" 0 DISPLAY_IDENTIFIER CDD_FordBlaBoxIfCmp1.SenderPorts.FordVehTrlrAidHitchToAxle.Val /end MEASUREMENT
/begin MEASUREMENT CDD_FordBlaBoxIfCmp1.FordVehTrlrAidMsgTxtReq.Val "MICROSAR RTE" UBYTE NO_COMPU_METHOD 0 0 0 255 ECU_ADDRESS 0 SYMBOL_LINK "Rte_CDD_FordBlaBoxIfCmp1_FordVehTrlrAidMsgTxtReq_Val" 0 DISPLAY_IDENTIFIER CDD_FordBlaBoxIfCmp1.SenderPorts.FordVehTrlrAidMsgTxtReq.Val /end MEASUREMENT
/begin MEASUREMENT CDD_FordBlaBoxIfCmp1.FordVehTrlrAidSetUp.Val "MICROSAR RTE" UBYTE NO_COMPU_METHOD 0 0 0 255 ECU_ADDRESS 0 SYMBOL_LINK "Rte_CDD_FordBlaBoxIfCmp1_FordVehTrlrAidSetUp_Val" 0 DISPLAY_IDENTIFIER CDD_FordBlaBoxIfCmp1.SenderPorts.FordVehTrlrAidSetUp.Val /end MEASUREMENT
/begin MEASUREMENT CDD_FordBlaBoxIfCmp1.FordVehTrlrAidTarIdn.Val "MICROSAR RTE" UBYTE NO_COMPU_METHOD 0 0 0 255 ECU_ADDRESS 0 SYMBOL_LINK "Rte_CDD_FordBlaBoxIfCmp1_FordVehTrlrAidTarIdn_Val" 0 DISPLAY_IDENTIFIER CDD_FordBlaBoxIfCmp1.SenderPorts.FordVehTrlrAidTarIdn.Val /end MEASUREMENT
/begin MEASUREMENT CDD_FordBlaBoxIfCmp1.FordVehTrlrAidTrlrIdn.Val "MICROSAR RTE" UBYTE NO_COMPU_METHOD 0 0 0 255 ECU_ADDRESS 0 SYMBOL_LINK "Rte_CDD_FordBlaBoxIfCmp1_FordVehTrlrAidTrlrIdn_Val" 0 DISPLAY_IDENTIFIER CDD_FordBlaBoxIfCmp1.SenderPorts.FordVehTrlrAidTrlrIdn.Val /end MEASUREMENT
/begin MEASUREMENT CDD_FordBlaBoxIfCmp1.FordVehTrlrHitchLampReq.Val "MICROSAR RTE" UBYTE NO_COMPU_METHOD 0 0 0 255 ECU_ADDRESS 0 SYMBOL_LINK "Rte_CDD_FordBlaBoxIfCmp1_FordVehTrlrHitchLampReq_Val" 0 DISPLAY_IDENTIFIER CDD_FordBlaBoxIfCmp1.SenderPorts.FordVehTrlrHitchLampReq.Val /end MEASUREMENT
/begin MEASUREMENT CDD_FordBlaBoxIfCmp1.FordVehVelMaxReqTrlrAid.Val "MICROSAR RTE" UBYTE NO_COMPU_METHOD 0 0 0 255 ECU_ADDRESS 0 SYMBOL_LINK "Rte_CDD_FordBlaBoxIfCmp1_FordVehVelMaxReqTrlrAid_Val" 0 DISPLAY_IDENTIFIER CDD_FordBlaBoxIfCmp1.SenderPorts.FordVehVelMaxReqTrlrAid.Val /end MEASUREMENT
/begin MEASUREMENT CDD_FordBlaBoxIfCmp1.FordVehVelTrlrAidReq.Val "MICROSAR RTE" UBYTE NO_COMPU_METHOD 0 0 0 255 ECU_ADDRESS 0 SYMBOL_LINK "Rte_CDD_FordBlaBoxIfCmp1_FordVehVelTrlrAidReq_Val" 0 DISPLAY_IDENTIFIER CDD_FordBlaBoxIfCmp1.SenderPorts.FordVehVelTrlrAidReq.Val /end MEASUREMENT
/begin MEASUREMENT CDD_FordBlaBoxIfCmp1.FordWrSrvActvNiblCmpIntSts.Val "MICROSAR RTE" ULONG NO_COMPU_METHOD 0 0 0 4294967295 ECU_ADDRESS 0 SYMBOL_LINK "Rte_CDD_FordBlaBoxIfCmp1_FordWrSrvActvNiblCmpIntSts_Val" 0 DISPLAY_IDENTIFIER CDD_FordBlaBoxIfCmp1.ReceiverPorts.FordWrSrvActvNiblCmpIntSts.Val /end MEASUREMENT
/begin MEASUREMENT CDD_FordBlaBoxIfCmp1.FordWrSrvLaneDprtrWarnIntSts.Val "MICROSAR RTE" ULONG NO_COMPU_METHOD 0 0 0 4294967295 ECU_ADDRESS 0 SYMBOL_LINK "Rte_CDD_FordBlaBoxIfCmp1_FordWrSrvLaneDprtrWarnIntSts_Val" 0 DISPLAY_IDENTIFIER CDD_FordBlaBoxIfCmp1.ReceiverPorts.FordWrSrvLaneDprtrWarnIntSts.Val /end MEASUREMENT
/begin MEASUREMENT CDD_FordBlaBoxIfCmp1.FordWrSrvLaneKeepAssiIntSts.Val "MICROSAR RTE" ULONG NO_COMPU_METHOD 0 0 0 4294967295 ECU_ADDRESS 0 SYMBOL_LINK "Rte_CDD_FordBlaBoxIfCmp1_FordWrSrvLaneKeepAssiIntSts_Val" 0 DISPLAY_IDENTIFIER CDD_FordBlaBoxIfCmp1.ReceiverPorts.FordWrSrvLaneKeepAssiIntSts.Val /end MEASUREMENT
/begin MEASUREMENT CDD_FordBlaBoxIfCmp1.FordWrSrvLatCtrlIntSts.Val "MICROSAR RTE" ULONG NO_COMPU_METHOD 0 0 0 4294967295 ECU_ADDRESS 0 SYMBOL_LINK "Rte_CDD_FordBlaBoxIfCmp1_FordWrSrvLatCtrlIntSts_Val" 0 DISPLAY_IDENTIFIER CDD_FordBlaBoxIfCmp1.ReceiverPorts.FordWrSrvLatCtrlIntSts.Val /end MEASUREMENT
/begin MEASUREMENT CDD_FordBlaBoxIfCmp1.FordWrSrvPullDriftCmpIntSts.Val "MICROSAR RTE" ULONG NO_COMPU_METHOD 0 0 0 4294967295 ECU_ADDRESS 0 SYMBOL_LINK "Rte_CDD_FordBlaBoxIfCmp1_FordWrSrvPullDriftCmpIntSts_Val" 0 DISPLAY_IDENTIFIER CDD_FordBlaBoxIfCmp1.ReceiverPorts.FordWrSrvPullDriftCmpIntSts.Val /end MEASUREMENT
/begin MEASUREMENT CDD_FordBlaBoxIfCmp1.FordWrSrvTrlrBackupAssiIntSts.Val "MICROSAR RTE" ULONG NO_COMPU_METHOD 0 0 0 4294967295 ECU_ADDRESS 0 SYMBOL_LINK "Rte_CDD_FordBlaBoxIfCmp1_FordWrSrvTrlrBackupAssiIntSts_Val" 0 DISPLAY_IDENTIFIER CDD_FordBlaBoxIfCmp1.ReceiverPorts.FordWrSrvTrlrBackupAssiIntSts.Val /end MEASUREMENT
/begin MEASUREMENT CDD_FordBlaBoxIfCmp1.LaneAssi "MICROSAR RTE" UBYTE NO_COMPU_METHOD 0 0 0 255 MATRIX_DIM 256 1 1 ECU_ADDRESS 0 SYMBOL_LINK "Rte_CDD_FordBlaBoxIfCmp1_LaneAssi" 0 DISPLAY_IDENTIFIER CDD_FordBlaBoxIfCmp1.PerInstanceMemories.LaneAssi /end MEASUREMENT
/begin MEASUREMENT CDD_FordBlaBoxIfCmp1.LaneDprtrWarnIntSts.Val "MICROSAR RTE" ULONG NO_COMPU_METHOD 0 0 0 4294967295 ECU_ADDRESS 0 SYMBOL_LINK "Rte_CDD_FordBlaBoxIfCmp1_LaneDprtrWarnIntSts_Val" 0 DISPLAY_IDENTIFIER CDD_FordBlaBoxIfCmp1.SenderPorts.LaneDprtrWarnIntSts.Val /end MEASUREMENT
/begin MEASUREMENT CDD_FordBlaBoxIfCmp1.LaneKeepAssiIntSts.Val "MICROSAR RTE" ULONG NO_COMPU_METHOD 0 0 0 4294967295 ECU_ADDRESS 0 SYMBOL_LINK "Rte_CDD_FordBlaBoxIfCmp1_LaneKeepAssiIntSts_Val" 0 DISPLAY_IDENTIFIER CDD_FordBlaBoxIfCmp1.SenderPorts.LaneKeepAssiIntSts.Val /end MEASUREMENT
/begin MEASUREMENT CDD_FordBlaBoxIfCmp1.LatCtrlIntSts.Val "MICROSAR RTE" ULONG NO_COMPU_METHOD 0 0 0 4294967295 ECU_ADDRESS 0 SYMBOL_LINK "Rte_CDD_FordBlaBoxIfCmp1_LatCtrlIntSts_Val" 0 DISPLAY_IDENTIFIER CDD_FordBlaBoxIfCmp1.SenderPorts.LatCtrlIntSts.Val /end MEASUREMENT
/begin MEASUREMENT CDD_FordBlaBoxIfCmp1.PullDriftCmp "MICROSAR RTE" UBYTE NO_COMPU_METHOD 0 0 0 255 MATRIX_DIM 128 1 1 ECU_ADDRESS 0 SYMBOL_LINK "Rte_CDD_FordBlaBoxIfCmp1_PullDriftCmp" 0 DISPLAY_IDENTIFIER CDD_FordBlaBoxIfCmp1.PerInstanceMemories.PullDriftCmp /end MEASUREMENT
/begin MEASUREMENT CDD_FordBlaBoxIfCmp1.PullDriftCmpFctCallSel "MICROSAR RTE" UBYTE RTE_CM_BOOLEAN 0 0 0 255 ECU_ADDRESS 0 SYMBOL_LINK "Rte_CDD_FordBlaBoxIfCmp1_PullDriftCmpFctCallSel" 0 DISPLAY_IDENTIFIER CDD_FordBlaBoxIfCmp1.PerInstanceMemories.PullDriftCmpFctCallSel /end MEASUREMENT
/begin MEASUREMENT CDD_FordBlaBoxIfCmp1.PullDriftCmpIntSts.Val "MICROSAR RTE" ULONG NO_COMPU_METHOD 0 0 0 4294967295 ECU_ADDRESS 0 SYMBOL_LINK "Rte_CDD_FordBlaBoxIfCmp1_PullDriftCmpIntSts_Val" 0 DISPLAY_IDENTIFIER CDD_FordBlaBoxIfCmp1.SenderPorts.PullDriftCmpIntSts.Val /end MEASUREMENT
/begin MEASUREMENT CDD_FordBlaBoxIfCmp1.SrvPullDriftCmpAct.Val "MICROSAR RTE" SWORD NO_COMPU_METHOD 0 0 -32768 32767 ECU_ADDRESS 0 SYMBOL_LINK "Rte_CDD_FordBlaBoxIfCmp1_SrvPullDriftCmpAct_Val" 0 DISPLAY_IDENTIFIER CDD_FordBlaBoxIfCmp1.SenderPorts.SrvPullDriftCmpAct.Val /end MEASUREMENT
/begin MEASUREMENT CDD_FordBlaBoxIfCmp1.SrvPullDriftCmpRstVal.Val "MICROSAR RTE" SWORD NO_COMPU_METHOD 0 0 -32768 32767 ECU_ADDRESS 0 SYMBOL_LINK "Rte_CDD_FordBlaBoxIfCmp1_SrvPullDriftCmpRstVal_Val" 0 DISPLAY_IDENTIFIER CDD_FordBlaBoxIfCmp1.SenderPorts.SrvPullDriftCmpRstVal.Val /end MEASUREMENT
/begin MEASUREMENT CDD_FordBlaBoxIfCmp1.TqOffsTbl "MICROSAR RTE" UWORD NO_COMPU_METHOD 0 0 0 65535 MATRIX_DIM 20 12 1 ECU_ADDRESS 0 SYMBOL_LINK "Rte_CDD_FordBlaBoxIfCmp1_TqOffsTbl" 0 DISPLAY_IDENTIFIER CDD_FordBlaBoxIfCmp1.PerInstanceMemories.TqOffsTbl /end MEASUREMENT
/begin MEASUREMENT CDD_FordBlaBoxIfCmp1.TrlrBackAssiFctCallSel "MICROSAR RTE" UBYTE RTE_CM_BOOLEAN 0 0 0 255 ECU_ADDRESS 0 SYMBOL_LINK "Rte_CDD_FordBlaBoxIfCmp1_TrlrBackAssiFctCallSel" 0 DISPLAY_IDENTIFIER CDD_FordBlaBoxIfCmp1.PerInstanceMemories.TrlrBackAssiFctCallSel /end MEASUREMENT
/begin MEASUREMENT CDD_FordBlaBoxIfCmp1.TrlrBackupAssi "MICROSAR RTE" UBYTE NO_COMPU_METHOD 0 0 0 255 MATRIX_DIM 512 1 1 ECU_ADDRESS 0 SYMBOL_LINK "Rte_CDD_FordBlaBoxIfCmp1_TrlrBackupAssi" 0 DISPLAY_IDENTIFIER CDD_FordBlaBoxIfCmp1.PerInstanceMemories.TrlrBackupAssi /end MEASUREMENT
/begin MEASUREMENT CDD_FordBlaBoxIfCmp1.TrlrBackupAssiIntSts.Val "MICROSAR RTE" ULONG NO_COMPU_METHOD 0 0 0 4294967295 ECU_ADDRESS 0 SYMBOL_LINK "Rte_CDD_FordBlaBoxIfCmp1_TrlrBackupAssiIntSts_Val" 0 DISPLAY_IDENTIFIER CDD_FordBlaBoxIfCmp1.SenderPorts.TrlrBackupAssiIntSts.Val /end MEASUREMENT
/begin MEASUREMENT CDD_FordBlaBoxIfCmp1.VehSpd.Val "MICROSAR RTE" FLOAT32_IEEE NO_COMPU_METHOD 0 0 -3.402823466e+38 3.402823466e+38 ECU_ADDRESS 0 SYMBOL_LINK "Rte_ImcSigArbn_VehSpdImcCorrd_Val" 0 DISPLAY_IDENTIFIER CDD_FordBlaBoxIfCmp1.ReceiverPorts.VehSpd.Val /end MEASUREMENT
/begin MEASUREMENT CDD_FordBlaBoxIfCmp2.EcuId.Val "MICROSAR RTE" UBYTE NO_COMPU_METHOD 0 0 0 255 ECU_ADDRESS 0 SYMBOL_LINK "Rte_DualEcuIdn_EcuId_Val" 0 DISPLAY_IDENTIFIER CDD_FordBlaBoxIfCmp2.ReceiverPorts.EcuId.Val /end MEASUREMENT
/begin MEASUREMENT CDD_FordBlaBoxIfCmp2.EvasSteerAssiFctCallTog "MICROSAR RTE" UBYTE RTE_CM_BOOLEAN 0 0 0 255 ECU_ADDRESS 0 SYMBOL_LINK "Rte_CDD_FordBlaBoxIfCmp2_EvasSteerAssiFctCallTog" 0 DISPLAY_IDENTIFIER CDD_FordBlaBoxIfCmp2.PerInstanceMemories.EvasSteerAssiFctCallTog /end MEASUREMENT
/begin MEASUREMENT CDD_FordBlaBoxIfCmp2.FordBrkPlsRednActvnCntr.Val "MICROSAR RTE" UWORD NO_COMPU_METHOD 0 0 0 65535 ECU_ADDRESS 0 SYMBOL_LINK "Rte_CDD_FordBlaBoxIfCmp2_FordBrkPlsRednActvnCntr_Val" 0 DISPLAY_IDENTIFIER CDD_FordBlaBoxIfCmp2.SenderPorts.FordBrkPlsRednActvnCntr.Val /end MEASUREMENT
/begin MEASUREMENT CDD_FordBlaBoxIfCmp2.FordEvasSteerAssiIntSts.Val "MICROSAR RTE" ULONG NO_COMPU_METHOD 0 0 0 4294967295 ECU_ADDRESS 0 SYMBOL_LINK "Rte_CDD_FordBlaBoxIfCmp2_FordEvasSteerAssiIntSts_Val" 0 DISPLAY_IDENTIFIER CDD_FordBlaBoxIfCmp2.SenderPorts.FordEvasSteerAssiIntSts.Val /end MEASUREMENT
/begin MEASUREMENT CDD_FordBlaBoxIfCmp2.FordEvasSteerAssiSwVers.Val "MICROSAR RTE" ULONG NO_COMPU_METHOD 0 0 0 4294967295 ECU_ADDRESS 0 SYMBOL_LINK "Rte_CDD_FordBlaBoxIfCmp2_FordEvasSteerAssiSwVers_Val" 0 DISPLAY_IDENTIFIER CDD_FordBlaBoxIfCmp2.SenderPorts.FordEvasSteerAssiSwVers.Val /end MEASUREMENT
/begin MEASUREMENT CDD_FordBlaBoxIfCmp2.FordEvasSteerAssiTqReq.Val "MICROSAR RTE" FLOAT32_IEEE NO_COMPU_METHOD 0 0 -3.402823466e+38 3.402823466e+38 ECU_ADDRESS 0 SYMBOL_LINK "Rte_CDD_FordBlaBoxIfCmp2_FordEvasSteerAssiTqReq_Val" 0 DISPLAY_IDENTIFIER CDD_FordBlaBoxIfCmp2.SenderPorts.FordEvasSteerAssiTqReq.Val /end MEASUREMENT
/begin MEASUREMENT CDD_FordBlaBoxIfCmp2.FordSteerTqDstbcRejctnIntSts.Val "MICROSAR RTE" ULONG NO_COMPU_METHOD 0 0 0 4294967295 ECU_ADDRESS 0 SYMBOL_LINK "Rte_CDD_FordBlaBoxIfCmp2_FordSteerTqDstbcRejctnIntSts_Val" 0 DISPLAY_IDENTIFIER CDD_FordBlaBoxIfCmp2.SenderPorts.FordSteerTqDstbcRejctnIntSts.Val /end MEASUREMENT
/begin MEASUREMENT CDD_FordBlaBoxIfCmp2.FordSteerTqDstbcRejctnSwVers.Val "MICROSAR RTE" ULONG NO_COMPU_METHOD 0 0 0 4294967295 ECU_ADDRESS 0 SYMBOL_LINK "Rte_CDD_FordBlaBoxIfCmp2_FordSteerTqDstbcRejctnSwVers_Val" 0 DISPLAY_IDENTIFIER CDD_FordBlaBoxIfCmp2.SenderPorts.FordSteerTqDstbcRejctnSwVers.Val /end MEASUREMENT
/begin MEASUREMENT CDD_FordBlaBoxIfCmp2.FordSteerTqDstbcRejctnTqReq.Val "MICROSAR RTE" FLOAT32_IEEE NO_COMPU_METHOD 0 0 -3.402823466e+38 3.402823466e+38 ECU_ADDRESS 0 SYMBOL_LINK "Rte_CDD_FordBlaBoxIfCmp2_FordSteerTqDstbcRejctnTqReq_Val" 0 DISPLAY_IDENTIFIER CDD_FordBlaBoxIfCmp2.SenderPorts.FordSteerTqDstbcRejctnTqReq.Val /end MEASUREMENT
/begin MEASUREMENT CDD_FordBlaBoxIfCmp2.FordTqSteerCmpActvnCntr.Val "MICROSAR RTE" UWORD NO_COMPU_METHOD 0 0 0 65535 ECU_ADDRESS 0 SYMBOL_LINK "Rte_CDD_FordBlaBoxIfCmp2_FordTqSteerCmpActvnCntr_Val" 0 DISPLAY_IDENTIFIER CDD_FordBlaBoxIfCmp2.SenderPorts.FordTqSteerCmpActvnCntr.Val /end MEASUREMENT
/begin MEASUREMENT CDD_FordBlaBoxIfCmp2.FordVehEvasSteerAssiSts.Ford_EsaOn_B_Stat "MICROSAR RTE" UBYTE RTE_CM_BOOLEAN 0 0 0 255 ECU_ADDRESS 0 SYMBOL_LINK "Rte_CDD_FordBlaBoxIfCmp2_FordVehEvasSteerAssiSts_Ford_EsaOn_B_Stat" 0 DISPLAY_IDENTIFIER CDD_FordBlaBoxIfCmp2.SenderPorts.FordVehEvasSteerAssiSts.Ford_EsaOn_B_Stat /end MEASUREMENT
/begin MEASUREMENT CDD_FordBlaBoxIfCmp2.FordWrSrvBrkPlsRednActvnCntr.Val "MICROSAR RTE" UWORD NO_COMPU_METHOD 0 0 0 65535 ECU_ADDRESS 0 SYMBOL_LINK "Rte_CDD_FordBlaBoxIfCmp2_FordWrSrvBrkPlsRednActvnCntr_Val" 0 DISPLAY_IDENTIFIER CDD_FordBlaBoxIfCmp2.ReceiverPorts.FordWrSrvBrkPlsRednActvnCntr.Val /end MEASUREMENT
/begin MEASUREMENT CDD_FordBlaBoxIfCmp2.FordWrSrvEvasSteerAssiIntSts.Val "MICROSAR RTE" ULONG NO_COMPU_METHOD 0 0 0 4294967295 ECU_ADDRESS 0 SYMBOL_LINK "Rte_CDD_FordBlaBoxIfCmp2_FordWrSrvEvasSteerAssiIntSts_Val" 0 DISPLAY_IDENTIFIER CDD_FordBlaBoxIfCmp2.ReceiverPorts.FordWrSrvEvasSteerAssiIntSts.Val /end MEASUREMENT
/begin MEASUREMENT CDD_FordBlaBoxIfCmp2.FordWrSrvSteerTqDstbcRejctnIntSts.Val "MICROSAR RTE" ULONG NO_COMPU_METHOD 0 0 0 4294967295 ECU_ADDRESS 0 SYMBOL_LINK "Rte_CDD_FordBlaBoxIfCmp2_FordWrSrvSteerTqDstbcRejctnIntSts_Val" 0 DISPLAY_IDENTIFIER CDD_FordBlaBoxIfCmp2.ReceiverPorts.FordWrSrvSteerTqDstbcRejctnIntSts.Val /end MEASUREMENT
/begin MEASUREMENT CDD_FordBlaBoxIfCmp2.FordWrSrvTqSteerCmpActvnCntr.Val "MICROSAR RTE" UWORD NO_COMPU_METHOD 0 0 0 65535 ECU_ADDRESS 0 SYMBOL_LINK "Rte_CDD_FordBlaBoxIfCmp2_FordWrSrvTqSteerCmpActvnCntr_Val" 0 DISPLAY_IDENTIFIER CDD_FordBlaBoxIfCmp2.ReceiverPorts.FordWrSrvTqSteerCmpActvnCntr.Val /end MEASUREMENT
/begin MEASUREMENT CDD_FordT3T6McuCfg.Adc0Faild.Logl "MICROSAR RTE" UBYTE RTE_CM_BOOLEAN 0 0 0 255 ECU_ADDRESS 0 SYMBOL_LINK "Rte_CDD_FordT3T6McuCfg_Adc0Faild_Logl" 0 DISPLAY_IDENTIFIER CDD_FordT3T6McuCfg.ReceiverPorts.Adc0Faild.Logl /end MEASUREMENT
/begin MEASUREMENT CDD_FordT3T6McuCfg.Adc1Faild.Logl "MICROSAR RTE" UBYTE RTE_CM_BOOLEAN 0 0 0 255 ECU_ADDRESS 0 SYMBOL_LINK "Rte_CDD_FordT3T6McuCfg_Adc1Faild_Logl" 0 DISPLAY_IDENTIFIER CDD_FordT3T6McuCfg.ReceiverPorts.Adc1Faild.Logl /end MEASUREMENT
/begin MEASUREMENT CDD_FordT3T6McuCfg.Adc1ScanGroup2Ref0.Val "MICROSAR RTE" FLOAT32_IEEE NO_COMPU_METHOD 0 0 -3.402823466e+38 3.402823466e+38 ECU_ADDRESS 0 SYMBOL_LINK "Rte_CDD_FordT3T6McuCfg_Adc1ScanGroup2Ref0_Val" 0 DISPLAY_IDENTIFIER CDD_FordT3T6McuCfg.SenderPorts.Adc1ScanGroup2Ref0.Val /end MEASUREMENT
/begin MEASUREMENT CDD_FordT3T6McuCfg.Adc1ScanGroup2Ref1.Val "MICROSAR RTE" FLOAT32_IEEE NO_COMPU_METHOD 0 0 -3.402823466e+38 3.402823466e+38 ECU_ADDRESS 0 SYMBOL_LINK "Rte_CDD_FordT3T6McuCfg_Adc1ScanGroup2Ref1_Val" 0 DISPLAY_IDENTIFIER CDD_FordT3T6McuCfg.SenderPorts.Adc1ScanGroup2Ref1.Val /end MEASUREMENT
/begin MEASUREMENT CDD_FordT3T6McuCfg.Adc1ScanGroup3Ref0.Val "MICROSAR RTE" FLOAT32_IEEE NO_COMPU_METHOD 0 0 -3.402823466e+38 3.402823466e+38 ECU_ADDRESS 0 SYMBOL_LINK "Rte_CDD_FordT3T6McuCfg_Adc1ScanGroup3Ref0_Val" 0 DISPLAY_IDENTIFIER CDD_FordT3T6McuCfg.SenderPorts.Adc1ScanGroup3Ref0.Val /end MEASUREMENT
/begin MEASUREMENT CDD_FordT3T6McuCfg.Adc1ScanGroup3Ref1.Val "MICROSAR RTE" FLOAT32_IEEE NO_COMPU_METHOD 0 0 -3.402823466e+38 3.402823466e+38 ECU_ADDRESS 0 SYMBOL_LINK "Rte_CDD_FordT3T6McuCfg_Adc1ScanGroup3Ref1_Val" 0 DISPLAY_IDENTIFIER CDD_FordT3T6McuCfg.SenderPorts.Adc1ScanGroup3Ref1.Val /end MEASUREMENT
/begin MEASUREMENT CDD_FordT3T6McuCfg.Adc1SelfDiag0.Val "MICROSAR RTE" FLOAT32_IEEE NO_COMPU_METHOD 0 0 0.0 5.0 ECU_ADDRESS 0 SYMBOL_LINK "Rte_CDD_FordT3T6McuCfg_Adc1SelfDiag0_Val" 0 DISPLAY_IDENTIFIER CDD_FordT3T6McuCfg.SenderPorts.Adc1SelfDiag0.Val /end MEASUREMENT
/begin MEASUREMENT CDD_FordT3T6McuCfg.Adc1SelfDiag2.Val "MICROSAR RTE" FLOAT32_IEEE NO_COMPU_METHOD 0 0 0.0 5.0 ECU_ADDRESS 0 SYMBOL_LINK "Rte_CDD_FordT3T6McuCfg_Adc1SelfDiag2_Val" 0 DISPLAY_IDENTIFIER CDD_FordT3T6McuCfg.SenderPorts.Adc1SelfDiag2.Val /end MEASUREMENT
/begin MEASUREMENT CDD_FordT3T6McuCfg.Adc1SelfDiag4.Val "MICROSAR RTE" FLOAT32_IEEE NO_COMPU_METHOD 0 0 0.0 5.0 ECU_ADDRESS 0 SYMBOL_LINK "Rte_CDD_FordT3T6McuCfg_Adc1SelfDiag4_Val" 0 DISPLAY_IDENTIFIER CDD_FordT3T6McuCfg.SenderPorts.Adc1SelfDiag4.Val /end MEASUREMENT
/begin MEASUREMENT CDD_FordT3T6McuCfg.BattRtnCurrAdc.Val "MICROSAR RTE" FLOAT32_IEEE NO_COMPU_METHOD 0 0 0.0 5.0 ECU_ADDRESS 0 SYMBOL_LINK "Rte_CDD_FordT3T6McuCfg_BattRtnCurrAdc_Val" 0 DISPLAY_IDENTIFIER CDD_FordT3T6McuCfg.SenderPorts.BattRtnCurrAdc.Val /end MEASUREMENT
/begin MEASUREMENT CDD_FordT3T6McuCfg.BattRtnCurrAdcFaild.Logl "MICROSAR RTE" UBYTE RTE_CM_BOOLEAN 0 0 0 255 ECU_ADDRESS 0 SYMBOL_LINK "Rte_CDD_FordT3T6McuCfg_BattRtnCurrAdcFaild_Logl" 0 DISPLAY_IDENTIFIER CDD_FordT3T6McuCfg.SenderPorts.BattRtnCurrAdcFaild.Logl /end MEASUREMENT
/begin MEASUREMENT CDD_FordT3T6McuCfg.BattVltg.Val "MICROSAR RTE" FLOAT32_IEEE NO_COMPU_METHOD 0 0 0.0 40.0 ECU_ADDRESS 0 SYMBOL_LINK "Rte_CDD_FordT3T6McuCfg_BattVltg_Val" 0 DISPLAY_IDENTIFIER CDD_FordT3T6McuCfg.SenderPorts.BattVltg.Val /end MEASUREMENT
/begin MEASUREMENT CDD_FordT3T6McuCfg.BattVltgAdcFaild.Logl "MICROSAR RTE" UBYTE RTE_CM_BOOLEAN 0 0 0 255 ECU_ADDRESS 0 SYMBOL_LINK "Rte_CDD_FordT3T6McuCfg_BattVltgAdcFaild_Logl" 0 DISPLAY_IDENTIFIER CDD_FordT3T6McuCfg.SenderPorts.BattVltgAdcFaild.Logl /end MEASUREMENT
/begin MEASUREMENT CDD_FordT3T6McuCfg.BattVltgSwd1.Val "MICROSAR RTE" FLOAT32_IEEE NO_COMPU_METHOD 0 0 0.0 40.0 ECU_ADDRESS 0 SYMBOL_LINK "Rte_CDD_FordT3T6McuCfg_BattVltgSwd1_Val" 0 DISPLAY_IDENTIFIER CDD_FordT3T6McuCfg.SenderPorts.BattVltgSwd1.Val /end MEASUREMENT
/begin MEASUREMENT CDD_FordT3T6McuCfg.BattVltgSwd1AdcFaild.Logl "MICROSAR RTE" UBYTE RTE_CM_BOOLEAN 0 0 0 255 ECU_ADDRESS 0 SYMBOL_LINK "Rte_CDD_FordT3T6McuCfg_BattVltgSwd1AdcFaild_Logl" 0 DISPLAY_IDENTIFIER CDD_FordT3T6McuCfg.SenderPorts.BattVltgSwd1AdcFaild.Logl /end MEASUREMENT
/begin MEASUREMENT CDD_FordT3T6McuCfg.ChrgPmpDiag.Val "MICROSAR RTE" FLOAT32_IEEE NO_COMPU_METHOD 0 0 0.0 5.0 ECU_ADDRESS 0 SYMBOL_LINK "Rte_CDD_FordT3T6McuCfg_ChrgPmpDiag_Val" 0 DISPLAY_IDENTIFIER CDD_FordT3T6McuCfg.SenderPorts.ChrgPmpDiag.Val /end MEASUREMENT
/begin MEASUREMENT CDD_FordT3T6McuCfg.ChrgPmpDiagAdcFaild.Logl "MICROSAR RTE" UBYTE RTE_CM_BOOLEAN 0 0 0 255 ECU_ADDRESS 0 SYMBOL_LINK "Rte_CDD_FordT3T6McuCfg_ChrgPmpDiagAdcFaild_Logl" 0 DISPLAY_IDENTIFIER CDD_FordT3T6McuCfg.SenderPorts.ChrgPmpDiagAdcFaild.Logl /end MEASUREMENT
/begin MEASUREMENT CDD_FordT3T6McuCfg.EcuId.Val "MICROSAR RTE" UBYTE NO_COMPU_METHOD 0 0 0 255 ECU_ADDRESS 0 SYMBOL_LINK "Rte_DualEcuIdn_EcuId_Val" 0 DISPLAY_IDENTIFIER CDD_FordT3T6McuCfg.ReceiverPorts.EcuId.Val /end MEASUREMENT
/begin MEASUREMENT CDD_FordT3T6McuCfg.EcuT.Val "MICROSAR RTE" FLOAT32_IEEE NO_COMPU_METHOD 0 0 0.0 5.0 ECU_ADDRESS 0 SYMBOL_LINK "Rte_CDD_FordT3T6McuCfg_EcuT_Val" 0 DISPLAY_IDENTIFIER CDD_FordT3T6McuCfg.SenderPorts.EcuT.Val /end MEASUREMENT
/begin MEASUREMENT CDD_FordT3T6McuCfg.EcuTAdcFaild.Logl "MICROSAR RTE" UBYTE RTE_CM_BOOLEAN 0 0 0 255 ECU_ADDRESS 0 SYMBOL_LINK "Rte_CDD_FordT3T6McuCfg_EcuTAdcFaild_Logl" 0 DISPLAY_IDENTIFIER CDD_FordT3T6McuCfg.SenderPorts.EcuTAdcFaild.Logl /end MEASUREMENT
/begin MEASUREMENT CDD_FordT3T6McuCfg.HwAg1SnsrNr.Val "MICROSAR RTE" UBYTE NO_COMPU_METHOD 0 0 0 255 ECU_ADDRESS 0 SYMBOL_LINK "Rte_CDD_FordT3T6McuCfg_HwAg1SnsrNr_Val" 0 DISPLAY_IDENTIFIER CDD_FordT3T6McuCfg.SenderPorts.HwAg1SnsrNr.Val /end MEASUREMENT
/begin MEASUREMENT CDD_FordT3T6McuCfg.HwAg1SnsrTyp.Val "MICROSAR RTE" UBYTE RTE_CM_ENUM_HwAgSnsrTyp1 0 0 0 255 ECU_ADDRESS 0 SYMBOL_LINK "Rte_CDD_FordT3T6McuCfg_HwAg1SnsrTyp_Val" 0 DISPLAY_IDENTIFIER CDD_FordT3T6McuCfg.SenderPorts.HwAg1SnsrTyp.Val /end MEASUREMENT
/begin MEASUREMENT CDD_FordT3T6McuCfg.MotAg2Cos.Val "MICROSAR RTE" FLOAT32_IEEE NO_COMPU_METHOD 0 0 0.0 5.0 ECU_ADDRESS 0 SYMBOL_LINK "Rte_CDD_FordT3T6McuCfg_MotAg2Cos_Val" 0 DISPLAY_IDENTIFIER CDD_FordT3T6McuCfg.SenderPorts.MotAg2Cos.Val /end MEASUREMENT
/begin MEASUREMENT CDD_FordT3T6McuCfg.MotAg2CosAdcFaild.Logl "MICROSAR RTE" UBYTE RTE_CM_BOOLEAN 0 0 0 255 ECU_ADDRESS 0 SYMBOL_LINK "Rte_CDD_FordT3T6McuCfg_MotAg2CosAdcFaild_Logl" 0 DISPLAY_IDENTIFIER CDD_FordT3T6McuCfg.SenderPorts.MotAg2CosAdcFaild.Logl /end MEASUREMENT
/begin MEASUREMENT CDD_FordT3T6McuCfg.MotAg2Sin.Val "MICROSAR RTE" FLOAT32_IEEE NO_COMPU_METHOD 0 0 0.0 5.0 ECU_ADDRESS 0 SYMBOL_LINK "Rte_CDD_FordT3T6McuCfg_MotAg2Sin_Val" 0 DISPLAY_IDENTIFIER CDD_FordT3T6McuCfg.SenderPorts.MotAg2Sin.Val /end MEASUREMENT
/begin MEASUREMENT CDD_FordT3T6McuCfg.MotAg2SinAdcFaild.Logl "MICROSAR RTE" UBYTE RTE_CM_BOOLEAN 0 0 0 255 ECU_ADDRESS 0 SYMBOL_LINK "Rte_CDD_FordT3T6McuCfg_MotAg2SinAdcFaild_Logl" 0 DISPLAY_IDENTIFIER CDD_FordT3T6McuCfg.SenderPorts.MotAg2SinAdcFaild.Logl /end MEASUREMENT
/begin MEASUREMENT CDD_FordT3T6McuCfg.MotAg5CosAdcFaild.Logl "MICROSAR RTE" UBYTE RTE_CM_BOOLEAN 0 0 0 255 ECU_ADDRESS 0 SYMBOL_LINK "Rte_CDD_FordT3T6McuCfg_MotAg5CosAdcFaild_Logl" 0 DISPLAY_IDENTIFIER CDD_FordT3T6McuCfg.SenderPorts.MotAg5CosAdcFaild.Logl /end MEASUREMENT
/begin MEASUREMENT CDD_FordT3T6McuCfg.MotAg5SinAdcFaild.Logl "MICROSAR RTE" UBYTE RTE_CM_BOOLEAN 0 0 0 255 ECU_ADDRESS 0 SYMBOL_LINK "Rte_CDD_FordT3T6McuCfg_MotAg5SinAdcFaild_Logl" 0 DISPLAY_IDENTIFIER CDD_FordT3T6McuCfg.SenderPorts.MotAg5SinAdcFaild.Logl /end MEASUREMENT
/begin MEASUREMENT CDD_FordT3T6McuCfg.MotAg6CosAdcFaild.Logl "MICROSAR RTE" UBYTE RTE_CM_BOOLEAN 0 0 0 255 ECU_ADDRESS 0 SYMBOL_LINK "Rte_CDD_FordT3T6McuCfg_MotAg6CosAdcFaild_Logl" 0 DISPLAY_IDENTIFIER CDD_FordT3T6McuCfg.SenderPorts.MotAg6CosAdcFaild.Logl /end MEASUREMENT
/begin MEASUREMENT CDD_FordT3T6McuCfg.MotAg6SinAdcFaild.Logl "MICROSAR RTE" UBYTE RTE_CM_BOOLEAN 0 0 0 255 ECU_ADDRESS 0 SYMBOL_LINK "Rte_CDD_FordT3T6McuCfg_MotAg6SinAdcFaild_Logl" 0 DISPLAY_IDENTIFIER CDD_FordT3T6McuCfg.SenderPorts.MotAg6SinAdcFaild.Logl /end MEASUREMENT
/begin MEASUREMENT CDD_FordT3T6McuCfg.MotCurrAdcPeakAAdcFaild.Logl "MICROSAR RTE" UBYTE RTE_CM_BOOLEAN 0 0 0 255 ECU_ADDRESS 0 SYMBOL_LINK "Rte_CDD_FordT3T6McuCfg_MotCurrAdcPeakAAdcFaild_Logl" 0 DISPLAY_IDENTIFIER CDD_FordT3T6McuCfg.SenderPorts.MotCurrAdcPeakAAdcFaild.Logl /end MEASUREMENT
/begin MEASUREMENT CDD_FordT3T6McuCfg.MotCurrAdcPeakBAdcFaild.Logl "MICROSAR RTE" UBYTE RTE_CM_BOOLEAN 0 0 0 255 ECU_ADDRESS 0 SYMBOL_LINK "Rte_CDD_FordT3T6McuCfg_MotCurrAdcPeakBAdcFaild_Logl" 0 DISPLAY_IDENTIFIER CDD_FordT3T6McuCfg.SenderPorts.MotCurrAdcPeakBAdcFaild.Logl /end MEASUREMENT
/begin MEASUREMENT CDD_FordT3T6McuCfg.MotCurrAdcPeakCAdcFaild.Logl "MICROSAR RTE" UBYTE RTE_CM_BOOLEAN 0 0 0 255 ECU_ADDRESS 0 SYMBOL_LINK "Rte_CDD_FordT3T6McuCfg_MotCurrAdcPeakCAdcFaild_Logl" 0 DISPLAY_IDENTIFIER CDD_FordT3T6McuCfg.SenderPorts.MotCurrAdcPeakCAdcFaild.Logl /end MEASUREMENT
/begin MEASUREMENT CDD_FordT3T6McuCfg.MotCurrAdcVlyAAdcFaild.Logl "MICROSAR RTE" UBYTE RTE_CM_BOOLEAN 0 0 0 255 ECU_ADDRESS 0 SYMBOL_LINK "Rte_CDD_FordT3T6McuCfg_MotCurrAdcVlyAAdcFaild_Logl" 0 DISPLAY_IDENTIFIER CDD_FordT3T6McuCfg.SenderPorts.MotCurrAdcVlyAAdcFaild.Logl /end MEASUREMENT
/begin MEASUREMENT CDD_FordT3T6McuCfg.MotCurrAdcVlyBAdcFaild.Logl "MICROSAR RTE" UBYTE RTE_CM_BOOLEAN 0 0 0 255 ECU_ADDRESS 0 SYMBOL_LINK "Rte_CDD_FordT3T6McuCfg_MotCurrAdcVlyBAdcFaild_Logl" 0 DISPLAY_IDENTIFIER CDD_FordT3T6McuCfg.SenderPorts.MotCurrAdcVlyBAdcFaild.Logl /end MEASUREMENT
/begin MEASUREMENT CDD_FordT3T6McuCfg.MotCurrAdcVlyCAdcFaild.Logl "MICROSAR RTE" UBYTE RTE_CM_BOOLEAN 0 0 0 255 ECU_ADDRESS 0 SYMBOL_LINK "Rte_CDD_FordT3T6McuCfg_MotCurrAdcVlyCAdcFaild_Logl" 0 DISPLAY_IDENTIFIER CDD_FordT3T6McuCfg.SenderPorts.MotCurrAdcVlyCAdcFaild.Logl /end MEASUREMENT
/begin MEASUREMENT CDD_FordT3T6McuCfg.MotCurrSnsrOffs1AdcFaild.Logl "MICROSAR RTE" UBYTE RTE_CM_BOOLEAN 0 0 0 255 ECU_ADDRESS 0 SYMBOL_LINK "Rte_CDD_FordT3T6McuCfg_MotCurrSnsrOffs1AdcFaild_Logl" 0 DISPLAY_IDENTIFIER CDD_FordT3T6McuCfg.SenderPorts.MotCurrSnsrOffs1AdcFaild.Logl /end MEASUREMENT
/begin MEASUREMENT CDD_FordT3T6McuCfg.MotDrvr1IninTestCmpl.Logl "MICROSAR RTE" UBYTE RTE_CM_BOOLEAN 0 0 0 255 ECU_ADDRESS 0 SYMBOL_LINK "Rte_CDD_FordT3T6McuCfg_MotDrvr1IninTestCmpl_Logl" 0 DISPLAY_IDENTIFIER CDD_FordT3T6McuCfg.SenderPorts.MotDrvr1IninTestCmpl.Logl /end MEASUREMENT
/begin MEASUREMENT CDD_FordT3T6McuCfg.PwrDiscnctSwtDiag.Val "MICROSAR RTE" FLOAT32_IEEE NO_COMPU_METHOD 0 0 0.0 5.0 ECU_ADDRESS 0 SYMBOL_LINK "Rte_CDD_FordT3T6McuCfg_PwrDiscnctSwtDiag_Val" 0 DISPLAY_IDENTIFIER CDD_FordT3T6McuCfg.SenderPorts.PwrDiscnctSwtDiag.Val /end MEASUREMENT
/begin MEASUREMENT CDD_FordT3T6McuCfg.PwrDiscnctSwtDiagAdcFaild.Logl "MICROSAR RTE" UBYTE RTE_CM_BOOLEAN 0 0 0 255 ECU_ADDRESS 0 SYMBOL_LINK "Rte_CDD_FordT3T6McuCfg_PwrDiscnctSwtDiagAdcFaild_Logl" 0 DISPLAY_IDENTIFIER CDD_FordT3T6McuCfg.SenderPorts.PwrDiscnctSwtDiagAdcFaild.Logl /end MEASUREMENT
/begin MEASUREMENT CDD_GtmCfgAndUse.AdcStrtOfCnvn2 "MICROSAR RTE" ULONG NO_COMPU_METHOD 0 0 0 4294967295 ECU_ADDRESS 0 SYMBOL_LINK "Rte_CDD_GtmCfgAndUse_AdcStrtOfCnvn2" 0 DISPLAY_IDENTIFIER CDD_GtmCfgAndUse.PerInstanceMemories.AdcStrtOfCnvn2 /end MEASUREMENT
/begin MEASUREMENT CDD_GtmCfgAndUse.AdcStrtOfCnvnPeak "MICROSAR RTE" ULONG NO_COMPU_METHOD 0 0 0 4294967295 ECU_ADDRESS 0 SYMBOL_LINK "Rte_CDD_GtmCfgAndUse_AdcStrtOfCnvnPeak" 0 DISPLAY_IDENTIFIER CDD_GtmCfgAndUse.PerInstanceMemories.AdcStrtOfCnvnPeak /end MEASUREMENT
/begin MEASUREMENT CDD_GtmCfgAndUse.Dma2MilliSecToMotCtrlTrig "MICROSAR RTE" ULONG NO_COMPU_METHOD 0 0 0 4294967295 ECU_ADDRESS 0 SYMBOL_LINK "Rte_CDD_GtmCfgAndUse_Dma2MilliSecToMotCtrlTrig" 0 DISPLAY_IDENTIFIER CDD_GtmCfgAndUse.PerInstanceMemories.Dma2MilliSecToMotCtrlTrig /end MEASUREMENT
/begin MEASUREMENT CDD_GtmCfgAndUse.DmaMotAgATrig "MICROSAR RTE" ULONG NO_COMPU_METHOD 0 0 0 4294967295 ECU_ADDRESS 0 SYMBOL_LINK "Rte_CDD_GtmCfgAndUse_DmaMotAgATrig" 0 DISPLAY_IDENTIFIER CDD_GtmCfgAndUse.PerInstanceMemories.DmaMotAgATrig /end MEASUREMENT
/begin MEASUREMENT CDD_GtmCfgAndUse.DmaMotCtrlTo2MilliSecTrig "MICROSAR RTE" ULONG NO_COMPU_METHOD 0 0 0 4294967295 ECU_ADDRESS 0 SYMBOL_LINK "Rte_CDD_GtmCfgAndUse_DmaMotCtrlTo2MilliSecTrig" 0 DISPLAY_IDENTIFIER CDD_GtmCfgAndUse.PerInstanceMemories.DmaMotCtrlTo2MilliSecTrig /end MEASUREMENT
/begin MEASUREMENT CDD_GtmCfgAndUse.IvtrFetFltPha.Val "MICROSAR RTE" UBYTE RTE_CM_ENUM_IvtrFetFltPha1 0 0 0 255 ECU_ADDRESS 0 SYMBOL_LINK "Rte_GateDrv0Ctrl_IvtrFetFltPha_Val" 0 DISPLAY_IDENTIFIER CDD_GtmCfgAndUse.ReceiverPorts.IvtrFetFltPha.Val /end MEASUREMENT
/begin MEASUREMENT CDD_GtmCfgAndUse.MissUpdCntr "MICROSAR RTE" UWORD NO_COMPU_METHOD 0 0 0 65535 ECU_ADDRESS 0 SYMBOL_LINK "Rte_CDD_GtmCfgAndUse_MissUpdCntr" 0 DISPLAY_IDENTIFIER CDD_GtmCfgAndUse.PerInstanceMemories.MissUpdCntr /end MEASUREMENT
/begin MEASUREMENT CDD_GtmCfgAndUse.MissUpdIninCntr "MICROSAR RTE" UBYTE NO_COMPU_METHOD 0 0 0 255 ECU_ADDRESS 0 SYMBOL_LINK "Rte_CDD_GtmCfgAndUse_MissUpdIninCntr" 0 DISPLAY_IDENTIFIER CDD_GtmCfgAndUse.PerInstanceMemories.MissUpdIninCntr /end MEASUREMENT
/begin MEASUREMENT CDD_GtmCfgAndUse.MotCurrEolCalSt.Val "MICROSAR RTE" UBYTE RTE_CM_ENUM_MotCurrEolCalSt2 0 0 0 255 ECU_ADDRESS 0 SYMBOL_LINK "Rte_CDD_CurrMeas_MotCurrEolCalSt_Val" 0 DISPLAY_IDENTIFIER CDD_GtmCfgAndUse.ReceiverPorts.MotCurrEolCalSt.Val /end MEASUREMENT
/begin MEASUREMENT CDD_GtmCfgAndUse.PhaAFetFldSts "MICROSAR RTE" UBYTE RTE_CM_BOOLEAN 0 0 0 255 ECU_ADDRESS 0 SYMBOL_LINK "Rte_CDD_GtmCfgAndUse_PhaAFetFldSts" 0 DISPLAY_IDENTIFIER CDD_GtmCfgAndUse.PerInstanceMemories.PhaAFetFldSts /end MEASUREMENT
/begin MEASUREMENT CDD_GtmCfgAndUse.PhaBFetFldSts "MICROSAR RTE" UBYTE RTE_CM_BOOLEAN 0 0 0 255 ECU_ADDRESS 0 SYMBOL_LINK "Rte_CDD_GtmCfgAndUse_PhaBFetFldSts" 0 DISPLAY_IDENTIFIER CDD_GtmCfgAndUse.PerInstanceMemories.PhaBFetFldSts /end MEASUREMENT
/begin MEASUREMENT CDD_GtmCfgAndUse.PhaCFetFldSts "MICROSAR RTE" UBYTE RTE_CM_BOOLEAN 0 0 0 255 ECU_ADDRESS 0 SYMBOL_LINK "Rte_CDD_GtmCfgAndUse_PhaCFetFldSts" 0 DISPLAY_IDENTIFIER CDD_GtmCfgAndUse.PerInstanceMemories.PhaCFetFldSts /end MEASUREMENT
/begin MEASUREMENT CDD_GtmCfgAndUse.PhaOnTiCntrAPrev "MICROSAR RTE" ULONG NO_COMPU_METHOD 0 0 0 4294967295 ECU_ADDRESS 0 SYMBOL_LINK "Rte_CDD_GtmCfgAndUse_PhaOnTiCntrAPrev" 0 DISPLAY_IDENTIFIER CDD_GtmCfgAndUse.PerInstanceMemories.PhaOnTiCntrAPrev /end MEASUREMENT
/begin MEASUREMENT CDD_GtmCfgAndUse.PhaOnTiCntrBPrev "MICROSAR RTE" ULONG NO_COMPU_METHOD 0 0 0 4294967295 ECU_ADDRESS 0 SYMBOL_LINK "Rte_CDD_GtmCfgAndUse_PhaOnTiCntrBPrev" 0 DISPLAY_IDENTIFIER CDD_GtmCfgAndUse.PerInstanceMemories.PhaOnTiCntrBPrev /end MEASUREMENT
/begin MEASUREMENT CDD_GtmCfgAndUse.PhaOnTiCntrCPrev "MICROSAR RTE" ULONG NO_COMPU_METHOD 0 0 0 4294967295 ECU_ADDRESS 0 SYMBOL_LINK "Rte_CDD_GtmCfgAndUse_PhaOnTiCntrCPrev" 0 DISPLAY_IDENTIFIER CDD_GtmCfgAndUse.PerInstanceMemories.PhaOnTiCntrCPrev /end MEASUREMENT
/begin MEASUREMENT CDD_GtmCfgAndUse.PhaOnTiMeasdA.Val "MICROSAR RTE" ULONG NO_COMPU_METHOD 0 0 0 4294967295 ECU_ADDRESS 0 SYMBOL_LINK "Rte_CDD_GtmCfgAndUse_PhaOnTiMeasdA_Val" 0 DISPLAY_IDENTIFIER CDD_GtmCfgAndUse.SenderPorts.PhaOnTiMeasdA.Val /end MEASUREMENT
/begin MEASUREMENT CDD_GtmCfgAndUse.PhaOnTiMeasdB.Val "MICROSAR RTE" ULONG NO_COMPU_METHOD 0 0 0 4294967295 ECU_ADDRESS 0 SYMBOL_LINK "Rte_CDD_GtmCfgAndUse_PhaOnTiMeasdB_Val" 0 DISPLAY_IDENTIFIER CDD_GtmCfgAndUse.SenderPorts.PhaOnTiMeasdB.Val /end MEASUREMENT
/begin MEASUREMENT CDD_GtmCfgAndUse.PhaOnTiMeasdC.Val "MICROSAR RTE" ULONG NO_COMPU_METHOD 0 0 0 4294967295 ECU_ADDRESS 0 SYMBOL_LINK "Rte_CDD_GtmCfgAndUse_PhaOnTiMeasdC_Val" 0 DISPLAY_IDENTIFIER CDD_GtmCfgAndUse.SenderPorts.PhaOnTiMeasdC.Val /end MEASUREMENT
/begin MEASUREMENT CDD_GtmCfgAndUse.SysSt.Val "MICROSAR RTE" UBYTE RTE_CM_ENUM_SysSt1 0 0 0 255 ECU_ADDRESS 0 SYMBOL_LINK "Rte_SysStMod_SysSt_Val" 0 DISPLAY_IDENTIFIER CDD_GtmCfgAndUse.ReceiverPorts.SysSt.Val /end MEASUREMENT
/begin MEASUREMENT CDD_GtmCfgAndUse.SysStEnaPrev "MICROSAR RTE" UBYTE RTE_CM_BOOLEAN 0 0 0 255 ECU_ADDRESS 0 SYMBOL_LINK "Rte_CDD_GtmCfgAndUse_SysStEnaPrev" 0 DISPLAY_IDENTIFIER CDD_GtmCfgAndUse.PerInstanceMemories.SysStEnaPrev /end MEASUREMENT
/begin MEASUREMENT CDD_HwTq1Meas.HwTq1.Val "MICROSAR RTE" FLOAT32_IEEE NO_COMPU_METHOD 0 0 -3.402823466e+38 3.402823466e+38 ECU_ADDRESS 0 SYMBOL_LINK "Rte_CDD_HwTq1Meas_HwTq1_Val" 0 DISPLAY_IDENTIFIER CDD_HwTq1Meas.SenderPorts.HwTq1.Val /end MEASUREMENT
/begin MEASUREMENT CDD_HwTq1Meas.HwTq1ComStsErrCntr "MICROSAR RTE" UBYTE NO_COMPU_METHOD 0 0 0 255 ECU_ADDRESS 0 SYMBOL_LINK "Rte_CDD_HwTq1Meas_HwTq1ComStsErrCntr" 0 DISPLAY_IDENTIFIER CDD_HwTq1Meas.PerInstanceMemories.HwTq1ComStsErrCntr /end MEASUREMENT
/begin MEASUREMENT CDD_HwTq1Meas.HwTq1IntSnsrErrCntr "MICROSAR RTE" UBYTE NO_COMPU_METHOD 0 0 0 255 ECU_ADDRESS 0 SYMBOL_LINK "Rte_CDD_HwTq1Meas_HwTq1IntSnsrErrCntr" 0 DISPLAY_IDENTIFIER CDD_HwTq1Meas.PerInstanceMemories.HwTq1IntSnsrErrCntr /end MEASUREMENT
/begin MEASUREMENT CDD_HwTq1Meas.HwTq1MeasPrevHwTq1 "MICROSAR RTE" FLOAT32_IEEE NO_COMPU_METHOD 0 0 -3.402823466e+38 3.402823466e+38 ECU_ADDRESS 0 SYMBOL_LINK "Rte_CDD_HwTq1Meas_HwTq1MeasPrevHwTq1" 0 DISPLAY_IDENTIFIER CDD_HwTq1Meas.PerInstanceMemories.HwTq1MeasPrevHwTq1 /end MEASUREMENT
/begin MEASUREMENT CDD_HwTq1Meas.HwTq1MeasPrevRollgCntr "MICROSAR RTE" UBYTE NO_COMPU_METHOD 0 0 0 255 ECU_ADDRESS 0 SYMBOL_LINK "Rte_CDD_HwTq1Meas_HwTq1MeasPrevRollgCntr" 0 DISPLAY_IDENTIFIER CDD_HwTq1Meas.PerInstanceMemories.HwTq1MeasPrevRollgCntr /end MEASUREMENT
/begin MEASUREMENT CDD_HwTq1Meas.HwTq1MsgMissRxCnt "MICROSAR RTE" ULONG NO_COMPU_METHOD 0 0 0 4294967295 ECU_ADDRESS 0 SYMBOL_LINK "Rte_CDD_HwTq1Meas_HwTq1MsgMissRxCnt" 0 DISPLAY_IDENTIFIER CDD_HwTq1Meas.PerInstanceMemories.HwTq1MsgMissRxCnt /end MEASUREMENT
/begin MEASUREMENT CDD_HwTq1Meas.HwTq1Offs.OffsTrim "MICROSAR RTE" FLOAT32_IEEE NO_COMPU_METHOD 0 0 -3.402823466e+38 3.402823466e+38 ECU_ADDRESS 0 SYMBOL_LINK "Rte_CDD_HwTq1Meas_HwTq1Offs.OffsTrim" 0 DISPLAY_IDENTIFIER CDD_HwTq1Meas.PerInstanceMemories.HwTq1Offs.OffsTrim /end MEASUREMENT
/begin MEASUREMENT CDD_HwTq1Meas.HwTq1Offs.OffsTrimPrfmdSts "MICROSAR RTE" UBYTE RTE_CM_BOOLEAN 0 0 0 255 ECU_ADDRESS 0 SYMBOL_LINK "Rte_CDD_HwTq1Meas_HwTq1Offs.OffsTrimPrfmdSts" 0 DISPLAY_IDENTIFIER CDD_HwTq1Meas.PerInstanceMemories.HwTq1Offs.OffsTrimPrfmdSts /end MEASUREMENT
/begin MEASUREMENT CDD_HwTq1Meas.HwTq1Polarity.Val "MICROSAR RTE" SBYTE NO_COMPU_METHOD 0 0 -128 127 ECU_ADDRESS 0 SYMBOL_LINK "Rte_PolarityCfg_HwTq1Polarity_Val" 0 DISPLAY_IDENTIFIER CDD_HwTq1Meas.ReceiverPorts.HwTq1Polarity.Val /end MEASUREMENT
/begin MEASUREMENT CDD_HwTq1Meas.HwTq1Qlfr.Val "MICROSAR RTE" UBYTE RTE_CM_ENUM_SigQlfr1 0 0 0 255 ECU_ADDRESS 0 SYMBOL_LINK "Rte_CDD_HwTq1Meas_HwTq1Qlfr_Val" 0 DISPLAY_IDENTIFIER CDD_HwTq1Meas.SenderPorts.HwTq1Qlfr.Val /end MEASUREMENT
/begin MEASUREMENT CDD_HwTq1Meas.HwTq1RollgCntr.Val "MICROSAR RTE" UBYTE NO_COMPU_METHOD 0 0 0 255 ECU_ADDRESS 0 SYMBOL_LINK "Rte_CDD_HwTq1Meas_HwTq1RollgCntr_Val" 0 DISPLAY_IDENTIFIER CDD_HwTq1Meas.SenderPorts.HwTq1RollgCntr.Val /end MEASUREMENT
/begin MEASUREMENT CDD_HwTq1Meas.RackLimrCcwEot1 "MICROSAR RTE" FLOAT32_IEEE NO_COMPU_METHOD 0 0 -3.402823466e+38 3.402823466e+38 ECU_ADDRESS 0 SYMBOL_LINK "Rte_CDD_HwTq1Meas_RackLimrCcwEot1" 0 DISPLAY_IDENTIFIER CDD_HwTq1Meas.PerInstanceMemories.RackLimrCcwEot1 /end MEASUREMENT
/begin MEASUREMENT CDD_HwTq1Meas.RackLimrCcwEotSig1.Val "MICROSAR RTE" FLOAT32_IEEE NO_COMPU_METHOD 0 0 -3.402823466e+38 3.402823466e+38 ECU_ADDRESS 0 SYMBOL_LINK "Rte_CDD_HwTq1Meas_RackLimrCcwEotSig1_Val" 0 DISPLAY_IDENTIFIER CDD_HwTq1Meas.SenderPorts.RackLimrCcwEotSig1.Val /end MEASUREMENT
/begin MEASUREMENT CDD_HwTq1Meas.RackLimrCwEot1 "MICROSAR RTE" FLOAT32_IEEE NO_COMPU_METHOD 0 0 -3.402823466e+38 3.402823466e+38 ECU_ADDRESS 0 SYMBOL_LINK "Rte_CDD_HwTq1Meas_RackLimrCwEot1" 0 DISPLAY_IDENTIFIER CDD_HwTq1Meas.PerInstanceMemories.RackLimrCwEot1 /end MEASUREMENT
/begin MEASUREMENT CDD_HwTq1Meas.RackLimrCwEotSig1.Val "MICROSAR RTE" FLOAT32_IEEE NO_COMPU_METHOD 0 0 -3.402823466e+38 3.402823466e+38 ECU_ADDRESS 0 SYMBOL_LINK "Rte_CDD_HwTq1Meas_RackLimrCwEotSig1_Val" 0 DISPLAY_IDENTIFIER CDD_HwTq1Meas.SenderPorts.RackLimrCwEotSig1.Val /end MEASUREMENT
/begin MEASUREMENT CDD_HwTq1Meas.RackLimrEot1Avl "MICROSAR RTE" UBYTE RTE_CM_BOOLEAN 0 0 0 255 ECU_ADDRESS 0 SYMBOL_LINK "Rte_CDD_HwTq1Meas_RackLimrEot1Avl" 0 DISPLAY_IDENTIFIER CDD_HwTq1Meas.PerInstanceMemories.RackLimrEot1Avl /end MEASUREMENT
/begin MEASUREMENT CDD_HwTq1Meas.RackLimrEot1Data0 "MICROSAR RTE" UBYTE NO_COMPU_METHOD 0 0 0 255 ECU_ADDRESS 0 SYMBOL_LINK "Rte_CDD_HwTq1Meas_RackLimrEot1Data0" 0 DISPLAY_IDENTIFIER CDD_HwTq1Meas.PerInstanceMemories.RackLimrEot1Data0 /end MEASUREMENT
/begin MEASUREMENT CDD_HwTq1Meas.RackLimrEot1Data1 "MICROSAR RTE" UBYTE NO_COMPU_METHOD 0 0 0 255 ECU_ADDRESS 0 SYMBOL_LINK "Rte_CDD_HwTq1Meas_RackLimrEot1Data1" 0 DISPLAY_IDENTIFIER CDD_HwTq1Meas.PerInstanceMemories.RackLimrEot1Data1 /end MEASUREMENT
/begin MEASUREMENT CDD_HwTq1Meas.RackLimrEot1Data2 "MICROSAR RTE" UBYTE NO_COMPU_METHOD 0 0 0 255 ECU_ADDRESS 0 SYMBOL_LINK "Rte_CDD_HwTq1Meas_RackLimrEot1Data2" 0 DISPLAY_IDENTIFIER CDD_HwTq1Meas.PerInstanceMemories.RackLimrEot1Data2 /end MEASUREMENT
/begin MEASUREMENT CDD_HwTq1Meas.RackLimrEot1Id2DataReadCmpl "MICROSAR RTE" UBYTE RTE_CM_BOOLEAN 0 0 0 255 ECU_ADDRESS 0 SYMBOL_LINK "Rte_CDD_HwTq1Meas_RackLimrEot1Id2DataReadCmpl" 0 DISPLAY_IDENTIFIER CDD_HwTq1Meas.PerInstanceMemories.RackLimrEot1Id2DataReadCmpl /end MEASUREMENT
/begin MEASUREMENT CDD_HwTq1Meas.RackLimrEot1Id3DataReadCmpl "MICROSAR RTE" UBYTE RTE_CM_BOOLEAN 0 0 0 255 ECU_ADDRESS 0 SYMBOL_LINK "Rte_CDD_HwTq1Meas_RackLimrEot1Id3DataReadCmpl" 0 DISPLAY_IDENTIFIER CDD_HwTq1Meas.PerInstanceMemories.RackLimrEot1Id3DataReadCmpl /end MEASUREMENT
/begin MEASUREMENT CDD_HwTq1Meas.RackLimrEot1Id4DataReadCmpl "MICROSAR RTE" UBYTE RTE_CM_BOOLEAN 0 0 0 255 ECU_ADDRESS 0 SYMBOL_LINK "Rte_CDD_HwTq1Meas_RackLimrEot1Id4DataReadCmpl" 0 DISPLAY_IDENTIFIER CDD_HwTq1Meas.PerInstanceMemories.RackLimrEot1Id4DataReadCmpl /end MEASUREMENT
/begin MEASUREMENT CDD_HwTq1Meas.RackLimrEotSig1Avl.Logl "MICROSAR RTE" UBYTE RTE_CM_BOOLEAN 0 0 0 255 ECU_ADDRESS 0 SYMBOL_LINK "Rte_CDD_HwTq1Meas_RackLimrEotSig1Avl_Logl" 0 DISPLAY_IDENTIFIER CDD_HwTq1Meas.SenderPorts.RackLimrEotSig1Avl.Logl /end MEASUREMENT
/begin MEASUREMENT CDD_HwTq8Meas.HwTq8.Val "MICROSAR RTE" FLOAT32_IEEE NO_COMPU_METHOD 0 0 -3.402823466e+38 3.402823466e+38 ECU_ADDRESS 0 SYMBOL_LINK "Rte_CDD_HwTq8Meas_HwTq8_Val" 0 DISPLAY_IDENTIFIER CDD_HwTq8Meas.SenderPorts.HwTq8.Val /end MEASUREMENT
/begin MEASUREMENT CDD_HwTq8Meas.HwTq8ComStsErrCntr "MICROSAR RTE" UBYTE NO_COMPU_METHOD 0 0 0 255 ECU_ADDRESS 0 SYMBOL_LINK "Rte_CDD_HwTq8Meas_HwTq8ComStsErrCntr" 0 DISPLAY_IDENTIFIER CDD_HwTq8Meas.PerInstanceMemories.HwTq8ComStsErrCntr /end MEASUREMENT
/begin MEASUREMENT CDD_HwTq8Meas.HwTq8IntSnsrErrCntr "MICROSAR RTE" UBYTE NO_COMPU_METHOD 0 0 0 255 ECU_ADDRESS 0 SYMBOL_LINK "Rte_CDD_HwTq8Meas_HwTq8IntSnsrErrCntr" 0 DISPLAY_IDENTIFIER CDD_HwTq8Meas.PerInstanceMemories.HwTq8IntSnsrErrCntr /end MEASUREMENT
/begin MEASUREMENT CDD_HwTq8Meas.HwTq8MsgMissRxCnt "MICROSAR RTE" ULONG NO_COMPU_METHOD 0 0 0 4294967295 ECU_ADDRESS 0 SYMBOL_LINK "Rte_CDD_HwTq8Meas_HwTq8MsgMissRxCnt" 0 DISPLAY_IDENTIFIER CDD_HwTq8Meas.PerInstanceMemories.HwTq8MsgMissRxCnt /end MEASUREMENT
/begin MEASUREMENT CDD_HwTq8Meas.HwTq8Offs.OffsTrim "MICROSAR RTE" FLOAT32_IEEE NO_COMPU_METHOD 0 0 -3.402823466e+38 3.402823466e+38 ECU_ADDRESS 0 SYMBOL_LINK "Rte_CDD_HwTq8Meas_HwTq8Offs.OffsTrim" 0 DISPLAY_IDENTIFIER CDD_HwTq8Meas.PerInstanceMemories.HwTq8Offs.OffsTrim /end MEASUREMENT
/begin MEASUREMENT CDD_HwTq8Meas.HwTq8Offs.OffsTrimPrfmdSts "MICROSAR RTE" UBYTE RTE_CM_BOOLEAN 0 0 0 255 ECU_ADDRESS 0 SYMBOL_LINK "Rte_CDD_HwTq8Meas_HwTq8Offs.OffsTrimPrfmdSts" 0 DISPLAY_IDENTIFIER CDD_HwTq8Meas.PerInstanceMemories.HwTq8Offs.OffsTrimPrfmdSts /end MEASUREMENT
/begin MEASUREMENT CDD_HwTq8Meas.HwTq8Polarity.Val "MICROSAR RTE" SBYTE NO_COMPU_METHOD 0 0 -128 127 ECU_ADDRESS 0 SYMBOL_LINK "Rte_PolarityCfg_HwTq0Polarity_Val" 0 DISPLAY_IDENTIFIER CDD_HwTq8Meas.ReceiverPorts.HwTq8Polarity.Val /end MEASUREMENT
/begin MEASUREMENT CDD_HwTq8Meas.HwTq8PrevHwTq8 "MICROSAR RTE" FLOAT32_IEEE NO_COMPU_METHOD 0 0 -3.402823466e+38 3.402823466e+38 ECU_ADDRESS 0 SYMBOL_LINK "Rte_CDD_HwTq8Meas_HwTq8PrevHwTq8" 0 DISPLAY_IDENTIFIER CDD_HwTq8Meas.PerInstanceMemories.HwTq8PrevHwTq8 /end MEASUREMENT
/begin MEASUREMENT CDD_HwTq8Meas.HwTq8PrevRollgCntr "MICROSAR RTE" UBYTE NO_COMPU_METHOD 0 0 0 255 ECU_ADDRESS 0 SYMBOL_LINK "Rte_CDD_HwTq8Meas_HwTq8PrevRollgCntr" 0 DISPLAY_IDENTIFIER CDD_HwTq8Meas.PerInstanceMemories.HwTq8PrevRollgCntr /end MEASUREMENT
/begin MEASUREMENT CDD_HwTq8Meas.HwTq8Qlfr.Val "MICROSAR RTE" UBYTE RTE_CM_ENUM_SigQlfr1 0 0 0 255 ECU_ADDRESS 0 SYMBOL_LINK "Rte_CDD_HwTq8Meas_HwTq8Qlfr_Val" 0 DISPLAY_IDENTIFIER CDD_HwTq8Meas.SenderPorts.HwTq8Qlfr.Val /end MEASUREMENT
/begin MEASUREMENT CDD_HwTq8Meas.HwTq8RollgCntr.Val "MICROSAR RTE" UBYTE NO_COMPU_METHOD 0 0 0 255 ECU_ADDRESS 0 SYMBOL_LINK "Rte_CDD_HwTq8Meas_HwTq8RollgCntr_Val" 0 DISPLAY_IDENTIFIER CDD_HwTq8Meas.SenderPorts.HwTq8RollgCntr.Val /end MEASUREMENT
/begin MEASUREMENT CDD_HwTq8Meas.RackLimrCcwEot8 "MICROSAR RTE" FLOAT32_IEEE NO_COMPU_METHOD 0 0 -3.402823466e+38 3.402823466e+38 ECU_ADDRESS 0 SYMBOL_LINK "Rte_CDD_HwTq8Meas_RackLimrCcwEot8" 0 DISPLAY_IDENTIFIER CDD_HwTq8Meas.PerInstanceMemories.RackLimrCcwEot8 /end MEASUREMENT
/begin MEASUREMENT CDD_HwTq8Meas.RackLimrCcwEotSig8.Val "MICROSAR RTE" FLOAT32_IEEE NO_COMPU_METHOD 0 0 -3.402823466e+38 3.402823466e+38 ECU_ADDRESS 0 SYMBOL_LINK "Rte_CDD_HwTq8Meas_RackLimrCcwEotSig8_Val" 0 DISPLAY_IDENTIFIER CDD_HwTq8Meas.SenderPorts.RackLimrCcwEotSig8.Val /end MEASUREMENT
/begin MEASUREMENT CDD_HwTq8Meas.RackLimrCwEot8 "MICROSAR RTE" FLOAT32_IEEE NO_COMPU_METHOD 0 0 -3.402823466e+38 3.402823466e+38 ECU_ADDRESS 0 SYMBOL_LINK "Rte_CDD_HwTq8Meas_RackLimrCwEot8" 0 DISPLAY_IDENTIFIER CDD_HwTq8Meas.PerInstanceMemories.RackLimrCwEot8 /end MEASUREMENT
/begin MEASUREMENT CDD_HwTq8Meas.RackLimrCwEotSig8.Val "MICROSAR RTE" FLOAT32_IEEE NO_COMPU_METHOD 0 0 -3.402823466e+38 3.402823466e+38 ECU_ADDRESS 0 SYMBOL_LINK "Rte_CDD_HwTq8Meas_RackLimrCwEotSig8_Val" 0 DISPLAY_IDENTIFIER CDD_HwTq8Meas.SenderPorts.RackLimrCwEotSig8.Val /end MEASUREMENT
/begin MEASUREMENT CDD_HwTq8Meas.RackLimrEot8Avl "MICROSAR RTE" UBYTE RTE_CM_BOOLEAN 0 0 0 255 ECU_ADDRESS 0 SYMBOL_LINK "Rte_CDD_HwTq8Meas_RackLimrEot8Avl" 0 DISPLAY_IDENTIFIER CDD_HwTq8Meas.PerInstanceMemories.RackLimrEot8Avl /end MEASUREMENT
/begin MEASUREMENT CDD_HwTq8Meas.RackLimrEot8Data0 "MICROSAR RTE" UBYTE NO_COMPU_METHOD 0 0 0 255 ECU_ADDRESS 0 SYMBOL_LINK "Rte_CDD_HwTq8Meas_RackLimrEot8Data0" 0 DISPLAY_IDENTIFIER CDD_HwTq8Meas.PerInstanceMemories.RackLimrEot8Data0 /end MEASUREMENT
/begin MEASUREMENT CDD_HwTq8Meas.RackLimrEot8Data1 "MICROSAR RTE" UBYTE NO_COMPU_METHOD 0 0 0 255 ECU_ADDRESS 0 SYMBOL_LINK "Rte_CDD_HwTq8Meas_RackLimrEot8Data1" 0 DISPLAY_IDENTIFIER CDD_HwTq8Meas.PerInstanceMemories.RackLimrEot8Data1 /end MEASUREMENT
/begin MEASUREMENT CDD_HwTq8Meas.RackLimrEot8Data2 "MICROSAR RTE" UBYTE NO_COMPU_METHOD 0 0 0 255 ECU_ADDRESS 0 SYMBOL_LINK "Rte_CDD_HwTq8Meas_RackLimrEot8Data2" 0 DISPLAY_IDENTIFIER CDD_HwTq8Meas.PerInstanceMemories.RackLimrEot8Data2 /end MEASUREMENT
/begin MEASUREMENT CDD_HwTq8Meas.RackLimrEot8Id2DataReadCmpl "MICROSAR RTE" UBYTE RTE_CM_BOOLEAN 0 0 0 255 ECU_ADDRESS 0 SYMBOL_LINK "Rte_CDD_HwTq8Meas_RackLimrEot8Id2DataReadCmpl" 0 DISPLAY_IDENTIFIER CDD_HwTq8Meas.PerInstanceMemories.RackLimrEot8Id2DataReadCmpl /end MEASUREMENT
/begin MEASUREMENT CDD_HwTq8Meas.RackLimrEot8Id3DataReadCmpl "MICROSAR RTE" UBYTE RTE_CM_BOOLEAN 0 0 0 255 ECU_ADDRESS 0 SYMBOL_LINK "Rte_CDD_HwTq8Meas_RackLimrEot8Id3DataReadCmpl" 0 DISPLAY_IDENTIFIER CDD_HwTq8Meas.PerInstanceMemories.RackLimrEot8Id3DataReadCmpl /end MEASUREMENT
/begin MEASUREMENT CDD_HwTq8Meas.RackLimrEot8Id4DataReadCmpl "MICROSAR RTE" UBYTE RTE_CM_BOOLEAN 0 0 0 255 ECU_ADDRESS 0 SYMBOL_LINK "Rte_CDD_HwTq8Meas_RackLimrEot8Id4DataReadCmpl" 0 DISPLAY_IDENTIFIER CDD_HwTq8Meas.PerInstanceMemories.RackLimrEot8Id4DataReadCmpl /end MEASUREMENT
/begin MEASUREMENT CDD_HwTq8Meas.RackLimrEotSig8Avl.Logl "MICROSAR RTE" UBYTE RTE_CM_BOOLEAN 0 0 0 255 ECU_ADDRESS 0 SYMBOL_LINK "Rte_CDD_HwTq8Meas_RackLimrEotSig8Avl_Logl" 0 DISPLAY_IDENTIFIER CDD_HwTq8Meas.SenderPorts.RackLimrEotSig8Avl.Logl /end MEASUREMENT
/begin MEASUREMENT CDD_McuCoreCfgAndDiagc.dMcuCoreCfgAndDiagcBistRunCmpl "MCU Core Configuration And Diagnostic BIST Run Complete\r\n" UBYTE RTE_CM_BOOLEAN 0 0 0 255 ECU_ADDRESS 0 SYMBOL_LINK "Rte_CDD_McuCoreCfgAndDiagc_dMcuCoreCfgAndDiagcBistRunCmpl" 0 DISPLAY_IDENTIFIER CDD_McuCoreCfgAndDiagc.PerInstanceMemories.dMcuCoreCfgAndDiagcBistRunCmpl /end MEASUREMENT
/begin MEASUREMENT CDD_McuDiagc.FastLoopCntr.Val "MICROSAR RTE" UWORD NO_COMPU_METHOD 0 0 0 65535 ECU_ADDRESS 0 SYMBOL_LINK "Rte_CDD_MotCtrlMgr_FastLoopCntr_Val" 0 DISPLAY_IDENTIFIER CDD_McuDiagc.ReceiverPorts.FastLoopCntr.Val /end MEASUREMENT
/begin MEASUREMENT CDD_McuDiagc.FastLoopCntrDiagcCfgd "MICROSAR RTE" UBYTE NO_COMPU_METHOD 0 0 0 255 ECU_ADDRESS 0 SYMBOL_LINK "Rte_CDD_McuDiagc_FastLoopCntrDiagcCfgd" 0 DISPLAY_IDENTIFIER CDD_McuDiagc.PerInstanceMemories.FastLoopCntrDiagcCfgd /end MEASUREMENT
/begin MEASUREMENT CDD_McuDiagc.FastLoopCntrPrev "MICROSAR RTE" UWORD NO_COMPU_METHOD 0 0 0 65535 ECU_ADDRESS 0 SYMBOL_LINK "Rte_CDD_McuDiagc_FastLoopCntrPrev" 0 DISPLAY_IDENTIFIER CDD_McuDiagc.PerInstanceMemories.FastLoopCntrPrev /end MEASUREMENT
/begin MEASUREMENT CDD_McuDiagc.LoopCntr2MilliSec.Val "MICROSAR RTE" UWORD NO_COMPU_METHOD 0 0 0 65535 ECU_ADDRESS 0 SYMBOL_LINK "Rte_CDD_McuDiagc_LoopCntr2MilliSec_Val" 0 DISPLAY_IDENTIFIER CDD_McuDiagc.SenderPorts.LoopCntr2MilliSec.Val /end MEASUREMENT
/begin MEASUREMENT CDD_McuDiagc.LoopCntr2MilliSecStore "MICROSAR RTE" UWORD NO_COMPU_METHOD 0 0 0 65535 ECU_ADDRESS 0 SYMBOL_LINK "Rte_CDD_McuDiagc_LoopCntr2MilliSecStore" 0 DISPLAY_IDENTIFIER CDD_McuDiagc.PerInstanceMemories.LoopCntr2MilliSecStore /end MEASUREMENT
/begin MEASUREMENT CDD_McuDiagc.LoopCntrPrev "MICROSAR RTE" UWORD NO_COMPU_METHOD 0 0 0 65535 ECU_ADDRESS 0 SYMBOL_LINK "Rte_CDD_McuDiagc_LoopCntrPrev" 0 DISPLAY_IDENTIFIER CDD_McuDiagc.PerInstanceMemories.LoopCntrPrev /end MEASUREMENT
/begin MEASUREMENT CDD_McuDiagc.SlowLoopCntr.Val "MICROSAR RTE" UWORD NO_COMPU_METHOD 0 0 0 65535 ECU_ADDRESS 0 SYMBOL_LINK "Rte_CDD_MotCtrlMgr_SlowLoopCntr_Val" 0 DISPLAY_IDENTIFIER CDD_McuDiagc.ReceiverPorts.SlowLoopCntr.Val /end MEASUREMENT
/begin MEASUREMENT CDD_McuDiagc.dMcuDiagcFastLoopCntrMax "MICROSAR RTE" UWORD NO_COMPU_METHOD 0 0 0 65535 ECU_ADDRESS 0 SYMBOL_LINK "Rte_CDD_McuDiagc_dMcuDiagcFastLoopCntrMax" 0 DISPLAY_IDENTIFIER CDD_McuDiagc.PerInstanceMemories.dMcuDiagcFastLoopCntrMax /end MEASUREMENT
/begin MEASUREMENT CDD_McuDiagc.dMcuDiagcFastLoopCntrMin "MICROSAR RTE" UWORD NO_COMPU_METHOD 0 0 0 65535 ECU_ADDRESS 0 SYMBOL_LINK "Rte_CDD_McuDiagc_dMcuDiagcFastLoopCntrMin" 0 DISPLAY_IDENTIFIER CDD_McuDiagc.PerInstanceMemories.dMcuDiagcFastLoopCntrMin /end MEASUREMENT
/begin MEASUREMENT CDD_McuDiagc.dMcuDiagcLoopCntr2MilliSecMotCtrlDif "MICROSAR RTE" UWORD NO_COMPU_METHOD 0 0 0 65535 ECU_ADDRESS 0 SYMBOL_LINK "Rte_CDD_McuDiagc_dMcuDiagcLoopCntr2MilliSecMotCtrlDif" 0 DISPLAY_IDENTIFIER CDD_McuDiagc.PerInstanceMemories.dMcuDiagcLoopCntr2MilliSecMotCtrlDif /end MEASUREMENT
/begin MEASUREMENT CDD_MotAg5Meas.MotAg5Cos.Val "MICROSAR RTE" FLOAT32_IEEE NO_COMPU_METHOD 0 0 -3.402823466e+38 3.402823466e+38 ECU_ADDRESS 0 SYMBOL_LINK "Rte_CDD_MotCtrlMgr_MotAg5Cos_Val" 0 DISPLAY_IDENTIFIER CDD_MotAg5Meas.ReceiverPorts.MotAg5Cos.Val /end MEASUREMENT
/begin MEASUREMENT CDD_MotAg5Meas.MotAg5CosAdcFaild.Logl "MICROSAR RTE" UBYTE RTE_CM_BOOLEAN 0 0 0 255 ECU_ADDRESS 0 SYMBOL_LINK "Rte_CDD_FordT3T6McuCfg_MotAg5CosAdcFaild_Logl" 0 DISPLAY_IDENTIFIER CDD_MotAg5Meas.ReceiverPorts.MotAg5CosAdcFaild.Logl /end MEASUREMENT
/begin MEASUREMENT CDD_MotAg5Meas.MotAg5CosMaxLpFil.FilGain "MICROSAR RTE" FLOAT32_IEEE NO_COMPU_METHOD 0 0 -3.402823466e+38 3.402823466e+38 ECU_ADDRESS 0 SYMBOL_LINK "Rte_CDD_MotAg5Meas_MotAg5CosMaxLpFil.FilGain" 0 DISPLAY_IDENTIFIER CDD_MotAg5Meas.PerInstanceMemories.MotAg5CosMaxLpFil.FilGain /end MEASUREMENT
/begin MEASUREMENT CDD_MotAg5Meas.MotAg5CosMaxLpFil.FilSt "MICROSAR RTE" FLOAT32_IEEE NO_COMPU_METHOD 0 0 -3.402823466e+38 3.402823466e+38 ECU_ADDRESS 0 SYMBOL_LINK "Rte_CDD_MotAg5Meas_MotAg5CosMaxLpFil.FilSt" 0 DISPLAY_IDENTIFIER CDD_MotAg5Meas.PerInstanceMemories.MotAg5CosMaxLpFil.FilSt /end MEASUREMENT
/begin MEASUREMENT CDD_MotAg5Meas.MotAg5CosMinLpFil.FilGain "MICROSAR RTE" FLOAT32_IEEE NO_COMPU_METHOD 0 0 -3.402823466e+38 3.402823466e+38 ECU_ADDRESS 0 SYMBOL_LINK "Rte_CDD_MotAg5Meas_MotAg5CosMinLpFil.FilGain" 0 DISPLAY_IDENTIFIER CDD_MotAg5Meas.PerInstanceMemories.MotAg5CosMinLpFil.FilGain /end MEASUREMENT
/begin MEASUREMENT CDD_MotAg5Meas.MotAg5CosMinLpFil.FilSt "MICROSAR RTE" FLOAT32_IEEE NO_COMPU_METHOD 0 0 -3.402823466e+38 3.402823466e+38 ECU_ADDRESS 0 SYMBOL_LINK "Rte_CDD_MotAg5Meas_MotAg5CosMinLpFil.FilSt" 0 DISPLAY_IDENTIFIER CDD_MotAg5Meas.PerInstanceMemories.MotAg5CosMinLpFil.FilSt /end MEASUREMENT
/begin MEASUREMENT CDD_MotAg5Meas.MotAg5CosRtAmpRecpr.Val "MICROSAR RTE" FLOAT32_IEEE NO_COMPU_METHOD 0 0 -3.402823466e+38 3.402823466e+38 ECU_ADDRESS 0 SYMBOL_LINK "Rte_CDD_MotAg5Meas_MotAg5CosRtAmpRecpr_Val" 0 DISPLAY_IDENTIFIER CDD_MotAg5Meas.SenderPorts.MotAg5CosRtAmpRecpr.Val /end MEASUREMENT
/begin MEASUREMENT CDD_MotAg5Meas.MotAg5CosRtOffs.Val "MICROSAR RTE" FLOAT32_IEEE NO_COMPU_METHOD 0 0 -3.402823466e+38 3.402823466e+38 ECU_ADDRESS 0 SYMBOL_LINK "Rte_CDD_MotAg5Meas_MotAg5CosRtOffs_Val" 0 DISPLAY_IDENTIFIER CDD_MotAg5Meas.SenderPorts.MotAg5CosRtOffs.Val /end MEASUREMENT
/begin GROUP CDD_FordBlaBoxIfCmn.FordVehYawRateCmpdRaw.Val "MICROSAR RTE" /begin SUB_GROUP /end SUB_GROUP /begin FUNCTION_LIST /end FUNCTION_LIST /begin REF_CHARACTERISTIC /end REF_CHARACTERISTIC /begin REF_MEASUREMENT CDD_FordBlaBoxIfCmn.FordVehYawRateCmpdRaw.Val /end REF_MEASUREMENT /end GROUP
/begin GROUP CDD_FordBlaBoxIfCmn.FordVehYawRateRaw.Ford_VehYaw_W_Actl "MICROSAR RTE" /begin SUB_GROUP /end SUB_GROUP /begin FUNCTION_LIST /end FUNCTION_LIST /begin REF_CHARACTERISTIC /end REF_CHARACTERISTIC /begin REF_MEASUREMENT CDD_FordBlaBoxIfCmn.FordVehYawRateRaw.Ford_VehYaw_W_Actl /end REF_MEASUREMENT /end GROUP
/begin GROUP CDD_FordBlaBoxIfCmn.FordVehYawRateRawVld.Logl "MICROSAR RTE" /begin SUB_GROUP /end SUB_GROUP /begin FUNCTION_LIST /end FUNCTION_LIST /begin REF_CHARACTERISTIC /end REF_CHARACTERISTIC /begin REF_MEASUREMENT CDD_FordBlaBoxIfCmn.FordVehYawRateRawVld.Logl /end REF_MEASUREMENT /end GROUP
/begin GROUP CDD_FordBlaBoxIfCmn.FordVehYawRateVld.Logl "MICROSAR RTE" /begin SUB_GROUP /end SUB_GROUP /begin FUNCTION_LIST /end FUNCTION_LIST /begin REF_CHARACTERISTIC /end REF_CHARACTERISTIC /begin REF_MEASUREMENT CDD_FordBlaBoxIfCmn.FordVehYawRateVld.Logl /end REF_MEASUREMENT /end GROUP
/begin GROUP CDD_FordBlaBoxIfCmn.FordVehYawStabyRaw.Val "MICROSAR RTE" /begin SUB_GROUP /end SUB_GROUP /begin FUNCTION_LIST /end FUNCTION_LIST /begin REF_CHARACTERISTIC /end REF_CHARACTERISTIC /begin REF_MEASUREMENT CDD_FordBlaBoxIfCmn.FordVehYawStabyRaw.Val /end REF_MEASUREMENT /end GROUP
/begin GROUP CDD_FordBlaBoxIfCmn.FordVehYawStabyVld.Logl "MICROSAR RTE" /begin SUB_GROUP /end SUB_GROUP /begin FUNCTION_LIST /end FUNCTION_LIST /begin REF_CHARACTERISTIC /end REF_CHARACTERISTIC /begin REF_MEASUREMENT CDD_FordBlaBoxIfCmn.FordVehYawStabyVld.Logl /end REF_MEASUREMENT /end GROUP
/begin GROUP CDD_FordBlaBoxIfCmn.FordYawRateSnsrIdHi.Val "MICROSAR RTE" /begin SUB_GROUP /end SUB_GROUP /begin FUNCTION_LIST /end FUNCTION_LIST /begin REF_CHARACTERISTIC /end REF_CHARACTERISTIC /begin REF_MEASUREMENT CDD_FordBlaBoxIfCmn.FordYawRateSnsrIdHi.Val /end REF_MEASUREMENT /end GROUP
/begin GROUP CDD_FordBlaBoxIfCmn.FordYawRateSnsrIdLo.Val "MICROSAR RTE" /begin SUB_GROUP /end SUB_GROUP /begin FUNCTION_LIST /end FUNCTION_LIST /begin REF_CHARACTERISTIC /end REF_CHARACTERISTIC /begin REF_MEASUREMENT CDD_FordBlaBoxIfCmn.FordYawRateSnsrIdLo.Val /end REF_MEASUREMENT /end GROUP
/begin GROUP CDD_FordBlaBoxIfCmn.HwVel.Val "MICROSAR RTE" /begin SUB_GROUP /end SUB_GROUP /begin FUNCTION_LIST /end FUNCTION_LIST /begin REF_CHARACTERISTIC /end REF_CHARACTERISTIC /begin REF_MEASUREMENT CDD_FordBlaBoxIfCmn.HwVel.Val /end REF_MEASUREMENT /end GROUP
/begin GROUP CDD_FordBlaBoxIfCmn.IntAgCtrlSt.Val "MICROSAR RTE" /begin SUB_GROUP /end SUB_GROUP /begin FUNCTION_LIST /end FUNCTION_LIST /begin REF_CHARACTERISTIC /end REF_CHARACTERISTIC /begin REF_MEASUREMENT CDD_FordBlaBoxIfCmn.IntAgCtrlSt.Val /end REF_MEASUREMENT /end GROUP
/begin GROUP CDD_FordBlaBoxIfCmn.RackToPinionRat.Val "MICROSAR RTE" /begin SUB_GROUP /end SUB_GROUP /begin FUNCTION_LIST /end FUNCTION_LIST /begin REF_CHARACTERISTIC /end REF_CHARACTERISTIC /begin REF_MEASUREMENT CDD_FordBlaBoxIfCmn.RackToPinionRat.Val /end REF_MEASUREMENT /end GROUP
/begin GROUP CDD_FordBlaBoxIfCmn.ReceiverPorts "MICROSAR RTE"
 /begin SUB_GROUP CDD_FordBlaBoxIfCmn.ActvParkAssiTqFild.Val CDD_FordBlaBoxIfCmn.EcuId.Val CDD_FordBlaBoxIfCmn.EngTqClass.Val CDD_FordBlaBoxIfCmn.FildVehSpdVld.Logl CDD_FordBlaBoxIfCmn.FordActvNiblCtrlEnad.Logl CDD_FordBlaBoxIfCmn.FordAppldFinalMotTq.Val CDD_FordBlaBoxIfCmn.FordAppldFinalMotTqVld.Logl CDD_FordBlaBoxIfCmn.FordBoostCrvAssiTq.Val CDD_FordBlaBoxIfCmn.FordBoostCrvInpTq.Val CDD_FordBlaBoxIfCmn.FordBrkPlsRejctnEnad.Logl CDD_FordBlaBoxIfCmn.FordCmpdHwPosn.Val CDD_FordBlaBoxIfCmn.FordCmpdHwPosnQlyFac.Val CDD_FordBlaBoxIfCmn.FordEvasSteerAssiEnaReq.Val CDD_FordBlaBoxIfCmn.FordEvasSteerAssiEnad.Logl CDD_FordBlaBoxIfCmn.FordHwVelVld.Logl CDD_FordBlaBoxIfCmn.FordInpTqRaw.Val CDD_FordBlaBoxIfCmn.FordInpTqRawVld.Logl CDD_FordBlaBoxIfCmn.FordLaneCentrAssiEnad.Logl CDD_FordBlaBoxIfCmn.FordLaneDprtrWarnEnad.Logl CDD_FordBlaBoxIfCmn.FordLaneKeepAssiEnad.Logl CDD_FordBlaBoxIfCmn.FordMaxAsscTq.Val CDD_FordBlaBoxIfCmn.FordMsgInp1Vld.Logl CDD_FordBlaBoxIfCmn.FordMsgInp2Vld.Logl CDD_FordBlaBoxIfCmn.FordMsgInp3Vld.Logl CDD_FordBlaBoxIfCmn.FordMsgInp4Vld.Logl CDD_FordBlaBoxIfCmn.FordPullDriftCmpEnad.Logl CDD_FordBlaBoxIfCmn.FordRelHwPosn.Val CDD_FordBlaBoxIfCmn.FordRelHwPosnVld.Logl CDD_FordBlaBoxIfCmn.FordReqdFinalMotTq.Val CDD_FordBlaBoxIfCmn.FordResrchFctEnad.Logl CDD_FordBlaBoxIfCmn.FordTqSteerCmpEnad.Logl CDD_FordBlaBoxIfCmn.FordTrfcJamAssiEnad.Logl CDD_FordBlaBoxIfCmn.FordTrlrAidHitchAgRate.Val CDD_FordBlaBoxIfCmn.FordTrlrBackupAssi5WhlEnad.Logl CDD_FordBlaBoxIfCmn.FordTrlrBackupAssiEnad.Logl CDD_FordBlaBoxIfCmn.FordTrlrBackupAssiTrigEnad.Logl CDD_FordBlaBoxIfCmn.FordVehAbsActv.Val CDD_FordBlaBoxIfCmn.FordVehAbsEscStsVld.Logl CDD_FordBlaBoxIfCmn.FordVehAccrPedlPosnStsQlyFacRaw.Val CDD_FordBlaBoxIfCmn.FordVehAccrPedlPosnStsRaw.Val CDD_FordBlaBoxIfCmn.FordVehAccrPedlPosnStsVld.Logl CDD_FordBlaBoxIfCmn.FordVehActBrkTqRaw.Val CDD_FordBlaBoxIfCmn.FordVehBlaBoxInp1HiPart.Val CDD_FordBlaBoxIfCmn.FordVehBlaBoxInp1LoPart.Val CDD_FordBlaBoxIfCmn.FordVehBlaBoxInp2HiPart.Val CDD_FordBlaBoxIfCmn.FordVehBlaBoxInp2LoPart.Val CDD_FordBlaBoxIfCmn.FordVehBlaBoxInp3HiPart.Val CDD_FordBlaBoxIfCmn.FordVehBlaBoxInp3LoPart.Val CDD_FordBlaBoxIfCmn.FordVehBlaBoxInp4HiPart.Val CDD_FordBlaBoxIfCmn.FordVehBlaBoxInp4LoPart.Val CDD_FordBlaBoxIfCmn.FordVehBrkPedlAppld.Val CDD_FordBlaBoxIfCmn.FordVehBrkPedlAppldQlyFac.Val CDD_FordBlaBoxIfCmn.FordVehBrkPedlVld.Logl CDD_FordBlaBoxIfCmn.FordVehBrkTqVld.Logl CDD_FordBlaBoxIfCmn.FordVehCllsnMtgtnByBrkgDenied.Val CDD_FordBlaBoxIfCmn.FordVehCllsnMtgtnByBrkgDisad.Val CDD_FordBlaBoxIfCmn.FordVehCllsnMtgtnByBrkgLatDstRaw.Val CDD_FordBlaBoxIfCmn.FordVehCllsnMtgtnByBrkgLgtDstRaw.Val CDD_FordBlaBoxIfCmn.FordVehCllsnMtgtnByBrkgObjDataConfLvlRaw.Val CDD_FordBlaBoxIfCmn.FordVehCllsnMtgtnByBrkgObjTypClassnRaw.Val CDD_FordBlaBoxIfCmn.FordVehCllsnMtgtnByBrkgRelLatVelRaw.Val CDD_FordBlaBoxIfCmn.FordVehCllsnMtgtnByBrkgRelLgtVelRaw.Val CDD_FordBlaBoxIfCmn.FordVehCllsnMtgtnByBrkgTiToCllsnRaw.Val CDD_FordBlaBoxIfCmn.FordVehEngSpdRaw.Val CDD_FordBlaBoxIfCmn.FordVehEngSpdVld.Logl CDD_FordBlaBoxIfCmn.FordVehEscActv.Val CDD_FordBlaBoxIfCmn.FordVehEvasSteerAssiImgProcrModlAVld.Logl CDD_FordBlaBoxIfCmn.FordVehEvasSteerAssiReq.Val CDD_FordBlaBoxIfCmn.FordVehEvasSteerAssiReqVld.Logl CDD_FordBlaBoxIfCmn.FordVehFrntLeWhlCntrDirVld.Logl CDD_FordBlaBoxIfCmn.FordVehFrntLeWhlDirRaw.Val CDD_FordBlaBoxIfCmn.FordVehFrntLeWhlRollgCntr.Val CDD_FordBlaBoxIfCmn.FordVehFrntLeWhlSpdRaw.Val CDD_FordBlaBoxIfCmn.FordVehFrntLeWhlSpdVld.Logl CDD_FordBlaBoxIfCmn.FordVehFrntRiWhlCntrDirVld.Logl CDD_FordBlaBoxIfCmn.FordVehFrntRiWhlDirRaw.Val CDD_FordBlaBoxIfCmn.FordVehFrntRiWhlRollgCntr.Val CDD_FordBlaBoxIfCmn.FordVehFrntRiWhlSpdRaw.Val CDD_FordBlaBoxIfCmn.FordVehFrntRiWhlSpdVld.Logl CDD_FordBlaBoxIfCmn.FordVehGearLvrPosn.Val CDD_FordBlaBoxIfCmn.FordVehGearLvrPosnVldInt.Logl CDD_FordBlaBoxIfCmn.FordVehGearPosnRaw.Val CDD_FordBlaBoxIfCmn.FordVehGearRvsStsRaw.Val CDD_FordBlaBoxIfCmn.FordVehGearRvsStsVld.Logl CDD_FordBlaBoxIfCmn.FordVehIgnSts.Val CDD_FordBlaBoxIfCmn.FordVehIgnStsVld.Logl CDD_FordBlaBoxIfCmn.FordVehLaneAssiImgProcgModlAVld.Logl CDD_FordBlaBoxIfCmn.FordVehLaneDetnWarnInten.Val CDD_FordBlaBoxIfCmn.FordVehLaneDetnWarnSts.Val CDD_FordBlaBoxIfCmn.FordVehLaneKeepSysCrvtRaw.Val CDD_FordBlaBoxIfCmn.FordVehLaneKeepSysRampTyp.Val CDD_FordBlaBoxIfCmn.FordVehLaneKeepSysReqdAgRaw.Val CDD_FordBlaBoxIfCmn.FordVehLaneKeepSysSts.Val CDD_FordBlaBoxIfCmn.FordVehLatACmpdRaw.Val CDD_FordBlaBoxIfCmn.FordVehLatACmpdVld.Logl CDD_FordBlaBoxIfCmn.FordVehLatCtrlCrvtRateRaw.Val CDD_FordBlaBoxIfCmn.FordVehLatCtrlCrvtRaw.Val CDD_FordBlaBoxIfCmn.FordVehLatCtrlHandsOffDetnTqStimlsReq.Val CDD_FordBlaBoxIfCmn.FordVehLatCtrlImgProcrModlAVld.Logl CDD_FordBlaBoxIfCmn.FordVehLatCtrlPahOffsRaw.Val CDD_FordBlaBoxIfCmn.FordVehLatCtrlPahRaw.Val CDD_FordBlaBoxIfCmn.FordVehLatCtrlPrcsn.Val CDD_FordBlaBoxIfCmn.FordVehLatCtrlRampTyp.Val CDD_FordBlaBoxIfCmn.FordVehLatCtrlReq.Val CDD_FordBlaBoxIfCmn.FordVehLatCtrlRingMax.Val CDD_FordBlaBoxIfCmn.FordVehLgtACmpdRaw.Val CDD_FordBlaBoxIfCmn.FordVehLgtACmpdVld.Logl CDD_FordBlaBoxIfCmn.FordVehLoSpdMtnCtrlBrkSprtStsRaw.Val CDD_FordBlaBoxIfCmn.FordVehLoSpdMtnCtrlBrkSprtVld.Logl CDD_FordBlaBoxIfCmn.FordVehParkAidModlStsVld.Logl CDD_FordBlaBoxIfCmn.FordVehParkAidModlSysSt.Val CDD_FordBlaBoxIfCmn.FordVehPrpnWhlTqRaw.Val CDD_FordBlaBoxIfCmn.FordVehPrpnWhlTqVld.Logl CDD_FordBlaBoxIfCmn.FordVehReLeWhlCntrDirVld.Logl CDD_FordBlaBoxIfCmn.FordVehReLeWhlDirRaw.Val CDD_FordBlaBoxIfCmn.FordVehReLeWhlRollgCntr.Val CDD_FordBlaBoxIfCmn.FordVehReLeWhlSpdRaw.Val CDD_FordBlaBoxIfCmn.FordVehReLeWhlSpdVld.Logl CDD_FordBlaBoxIfCmn.FordVehReRiWhlCntrDirVld.Logl CDD_FordBlaBoxIfCmn.FordVehReRiWhlDirRaw.Val CDD_FordBlaBoxIfCmn.FordVehReRiWhlRollgCntr.Val CDD_FordBlaBoxIfCmn.FordVehReRiWhlSpdRaw.Val CDD_FordBlaBoxIfCmn.FordVehReRiWhlSpdVld.Logl CDD_FordBlaBoxIfCmn.FordVehSelDrvModChassisVld.Logl CDD_FordBlaBoxIfCmn.FordVehSpd.Val CDD_FordBlaBoxIfCmn.FordVehSpdBrkModlRaw.Val CDD_FordBlaBoxIfCmn.FordVehSpdOverGndRaw.Val CDD_FordBlaBoxIfCmn.FordVehSpdOverGndVld.Logl CDD_FordBlaBoxIfCmn.FordVehSteerPinionAgOffsRaw.Val CDD_FordBlaBoxIfCmn.FordVehSteerPinionAgOffsVld.Logl CDD_FordBlaBoxIfCmn.FordVehSteerPinionOffsStsRaw.Val CDD_FordBlaBoxIfCmn.FordVehTireCircum.Val CDD_FordBlaBoxIfCmn.FordVehTrlrAgOffsDirRaw.Val CDD_FordBlaBoxIfCmn.FordVehTrlrAidAcqSts.Val CDD_FordBlaBoxIfCmn.FordVehTrlrAidAvlRaw.Val CDD_FordBlaBoxIfCmn.FordVehTrlrAidCnclReq.Val CDD_FordBlaBoxIfCmn.FordVehTrlrAidCnclReqVld.Logl CDD_FordBlaBoxIfCmn.FordVehTrlrAidHitchAg.Val CDD_FordBlaBoxIfCmn.FordVehTrlrAidIdnNrRaw.Val CDD_FordBlaBoxIfCmn.FordVehTrlrAidIdnVal.Val CDD_FordBlaBoxIfCmn.FordVehTrlrAidKnobBtn.Val CDD_FordBlaBoxIfCmn.FordVehTrlrAidKnobPosn.Val CDD_FordBlaBoxIfCmn.FordVehTrlrAidKnobPosnVld.Logl CDD_FordBlaBoxIfCmn.FordVehTrlrAidKnobStsVld.Logl CDD_FordBlaBoxIfCmn.FordVehTrlrAidModReq.Val CDD_FordBlaBoxIfCmn.FordVehTrlrAidModReqVld.Logl CDD_FordBlaBoxIfCmn.FordVehTrlrAidSetUpRaw.Val CDD_FordBlaBoxIfCmn.FordVehTrlrAidTrakgSt.Val CDD_FordBlaBoxIfCmn.FordVehTrlrAidTrakgStVld.Logl CDD_FordBlaBoxIfCmn.FordVehTrlrAidTrlrRvsGuidcSts.Val CDD_FordBlaBoxIfCmn.FordVehTrlrAxleToBmpRaw.Val CDD_FordBlaBoxIfCmn.FordVehTrlrBackupAssiAvlVld.Logl CDD_FordBlaBoxIfCmn.FordVehTrlrBackupAssiMeasVld.Logl CDD_FordBlaBoxIfCmn.FordVehTrlrBallToAxle.Val CDD_FordBlaBoxIfCmn.FordVehTrlrBrkCnctnStsRaw.Val CDD_FordBlaBoxIfCmn.FordVehTrlrEnaReqRaw.Val CDD_FordBlaBoxIfCmn.FordVehTrlrHitchAgRateRaw.Val CDD_FordBlaBoxIfCmn.FordVehTrlrHitchAgVld.Logl CDD_FordBlaBoxIfCmn.FordVehTrlrHitchRateVld.Logl CDD_FordBlaBoxIfCmn.FordVehTrlrHitchYawAgRaw.Val CDD_FordBlaBoxIfCmn.FordVehTrlrHitchYawSts.Val CDD_FordBlaBoxIfCmn.FordVehTrlrIdnTypRaw.Val CDD_FordBlaBoxIfCmn.FordVehTrlrLampCnctnStsRaw.Val CDD_FordBlaBoxIfCmn.FordVehTrlrRvsCnclReqRaw.Val CDD_FordBlaBoxIfCmn.FordVehTrlrRvsEnaRaw.Val CDD_FordBlaBoxIfCmn.FordVehTrlrRvsMsgTxtReqRaw.Val CDD_FordBlaBoxIfCmn.FordVehTrlrTarVld.Logl CDD_FordBlaBoxIfCmn.FordVehTrlrYawRateQlyFac.Val CDD_FordBlaBoxIfCmn.FordVehTrlrYawRateRaw.Val CDD_FordBlaBoxIfCmn.FordVehTrsmDesGearRaw.Val CDD_FordBlaBoxIfCmn.FordVehTurnSigSwtStsRaw.Val CDD_FordBlaBoxIfCmn.FordVehTurnSigVld.Logl CDD_FordBlaBoxIfCmn.FordVehVertACmpdRaw.Val CDD_FordBlaBoxIfCmn.FordVehYawRateCmpdRaw.Val CDD_FordBlaBoxIfCmn.FordVehYawRateRaw.Ford_VehYaw_W_Actl CDD_FordBlaBoxIfCmn.FordVehYawRateRawVld.Logl CDD_FordBlaBoxIfCmn.FordVehYawRateVld.Logl CDD_FordBlaBoxIfCmn.FordVehYawStabyRaw.Val CDD_FordBlaBoxIfCmn.FordVehYawStabyVld.Logl CDD_FordBlaBoxIfCmn.FordYawRateSnsrIdHi.Val CDD_FordBlaBoxIfCmn.FordYawRateSnsrIdLo.Val CDD_FordBlaBoxIfCmn.HwVel.Val CDD_FordBlaBoxIfCmn.IntAgCtrlSt.Val CDD_FordBlaBoxIfCmn.RackToPinionRat.Val CDD_FordBlaBoxIfCmn.SelnDrvgModSteerModReq.Val CDD_FordBlaBoxIfCmn.SemiAutParlParkAgCtrlSts1.Val CDD_FordBlaBoxIfCmn.SemiAutParlParkAgCtrlSts2.Logl CDD_FordBlaBoxIfCmn.SemiAutParlParkAgCtrlSts3.Logl CDD_FordBlaBoxIfCmn.SemiAutParlParkAgCtrlSts4.Logl CDD_FordBlaBoxIfCmn.SemiAutParlParkAgCtrlSts5.Logl CDD_FordBlaBoxIfCmn.TrlrBackupAssiEnaVld.Logl CDD_FordBlaBoxIfCmn.TrlrBackupAssiRvsVld.Logl CDD_FordBlaBoxIfCmn.TrlrBackupAssiYawRateVld.Logl CDD_FordBlaBoxIfCmn.VehSpd.Val CDD_FordBlaBoxIfCmn.VehSpdVld.Logl CDD_FordBlaBoxIfCmn.VehSteerRat.Val CDD_FordBlaBoxIfCmn.VehWhlBas.Val CDD_FordBlaBoxIfCmn.VertAVld.Logl /end SUB_GROUP
 /begin FUNCTION_LIST /end FUNCTION_LIST
 /begin REF_CHARACTERISTIC /end REF_CHARACTERISTIC
 /begin REF_MEASUREMENT /end REF_MEASUREMENT
/end GROUP
/begin GROUP CDD_FordBlaBoxIfCmn.SelnDrvgModSteerModReq.Val "MICROSAR RTE" /begin SUB_GROUP /end SUB_GROUP /begin FUNCTION_LIST /end FUNCTION_LIST /begin REF_CHARACTERISTIC /end REF_CHARACTERISTIC /begin REF_MEASUREMENT CDD_FordBlaBoxIfCmn.SelnDrvgModSteerModReq.Val /end REF_MEASUREMENT /end GROUP
/begin GROUP CDD_FordBlaBoxIfCmn.SemiAutParlParkAgCtrlSts1.Val "MICROSAR RTE" /begin SUB_GROUP /end SUB_GROUP /begin FUNCTION_LIST /end FUNCTION_LIST /begin REF_CHARACTERISTIC /end REF_CHARACTERISTIC /begin REF_MEASUREMENT CDD_FordBlaBoxIfCmn.SemiAutParlParkAgCtrlSts1.Val /end REF_MEASUREMENT /end GROUP
/begin GROUP CDD_FordBlaBoxIfCmn.SemiAutParlParkAgCtrlSts2.Logl "MICROSAR RTE" /begin SUB_GROUP /end SUB_GROUP /begin FUNCTION_LIST /end FUNCTION_LIST /begin REF_CHARACTERISTIC /end REF_CHARACTERISTIC /begin REF_MEASUREMENT CDD_FordBlaBoxIfCmn.SemiAutParlParkAgCtrlSts2.Logl /end REF_MEASUREMENT /end GROUP
/begin GROUP CDD_FordBlaBoxIfCmn.SemiAutParlParkAgCtrlSts3.Logl "MICROSAR RTE" /begin SUB_GROUP /end SUB_GROUP /begin FUNCTION_LIST /end FUNCTION_LIST /begin REF_CHARACTERISTIC /end REF_CHARACTERISTIC /begin REF_MEASUREMENT CDD_FordBlaBoxIfCmn.SemiAutParlParkAgCtrlSts3.Logl /end REF_MEASUREMENT /end GROUP
/begin GROUP CDD_FordBlaBoxIfCmn.SemiAutParlParkAgCtrlSts4.Logl "MICROSAR RTE" /begin SUB_GROUP /end SUB_GROUP /begin FUNCTION_LIST /end FUNCTION_LIST /begin REF_CHARACTERISTIC /end REF_CHARACTERISTIC /begin REF_MEASUREMENT CDD_FordBlaBoxIfCmn.SemiAutParlParkAgCtrlSts4.Logl /end REF_MEASUREMENT /end GROUP
/begin GROUP CDD_FordBlaBoxIfCmn.SemiAutParlParkAgCtrlSts5.Logl "MICROSAR RTE" /begin SUB_GROUP /end SUB_GROUP /begin FUNCTION_LIST /end FUNCTION_LIST /begin REF_CHARACTERISTIC /end REF_CHARACTERISTIC /begin REF_MEASUREMENT CDD_FordBlaBoxIfCmn.SemiAutParlParkAgCtrlSts5.Logl /end REF_MEASUREMENT /end GROUP
/begin GROUP CDD_FordBlaBoxIfCmn.TrlrBackupAssiEnaVld.Logl "MICROSAR RTE" /begin SUB_GROUP /end SUB_GROUP /begin FUNCTION_LIST /end FUNCTION_LIST /begin REF_CHARACTERISTIC /end REF_CHARACTERISTIC /begin REF_MEASUREMENT CDD_FordBlaBoxIfCmn.TrlrBackupAssiEnaVld.Logl /end REF_MEASUREMENT /end GROUP
/begin GROUP CDD_FordBlaBoxIfCmn.TrlrBackupAssiRvsVld.Logl "MICROSAR RTE" /begin SUB_GROUP /end SUB_GROUP /begin FUNCTION_LIST /end FUNCTION_LIST /begin REF_CHARACTERISTIC /end REF_CHARACTERISTIC /begin REF_MEASUREMENT CDD_FordBlaBoxIfCmn.TrlrBackupAssiRvsVld.Logl /end REF_MEASUREMENT /end GROUP
/begin GROUP CDD_FordBlaBoxIfCmn.TrlrBackupAssiYawRateVld.Logl "MICROSAR RTE" /begin SUB_GROUP /end SUB_GROUP /begin FUNCTION_LIST /end FUNCTION_LIST /begin REF_CHARACTERISTIC /end REF_CHARACTERISTIC /begin REF_MEASUREMENT CDD_FordBlaBoxIfCmn.TrlrBackupAssiYawRateVld.Logl /end REF_MEASUREMENT /end GROUP
/begin GROUP CDD_FordBlaBoxIfCmn.VehSpd.Val "MICROSAR RTE" /begin SUB_GROUP /end SUB_GROUP /begin FUNCTION_LIST /end FUNCTION_LIST /begin REF_CHARACTERISTIC /end REF_CHARACTERISTIC /begin REF_MEASUREMENT CDD_FordBlaBoxIfCmn.VehSpd.Val /end REF_MEASUREMENT /end GROUP
/begin GROUP CDD_FordBlaBoxIfCmn.VehSpdVld.Logl "MICROSAR RTE" /begin SUB_GROUP /end SUB_GROUP /begin FUNCTION_LIST /end FUNCTION_LIST /begin REF_CHARACTERISTIC /end REF_CHARACTERISTIC /begin REF_MEASUREMENT CDD_FordBlaBoxIfCmn.VehSpdVld.Logl /end REF_MEASUREMENT /end GROUP
/begin GROUP CDD_FordBlaBoxIfCmn.VehSteerRat.Val "MICROSAR RTE" /begin SUB_GROUP /end SUB_GROUP /begin FUNCTION_LIST /end FUNCTION_LIST /begin REF_CHARACTERISTIC /end REF_CHARACTERISTIC /begin REF_MEASUREMENT CDD_FordBlaBoxIfCmn.VehSteerRat.Val /end REF_MEASUREMENT /end GROUP
/begin GROUP CDD_FordBlaBoxIfCmn.VehWhlBas.Val "MICROSAR RTE" /begin SUB_GROUP /end SUB_GROUP /begin FUNCTION_LIST /end FUNCTION_LIST /begin REF_CHARACTERISTIC /end REF_CHARACTERISTIC /begin REF_MEASUREMENT CDD_FordBlaBoxIfCmn.VehWhlBas.Val /end REF_MEASUREMENT /end GROUP
/begin GROUP CDD_FordBlaBoxIfCmn.VertAVld.Logl "MICROSAR RTE" /begin SUB_GROUP /end SUB_GROUP /begin FUNCTION_LIST /end FUNCTION_LIST /begin REF_CHARACTERISTIC /end REF_CHARACTERISTIC /begin REF_MEASUREMENT CDD_FordBlaBoxIfCmn.VertAVld.Logl /end REF_MEASUREMENT /end GROUP
/begin GROUP CDD_FordBlaBoxIfCmp1 "MICROSAR RTE"
 /begin SUB_GROUP CDD_FordBlaBoxIfCmp1.CalibrationParameters CDD_FordBlaBoxIfCmp1.CalibrationPorts CDD_FordBlaBoxIfCmp1.PerInstanceMemories CDD_FordBlaBoxIfCmp1.ReceiverPorts CDD_FordBlaBoxIfCmp1.SenderPorts /end SUB_GROUP
 /begin FUNCTION_LIST /end FUNCTION_LIST
 /begin REF_CHARACTERISTIC /end REF_CHARACTERISTIC
 /begin REF_MEASUREMENT /end REF_MEASUREMENT
/end GROUP
/begin GROUP CDD_FordBlaBoxIfCmp1.ActvNiblCmpIntSts.Val "MICROSAR RTE" /begin SUB_GROUP /end SUB_GROUP /begin FUNCTION_LIST /end FUNCTION_LIST /begin REF_CHARACTERISTIC /end REF_CHARACTERISTIC /begin REF_MEASUREMENT CDD_FordBlaBoxIfCmp1.ActvNiblCmpIntSts.Val /end REF_MEASUREMENT /end GROUP
/begin GROUP CDD_FordBlaBoxIfCmp1.ActvNiblCtrl "MICROSAR RTE" /begin SUB_GROUP /end SUB_GROUP /begin FUNCTION_LIST /end FUNCTION_LIST /begin REF_CHARACTERISTIC /end REF_CHARACTERISTIC /begin REF_MEASUREMENT CDD_FordBlaBoxIfCmp1.ActvNiblCtrl /end REF_MEASUREMENT /end GROUP
/begin GROUP CDD_FordBlaBoxIfCmp1.ActvNiblCtrlDft "MICROSAR RTE" /begin SUB_GROUP /end SUB_GROUP /begin FUNCTION_LIST /end FUNCTION_LIST /begin REF_CHARACTERISTIC CDD_FordBlaBoxIfCmp1.ActvNiblCtrlDft /end REF_CHARACTERISTIC /begin REF_MEASUREMENT /end REF_MEASUREMENT /end GROUP
/begin GROUP CDD_FordBlaBoxIfCmp1.AssiMotTqWhlImbRejctnMinX.Ary2D "MICROSAR RTE" /begin SUB_GROUP /end SUB_GROUP /begin FUNCTION_LIST /end FUNCTION_LIST /begin REF_CHARACTERISTIC CDD_FordBlaBoxIfCmp1.AssiMotTqWhlImbRejctnMinX.Ary2D /end REF_CHARACTERISTIC /begin REF_MEASUREMENT /end REF_MEASUREMENT /end GROUP
/begin GROUP CDD_FordBlaBoxIfCmp1.AssiMotTqWhlImbRejctnMinY.Ary2D "MICROSAR RTE" /begin SUB_GROUP /end SUB_GROUP /begin FUNCTION_LIST /end FUNCTION_LIST /begin REF_CHARACTERISTIC CDD_FordBlaBoxIfCmp1.AssiMotTqWhlImbRejctnMinY.Ary2D /end REF_CHARACTERISTIC /begin REF_MEASUREMENT /end REF_MEASUREMENT /end GROUP
/begin GROUP CDD_FordBlaBoxIfCmp1.CalibrationParameters "MICROSAR RTE"
 /begin SUB_GROUP CDD_FordBlaBoxIfCmp1.ActvNiblCtrlDft CDD_FordBlaBoxIfCmp1.LaneAssiDft CDD_FordBlaBoxIfCmp1.PullDriftCmpDft CDD_FordBlaBoxIfCmp1.TrlrBackupAssiDft /end SUB_GROUP
 /begin FUNCTION_LIST /end FUNCTION_LIST
 /begin REF_CHARACTERISTIC /end REF_CHARACTERISTIC
 /begin REF_MEASUREMENT /end REF_MEASUREMENT
/end GROUP
/begin GROUP CDD_FordBlaBoxIfCmp1.CalibrationPorts "MICROSAR RTE"
 /begin SUB_GROUP CDD_FordBlaBoxIfCmp1.AssiMotTqWhlImbRejctnMinX.Ary2D CDD_FordBlaBoxIfCmp1.AssiMotTqWhlImbRejctnMinY.Ary2D CDD_FordBlaBoxIfCmp1.SysGlbPrmSysKineRat.Val CDD_FordBlaBoxIfCmp1.SysGlbPrmVehSpdBilnrSeln.Ary1D /end SUB_GROUP
 /begin FUNCTION_LIST /end FUNCTION_LIST
 /begin REF_CHARACTERISTIC /end REF_CHARACTERISTIC
 /begin REF_MEASUREMENT /end REF_MEASUREMENT
/end GROUP
/begin GROUP CDD_FordBlaBoxIfCmp1.EcuId.Val "MICROSAR RTE" /begin SUB_GROUP /end SUB_GROUP /begin FUNCTION_LIST /end FUNCTION_LIST /begin REF_CHARACTERISTIC /end REF_CHARACTERISTIC /begin REF_MEASUREMENT CDD_FordBlaBoxIfCmp1.EcuId.Val /end REF_MEASUREMENT /end GROUP
/begin GROUP CDD_FordBlaBoxIfCmp1.FordActvNiblCtrlDiagcSts.Val "MICROSAR RTE" /begin SUB_GROUP /end SUB_GROUP /begin FUNCTION_LIST /end FUNCTION_LIST /begin REF_CHARACTERISTIC /end REF_CHARACTERISTIC /begin REF_MEASUREMENT CDD_FordBlaBoxIfCmp1.FordActvNiblCtrlDiagcSts.Val /end REF_MEASUREMENT /end GROUP
/begin GROUP CDD_FordBlaBoxIfCmp1.FordActvNiblCtrlSwVers.Val "MICROSAR RTE" /begin SUB_GROUP /end SUB_GROUP /begin FUNCTION_LIST /end FUNCTION_LIST /begin REF_CHARACTERISTIC /end REF_CHARACTERISTIC /begin REF_MEASUREMENT CDD_FordBlaBoxIfCmp1.FordActvNiblCtrlSwVers.Val /end REF_MEASUREMENT /end GROUP
/begin GROUP CDD_FordBlaBoxIfCmp1.FordActvNiblCtrlTqReq.Val "MICROSAR RTE" /begin SUB_GROUP /end SUB_GROUP /begin FUNCTION_LIST /end FUNCTION_LIST /begin REF_CHARACTERISTIC /end REF_CHARACTERISTIC /begin REF_MEASUREMENT CDD_FordBlaBoxIfCmp1.FordActvNiblCtrlTqReq.Val /end REF_MEASUREMENT /end GROUP
/begin GROUP CDD_FordBlaBoxIfCmp1.FordBlaBoxSwVers.Val "MICROSAR RTE" /begin SUB_GROUP /end SUB_GROUP /begin FUNCTION_LIST /end FUNCTION_LIST /begin REF_CHARACTERISTIC /end REF_CHARACTERISTIC /begin REF_MEASUREMENT CDD_FordBlaBoxIfCmp1.FordBlaBoxSwVers.Val /end REF_MEASUREMENT /end GROUP
/begin GROUP CDD_FordBlaBoxIfCmp1.FordLaneAssiSwVers.Val "MICROSAR RTE" /begin SUB_GROUP /end SUB_GROUP /begin FUNCTION_LIST /end FUNCTION_LIST /begin REF_CHARACTERISTIC /end REF_CHARACTERISTIC /begin REF_MEASUREMENT CDD_FordBlaBoxIfCmp1.FordLaneAssiSwVers.Val /end REF_MEASUREMENT /end GROUP
/begin GROUP CDD_FordBlaBoxIfCmp1.FordLaneDprtrWarnTqReq.Val "MICROSAR RTE" /begin SUB_GROUP /end SUB_GROUP /begin FUNCTION_LIST /end FUNCTION_LIST /begin REF_CHARACTERISTIC /end REF_CHARACTERISTIC /begin REF_MEASUREMENT CDD_FordBlaBoxIfCmp1.FordLaneDprtrWarnTqReq.Val /end REF_MEASUREMENT /end GROUP
/begin GROUP CDD_FordBlaBoxIfCmp1.FordLaneKeepAssiTqReq.Val "MICROSAR RTE" /begin SUB_GROUP /end SUB_GROUP /begin FUNCTION_LIST /end FUNCTION_LIST /begin REF_CHARACTERISTIC /end REF_CHARACTERISTIC /begin REF_MEASUREMENT CDD_FordBlaBoxIfCmp1.FordLaneKeepAssiTqReq.Val /end REF_MEASUREMENT /end GROUP
/begin GROUP CDD_FordBlaBoxIfCmp1.FordLatCtrlTqReq.Val "MICROSAR RTE" /begin SUB_GROUP /end SUB_GROUP /begin FUNCTION_LIST /end FUNCTION_LIST /begin REF_CHARACTERISTIC /end REF_CHARACTERISTIC /begin REF_MEASUREMENT CDD_FordBlaBoxIfCmp1.FordLatCtrlTqReq.Val /end REF_MEASUREMENT /end GROUP
/begin GROUP CDD_FordBlaBoxIfCmp1.FordPullDriftCmpSwVers.Val "MICROSAR RTE" /begin SUB_GROUP /end SUB_GROUP /begin FUNCTION_LIST /end FUNCTION_LIST /begin REF_CHARACTERISTIC /end REF_CHARACTERISTIC /begin REF_MEASUREMENT CDD_FordBlaBoxIfCmp1.FordPullDriftCmpSwVers.Val /end REF_MEASUREMENT /end GROUP
/begin GROUP CDD_FordBlaBoxIfCmp1.FordPullDriftCmpTqReq.Val "MICROSAR RTE" /begin SUB_GROUP /end SUB_GROUP /begin FUNCTION_LIST /end FUNCTION_LIST /begin REF_CHARACTERISTIC /end REF_CHARACTERISTIC /begin REF_MEASUREMENT CDD_FordBlaBoxIfCmp1.FordPullDriftCmpTqReq.Val /end REF_MEASUREMENT /end GROUP
/begin GROUP CDD_FordBlaBoxIfCmp1.FordResrchFctSwVers.Val "MICROSAR RTE" /begin SUB_GROUP /end SUB_GROUP /begin FUNCTION_LIST /end FUNCTION_LIST /begin REF_CHARACTERISTIC /end REF_CHARACTERISTIC /begin REF_MEASUREMENT CDD_FordBlaBoxIfCmp1.FordResrchFctSwVers.Val /end REF_MEASUREMENT /end GROUP
/begin GROUP CDD_FordBlaBoxIfCmp1.FordSrvLaneDprtrWarnDiagcSts.Val "MICROSAR RTE" /begin SUB_GROUP /end SUB_GROUP /begin FUNCTION_LIST /end FUNCTION_LIST /begin REF_CHARACTERISTIC /end REF_CHARACTERISTIC /begin REF_MEASUREMENT CDD_FordBlaBoxIfCmp1.FordSrvLaneDprtrWarnDiagcSts.Val /end REF_MEASUREMENT /end GROUP
/begin GROUP CDD_FordBlaBoxIfCmp1.FordSrvPullDriftCmpRstVal.Val "MICROSAR RTE" /begin SUB_GROUP /end SUB_GROUP /begin FUNCTION_LIST /end FUNCTION_LIST /begin REF_CHARACTERISTIC /end REF_CHARACTERISTIC /begin REF_MEASUREMENT CDD_FordBlaBoxIfCmp1.FordSrvPullDriftCmpRstVal.Val /end REF_MEASUREMENT /end GROUP
/begin GROUP CDD_FordBlaBoxIfCmp1.FordTrlrBackupAssiSwVers.Val "MICROSAR RTE" /begin SUB_GROUP /end SUB_GROUP /begin FUNCTION_LIST /end FUNCTION_LIST /begin REF_CHARACTERISTIC /end REF_CHARACTERISTIC /begin REF_MEASUREMENT CDD_FordBlaBoxIfCmp1.FordTrlrBackupAssiSwVers.Val /end REF_MEASUREMENT /end GROUP
/begin GROUP CDD_FordBlaBoxIfCmp1.FordVehBBMsgOutp1HiPart.Val "MICROSAR RTE" /begin SUB_GROUP /end SUB_GROUP /begin FUNCTION_LIST /end FUNCTION_LIST /begin REF_CHARACTERISTIC /end REF_CHARACTERISTIC /begin REF_MEASUREMENT CDD_FordBlaBoxIfCmp1.FordVehBBMsgOutp1HiPart.Val /end REF_MEASUREMENT /end GROUP
/begin GROUP CDD_FordBlaBoxIfCmp1.FordVehBBMsgOutp1LoPart.Val "MICROSAR RTE" /begin SUB_GROUP /end SUB_GROUP /begin FUNCTION_LIST /end FUNCTION_LIST /begin REF_CHARACTERISTIC /end REF_CHARACTERISTIC /begin REF_MEASUREMENT CDD_FordBlaBoxIfCmp1.FordVehBBMsgOutp1LoPart.Val /end REF_MEASUREMENT /end GROUP
/begin GROUP CDD_FordBlaBoxIfCmp1.FordVehBBMsgOutp2HiPart.Val "MICROSAR RTE" /begin SUB_GROUP /end SUB_GROUP /begin FUNCTION_LIST /end FUNCTION_LIST /begin REF_CHARACTERISTIC /end REF_CHARACTERISTIC /begin REF_MEASUREMENT CDD_FordBlaBoxIfCmp1.FordVehBBMsgOutp2HiPart.Val /end REF_MEASUREMENT /end GROUP
/begin GROUP CDD_FordBlaBoxIfCmp1.FordVehBBMsgOutp2LoPart.Val "MICROSAR RTE" /begin SUB_GROUP /end SUB_GROUP /begin FUNCTION_LIST /end FUNCTION_LIST /begin REF_CHARACTERISTIC /end REF_CHARACTERISTIC /begin REF_MEASUREMENT CDD_FordBlaBoxIfCmp1.FordVehBBMsgOutp2LoPart.Val /end REF_MEASUREMENT /end GROUP
/begin GROUP CDD_FordBlaBoxIfCmp1.FordVehBBMsgOutp3HiPart.Val "MICROSAR RTE" /begin SUB_GROUP /end SUB_GROUP /begin FUNCTION_LIST /end FUNCTION_LIST /begin REF_CHARACTERISTIC /end REF_CHARACTERISTIC /begin REF_MEASUREMENT CDD_FordBlaBoxIfCmp1.FordVehBBMsgOutp3HiPart.Val /end REF_MEASUREMENT /end GROUP
/begin GROUP CDD_FordBlaBoxIfCmp1.FordVehBBMsgOutp3LoPart.Val "MICROSAR RTE" /begin SUB_GROUP /end SUB_GROUP /begin FUNCTION_LIST /end FUNCTION_LIST /begin REF_CHARACTERISTIC /end REF_CHARACTERISTIC /begin REF_MEASUREMENT CDD_FordBlaBoxIfCmp1.FordVehBBMsgOutp3LoPart.Val /end REF_MEASUREMENT /end GROUP
/begin GROUP CDD_FordBlaBoxIfCmp1.FordVehBBMsgOutp4HiPart.Val "MICROSAR RTE" /begin SUB_GROUP /end SUB_GROUP /begin FUNCTION_LIST /end FUNCTION_LIST /begin REF_CHARACTERISTIC /end REF_CHARACTERISTIC /begin REF_MEASUREMENT CDD_FordBlaBoxIfCmp1.FordVehBBMsgOutp4HiPart.Val /end REF_MEASUREMENT /end GROUP
/begin GROUP CDD_FordBlaBoxIfCmp1.FordVehBBMsgOutp4LoPart.Val "MICROSAR RTE" /begin SUB_GROUP /end SUB_GROUP /begin FUNCTION_LIST /end FUNCTION_LIST /begin REF_CHARACTERISTIC /end REF_CHARACTERISTIC /begin REF_MEASUREMENT CDD_FordBlaBoxIfCmp1.FordVehBBMsgOutp4LoPart.Val /end REF_MEASUREMENT /end GROUP
/begin GROUP CDD_FordBlaBoxIfCmp1.FordVehLaneAssiAvl.Val "MICROSAR RTE" /begin SUB_GROUP /end SUB_GROUP /begin FUNCTION_LIST /end FUNCTION_LIST /begin REF_CHARACTERISTIC /end REF_CHARACTERISTIC /begin REF_MEASUREMENT CDD_FordBlaBoxIfCmp1.FordVehLaneAssiAvl.Val /end REF_MEASUREMENT /end GROUP
/begin GROUP CDD_FordBlaBoxIfCmp1.FordVehLaneAssiHandsOff.Val "MICROSAR RTE" /begin SUB_GROUP /end SUB_GROUP /begin FUNCTION_LIST /end FUNCTION_LIST /begin REF_CHARACTERISTIC /end REF_CHARACTERISTIC /begin REF_MEASUREMENT CDD_FordBlaBoxIfCmp1.FordVehLaneAssiHandsOff.Val /end REF_MEASUREMENT /end GROUP
/begin GROUP CDD_FordBlaBoxIfCmp1.FordVehLaneAssiRejctn.Val "MICROSAR RTE" /begin SUB_GROUP /end SUB_GROUP /begin FUNCTION_LIST /end FUNCTION_LIST /begin REF_CHARACTERISTIC /end REF_CHARACTERISTIC /begin REF_MEASUREMENT CDD_FordBlaBoxIfCmp1.FordVehLaneAssiRejctn.Val /end REF_MEASUREMENT /end GROUP
/begin GROUP CDD_FordBlaBoxIfCmp1.FordVehLatCtrlLimSts.Ford_LatCtlLim_D_Stat "MICROSAR RTE" /begin SUB_GROUP /end SUB_GROUP /begin FUNCTION_LIST /end FUNCTION_LIST /begin REF_CHARACTERISTIC /end REF_CHARACTERISTIC
 /begin REF_MEASUREMENT CDD_FordBlaBoxIfCmp1.FordVehLatCtrlLimSts.Ford_LatCtlLim_D_Stat /end REF_MEASUREMENT
/end GROUP
/begin GROUP CDD_FordBlaBoxIfCmp1.FordVehLatCtrlSteerSts.Ford_LatCtlSte_D_Stat "MICROSAR RTE" /begin SUB_GROUP /end SUB_GROUP /begin FUNCTION_LIST /end FUNCTION_LIST /begin REF_CHARACTERISTIC /end REF_CHARACTERISTIC
 /begin REF_MEASUREMENT CDD_FordBlaBoxIfCmp1.FordVehLatCtrlSteerSts.Ford_LatCtlSte_D_Stat /end REF_MEASUREMENT
/end GROUP
/begin GROUP CDD_FordBlaBoxIfCmp1.FordVehLoSpdMtnCtrlBrkDecelEnaReq.Val "MICROSAR RTE" /begin SUB_GROUP /end SUB_GROUP /begin FUNCTION_LIST /end FUNCTION_LIST /begin REF_CHARACTERISTIC /end REF_CHARACTERISTIC /begin REF_MEASUREMENT CDD_FordBlaBoxIfCmp1.FordVehLoSpdMtnCtrlBrkDecelEnaReq.Val /end REF_MEASUREMENT /end GROUP
/begin GROUP CDD_FordBlaBoxIfCmp1.FordVehLoSpdMtnCtrlBrkTqReq.Val "MICROSAR RTE" /begin SUB_GROUP /end SUB_GROUP /begin FUNCTION_LIST /end FUNCTION_LIST /begin REF_CHARACTERISTIC /end REF_CHARACTERISTIC /begin REF_MEASUREMENT CDD_FordBlaBoxIfCmp1.FordVehLoSpdMtnCtrlBrkTqReq.Val /end REF_MEASUREMENT /end GROUP
/begin GROUP CDD_FordBlaBoxIfCmp1.FordVehTrfcJamAvdHandsOnConf.Val "MICROSAR RTE" /begin SUB_GROUP /end SUB_GROUP /begin FUNCTION_LIST /end FUNCTION_LIST /begin REF_CHARACTERISTIC /end REF_CHARACTERISTIC /begin REF_MEASUREMENT CDD_FordBlaBoxIfCmp1.FordVehTrfcJamAvdHandsOnConf.Val /end REF_MEASUREMENT /end GROUP
/begin GROUP CDD_FordBlaBoxIfCmp1.FordVehTrlrAgTarCalcn.Val "MICROSAR RTE" /begin SUB_GROUP /end SUB_GROUP /begin FUNCTION_LIST /end FUNCTION_LIST /begin REF_CHARACTERISTIC /end REF_CHARACTERISTIC /begin REF_MEASUREMENT CDD_FordBlaBoxIfCmp1.FordVehTrlrAgTarCalcn.Val /end REF_MEASUREMENT /end GROUP
/begin GROUP CDD_FordBlaBoxIfCmp1.FordVehTrlrAidAgMax.Val "MICROSAR RTE" /begin SUB_GROUP /end SUB_GROUP /begin FUNCTION_LIST /end FUNCTION_LIST /begin REF_CHARACTERISTIC /end REF_CHARACTERISTIC /begin REF_MEASUREMENT CDD_FordBlaBoxIfCmp1.FordVehTrlrAidAgMax.Val /end REF_MEASUREMENT /end GROUP
/begin GROUP CDD_FordBlaBoxIfCmp1.FordVehTrlrAidAgOffs.Val "MICROSAR RTE" /begin SUB_GROUP /end SUB_GROUP /begin FUNCTION_LIST /end FUNCTION_LIST /begin REF_CHARACTERISTIC /end REF_CHARACTERISTIC /begin REF_MEASUREMENT CDD_FordBlaBoxIfCmp1.FordVehTrlrAidAgOffs.Val /end REF_MEASUREMENT /end GROUP
/begin GROUP CDD_FordBlaBoxIfCmp1.FordVehTrlrAidAgWarn.Val "MICROSAR RTE" /begin SUB_GROUP /end SUB_GROUP /begin FUNCTION_LIST /end FUNCTION_LIST /begin REF_CHARACTERISTIC /end REF_CHARACTERISTIC /begin REF_MEASUREMENT CDD_FordBlaBoxIfCmp1.FordVehTrlrAidAgWarn.Val /end REF_MEASUREMENT /end GROUP
/begin GROUP CDD_FordBlaBoxIfCmp1.FordVehTrlrAidEnaSts.Val "MICROSAR RTE" /begin SUB_GROUP /end SUB_GROUP /begin FUNCTION_LIST /end FUNCTION_LIST /begin REF_CHARACTERISTIC /end REF_CHARACTERISTIC /begin REF_MEASUREMENT CDD_FordBlaBoxIfCmp1.FordVehTrlrAidEnaSts.Val /end REF_MEASUREMENT /end GROUP
/begin GROUP CDD_FordBlaBoxIfCmp1.FordVehTrlrAidHitchToAxle.Val "MICROSAR RTE" /begin SUB_GROUP /end SUB_GROUP /begin FUNCTION_LIST /end FUNCTION_LIST /begin REF_CHARACTERISTIC /end REF_CHARACTERISTIC /begin REF_MEASUREMENT CDD_FordBlaBoxIfCmp1.FordVehTrlrAidHitchToAxle.Val /end REF_MEASUREMENT /end GROUP
/begin GROUP CDD_FordBlaBoxIfCmp1.FordVehTrlrAidMsgTxtReq.Val "MICROSAR RTE" /begin SUB_GROUP /end SUB_GROUP /begin FUNCTION_LIST /end FUNCTION_LIST /begin REF_CHARACTERISTIC /end REF_CHARACTERISTIC /begin REF_MEASUREMENT CDD_FordBlaBoxIfCmp1.FordVehTrlrAidMsgTxtReq.Val /end REF_MEASUREMENT /end GROUP
/begin GROUP CDD_FordBlaBoxIfCmp1.FordVehTrlrAidSetUp.Val "MICROSAR RTE" /begin SUB_GROUP /end SUB_GROUP /begin FUNCTION_LIST /end FUNCTION_LIST /begin REF_CHARACTERISTIC /end REF_CHARACTERISTIC /begin REF_MEASUREMENT CDD_FordBlaBoxIfCmp1.FordVehTrlrAidSetUp.Val /end REF_MEASUREMENT /end GROUP
/begin GROUP CDD_FordBlaBoxIfCmp1.FordVehTrlrAidTarIdn.Val "MICROSAR RTE" /begin SUB_GROUP /end SUB_GROUP /begin FUNCTION_LIST /end FUNCTION_LIST /begin REF_CHARACTERISTIC /end REF_CHARACTERISTIC /begin REF_MEASUREMENT CDD_FordBlaBoxIfCmp1.FordVehTrlrAidTarIdn.Val /end REF_MEASUREMENT /end GROUP
/begin GROUP CDD_FordBlaBoxIfCmp1.FordVehTrlrAidTrlrIdn.Val "MICROSAR RTE" /begin SUB_GROUP /end SUB_GROUP /begin FUNCTION_LIST /end FUNCTION_LIST /begin REF_CHARACTERISTIC /end REF_CHARACTERISTIC /begin REF_MEASUREMENT CDD_FordBlaBoxIfCmp1.FordVehTrlrAidTrlrIdn.Val /end REF_MEASUREMENT /end GROUP
/begin GROUP CDD_FordBlaBoxIfCmp1.FordVehTrlrHitchLampReq.Val "MICROSAR RTE" /begin SUB_GROUP /end SUB_GROUP /begin FUNCTION_LIST /end FUNCTION_LIST /begin REF_CHARACTERISTIC /end REF_CHARACTERISTIC /begin REF_MEASUREMENT CDD_FordBlaBoxIfCmp1.FordVehTrlrHitchLampReq.Val /end REF_MEASUREMENT /end GROUP
/begin GROUP CDD_FordBlaBoxIfCmp1.FordVehVelMaxReqTrlrAid.Val "MICROSAR RTE" /begin SUB_GROUP /end SUB_GROUP /begin FUNCTION_LIST /end FUNCTION_LIST /begin REF_CHARACTERISTIC /end REF_CHARACTERISTIC /begin REF_MEASUREMENT CDD_FordBlaBoxIfCmp1.FordVehVelMaxReqTrlrAid.Val /end REF_MEASUREMENT /end GROUP
/begin GROUP CDD_FordBlaBoxIfCmp1.FordVehVelTrlrAidReq.Val "MICROSAR RTE" /begin SUB_GROUP /end SUB_GROUP /begin FUNCTION_LIST /end FUNCTION_LIST /begin REF_CHARACTERISTIC /end REF_CHARACTERISTIC /begin REF_MEASUREMENT CDD_FordBlaBoxIfCmp1.FordVehVelTrlrAidReq.Val /end REF_MEASUREMENT /end GROUP
/begin GROUP CDD_FordBlaBoxIfCmp1.FordWrSrvActvNiblCmpIntSts.Val "MICROSAR RTE" /begin SUB_GROUP /end SUB_GROUP /begin FUNCTION_LIST /end FUNCTION_LIST /begin REF_CHARACTERISTIC /end REF_CHARACTERISTIC /begin REF_MEASUREMENT CDD_FordBlaBoxIfCmp1.FordWrSrvActvNiblCmpIntSts.Val /end REF_MEASUREMENT /end GROUP
/begin GROUP CDD_FordBlaBoxIfCmp1.FordWrSrvLaneDprtrWarnIntSts.Val "MICROSAR RTE" /begin SUB_GROUP /end SUB_GROUP /begin FUNCTION_LIST /end FUNCTION_LIST /begin REF_CHARACTERISTIC /end REF_CHARACTERISTIC /begin REF_MEASUREMENT CDD_FordBlaBoxIfCmp1.FordWrSrvLaneDprtrWarnIntSts.Val /end REF_MEASUREMENT /end GROUP
/begin GROUP CDD_FordBlaBoxIfCmp1.FordWrSrvLaneKeepAssiIntSts.Val "MICROSAR RTE" /begin SUB_GROUP /end SUB_GROUP /begin FUNCTION_LIST /end FUNCTION_LIST /begin REF_CHARACTERISTIC /end REF_CHARACTERISTIC /begin REF_MEASUREMENT CDD_FordBlaBoxIfCmp1.FordWrSrvLaneKeepAssiIntSts.Val /end REF_MEASUREMENT /end GROUP
/begin GROUP CDD_FordBlaBoxIfCmp1.FordWrSrvLatCtrlIntSts.Val "MICROSAR RTE" /begin SUB_GROUP /end SUB_GROUP /begin FUNCTION_LIST /end FUNCTION_LIST /begin REF_CHARACTERISTIC /end REF_CHARACTERISTIC /begin REF_MEASUREMENT CDD_FordBlaBoxIfCmp1.FordWrSrvLatCtrlIntSts.Val /end REF_MEASUREMENT /end GROUP
/begin GROUP CDD_FordBlaBoxIfCmp1.FordWrSrvPullDriftCmpIntSts.Val "MICROSAR RTE" /begin SUB_GROUP /end SUB_GROUP /begin FUNCTION_LIST /end FUNCTION_LIST /begin REF_CHARACTERISTIC /end REF_CHARACTERISTIC /begin REF_MEASUREMENT CDD_FordBlaBoxIfCmp1.FordWrSrvPullDriftCmpIntSts.Val /end REF_MEASUREMENT /end GROUP
/begin GROUP CDD_FordBlaBoxIfCmp1.FordWrSrvTrlrBackupAssiIntSts.Val "MICROSAR RTE" /begin SUB_GROUP /end SUB_GROUP /begin FUNCTION_LIST /end FUNCTION_LIST /begin REF_CHARACTERISTIC /end REF_CHARACTERISTIC /begin REF_MEASUREMENT CDD_FordBlaBoxIfCmp1.FordWrSrvTrlrBackupAssiIntSts.Val /end REF_MEASUREMENT /end GROUP
/begin GROUP CDD_FordBlaBoxIfCmp1.LaneAssi "MICROSAR RTE" /begin SUB_GROUP /end SUB_GROUP /begin FUNCTION_LIST /end FUNCTION_LIST /begin REF_CHARACTERISTIC /end REF_CHARACTERISTIC /begin REF_MEASUREMENT CDD_FordBlaBoxIfCmp1.LaneAssi /end REF_MEASUREMENT /end GROUP
/begin GROUP CDD_FordBlaBoxIfCmp1.LaneAssiDft "MICROSAR RTE" /begin SUB_GROUP /end SUB_GROUP /begin FUNCTION_LIST /end FUNCTION_LIST /begin REF_CHARACTERISTIC CDD_FordBlaBoxIfCmp1.LaneAssiDft /end REF_CHARACTERISTIC /begin REF_MEASUREMENT /end REF_MEASUREMENT /end GROUP
/begin GROUP CDD_FordBlaBoxIfCmp1.LaneDprtrWarnIntSts.Val "MICROSAR RTE" /begin SUB_GROUP /end SUB_GROUP /begin FUNCTION_LIST /end FUNCTION_LIST /begin REF_CHARACTERISTIC /end REF_CHARACTERISTIC /begin REF_MEASUREMENT CDD_FordBlaBoxIfCmp1.LaneDprtrWarnIntSts.Val /end REF_MEASUREMENT /end GROUP
/begin GROUP CDD_FordBlaBoxIfCmp1.LaneKeepAssiIntSts.Val "MICROSAR RTE" /begin SUB_GROUP /end SUB_GROUP /begin FUNCTION_LIST /end FUNCTION_LIST /begin REF_CHARACTERISTIC /end REF_CHARACTERISTIC /begin REF_MEASUREMENT CDD_FordBlaBoxIfCmp1.LaneKeepAssiIntSts.Val /end REF_MEASUREMENT /end GROUP
/begin GROUP CDD_FordBlaBoxIfCmp1.LatCtrlIntSts.Val "MICROSAR RTE" /begin SUB_GROUP /end SUB_GROUP /begin FUNCTION_LIST /end FUNCTION_LIST /begin REF_CHARACTERISTIC /end REF_CHARACTERISTIC /begin REF_MEASUREMENT CDD_FordBlaBoxIfCmp1.LatCtrlIntSts.Val /end REF_MEASUREMENT /end GROUP
/begin GROUP CDD_FordBlaBoxIfCmp1.PerInstanceMemories "MICROSAR RTE"
 /begin SUB_GROUP CDD_FordBlaBoxIfCmp1.ActvNiblCtrl CDD_FordBlaBoxIfCmp1.LaneAssi CDD_FordBlaBoxIfCmp1.PullDriftCmp CDD_FordBlaBoxIfCmp1.PullDriftCmpFctCallSel CDD_FordBlaBoxIfCmp1.TqOffsTbl CDD_FordBlaBoxIfCmp1.TrlrBackAssiFctCallSel CDD_FordBlaBoxIfCmp1.TrlrBackupAssi /end SUB_GROUP
 /begin FUNCTION_LIST /end FUNCTION_LIST
 /begin REF_CHARACTERISTIC /end REF_CHARACTERISTIC
 /begin REF_MEASUREMENT /end REF_MEASUREMENT
/end GROUP
/begin GROUP CDD_FordBlaBoxIfCmp1.PullDriftCmp "MICROSAR RTE" /begin SUB_GROUP /end SUB_GROUP /begin FUNCTION_LIST /end FUNCTION_LIST /begin REF_CHARACTERISTIC /end REF_CHARACTERISTIC /begin REF_MEASUREMENT CDD_FordBlaBoxIfCmp1.PullDriftCmp /end REF_MEASUREMENT /end GROUP
/begin GROUP CDD_FordBlaBoxIfCmp1.PullDriftCmpDft "MICROSAR RTE" /begin SUB_GROUP /end SUB_GROUP /begin FUNCTION_LIST /end FUNCTION_LIST /begin REF_CHARACTERISTIC CDD_FordBlaBoxIfCmp1.PullDriftCmpDft /end REF_CHARACTERISTIC /begin REF_MEASUREMENT /end REF_MEASUREMENT /end GROUP
/begin GROUP CDD_FordBlaBoxIfCmp1.PullDriftCmpFctCallSel "MICROSAR RTE" /begin SUB_GROUP /end SUB_GROUP /begin FUNCTION_LIST /end FUNCTION_LIST /begin REF_CHARACTERISTIC /end REF_CHARACTERISTIC /begin REF_MEASUREMENT CDD_FordBlaBoxIfCmp1.PullDriftCmpFctCallSel /end REF_MEASUREMENT /end GROUP
/begin GROUP CDD_FordBlaBoxIfCmp1.PullDriftCmpIntSts.Val "MICROSAR RTE" /begin SUB_GROUP /end SUB_GROUP /begin FUNCTION_LIST /end FUNCTION_LIST /begin REF_CHARACTERISTIC /end REF_CHARACTERISTIC /begin REF_MEASUREMENT CDD_FordBlaBoxIfCmp1.PullDriftCmpIntSts.Val /end REF_MEASUREMENT /end GROUP
/begin GROUP CDD_FordBlaBoxIfCmp1.ReceiverPorts "MICROSAR RTE"
 /begin SUB_GROUP CDD_FordBlaBoxIfCmp1.EcuId.Val CDD_FordBlaBoxIfCmp1.FordActvNiblCtrlDiagcSts.Val CDD_FordBlaBoxIfCmp1.FordSrvLaneDprtrWarnDiagcSts.Val CDD_FordBlaBoxIfCmp1.FordSrvPullDriftCmpRstVal.Val CDD_FordBlaBoxIfCmp1.FordWrSrvActvNiblCmpIntSts.Val CDD_FordBlaBoxIfCmp1.FordWrSrvLaneDprtrWarnIntSts.Val CDD_FordBlaBoxIfCmp1.FordWrSrvLaneKeepAssiIntSts.Val CDD_FordBlaBoxIfCmp1.FordWrSrvLatCtrlIntSts.Val CDD_FordBlaBoxIfCmp1.FordWrSrvPullDriftCmpIntSts.Val CDD_FordBlaBoxIfCmp1.FordWrSrvTrlrBackupAssiIntSts.Val CDD_FordBlaBoxIfCmp1.VehSpd.Val /end SUB_GROUP
 /begin FUNCTION_LIST /end FUNCTION_LIST
 /begin REF_CHARACTERISTIC /end REF_CHARACTERISTIC
 /begin REF_MEASUREMENT /end REF_MEASUREMENT
/end GROUP
/begin GROUP CDD_FordBlaBoxIfCmp1.SenderPorts "MICROSAR RTE"
 /begin SUB_GROUP CDD_FordBlaBoxIfCmp1.ActvNiblCmpIntSts.Val CDD_FordBlaBoxIfCmp1.FordActvNiblCtrlSwVers.Val CDD_FordBlaBoxIfCmp1.FordActvNiblCtrlTqReq.Val CDD_FordBlaBoxIfCmp1.FordBlaBoxSwVers.Val CDD_FordBlaBoxIfCmp1.FordLaneAssiSwVers.Val CDD_FordBlaBoxIfCmp1.FordLaneDprtrWarnTqReq.Val CDD_FordBlaBoxIfCmp1.FordLaneKeepAssiTqReq.Val CDD_FordBlaBoxIfCmp1.FordLatCtrlTqReq.Val CDD_FordBlaBoxIfCmp1.FordPullDriftCmpSwVers.Val CDD_FordBlaBoxIfCmp1.FordPullDriftCmpTqReq.Val CDD_FordBlaBoxIfCmp1.FordResrchFctSwVers.Val CDD_FordBlaBoxIfCmp1.FordTrlrBackupAssiSwVers.Val CDD_FordBlaBoxIfCmp1.FordVehBBMsgOutp1HiPart.Val CDD_FordBlaBoxIfCmp1.FordVehBBMsgOutp1LoPart.Val CDD_FordBlaBoxIfCmp1.FordVehBBMsgOutp2HiPart.Val CDD_FordBlaBoxIfCmp1.FordVehBBMsgOutp2LoPart.Val CDD_FordBlaBoxIfCmp1.FordVehBBMsgOutp3HiPart.Val CDD_FordBlaBoxIfCmp1.FordVehBBMsgOutp3LoPart.Val CDD_FordBlaBoxIfCmp1.FordVehBBMsgOutp4HiPart.Val CDD_FordBlaBoxIfCmp1.FordVehBBMsgOutp4LoPart.Val CDD_FordBlaBoxIfCmp1.FordVehLaneAssiAvl.Val CDD_FordBlaBoxIfCmp1.FordVehLaneAssiHandsOff.Val CDD_FordBlaBoxIfCmp1.FordVehLaneAssiRejctn.Val CDD_FordBlaBoxIfCmp1.FordVehLatCtrlLimSts.Ford_LatCtlLim_D_Stat CDD_FordBlaBoxIfCmp1.FordVehLatCtrlSteerSts.Ford_LatCtlSte_D_Stat CDD_FordBlaBoxIfCmp1.FordVehLoSpdMtnCtrlBrkDecelEnaReq.Val CDD_FordBlaBoxIfCmp1.FordVehLoSpdMtnCtrlBrkTqReq.Val CDD_FordBlaBoxIfCmp1.FordVehTrfcJamAvdHandsOnConf.Val CDD_FordBlaBoxIfCmp1.FordVehTrlrAgTarCalcn.Val CDD_FordBlaBoxIfCmp1.FordVehTrlrAidAgMax.Val CDD_FordBlaBoxIfCmp1.FordVehTrlrAidAgOffs.Val CDD_FordBlaBoxIfCmp1.FordVehTrlrAidAgWarn.Val CDD_FordBlaBoxIfCmp1.FordVehTrlrAidEnaSts.Val CDD_FordBlaBoxIfCmp1.FordVehTrlrAidHitchToAxle.Val CDD_FordBlaBoxIfCmp1.FordVehTrlrAidMsgTxtReq.Val CDD_FordBlaBoxIfCmp1.FordVehTrlrAidSetUp.Val CDD_FordBlaBoxIfCmp1.FordVehTrlrAidTarIdn.Val CDD_FordBlaBoxIfCmp1.FordVehTrlrAidTrlrIdn.Val CDD_FordBlaBoxIfCmp1.FordVehTrlrHitchLampReq.Val CDD_FordBlaBoxIfCmp1.FordVehVelMaxReqTrlrAid.Val CDD_FordBlaBoxIfCmp1.FordVehVelTrlrAidReq.Val CDD_FordBlaBoxIfCmp1.LaneDprtrWarnIntSts.Val CDD_FordBlaBoxIfCmp1.LaneKeepAssiIntSts.Val CDD_FordBlaBoxIfCmp1.LatCtrlIntSts.Val CDD_FordBlaBoxIfCmp1.PullDriftCmpIntSts.Val CDD_FordBlaBoxIfCmp1.SrvPullDriftCmpAct.Val CDD_FordBlaBoxIfCmp1.SrvPullDriftCmpRstVal.Val CDD_FordBlaBoxIfCmp1.TrlrBackupAssiIntSts.Val /end SUB_GROUP
 /begin FUNCTION_LIST /end FUNCTION_LIST
 /begin REF_CHARACTERISTIC /end REF_CHARACTERISTIC
 /begin REF_MEASUREMENT /end REF_MEASUREMENT
/end GROUP
/begin GROUP CDD_FordBlaBoxIfCmp1.SrvPullDriftCmpAct.Val "MICROSAR RTE" /begin SUB_GROUP /end SUB_GROUP /begin FUNCTION_LIST /end FUNCTION_LIST /begin REF_CHARACTERISTIC /end REF_CHARACTERISTIC /begin REF_MEASUREMENT CDD_FordBlaBoxIfCmp1.SrvPullDriftCmpAct.Val /end REF_MEASUREMENT /end GROUP
/begin GROUP CDD_FordBlaBoxIfCmp1.SrvPullDriftCmpRstVal.Val "MICROSAR RTE" /begin SUB_GROUP /end SUB_GROUP /begin FUNCTION_LIST /end FUNCTION_LIST /begin REF_CHARACTERISTIC /end REF_CHARACTERISTIC /begin REF_MEASUREMENT CDD_FordBlaBoxIfCmp1.SrvPullDriftCmpRstVal.Val /end REF_MEASUREMENT /end GROUP
/begin GROUP CDD_FordBlaBoxIfCmp1.SysGlbPrmSysKineRat.Val "MICROSAR RTE" /begin SUB_GROUP /end SUB_GROUP /begin FUNCTION_LIST /end FUNCTION_LIST /begin REF_CHARACTERISTIC CDD_FordBlaBoxIfCmp1.SysGlbPrmSysKineRat.Val /end REF_CHARACTERISTIC /begin REF_MEASUREMENT /end REF_MEASUREMENT /end GROUP
/begin GROUP CDD_FordBlaBoxIfCmp1.SysGlbPrmVehSpdBilnrSeln.Ary1D "MICROSAR RTE" /begin SUB_GROUP /end SUB_GROUP /begin FUNCTION_LIST /end FUNCTION_LIST /begin REF_CHARACTERISTIC CDD_FordBlaBoxIfCmp1.SysGlbPrmVehSpdBilnrSeln.Ary1D /end REF_CHARACTERISTIC /begin REF_MEASUREMENT /end REF_MEASUREMENT /end GROUP
/begin GROUP CDD_FordBlaBoxIfCmp1.TqOffsTbl "MICROSAR RTE" /begin SUB_GROUP /end SUB_GROUP /begin FUNCTION_LIST /end FUNCTION_LIST /begin REF_CHARACTERISTIC /end REF_CHARACTERISTIC /begin REF_MEASUREMENT CDD_FordBlaBoxIfCmp1.TqOffsTbl /end REF_MEASUREMENT /end GROUP
/begin GROUP CDD_FordBlaBoxIfCmp1.TrlrBackAssiFctCallSel "MICROSAR RTE" /begin SUB_GROUP /end SUB_GROUP /begin FUNCTION_LIST /end FUNCTION_LIST /begin REF_CHARACTERISTIC /end REF_CHARACTERISTIC /begin REF_MEASUREMENT CDD_FordBlaBoxIfCmp1.TrlrBackAssiFctCallSel /end REF_MEASUREMENT /end GROUP
/begin GROUP CDD_FordBlaBoxIfCmp1.TrlrBackupAssi "MICROSAR RTE" /begin SUB_GROUP /end SUB_GROUP /begin FUNCTION_LIST /end FUNCTION_LIST /begin REF_CHARACTERISTIC /end REF_CHARACTERISTIC /begin REF_MEASUREMENT CDD_FordBlaBoxIfCmp1.TrlrBackupAssi /end REF_MEASUREMENT /end GROUP
/begin GROUP CDD_FordBlaBoxIfCmp1.TrlrBackupAssiDft "MICROSAR RTE" /begin SUB_GROUP /end SUB_GROUP /begin FUNCTION_LIST /end FUNCTION_LIST /begin REF_CHARACTERISTIC CDD_FordBlaBoxIfCmp1.TrlrBackupAssiDft /end REF_CHARACTERISTIC /begin REF_MEASUREMENT /end REF_MEASUREMENT /end GROUP
/begin GROUP CDD_FordBlaBoxIfCmp1.TrlrBackupAssiIntSts.Val "MICROSAR RTE" /begin SUB_GROUP /end SUB_GROUP /begin FUNCTION_LIST /end FUNCTION_LIST /begin REF_CHARACTERISTIC /end REF_CHARACTERISTIC /begin REF_MEASUREMENT CDD_FordBlaBoxIfCmp1.TrlrBackupAssiIntSts.Val /end REF_MEASUREMENT /end GROUP
/begin GROUP CDD_FordBlaBoxIfCmp1.VehSpd.Val "MICROSAR RTE" /begin SUB_GROUP /end SUB_GROUP /begin FUNCTION_LIST /end FUNCTION_LIST /begin REF_CHARACTERISTIC /end REF_CHARACTERISTIC /begin REF_MEASUREMENT CDD_FordBlaBoxIfCmp1.VehSpd.Val /end REF_MEASUREMENT /end GROUP
/begin GROUP CDD_FordBlaBoxIfCmp2 "MICROSAR RTE"
 /begin SUB_GROUP CDD_FordBlaBoxIfCmp2.PerInstanceMemories CDD_FordBlaBoxIfCmp2.ReceiverPorts CDD_FordBlaBoxIfCmp2.SenderPorts /end SUB_GROUP
 /begin FUNCTION_LIST /end FUNCTION_LIST
 /begin REF_CHARACTERISTIC /end REF_CHARACTERISTIC
 /begin REF_MEASUREMENT /end REF_MEASUREMENT
/end GROUP
/begin GROUP CDD_FordBlaBoxIfCmp2.EcuId.Val "MICROSAR RTE" /begin SUB_GROUP /end SUB_GROUP /begin FUNCTION_LIST /end FUNCTION_LIST /begin REF_CHARACTERISTIC /end REF_CHARACTERISTIC /begin REF_MEASUREMENT CDD_FordBlaBoxIfCmp2.EcuId.Val /end REF_MEASUREMENT /end GROUP
/begin GROUP CDD_FordBlaBoxIfCmp2.EvasSteerAssiFctCallTog "MICROSAR RTE" /begin SUB_GROUP /end SUB_GROUP /begin FUNCTION_LIST /end FUNCTION_LIST /begin REF_CHARACTERISTIC /end REF_CHARACTERISTIC /begin REF_MEASUREMENT CDD_FordBlaBoxIfCmp2.EvasSteerAssiFctCallTog /end REF_MEASUREMENT /end GROUP
/begin GROUP CDD_FordBlaBoxIfCmp2.FordBrkPlsRednActvnCntr.Val "MICROSAR RTE" /begin SUB_GROUP /end SUB_GROUP /begin FUNCTION_LIST /end FUNCTION_LIST /begin REF_CHARACTERISTIC /end REF_CHARACTERISTIC /begin REF_MEASUREMENT CDD_FordBlaBoxIfCmp2.FordBrkPlsRednActvnCntr.Val /end REF_MEASUREMENT /end GROUP
/begin GROUP CDD_FordBlaBoxIfCmp2.FordEvasSteerAssiIntSts.Val "MICROSAR RTE" /begin SUB_GROUP /end SUB_GROUP /begin FUNCTION_LIST /end FUNCTION_LIST /begin REF_CHARACTERISTIC /end REF_CHARACTERISTIC /begin REF_MEASUREMENT CDD_FordBlaBoxIfCmp2.FordEvasSteerAssiIntSts.Val /end REF_MEASUREMENT /end GROUP
/begin GROUP CDD_FordBlaBoxIfCmp2.FordEvasSteerAssiSwVers.Val "MICROSAR RTE" /begin SUB_GROUP /end SUB_GROUP /begin FUNCTION_LIST /end FUNCTION_LIST /begin REF_CHARACTERISTIC /end REF_CHARACTERISTIC /begin REF_MEASUREMENT CDD_FordBlaBoxIfCmp2.FordEvasSteerAssiSwVers.Val /end REF_MEASUREMENT /end GROUP
/begin GROUP CDD_FordBlaBoxIfCmp2.FordEvasSteerAssiTqReq.Val "MICROSAR RTE" /begin SUB_GROUP /end SUB_GROUP /begin FUNCTION_LIST /end FUNCTION_LIST /begin REF_CHARACTERISTIC /end REF_CHARACTERISTIC /begin REF_MEASUREMENT CDD_FordBlaBoxIfCmp2.FordEvasSteerAssiTqReq.Val /end REF_MEASUREMENT /end GROUP
/begin GROUP CDD_FordBlaBoxIfCmp2.FordSteerTqDstbcRejctnIntSts.Val "MICROSAR RTE" /begin SUB_GROUP /end SUB_GROUP /begin FUNCTION_LIST /end FUNCTION_LIST /begin REF_CHARACTERISTIC /end REF_CHARACTERISTIC /begin REF_MEASUREMENT CDD_FordBlaBoxIfCmp2.FordSteerTqDstbcRejctnIntSts.Val /end REF_MEASUREMENT /end GROUP
/begin GROUP CDD_FordBlaBoxIfCmp2.FordSteerTqDstbcRejctnSwVers.Val "MICROSAR RTE" /begin SUB_GROUP /end SUB_GROUP /begin FUNCTION_LIST /end FUNCTION_LIST /begin REF_CHARACTERISTIC /end REF_CHARACTERISTIC /begin REF_MEASUREMENT CDD_FordBlaBoxIfCmp2.FordSteerTqDstbcRejctnSwVers.Val /end REF_MEASUREMENT /end GROUP
/begin GROUP CDD_FordBlaBoxIfCmp2.FordSteerTqDstbcRejctnTqReq.Val "MICROSAR RTE" /begin SUB_GROUP /end SUB_GROUP /begin FUNCTION_LIST /end FUNCTION_LIST /begin REF_CHARACTERISTIC /end REF_CHARACTERISTIC /begin REF_MEASUREMENT CDD_FordBlaBoxIfCmp2.FordSteerTqDstbcRejctnTqReq.Val /end REF_MEASUREMENT /end GROUP
/begin GROUP CDD_FordBlaBoxIfCmp2.FordTqSteerCmpActvnCntr.Val "MICROSAR RTE" /begin SUB_GROUP /end SUB_GROUP /begin FUNCTION_LIST /end FUNCTION_LIST /begin REF_CHARACTERISTIC /end REF_CHARACTERISTIC /begin REF_MEASUREMENT CDD_FordBlaBoxIfCmp2.FordTqSteerCmpActvnCntr.Val /end REF_MEASUREMENT /end GROUP
/begin GROUP CDD_FordBlaBoxIfCmp2.FordVehEvasSteerAssiSts.Ford_EsaOn_B_Stat "MICROSAR RTE" /begin SUB_GROUP /end SUB_GROUP /begin FUNCTION_LIST /end FUNCTION_LIST /begin REF_CHARACTERISTIC /end REF_CHARACTERISTIC
 /begin REF_MEASUREMENT CDD_FordBlaBoxIfCmp2.FordVehEvasSteerAssiSts.Ford_EsaOn_B_Stat /end REF_MEASUREMENT
/end GROUP
/begin GROUP CDD_FordBlaBoxIfCmp2.FordWrSrvBrkPlsRednActvnCntr.Val "MICROSAR RTE" /begin SUB_GROUP /end SUB_GROUP /begin FUNCTION_LIST /end FUNCTION_LIST /begin REF_CHARACTERISTIC /end REF_CHARACTERISTIC /begin REF_MEASUREMENT CDD_FordBlaBoxIfCmp2.FordWrSrvBrkPlsRednActvnCntr.Val /end REF_MEASUREMENT /end GROUP
/begin GROUP CDD_FordBlaBoxIfCmp2.FordWrSrvEvasSteerAssiIntSts.Val "MICROSAR RTE" /begin SUB_GROUP /end SUB_GROUP /begin FUNCTION_LIST /end FUNCTION_LIST /begin REF_CHARACTERISTIC /end REF_CHARACTERISTIC /begin REF_MEASUREMENT CDD_FordBlaBoxIfCmp2.FordWrSrvEvasSteerAssiIntSts.Val /end REF_MEASUREMENT /end GROUP
/begin GROUP CDD_FordBlaBoxIfCmp2.FordWrSrvSteerTqDstbcRejctnIntSts.Val "MICROSAR RTE" /begin SUB_GROUP /end SUB_GROUP /begin FUNCTION_LIST /end FUNCTION_LIST /begin REF_CHARACTERISTIC /end REF_CHARACTERISTIC /begin REF_MEASUREMENT CDD_FordBlaBoxIfCmp2.FordWrSrvSteerTqDstbcRejctnIntSts.Val /end REF_MEASUREMENT /end GROUP
/begin GROUP CDD_FordBlaBoxIfCmp2.FordWrSrvTqSteerCmpActvnCntr.Val "MICROSAR RTE" /begin SUB_GROUP /end SUB_GROUP /begin FUNCTION_LIST /end FUNCTION_LIST /begin REF_CHARACTERISTIC /end REF_CHARACTERISTIC /begin REF_MEASUREMENT CDD_FordBlaBoxIfCmp2.FordWrSrvTqSteerCmpActvnCntr.Val /end REF_MEASUREMENT /end GROUP
/begin GROUP CDD_FordBlaBoxIfCmp2.PerInstanceMemories "MICROSAR RTE" /begin SUB_GROUP CDD_FordBlaBoxIfCmp2.EvasSteerAssiFctCallTog /end SUB_GROUP /begin FUNCTION_LIST /end FUNCTION_LIST /begin REF_CHARACTERISTIC /end REF_CHARACTERISTIC /begin REF_MEASUREMENT /end REF_MEASUREMENT /end GROUP
/begin GROUP CDD_FordBlaBoxIfCmp2.ReceiverPorts "MICROSAR RTE"
 /begin SUB_GROUP CDD_FordBlaBoxIfCmp2.EcuId.Val CDD_FordBlaBoxIfCmp2.FordWrSrvBrkPlsRednActvnCntr.Val CDD_FordBlaBoxIfCmp2.FordWrSrvEvasSteerAssiIntSts.Val CDD_FordBlaBoxIfCmp2.FordWrSrvSteerTqDstbcRejctnIntSts.Val CDD_FordBlaBoxIfCmp2.FordWrSrvTqSteerCmpActvnCntr.Val /end SUB_GROUP
 /begin FUNCTION_LIST /end FUNCTION_LIST
 /begin REF_CHARACTERISTIC /end REF_CHARACTERISTIC
 /begin REF_MEASUREMENT /end REF_MEASUREMENT
/end GROUP
/begin GROUP CDD_FordBlaBoxIfCmp2.SenderPorts "MICROSAR RTE"
 /begin SUB_GROUP CDD_FordBlaBoxIfCmp2.FordBrkPlsRednActvnCntr.Val CDD_FordBlaBoxIfCmp2.FordEvasSteerAssiIntSts.Val CDD_FordBlaBoxIfCmp2.FordEvasSteerAssiSwVers.Val CDD_FordBlaBoxIfCmp2.FordEvasSteerAssiTqReq.Val CDD_FordBlaBoxIfCmp2.FordSteerTqDstbcRejctnIntSts.Val CDD_FordBlaBoxIfCmp2.FordSteerTqDstbcRejctnSwVers.Val CDD_FordBlaBoxIfCmp2.FordSteerTqDstbcRejctnTqReq.Val CDD_FordBlaBoxIfCmp2.FordTqSteerCmpActvnCntr.Val CDD_FordBlaBoxIfCmp2.FordVehEvasSteerAssiSts.Ford_EsaOn_B_Stat /end SUB_GROUP
 /begin FUNCTION_LIST /end FUNCTION_LIST
 /begin REF_CHARACTERISTIC /end REF_CHARACTERISTIC
 /begin REF_MEASUREMENT /end REF_MEASUREMENT
/end GROUP
/begin GROUP CDD_FordT3T6McuCfg "MICROSAR RTE"
 /begin SUB_GROUP CDD_FordT3T6McuCfg.ReceiverPorts CDD_FordT3T6McuCfg.SenderPorts /end SUB_GROUP
 /begin FUNCTION_LIST /end FUNCTION_LIST
 /begin REF_CHARACTERISTIC /end REF_CHARACTERISTIC
 /begin REF_MEASUREMENT /end REF_MEASUREMENT
/end GROUP
/begin GROUP CDD_FordT3T6McuCfg.Adc0Faild.Logl "MICROSAR RTE" /begin SUB_GROUP /end SUB_GROUP /begin FUNCTION_LIST /end FUNCTION_LIST /begin REF_CHARACTERISTIC /end REF_CHARACTERISTIC /begin REF_MEASUREMENT CDD_FordT3T6McuCfg.Adc0Faild.Logl /end REF_MEASUREMENT /end GROUP
/begin GROUP CDD_FordT3T6McuCfg.Adc1Faild.Logl "MICROSAR RTE" /begin SUB_GROUP /end SUB_GROUP /begin FUNCTION_LIST /end FUNCTION_LIST /begin REF_CHARACTERISTIC /end REF_CHARACTERISTIC /begin REF_MEASUREMENT CDD_FordT3T6McuCfg.Adc1Faild.Logl /end REF_MEASUREMENT /end GROUP
/begin GROUP CDD_FordT3T6McuCfg.Adc1ScanGroup2Ref0.Val "MICROSAR RTE" /begin SUB_GROUP /end SUB_GROUP /begin FUNCTION_LIST /end FUNCTION_LIST /begin REF_CHARACTERISTIC /end REF_CHARACTERISTIC /begin REF_MEASUREMENT CDD_FordT3T6McuCfg.Adc1ScanGroup2Ref0.Val /end REF_MEASUREMENT /end GROUP
/begin GROUP CDD_FordT3T6McuCfg.Adc1ScanGroup2Ref1.Val "MICROSAR RTE" /begin SUB_GROUP /end SUB_GROUP /begin FUNCTION_LIST /end FUNCTION_LIST /begin REF_CHARACTERISTIC /end REF_CHARACTERISTIC /begin REF_MEASUREMENT CDD_FordT3T6McuCfg.Adc1ScanGroup2Ref1.Val /end REF_MEASUREMENT /end GROUP
/begin GROUP CDD_FordT3T6McuCfg.Adc1ScanGroup3Ref0.Val "MICROSAR RTE" /begin SUB_GROUP /end SUB_GROUP /begin FUNCTION_LIST /end FUNCTION_LIST /begin REF_CHARACTERISTIC /end REF_CHARACTERISTIC /begin REF_MEASUREMENT CDD_FordT3T6McuCfg.Adc1ScanGroup3Ref0.Val /end REF_MEASUREMENT /end GROUP
/begin GROUP CDD_FordT3T6McuCfg.Adc1ScanGroup3Ref1.Val "MICROSAR RTE" /begin SUB_GROUP /end SUB_GROUP /begin FUNCTION_LIST /end FUNCTION_LIST /begin REF_CHARACTERISTIC /end REF_CHARACTERISTIC /begin REF_MEASUREMENT CDD_FordT3T6McuCfg.Adc1ScanGroup3Ref1.Val /end REF_MEASUREMENT /end GROUP
/begin GROUP CDD_FordT3T6McuCfg.Adc1SelfDiag0.Val "MICROSAR RTE" /begin SUB_GROUP /end SUB_GROUP /begin FUNCTION_LIST /end FUNCTION_LIST /begin REF_CHARACTERISTIC /end REF_CHARACTERISTIC /begin REF_MEASUREMENT CDD_FordT3T6McuCfg.Adc1SelfDiag0.Val /end REF_MEASUREMENT /end GROUP
/begin GROUP CDD_FordT3T6McuCfg.Adc1SelfDiag2.Val "MICROSAR RTE" /begin SUB_GROUP /end SUB_GROUP /begin FUNCTION_LIST /end FUNCTION_LIST /begin REF_CHARACTERISTIC /end REF_CHARACTERISTIC /begin REF_MEASUREMENT CDD_FordT3T6McuCfg.Adc1SelfDiag2.Val /end REF_MEASUREMENT /end GROUP
/begin GROUP CDD_FordT3T6McuCfg.Adc1SelfDiag4.Val "MICROSAR RTE" /begin SUB_GROUP /end SUB_GROUP /begin FUNCTION_LIST /end FUNCTION_LIST /begin REF_CHARACTERISTIC /end REF_CHARACTERISTIC /begin REF_MEASUREMENT CDD_FordT3T6McuCfg.Adc1SelfDiag4.Val /end REF_MEASUREMENT /end GROUP
/begin GROUP CDD_FordT3T6McuCfg.BattRtnCurrAdc.Val "MICROSAR RTE" /begin SUB_GROUP /end SUB_GROUP /begin FUNCTION_LIST /end FUNCTION_LIST /begin REF_CHARACTERISTIC /end REF_CHARACTERISTIC /begin REF_MEASUREMENT CDD_FordT3T6McuCfg.BattRtnCurrAdc.Val /end REF_MEASUREMENT /end GROUP
/begin GROUP CDD_FordT3T6McuCfg.BattRtnCurrAdcFaild.Logl "MICROSAR RTE" /begin SUB_GROUP /end SUB_GROUP /begin FUNCTION_LIST /end FUNCTION_LIST /begin REF_CHARACTERISTIC /end REF_CHARACTERISTIC /begin REF_MEASUREMENT CDD_FordT3T6McuCfg.BattRtnCurrAdcFaild.Logl /end REF_MEASUREMENT /end GROUP
/begin GROUP CDD_FordT3T6McuCfg.BattVltg.Val "MICROSAR RTE" /begin SUB_GROUP /end SUB_GROUP /begin FUNCTION_LIST /end FUNCTION_LIST /begin REF_CHARACTERISTIC /end REF_CHARACTERISTIC /begin REF_MEASUREMENT CDD_FordT3T6McuCfg.BattVltg.Val /end REF_MEASUREMENT /end GROUP
/begin GROUP CDD_FordT3T6McuCfg.BattVltgAdcFaild.Logl "MICROSAR RTE" /begin SUB_GROUP /end SUB_GROUP /begin FUNCTION_LIST /end FUNCTION_LIST /begin REF_CHARACTERISTIC /end REF_CHARACTERISTIC /begin REF_MEASUREMENT CDD_FordT3T6McuCfg.BattVltgAdcFaild.Logl /end REF_MEASUREMENT /end GROUP
/begin GROUP CDD_FordT3T6McuCfg.BattVltgSwd1.Val "MICROSAR RTE" /begin SUB_GROUP /end SUB_GROUP /begin FUNCTION_LIST /end FUNCTION_LIST /begin REF_CHARACTERISTIC /end REF_CHARACTERISTIC /begin REF_MEASUREMENT CDD_FordT3T6McuCfg.BattVltgSwd1.Val /end REF_MEASUREMENT /end GROUP
/begin GROUP CDD_FordT3T6McuCfg.BattVltgSwd1AdcFaild.Logl "MICROSAR RTE" /begin SUB_GROUP /end SUB_GROUP /begin FUNCTION_LIST /end FUNCTION_LIST /begin REF_CHARACTERISTIC /end REF_CHARACTERISTIC /begin REF_MEASUREMENT CDD_FordT3T6McuCfg.BattVltgSwd1AdcFaild.Logl /end REF_MEASUREMENT /end GROUP
/begin GROUP CDD_FordT3T6McuCfg.ChrgPmpDiag.Val "MICROSAR RTE" /begin SUB_GROUP /end SUB_GROUP /begin FUNCTION_LIST /end FUNCTION_LIST /begin REF_CHARACTERISTIC /end REF_CHARACTERISTIC /begin REF_MEASUREMENT CDD_FordT3T6McuCfg.ChrgPmpDiag.Val /end REF_MEASUREMENT /end GROUP
/begin GROUP CDD_FordT3T6McuCfg.ChrgPmpDiagAdcFaild.Logl "MICROSAR RTE" /begin SUB_GROUP /end SUB_GROUP /begin FUNCTION_LIST /end FUNCTION_LIST /begin REF_CHARACTERISTIC /end REF_CHARACTERISTIC /begin REF_MEASUREMENT CDD_FordT3T6McuCfg.ChrgPmpDiagAdcFaild.Logl /end REF_MEASUREMENT /end GROUP
/begin GROUP CDD_FordT3T6McuCfg.EcuId.Val "MICROSAR RTE" /begin SUB_GROUP /end SUB_GROUP /begin FUNCTION_LIST /end FUNCTION_LIST /begin REF_CHARACTERISTIC /end REF_CHARACTERISTIC /begin REF_MEASUREMENT CDD_FordT3T6McuCfg.EcuId.Val /end REF_MEASUREMENT /end GROUP
/begin GROUP CDD_FordT3T6McuCfg.EcuT.Val "MICROSAR RTE" /begin SUB_GROUP /end SUB_GROUP /begin FUNCTION_LIST /end FUNCTION_LIST /begin REF_CHARACTERISTIC /end REF_CHARACTERISTIC /begin REF_MEASUREMENT CDD_FordT3T6McuCfg.EcuT.Val /end REF_MEASUREMENT /end GROUP
/begin GROUP CDD_FordT3T6McuCfg.EcuTAdcFaild.Logl "MICROSAR RTE" /begin SUB_GROUP /end SUB_GROUP /begin FUNCTION_LIST /end FUNCTION_LIST /begin REF_CHARACTERISTIC /end REF_CHARACTERISTIC /begin REF_MEASUREMENT CDD_FordT3T6McuCfg.EcuTAdcFaild.Logl /end REF_MEASUREMENT /end GROUP
/begin GROUP CDD_FordT3T6McuCfg.HwAg1SnsrNr.Val "MICROSAR RTE" /begin SUB_GROUP /end SUB_GROUP /begin FUNCTION_LIST /end FUNCTION_LIST /begin REF_CHARACTERISTIC /end REF_CHARACTERISTIC /begin REF_MEASUREMENT CDD_FordT3T6McuCfg.HwAg1SnsrNr.Val /end REF_MEASUREMENT /end GROUP
/begin GROUP CDD_FordT3T6McuCfg.HwAg1SnsrTyp.Val "MICROSAR RTE" /begin SUB_GROUP /end SUB_GROUP /begin FUNCTION_LIST /end FUNCTION_LIST /begin REF_CHARACTERISTIC /end REF_CHARACTERISTIC /begin REF_MEASUREMENT CDD_FordT3T6McuCfg.HwAg1SnsrTyp.Val /end REF_MEASUREMENT /end GROUP
/begin GROUP CDD_FordT3T6McuCfg.MotAg2Cos.Val "MICROSAR RTE" /begin SUB_GROUP /end SUB_GROUP /begin FUNCTION_LIST /end FUNCTION_LIST /begin REF_CHARACTERISTIC /end REF_CHARACTERISTIC /begin REF_MEASUREMENT CDD_FordT3T6McuCfg.MotAg2Cos.Val /end REF_MEASUREMENT /end GROUP
/begin GROUP CDD_FordT3T6McuCfg.MotAg2CosAdcFaild.Logl "MICROSAR RTE" /begin SUB_GROUP /end SUB_GROUP /begin FUNCTION_LIST /end FUNCTION_LIST /begin REF_CHARACTERISTIC /end REF_CHARACTERISTIC /begin REF_MEASUREMENT CDD_FordT3T6McuCfg.MotAg2CosAdcFaild.Logl /end REF_MEASUREMENT /end GROUP
/begin GROUP CDD_FordT3T6McuCfg.MotAg2Sin.Val "MICROSAR RTE" /begin SUB_GROUP /end SUB_GROUP /begin FUNCTION_LIST /end FUNCTION_LIST /begin REF_CHARACTERISTIC /end REF_CHARACTERISTIC /begin REF_MEASUREMENT CDD_FordT3T6McuCfg.MotAg2Sin.Val /end REF_MEASUREMENT /end GROUP
/begin GROUP CDD_FordT3T6McuCfg.MotAg2SinAdcFaild.Logl "MICROSAR RTE" /begin SUB_GROUP /end SUB_GROUP /begin FUNCTION_LIST /end FUNCTION_LIST /begin REF_CHARACTERISTIC /end REF_CHARACTERISTIC /begin REF_MEASUREMENT CDD_FordT3T6McuCfg.MotAg2SinAdcFaild.Logl /end REF_MEASUREMENT /end GROUP
/begin GROUP CDD_FordT3T6McuCfg.MotAg5CosAdcFaild.Logl "MICROSAR RTE" /begin SUB_GROUP /end SUB_GROUP /begin FUNCTION_LIST /end FUNCTION_LIST /begin REF_CHARACTERISTIC /end REF_CHARACTERISTIC /begin REF_MEASUREMENT CDD_FordT3T6McuCfg.MotAg5CosAdcFaild.Logl /end REF_MEASUREMENT /end GROUP
/begin GROUP CDD_FordT3T6McuCfg.MotAg5SinAdcFaild.Logl "MICROSAR RTE" /begin SUB_GROUP /end SUB_GROUP /begin FUNCTION_LIST /end FUNCTION_LIST /begin REF_CHARACTERISTIC /end REF_CHARACTERISTIC /begin REF_MEASUREMENT CDD_FordT3T6McuCfg.MotAg5SinAdcFaild.Logl /end REF_MEASUREMENT /end GROUP
/begin GROUP CDD_FordT3T6McuCfg.MotAg6CosAdcFaild.Logl "MICROSAR RTE" /begin SUB_GROUP /end SUB_GROUP /begin FUNCTION_LIST /end FUNCTION_LIST /begin REF_CHARACTERISTIC /end REF_CHARACTERISTIC /begin REF_MEASUREMENT CDD_FordT3T6McuCfg.MotAg6CosAdcFaild.Logl /end REF_MEASUREMENT /end GROUP
/begin GROUP CDD_FordT3T6McuCfg.MotAg6SinAdcFaild.Logl "MICROSAR RTE" /begin SUB_GROUP /end SUB_GROUP /begin FUNCTION_LIST /end FUNCTION_LIST /begin REF_CHARACTERISTIC /end REF_CHARACTERISTIC /begin REF_MEASUREMENT CDD_FordT3T6McuCfg.MotAg6SinAdcFaild.Logl /end REF_MEASUREMENT /end GROUP
/begin GROUP CDD_FordT3T6McuCfg.MotCurrAdcPeakAAdcFaild.Logl "MICROSAR RTE" /begin SUB_GROUP /end SUB_GROUP /begin FUNCTION_LIST /end FUNCTION_LIST /begin REF_CHARACTERISTIC /end REF_CHARACTERISTIC /begin REF_MEASUREMENT CDD_FordT3T6McuCfg.MotCurrAdcPeakAAdcFaild.Logl /end REF_MEASUREMENT /end GROUP
/begin GROUP CDD_FordT3T6McuCfg.MotCurrAdcPeakBAdcFaild.Logl "MICROSAR RTE" /begin SUB_GROUP /end SUB_GROUP /begin FUNCTION_LIST /end FUNCTION_LIST /begin REF_CHARACTERISTIC /end REF_CHARACTERISTIC /begin REF_MEASUREMENT CDD_FordT3T6McuCfg.MotCurrAdcPeakBAdcFaild.Logl /end REF_MEASUREMENT /end GROUP
/begin GROUP CDD_FordT3T6McuCfg.MotCurrAdcPeakCAdcFaild.Logl "MICROSAR RTE" /begin SUB_GROUP /end SUB_GROUP /begin FUNCTION_LIST /end FUNCTION_LIST /begin REF_CHARACTERISTIC /end REF_CHARACTERISTIC /begin REF_MEASUREMENT CDD_FordT3T6McuCfg.MotCurrAdcPeakCAdcFaild.Logl /end REF_MEASUREMENT /end GROUP
/begin GROUP CDD_FordT3T6McuCfg.MotCurrAdcVlyAAdcFaild.Logl "MICROSAR RTE" /begin SUB_GROUP /end SUB_GROUP /begin FUNCTION_LIST /end FUNCTION_LIST /begin REF_CHARACTERISTIC /end REF_CHARACTERISTIC /begin REF_MEASUREMENT CDD_FordT3T6McuCfg.MotCurrAdcVlyAAdcFaild.Logl /end REF_MEASUREMENT /end GROUP
/begin GROUP CDD_FordT3T6McuCfg.MotCurrAdcVlyBAdcFaild.Logl "MICROSAR RTE" /begin SUB_GROUP /end SUB_GROUP /begin FUNCTION_LIST /end FUNCTION_LIST /begin REF_CHARACTERISTIC /end REF_CHARACTERISTIC /begin REF_MEASUREMENT CDD_FordT3T6McuCfg.MotCurrAdcVlyBAdcFaild.Logl /end REF_MEASUREMENT /end GROUP
/begin GROUP CDD_FordT3T6McuCfg.MotCurrAdcVlyCAdcFaild.Logl "MICROSAR RTE" /begin SUB_GROUP /end SUB_GROUP /begin FUNCTION_LIST /end FUNCTION_LIST /begin REF_CHARACTERISTIC /end REF_CHARACTERISTIC /begin REF_MEASUREMENT CDD_FordT3T6McuCfg.MotCurrAdcVlyCAdcFaild.Logl /end REF_MEASUREMENT /end GROUP
/begin GROUP CDD_FordT3T6McuCfg.MotCurrSnsrOffs1AdcFaild.Logl "MICROSAR RTE" /begin SUB_GROUP /end SUB_GROUP /begin FUNCTION_LIST /end FUNCTION_LIST /begin REF_CHARACTERISTIC /end REF_CHARACTERISTIC /begin REF_MEASUREMENT CDD_FordT3T6McuCfg.MotCurrSnsrOffs1AdcFaild.Logl /end REF_MEASUREMENT /end GROUP
/begin GROUP CDD_FordT3T6McuCfg.MotDrvr1IninTestCmpl.Logl "MICROSAR RTE" /begin SUB_GROUP /end SUB_GROUP /begin FUNCTION_LIST /end FUNCTION_LIST /begin REF_CHARACTERISTIC /end REF_CHARACTERISTIC /begin REF_MEASUREMENT CDD_FordT3T6McuCfg.MotDrvr1IninTestCmpl.Logl /end REF_MEASUREMENT /end GROUP
/begin GROUP CDD_FordT3T6McuCfg.PwrDiscnctSwtDiag.Val "MICROSAR RTE" /begin SUB_GROUP /end SUB_GROUP /begin FUNCTION_LIST /end FUNCTION_LIST /begin REF_CHARACTERISTIC /end REF_CHARACTERISTIC /begin REF_MEASUREMENT CDD_FordT3T6McuCfg.PwrDiscnctSwtDiag.Val /end REF_MEASUREMENT /end GROUP
/begin GROUP CDD_FordT3T6McuCfg.PwrDiscnctSwtDiagAdcFaild.Logl "MICROSAR RTE" /begin SUB_GROUP /end SUB_GROUP /begin FUNCTION_LIST /end FUNCTION_LIST /begin REF_CHARACTERISTIC /end REF_CHARACTERISTIC /begin REF_MEASUREMENT CDD_FordT3T6McuCfg.PwrDiscnctSwtDiagAdcFaild.Logl /end REF_MEASUREMENT /end GROUP
/begin GROUP CDD_FordT3T6McuCfg.ReceiverPorts "MICROSAR RTE"
 /begin SUB_GROUP CDD_FordT3T6McuCfg.Adc0Faild.Logl CDD_FordT3T6McuCfg.Adc1Faild.Logl CDD_FordT3T6McuCfg.EcuId.Val /end SUB_GROUP
 /begin FUNCTION_LIST /end FUNCTION_LIST
 /begin REF_CHARACTERISTIC /end REF_CHARACTERISTIC
 /begin REF_MEASUREMENT /end REF_MEASUREMENT
/end GROUP
/begin GROUP CDD_FordT3T6McuCfg.SenderPorts "MICROSAR RTE"
 /begin SUB_GROUP CDD_FordT3T6McuCfg.Adc1ScanGroup2Ref0.Val CDD_FordT3T6McuCfg.Adc1ScanGroup2Ref1.Val CDD_FordT3T6McuCfg.Adc1ScanGroup3Ref0.Val CDD_FordT3T6McuCfg.Adc1ScanGroup3Ref1.Val CDD_FordT3T6McuCfg.Adc1SelfDiag0.Val CDD_FordT3T6McuCfg.Adc1SelfDiag2.Val CDD_FordT3T6McuCfg.Adc1SelfDiag4.Val CDD_FordT3T6McuCfg.BattRtnCurrAdc.Val CDD_FordT3T6McuCfg.BattRtnCurrAdcFaild.Logl CDD_FordT3T6McuCfg.BattVltg.Val CDD_FordT3T6McuCfg.BattVltgAdcFaild.Logl CDD_FordT3T6McuCfg.BattVltgSwd1.Val CDD_FordT3T6McuCfg.BattVltgSwd1AdcFaild.Logl CDD_FordT3T6McuCfg.ChrgPmpDiag.Val CDD_FordT3T6McuCfg.ChrgPmpDiagAdcFaild.Logl CDD_FordT3T6McuCfg.EcuT.Val CDD_FordT3T6McuCfg.EcuTAdcFaild.Logl CDD_FordT3T6McuCfg.HwAg1SnsrNr.Val CDD_FordT3T6McuCfg.HwAg1SnsrTyp.Val CDD_FordT3T6McuCfg.MotAg2Cos.Val CDD_FordT3T6McuCfg.MotAg2CosAdcFaild.Logl CDD_FordT3T6McuCfg.MotAg2Sin.Val CDD_FordT3T6McuCfg.MotAg2SinAdcFaild.Logl CDD_FordT3T6McuCfg.MotAg5CosAdcFaild.Logl CDD_FordT3T6McuCfg.MotAg5SinAdcFaild.Logl CDD_FordT3T6McuCfg.MotAg6CosAdcFaild.Logl CDD_FordT3T6McuCfg.MotAg6SinAdcFaild.Logl CDD_FordT3T6McuCfg.MotCurrAdcPeakAAdcFaild.Logl CDD_FordT3T6McuCfg.MotCurrAdcPeakBAdcFaild.Logl CDD_FordT3T6McuCfg.MotCurrAdcPeakCAdcFaild.Logl CDD_FordT3T6McuCfg.MotCurrAdcVlyAAdcFaild.Logl CDD_FordT3T6McuCfg.MotCurrAdcVlyBAdcFaild.Logl CDD_FordT3T6McuCfg.MotCurrAdcVlyCAdcFaild.Logl CDD_FordT3T6McuCfg.MotCurrSnsrOffs1AdcFaild.Logl CDD_FordT3T6McuCfg.MotDrvr1IninTestCmpl.Logl CDD_FordT3T6McuCfg.PwrDiscnctSwtDiag.Val CDD_FordT3T6McuCfg.PwrDiscnctSwtDiagAdcFaild.Logl /end SUB_GROUP
 /begin FUNCTION_LIST /end FUNCTION_LIST
 /begin REF_CHARACTERISTIC /end REF_CHARACTERISTIC
 /begin REF_MEASUREMENT /end REF_MEASUREMENT
/end GROUP
/begin GROUP CDD_GtmCfgAndUse "MICROSAR RTE"
 /begin SUB_GROUP CDD_GtmCfgAndUse.CalibrationPorts CDD_GtmCfgAndUse.PerInstanceMemories CDD_GtmCfgAndUse.ReceiverPorts CDD_GtmCfgAndUse.SenderPorts /end SUB_GROUP
 /begin FUNCTION_LIST /end FUNCTION_LIST
 /begin REF_CHARACTERISTIC /end REF_CHARACTERISTIC
 /begin REF_MEASUREMENT /end REF_MEASUREMENT
/end GROUP
/begin GROUP CDD_GtmCfgAndUse.AdcStrtOfCnvn2 "MICROSAR RTE" /begin SUB_GROUP /end SUB_GROUP /begin FUNCTION_LIST /end FUNCTION_LIST /begin REF_CHARACTERISTIC /end REF_CHARACTERISTIC /begin REF_MEASUREMENT CDD_GtmCfgAndUse.AdcStrtOfCnvn2 /end REF_MEASUREMENT /end GROUP
/begin GROUP CDD_GtmCfgAndUse.AdcStrtOfCnvnPeak "MICROSAR RTE" /begin SUB_GROUP /end SUB_GROUP /begin FUNCTION_LIST /end FUNCTION_LIST /begin REF_CHARACTERISTIC /end REF_CHARACTERISTIC /begin REF_MEASUREMENT CDD_GtmCfgAndUse.AdcStrtOfCnvnPeak /end REF_MEASUREMENT /end GROUP
/begin GROUP CDD_GtmCfgAndUse.CalibrationPorts "MICROSAR RTE"
 /begin SUB_GROUP CDD_GtmCfgAndUse.CurrMeasEolFixdPwmPerd.Val CDD_GtmCfgAndUse.CurrMeasEolOffsHiCmuOffs.Val CDD_GtmCfgAndUse.CurrMeasEolOffsLoCmuOffs.Val CDD_GtmCfgAndUse.GtmCfgAndUseAdcStrtOfCnvn2Offs.Val CDD_GtmCfgAndUse.GtmCfgAndUseAdcStrtOfCnvnPeakOffs.Val CDD_GtmCfgAndUse.GtmCfgAndUseDma2MilliSecToMotCtrlTrig.Val CDD_GtmCfgAndUse.GtmCfgAndUseDmaMotAgATrig.Val CDD_GtmCfgAndUse.GtmCfgAndUseDmaMotCtrlTo2MilliSecTrig.Val CDD_GtmCfgAndUse.GtmCfgAndUsePwmDbnd.Val /end SUB_GROUP
 /begin FUNCTION_LIST /end FUNCTION_LIST
 /begin REF_CHARACTERISTIC /end REF_CHARACTERISTIC
 /begin REF_MEASUREMENT /end REF_MEASUREMENT
/end GROUP
/begin GROUP CDD_GtmCfgAndUse.CurrMeasEolFixdPwmPerd.Val "MICROSAR RTE" /begin SUB_GROUP /end SUB_GROUP /begin FUNCTION_LIST /end FUNCTION_LIST /begin REF_CHARACTERISTIC CDD_GtmCfgAndUse.CurrMeasEolFixdPwmPerd.Val /end REF_CHARACTERISTIC /begin REF_MEASUREMENT /end REF_MEASUREMENT /end GROUP
/begin GROUP CDD_GtmCfgAndUse.CurrMeasEolOffsHiCmuOffs.Val "MICROSAR RTE" /begin SUB_GROUP /end SUB_GROUP /begin FUNCTION_LIST /end FUNCTION_LIST /begin REF_CHARACTERISTIC CDD_GtmCfgAndUse.CurrMeasEolOffsHiCmuOffs.Val /end REF_CHARACTERISTIC /begin REF_MEASUREMENT /end REF_MEASUREMENT /end GROUP
/begin GROUP CDD_GtmCfgAndUse.CurrMeasEolOffsLoCmuOffs.Val "MICROSAR RTE" /begin SUB_GROUP /end SUB_GROUP /begin FUNCTION_LIST /end FUNCTION_LIST /begin REF_CHARACTERISTIC CDD_GtmCfgAndUse.CurrMeasEolOffsLoCmuOffs.Val /end REF_CHARACTERISTIC /begin REF_MEASUREMENT /end REF_MEASUREMENT /end GROUP
/begin GROUP CDD_GtmCfgAndUse.Dma2MilliSecToMotCtrlTrig "MICROSAR RTE" /begin SUB_GROUP /end SUB_GROUP /begin FUNCTION_LIST /end FUNCTION_LIST /begin REF_CHARACTERISTIC /end REF_CHARACTERISTIC /begin REF_MEASUREMENT CDD_GtmCfgAndUse.Dma2MilliSecToMotCtrlTrig /end REF_MEASUREMENT /end GROUP
/begin GROUP CDD_GtmCfgAndUse.DmaMotAgATrig "MICROSAR RTE" /begin SUB_GROUP /end SUB_GROUP /begin FUNCTION_LIST /end FUNCTION_LIST /begin REF_CHARACTERISTIC /end REF_CHARACTERISTIC /begin REF_MEASUREMENT CDD_GtmCfgAndUse.DmaMotAgATrig /end REF_MEASUREMENT /end GROUP
/begin GROUP CDD_GtmCfgAndUse.DmaMotCtrlTo2MilliSecTrig "MICROSAR RTE" /begin SUB_GROUP /end SUB_GROUP /begin FUNCTION_LIST /end FUNCTION_LIST /begin REF_CHARACTERISTIC /end REF_CHARACTERISTIC /begin REF_MEASUREMENT CDD_GtmCfgAndUse.DmaMotCtrlTo2MilliSecTrig /end REF_MEASUREMENT /end GROUP
/begin GROUP CDD_GtmCfgAndUse.GtmCfgAndUseAdcStrtOfCnvn2Offs.Val "MICROSAR RTE" /begin SUB_GROUP /end SUB_GROUP /begin FUNCTION_LIST /end FUNCTION_LIST /begin REF_CHARACTERISTIC CDD_GtmCfgAndUse.GtmCfgAndUseAdcStrtOfCnvn2Offs.Val /end REF_CHARACTERISTIC /begin REF_MEASUREMENT /end REF_MEASUREMENT /end GROUP
/begin GROUP CDD_GtmCfgAndUse.GtmCfgAndUseAdcStrtOfCnvnPeakOffs.Val "MICROSAR RTE" /begin SUB_GROUP /end SUB_GROUP /begin FUNCTION_LIST /end FUNCTION_LIST /begin REF_CHARACTERISTIC CDD_GtmCfgAndUse.GtmCfgAndUseAdcStrtOfCnvnPeakOffs.Val /end REF_CHARACTERISTIC /begin REF_MEASUREMENT /end REF_MEASUREMENT /end GROUP
/begin GROUP CDD_GtmCfgAndUse.GtmCfgAndUseDma2MilliSecToMotCtrlTrig.Val "MICROSAR RTE" /begin SUB_GROUP /end SUB_GROUP /begin FUNCTION_LIST /end FUNCTION_LIST /begin REF_CHARACTERISTIC CDD_GtmCfgAndUse.GtmCfgAndUseDma2MilliSecToMotCtrlTrig.Val /end REF_CHARACTERISTIC /begin REF_MEASUREMENT /end REF_MEASUREMENT /end GROUP
/begin GROUP CDD_GtmCfgAndUse.GtmCfgAndUseDmaMotAgATrig.Val "MICROSAR RTE" /begin SUB_GROUP /end SUB_GROUP /begin FUNCTION_LIST /end FUNCTION_LIST /begin REF_CHARACTERISTIC CDD_GtmCfgAndUse.GtmCfgAndUseDmaMotAgATrig.Val /end REF_CHARACTERISTIC /begin REF_MEASUREMENT /end REF_MEASUREMENT /end GROUP
/begin GROUP CDD_GtmCfgAndUse.GtmCfgAndUseDmaMotCtrlTo2MilliSecTrig.Val "MICROSAR RTE" /begin SUB_GROUP /end SUB_GROUP /begin FUNCTION_LIST /end FUNCTION_LIST /begin REF_CHARACTERISTIC CDD_GtmCfgAndUse.GtmCfgAndUseDmaMotCtrlTo2MilliSecTrig.Val /end REF_CHARACTERISTIC /begin REF_MEASUREMENT /end REF_MEASUREMENT /end GROUP
/begin GROUP CDD_GtmCfgAndUse.GtmCfgAndUsePwmDbnd.Val "MICROSAR RTE" /begin SUB_GROUP /end SUB_GROUP /begin FUNCTION_LIST /end FUNCTION_LIST /begin REF_CHARACTERISTIC CDD_GtmCfgAndUse.GtmCfgAndUsePwmDbnd.Val /end REF_CHARACTERISTIC /begin REF_MEASUREMENT /end REF_MEASUREMENT /end GROUP
/begin GROUP CDD_GtmCfgAndUse.IvtrFetFltPha.Val "MICROSAR RTE" /begin SUB_GROUP /end SUB_GROUP /begin FUNCTION_LIST /end FUNCTION_LIST /begin REF_CHARACTERISTIC /end REF_CHARACTERISTIC /begin REF_MEASUREMENT CDD_GtmCfgAndUse.IvtrFetFltPha.Val /end REF_MEASUREMENT /end GROUP
/begin GROUP CDD_GtmCfgAndUse.MissUpdCntr "MICROSAR RTE" /begin SUB_GROUP /end SUB_GROUP /begin FUNCTION_LIST /end FUNCTION_LIST /begin REF_CHARACTERISTIC /end REF_CHARACTERISTIC /begin REF_MEASUREMENT CDD_GtmCfgAndUse.MissUpdCntr /end REF_MEASUREMENT /end GROUP
/begin GROUP CDD_GtmCfgAndUse.MissUpdIninCntr "MICROSAR RTE" /begin SUB_GROUP /end SUB_GROUP /begin FUNCTION_LIST /end FUNCTION_LIST /begin REF_CHARACTERISTIC /end REF_CHARACTERISTIC /begin REF_MEASUREMENT CDD_GtmCfgAndUse.MissUpdIninCntr /end REF_MEASUREMENT /end GROUP
/begin GROUP CDD_GtmCfgAndUse.MotCurrEolCalSt.Val "MICROSAR RTE" /begin SUB_GROUP /end SUB_GROUP /begin FUNCTION_LIST /end FUNCTION_LIST /begin REF_CHARACTERISTIC /end REF_CHARACTERISTIC /begin REF_MEASUREMENT CDD_GtmCfgAndUse.MotCurrEolCalSt.Val /end REF_MEASUREMENT /end GROUP
/begin GROUP CDD_GtmCfgAndUse.PerInstanceMemories "MICROSAR RTE"
 /begin SUB_GROUP CDD_GtmCfgAndUse.AdcStrtOfCnvn2 CDD_GtmCfgAndUse.AdcStrtOfCnvnPeak CDD_GtmCfgAndUse.Dma2MilliSecToMotCtrlTrig CDD_GtmCfgAndUse.DmaMotAgATrig CDD_GtmCfgAndUse.DmaMotCtrlTo2MilliSecTrig CDD_GtmCfgAndUse.MissUpdCntr CDD_GtmCfgAndUse.MissUpdIninCntr CDD_GtmCfgAndUse.PhaAFetFldSts CDD_GtmCfgAndUse.PhaBFetFldSts CDD_GtmCfgAndUse.PhaCFetFldSts CDD_GtmCfgAndUse.PhaOnTiCntrAPrev CDD_GtmCfgAndUse.PhaOnTiCntrBPrev CDD_GtmCfgAndUse.PhaOnTiCntrCPrev CDD_GtmCfgAndUse.SysStEnaPrev /end SUB_GROUP
 /begin FUNCTION_LIST /end FUNCTION_LIST
 /begin REF_CHARACTERISTIC /end REF_CHARACTERISTIC
 /begin REF_MEASUREMENT /end REF_MEASUREMENT
/end GROUP
/begin GROUP CDD_GtmCfgAndUse.PhaAFetFldSts "MICROSAR RTE" /begin SUB_GROUP /end SUB_GROUP /begin FUNCTION_LIST /end FUNCTION_LIST /begin REF_CHARACTERISTIC /end REF_CHARACTERISTIC /begin REF_MEASUREMENT CDD_GtmCfgAndUse.PhaAFetFldSts /end REF_MEASUREMENT /end GROUP
/begin GROUP CDD_GtmCfgAndUse.PhaBFetFldSts "MICROSAR RTE" /begin SUB_GROUP /end SUB_GROUP /begin FUNCTION_LIST /end FUNCTION_LIST /begin REF_CHARACTERISTIC /end REF_CHARACTERISTIC /begin REF_MEASUREMENT CDD_GtmCfgAndUse.PhaBFetFldSts /end REF_MEASUREMENT /end GROUP
/begin GROUP CDD_GtmCfgAndUse.PhaCFetFldSts "MICROSAR RTE" /begin SUB_GROUP /end SUB_GROUP /begin FUNCTION_LIST /end FUNCTION_LIST /begin REF_CHARACTERISTIC /end REF_CHARACTERISTIC /begin REF_MEASUREMENT CDD_GtmCfgAndUse.PhaCFetFldSts /end REF_MEASUREMENT /end GROUP
/begin GROUP CDD_GtmCfgAndUse.PhaOnTiCntrAPrev "MICROSAR RTE" /begin SUB_GROUP /end SUB_GROUP /begin FUNCTION_LIST /end FUNCTION_LIST /begin REF_CHARACTERISTIC /end REF_CHARACTERISTIC /begin REF_MEASUREMENT CDD_GtmCfgAndUse.PhaOnTiCntrAPrev /end REF_MEASUREMENT /end GROUP
/begin GROUP CDD_GtmCfgAndUse.PhaOnTiCntrBPrev "MICROSAR RTE" /begin SUB_GROUP /end SUB_GROUP /begin FUNCTION_LIST /end FUNCTION_LIST /begin REF_CHARACTERISTIC /end REF_CHARACTERISTIC /begin REF_MEASUREMENT CDD_GtmCfgAndUse.PhaOnTiCntrBPrev /end REF_MEASUREMENT /end GROUP
/begin GROUP CDD_GtmCfgAndUse.PhaOnTiCntrCPrev "MICROSAR RTE" /begin SUB_GROUP /end SUB_GROUP /begin FUNCTION_LIST /end FUNCTION_LIST /begin REF_CHARACTERISTIC /end REF_CHARACTERISTIC /begin REF_MEASUREMENT CDD_GtmCfgAndUse.PhaOnTiCntrCPrev /end REF_MEASUREMENT /end GROUP
/begin GROUP CDD_GtmCfgAndUse.PhaOnTiMeasdA.Val "MICROSAR RTE" /begin SUB_GROUP /end SUB_GROUP /begin FUNCTION_LIST /end FUNCTION_LIST /begin REF_CHARACTERISTIC /end REF_CHARACTERISTIC /begin REF_MEASUREMENT CDD_GtmCfgAndUse.PhaOnTiMeasdA.Val /end REF_MEASUREMENT /end GROUP
/begin GROUP CDD_GtmCfgAndUse.PhaOnTiMeasdB.Val "MICROSAR RTE" /begin SUB_GROUP /end SUB_GROUP /begin FUNCTION_LIST /end FUNCTION_LIST /begin REF_CHARACTERISTIC /end REF_CHARACTERISTIC /begin REF_MEASUREMENT CDD_GtmCfgAndUse.PhaOnTiMeasdB.Val /end REF_MEASUREMENT /end GROUP
/begin GROUP CDD_GtmCfgAndUse.PhaOnTiMeasdC.Val "MICROSAR RTE" /begin SUB_GROUP /end SUB_GROUP /begin FUNCTION_LIST /end FUNCTION_LIST /begin REF_CHARACTERISTIC /end REF_CHARACTERISTIC /begin REF_MEASUREMENT CDD_GtmCfgAndUse.PhaOnTiMeasdC.Val /end REF_MEASUREMENT /end GROUP
/begin GROUP CDD_GtmCfgAndUse.ReceiverPorts "MICROSAR RTE"
 /begin SUB_GROUP CDD_GtmCfgAndUse.IvtrFetFltPha.Val CDD_GtmCfgAndUse.MotCurrEolCalSt.Val CDD_GtmCfgAndUse.SysSt.Val /end SUB_GROUP
 /begin FUNCTION_LIST /end FUNCTION_LIST
 /begin REF_CHARACTERISTIC /end REF_CHARACTERISTIC
 /begin REF_MEASUREMENT /end REF_MEASUREMENT
/end GROUP
/begin GROUP CDD_GtmCfgAndUse.SenderPorts "MICROSAR RTE"
 /begin SUB_GROUP CDD_GtmCfgAndUse.PhaOnTiMeasdA.Val CDD_GtmCfgAndUse.PhaOnTiMeasdB.Val CDD_GtmCfgAndUse.PhaOnTiMeasdC.Val /end SUB_GROUP
 /begin FUNCTION_LIST /end FUNCTION_LIST
 /begin REF_CHARACTERISTIC /end REF_CHARACTERISTIC
 /begin REF_MEASUREMENT /end REF_MEASUREMENT
/end GROUP
/begin GROUP CDD_GtmCfgAndUse.SysSt.Val "MICROSAR RTE" /begin SUB_GROUP /end SUB_GROUP /begin FUNCTION_LIST /end FUNCTION_LIST /begin REF_CHARACTERISTIC /end REF_CHARACTERISTIC /begin REF_MEASUREMENT CDD_GtmCfgAndUse.SysSt.Val /end REF_MEASUREMENT /end GROUP
/begin GROUP CDD_GtmCfgAndUse.SysStEnaPrev "MICROSAR RTE" /begin SUB_GROUP /end SUB_GROUP /begin FUNCTION_LIST /end FUNCTION_LIST /begin REF_CHARACTERISTIC /end REF_CHARACTERISTIC /begin REF_MEASUREMENT CDD_GtmCfgAndUse.SysStEnaPrev /end REF_MEASUREMENT /end GROUP
/begin GROUP CDD_HwTq1Meas "MICROSAR RTE"
 /begin SUB_GROUP CDD_HwTq1Meas.CalibrationParameters CDD_HwTq1Meas.CalibrationPorts CDD_HwTq1Meas.PerInstanceMemories CDD_HwTq1Meas.ReceiverPorts CDD_HwTq1Meas.SenderPorts /end SUB_GROUP
 /begin FUNCTION_LIST /end FUNCTION_LIST
 /begin REF_CHARACTERISTIC /end REF_CHARACTERISTIC
 /begin REF_MEASUREMENT /end REF_MEASUREMENT
/end GROUP
/begin GROUP CDD_HwTq1Meas.CalibrationParameters "MICROSAR RTE" /begin SUB_GROUP CDD_HwTq1Meas.HwTq1OffsDft /end SUB_GROUP /begin FUNCTION_LIST /end FUNCTION_LIST /begin REF_CHARACTERISTIC /end REF_CHARACTERISTIC /begin REF_MEASUREMENT /end REF_MEASUREMENT /end GROUP
/begin GROUP CDD_HwTq1Meas.CalibrationPorts "MICROSAR RTE"
 /begin SUB_GROUP CDD_HwTq1Meas.HwTq1MeasHwTq1PrtclFltFailStep.Val CDD_HwTq1Meas.HwTq1MeasHwTq1PrtclFltPassStep.Val /end SUB_GROUP
 /begin FUNCTION_LIST /end FUNCTION_LIST
 /begin REF_CHARACTERISTIC /end REF_CHARACTERISTIC
 /begin REF_MEASUREMENT /end REF_MEASUREMENT
/end GROUP
/begin GROUP CDD_HwTq1Meas.HwTq1.Val "MICROSAR RTE" /begin SUB_GROUP /end SUB_GROUP /begin FUNCTION_LIST /end FUNCTION_LIST /begin REF_CHARACTERISTIC /end REF_CHARACTERISTIC /begin REF_MEASUREMENT CDD_HwTq1Meas.HwTq1.Val /end REF_MEASUREMENT /end GROUP
/begin GROUP CDD_HwTq1Meas.HwTq1ComStsErrCntr "MICROSAR RTE" /begin SUB_GROUP /end SUB_GROUP /begin FUNCTION_LIST /end FUNCTION_LIST /begin REF_CHARACTERISTIC /end REF_CHARACTERISTIC /begin REF_MEASUREMENT CDD_HwTq1Meas.HwTq1ComStsErrCntr /end REF_MEASUREMENT /end GROUP
/begin GROUP CDD_HwTq1Meas.HwTq1IntSnsrErrCntr "MICROSAR RTE" /begin SUB_GROUP /end SUB_GROUP /begin FUNCTION_LIST /end FUNCTION_LIST /begin REF_CHARACTERISTIC /end REF_CHARACTERISTIC /begin REF_MEASUREMENT CDD_HwTq1Meas.HwTq1IntSnsrErrCntr /end REF_MEASUREMENT /end GROUP
/begin GROUP CDD_HwTq1Meas.HwTq1MeasHwTq1PrtclFltFailStep.Val "MICROSAR RTE" /begin SUB_GROUP /end SUB_GROUP /begin FUNCTION_LIST /end FUNCTION_LIST /begin REF_CHARACTERISTIC CDD_HwTq1Meas.HwTq1MeasHwTq1PrtclFltFailStep.Val /end REF_CHARACTERISTIC /begin REF_MEASUREMENT /end REF_MEASUREMENT /end GROUP
/begin GROUP CDD_HwTq1Meas.HwTq1MeasHwTq1PrtclFltPassStep.Val "MICROSAR RTE" /begin SUB_GROUP /end SUB_GROUP /begin FUNCTION_LIST /end FUNCTION_LIST /begin REF_CHARACTERISTIC CDD_HwTq1Meas.HwTq1MeasHwTq1PrtclFltPassStep.Val /end REF_CHARACTERISTIC /begin REF_MEASUREMENT /end REF_MEASUREMENT /end GROUP
/begin GROUP CDD_HwTq1Meas.HwTq1MeasPrevHwTq1 "MICROSAR RTE" /begin SUB_GROUP /end SUB_GROUP /begin FUNCTION_LIST /end FUNCTION_LIST /begin REF_CHARACTERISTIC /end REF_CHARACTERISTIC /begin REF_MEASUREMENT CDD_HwTq1Meas.HwTq1MeasPrevHwTq1 /end REF_MEASUREMENT /end GROUP
/begin GROUP CDD_HwTq1Meas.HwTq1MeasPrevRollgCntr "MICROSAR RTE" /begin SUB_GROUP /end SUB_GROUP /begin FUNCTION_LIST /end FUNCTION_LIST /begin REF_CHARACTERISTIC /end REF_CHARACTERISTIC /begin REF_MEASUREMENT CDD_HwTq1Meas.HwTq1MeasPrevRollgCntr /end REF_MEASUREMENT /end GROUP
/begin GROUP CDD_HwTq1Meas.HwTq1MsgMissRxCnt "MICROSAR RTE" /begin SUB_GROUP /end SUB_GROUP /begin FUNCTION_LIST /end FUNCTION_LIST /begin REF_CHARACTERISTIC /end REF_CHARACTERISTIC /begin REF_MEASUREMENT CDD_HwTq1Meas.HwTq1MsgMissRxCnt /end REF_MEASUREMENT /end GROUP
/begin GROUP CDD_HwTq1Meas.HwTq1Offs "MICROSAR RTE" /begin SUB_GROUP /end SUB_GROUP /begin FUNCTION_LIST /end FUNCTION_LIST /begin REF_CHARACTERISTIC /end REF_CHARACTERISTIC
 /begin REF_MEASUREMENT CDD_HwTq1Meas.HwTq1Offs.OffsTrim CDD_HwTq1Meas.HwTq1Offs.OffsTrimPrfmdSts /end REF_MEASUREMENT
/end GROUP
/begin GROUP CDD_HwTq1Meas.HwTq1OffsDft "MICROSAR RTE" /begin SUB_GROUP /end SUB_GROUP /begin FUNCTION_LIST /end FUNCTION_LIST
 /begin REF_CHARACTERISTIC CDD_HwTq1Meas.HwTq1OffsDft.OffsTrim CDD_HwTq1Meas.HwTq1OffsDft.OffsTrimPrfmdSts /end REF_CHARACTERISTIC
 /begin REF_MEASUREMENT /end REF_MEASUREMENT
/end GROUP
/begin GROUP CDD_HwTq1Meas.HwTq1Polarity.Val "MICROSAR RTE" /begin SUB_GROUP /end SUB_GROUP /begin FUNCTION_LIST /end FUNCTION_LIST /begin REF_CHARACTERISTIC /end REF_CHARACTERISTIC /begin REF_MEASUREMENT CDD_HwTq1Meas.HwTq1Polarity.Val /end REF_MEASUREMENT /end GROUP
/begin GROUP CDD_HwTq1Meas.HwTq1Qlfr.Val "MICROSAR RTE" /begin SUB_GROUP /end SUB_GROUP /begin FUNCTION_LIST /end FUNCTION_LIST /begin REF_CHARACTERISTIC /end REF_CHARACTERISTIC /begin REF_MEASUREMENT CDD_HwTq1Meas.HwTq1Qlfr.Val /end REF_MEASUREMENT /end GROUP
/begin GROUP CDD_HwTq1Meas.HwTq1RollgCntr.Val "MICROSAR RTE" /begin SUB_GROUP /end SUB_GROUP /begin FUNCTION_LIST /end FUNCTION_LIST /begin REF_CHARACTERISTIC /end REF_CHARACTERISTIC /begin REF_MEASUREMENT CDD_HwTq1Meas.HwTq1RollgCntr.Val /end REF_MEASUREMENT /end GROUP
/begin GROUP CDD_HwTq1Meas.PerInstanceMemories "MICROSAR RTE"
 /begin SUB_GROUP CDD_HwTq1Meas.HwTq1ComStsErrCntr CDD_HwTq1Meas.HwTq1IntSnsrErrCntr CDD_HwTq1Meas.HwTq1MeasPrevHwTq1 CDD_HwTq1Meas.HwTq1MeasPrevRollgCntr CDD_HwTq1Meas.HwTq1MsgMissRxCnt CDD_HwTq1Meas.HwTq1Offs CDD_HwTq1Meas.RackLimrCcwEot1 CDD_HwTq1Meas.RackLimrCwEot1 CDD_HwTq1Meas.RackLimrEot1Avl CDD_HwTq1Meas.RackLimrEot1Data0 CDD_HwTq1Meas.RackLimrEot1Data1 CDD_HwTq1Meas.RackLimrEot1Data2 CDD_HwTq1Meas.RackLimrEot1Id2DataReadCmpl CDD_HwTq1Meas.RackLimrEot1Id3DataReadCmpl CDD_HwTq1Meas.RackLimrEot1Id4DataReadCmpl /end SUB_GROUP
 /begin FUNCTION_LIST /end FUNCTION_LIST
 /begin REF_CHARACTERISTIC /end REF_CHARACTERISTIC
 /begin REF_MEASUREMENT /end REF_MEASUREMENT
/end GROUP
/begin GROUP CDD_HwTq1Meas.RackLimrCcwEot1 "MICROSAR RTE" /begin SUB_GROUP /end SUB_GROUP /begin FUNCTION_LIST /end FUNCTION_LIST /begin REF_CHARACTERISTIC /end REF_CHARACTERISTIC /begin REF_MEASUREMENT CDD_HwTq1Meas.RackLimrCcwEot1 /end REF_MEASUREMENT /end GROUP
/begin GROUP CDD_HwTq1Meas.RackLimrCcwEotSig1.Val "MICROSAR RTE" /begin SUB_GROUP /end SUB_GROUP /begin FUNCTION_LIST /end FUNCTION_LIST /begin REF_CHARACTERISTIC /end REF_CHARACTERISTIC /begin REF_MEASUREMENT CDD_HwTq1Meas.RackLimrCcwEotSig1.Val /end REF_MEASUREMENT /end GROUP
/begin GROUP CDD_HwTq1Meas.RackLimrCwEot1 "MICROSAR RTE" /begin SUB_GROUP /end SUB_GROUP /begin FUNCTION_LIST /end FUNCTION_LIST /begin REF_CHARACTERISTIC /end REF_CHARACTERISTIC /begin REF_MEASUREMENT CDD_HwTq1Meas.RackLimrCwEot1 /end REF_MEASUREMENT /end GROUP
/begin GROUP CDD_HwTq1Meas.RackLimrCwEotSig1.Val "MICROSAR RTE" /begin SUB_GROUP /end SUB_GROUP /begin FUNCTION_LIST /end FUNCTION_LIST /begin REF_CHARACTERISTIC /end REF_CHARACTERISTIC /begin REF_MEASUREMENT CDD_HwTq1Meas.RackLimrCwEotSig1.Val /end REF_MEASUREMENT /end GROUP
/begin GROUP CDD_HwTq1Meas.RackLimrEot1Avl "MICROSAR RTE" /begin SUB_GROUP /end SUB_GROUP /begin FUNCTION_LIST /end FUNCTION_LIST /begin REF_CHARACTERISTIC /end REF_CHARACTERISTIC /begin REF_MEASUREMENT CDD_HwTq1Meas.RackLimrEot1Avl /end REF_MEASUREMENT /end GROUP
/begin GROUP CDD_HwTq1Meas.RackLimrEot1Data0 "MICROSAR RTE" /begin SUB_GROUP /end SUB_GROUP /begin FUNCTION_LIST /end FUNCTION_LIST /begin REF_CHARACTERISTIC /end REF_CHARACTERISTIC /begin REF_MEASUREMENT CDD_HwTq1Meas.RackLimrEot1Data0 /end REF_MEASUREMENT /end GROUP
/begin GROUP CDD_HwTq1Meas.RackLimrEot1Data1 "MICROSAR RTE" /begin SUB_GROUP /end SUB_GROUP /begin FUNCTION_LIST /end FUNCTION_LIST /begin REF_CHARACTERISTIC /end REF_CHARACTERISTIC /begin REF_MEASUREMENT CDD_HwTq1Meas.RackLimrEot1Data1 /end REF_MEASUREMENT /end GROUP
/begin GROUP CDD_HwTq1Meas.RackLimrEot1Data2 "MICROSAR RTE" /begin SUB_GROUP /end SUB_GROUP /begin FUNCTION_LIST /end FUNCTION_LIST /begin REF_CHARACTERISTIC /end REF_CHARACTERISTIC /begin REF_MEASUREMENT CDD_HwTq1Meas.RackLimrEot1Data2 /end REF_MEASUREMENT /end GROUP
/begin GROUP CDD_HwTq1Meas.RackLimrEot1Id2DataReadCmpl "MICROSAR RTE" /begin SUB_GROUP /end SUB_GROUP /begin FUNCTION_LIST /end FUNCTION_LIST /begin REF_CHARACTERISTIC /end REF_CHARACTERISTIC /begin REF_MEASUREMENT CDD_HwTq1Meas.RackLimrEot1Id2DataReadCmpl /end REF_MEASUREMENT /end GROUP
/begin GROUP CDD_HwTq1Meas.RackLimrEot1Id3DataReadCmpl "MICROSAR RTE" /begin SUB_GROUP /end SUB_GROUP /begin FUNCTION_LIST /end FUNCTION_LIST /begin REF_CHARACTERISTIC /end REF_CHARACTERISTIC /begin REF_MEASUREMENT CDD_HwTq1Meas.RackLimrEot1Id3DataReadCmpl /end REF_MEASUREMENT /end GROUP
/begin GROUP CDD_HwTq1Meas.RackLimrEot1Id4DataReadCmpl "MICROSAR RTE" /begin SUB_GROUP /end SUB_GROUP /begin FUNCTION_LIST /end FUNCTION_LIST /begin REF_CHARACTERISTIC /end REF_CHARACTERISTIC /begin REF_MEASUREMENT CDD_HwTq1Meas.RackLimrEot1Id4DataReadCmpl /end REF_MEASUREMENT /end GROUP
/begin GROUP CDD_HwTq1Meas.RackLimrEotSig1Avl.Logl "MICROSAR RTE" /begin SUB_GROUP /end SUB_GROUP /begin FUNCTION_LIST /end FUNCTION_LIST /begin REF_CHARACTERISTIC /end REF_CHARACTERISTIC /begin REF_MEASUREMENT CDD_HwTq1Meas.RackLimrEotSig1Avl.Logl /end REF_MEASUREMENT /end GROUP
/begin GROUP CDD_HwTq1Meas.ReceiverPorts "MICROSAR RTE" /begin SUB_GROUP CDD_HwTq1Meas.HwTq1Polarity.Val /end SUB_GROUP /begin FUNCTION_LIST /end FUNCTION_LIST /begin REF_CHARACTERISTIC /end REF_CHARACTERISTIC /begin REF_MEASUREMENT /end REF_MEASUREMENT /end GROUP
/begin GROUP CDD_HwTq1Meas.SenderPorts "MICROSAR RTE"
 /begin SUB_GROUP CDD_HwTq1Meas.HwTq1.Val CDD_HwTq1Meas.HwTq1Qlfr.Val CDD_HwTq1Meas.HwTq1RollgCntr.Val CDD_HwTq1Meas.RackLimrCcwEotSig1.Val CDD_HwTq1Meas.RackLimrCwEotSig1.Val CDD_HwTq1Meas.RackLimrEotSig1Avl.Logl /end SUB_GROUP
 /begin FUNCTION_LIST /end FUNCTION_LIST
 /begin REF_CHARACTERISTIC /end REF_CHARACTERISTIC
 /begin REF_MEASUREMENT /end REF_MEASUREMENT
/end GROUP
/begin GROUP CDD_HwTq8Meas "MICROSAR RTE"
 /begin SUB_GROUP CDD_HwTq8Meas.CalibrationParameters CDD_HwTq8Meas.CalibrationPorts CDD_HwTq8Meas.PerInstanceMemories CDD_HwTq8Meas.ReceiverPorts CDD_HwTq8Meas.SenderPorts /end SUB_GROUP
 /begin FUNCTION_LIST /end FUNCTION_LIST
 /begin REF_CHARACTERISTIC /end REF_CHARACTERISTIC
 /begin REF_MEASUREMENT /end REF_MEASUREMENT
/end GROUP
/begin GROUP CDD_HwTq8Meas.CalibrationParameters "MICROSAR RTE" /begin SUB_GROUP CDD_HwTq8Meas.HwTq8OffsDft /end SUB_GROUP /begin FUNCTION_LIST /end FUNCTION_LIST /begin REF_CHARACTERISTIC /end REF_CHARACTERISTIC /begin REF_MEASUREMENT /end REF_MEASUREMENT /end GROUP
/begin GROUP CDD_HwTq8Meas.CalibrationPorts "MICROSAR RTE"
 /begin SUB_GROUP CDD_HwTq8Meas.HwTq8MeasHwTq8PrtclFltFailStep.Val CDD_HwTq8Meas.HwTq8MeasHwTq8PrtclFltPassStep.Val /end SUB_GROUP
 /begin FUNCTION_LIST /end FUNCTION_LIST
 /begin REF_CHARACTERISTIC /end REF_CHARACTERISTIC
 /begin REF_MEASUREMENT /end REF_MEASUREMENT
/end GROUP
/begin GROUP CDD_HwTq8Meas.HwTq8.Val "MICROSAR RTE" /begin SUB_GROUP /end SUB_GROUP /begin FUNCTION_LIST /end FUNCTION_LIST /begin REF_CHARACTERISTIC /end REF_CHARACTERISTIC /begin REF_MEASUREMENT CDD_HwTq8Meas.HwTq8.Val /end REF_MEASUREMENT /end GROUP
/begin GROUP CDD_HwTq8Meas.HwTq8ComStsErrCntr "MICROSAR RTE" /begin SUB_GROUP /end SUB_GROUP /begin FUNCTION_LIST /end FUNCTION_LIST /begin REF_CHARACTERISTIC /end REF_CHARACTERISTIC /begin REF_MEASUREMENT CDD_HwTq8Meas.HwTq8ComStsErrCntr /end REF_MEASUREMENT /end GROUP
/begin GROUP CDD_HwTq8Meas.HwTq8IntSnsrErrCntr "MICROSAR RTE" /begin SUB_GROUP /end SUB_GROUP /begin FUNCTION_LIST /end FUNCTION_LIST /begin REF_CHARACTERISTIC /end REF_CHARACTERISTIC /begin REF_MEASUREMENT CDD_HwTq8Meas.HwTq8IntSnsrErrCntr /end REF_MEASUREMENT /end GROUP
/begin GROUP CDD_HwTq8Meas.HwTq8MeasHwTq8PrtclFltFailStep.Val "MICROSAR RTE" /begin SUB_GROUP /end SUB_GROUP /begin FUNCTION_LIST /end FUNCTION_LIST /begin REF_CHARACTERISTIC CDD_HwTq8Meas.HwTq8MeasHwTq8PrtclFltFailStep.Val /end REF_CHARACTERISTIC /begin REF_MEASUREMENT /end REF_MEASUREMENT /end GROUP
/begin GROUP CDD_HwTq8Meas.HwTq8MeasHwTq8PrtclFltPassStep.Val "MICROSAR RTE" /begin SUB_GROUP /end SUB_GROUP /begin FUNCTION_LIST /end FUNCTION_LIST /begin REF_CHARACTERISTIC CDD_HwTq8Meas.HwTq8MeasHwTq8PrtclFltPassStep.Val /end REF_CHARACTERISTIC /begin REF_MEASUREMENT /end REF_MEASUREMENT /end GROUP
/begin GROUP CDD_HwTq8Meas.HwTq8MsgMissRxCnt "MICROSAR RTE" /begin SUB_GROUP /end SUB_GROUP /begin FUNCTION_LIST /end FUNCTION_LIST /begin REF_CHARACTERISTIC /end REF_CHARACTERISTIC /begin REF_MEASUREMENT CDD_HwTq8Meas.HwTq8MsgMissRxCnt /end REF_MEASUREMENT /end GROUP
/begin GROUP CDD_HwTq8Meas.HwTq8Offs "MICROSAR RTE" /begin SUB_GROUP /end SUB_GROUP /begin FUNCTION_LIST /end FUNCTION_LIST /begin REF_CHARACTERISTIC /end REF_CHARACTERISTIC
 /begin REF_MEASUREMENT CDD_HwTq8Meas.HwTq8Offs.OffsTrim CDD_HwTq8Meas.HwTq8Offs.OffsTrimPrfmdSts /end REF_MEASUREMENT
/end GROUP
/begin GROUP CDD_HwTq8Meas.HwTq8OffsDft "MICROSAR RTE" /begin SUB_GROUP /end SUB_GROUP /begin FUNCTION_LIST /end FUNCTION_LIST
 /begin REF_CHARACTERISTIC CDD_HwTq8Meas.HwTq8OffsDft.OffsTrim CDD_HwTq8Meas.HwTq8OffsDft.OffsTrimPrfmdSts /end REF_CHARACTERISTIC
 /begin REF_MEASUREMENT /end REF_MEASUREMENT
/end GROUP
/begin GROUP CDD_HwTq8Meas.HwTq8Polarity.Val "MICROSAR RTE" /begin SUB_GROUP /end SUB_GROUP /begin FUNCTION_LIST /end FUNCTION_LIST /begin REF_CHARACTERISTIC /end REF_CHARACTERISTIC /begin REF_MEASUREMENT CDD_HwTq8Meas.HwTq8Polarity.Val /end REF_MEASUREMENT /end GROUP
/begin GROUP CDD_HwTq8Meas.HwTq8PrevHwTq8 "MICROSAR RTE" /begin SUB_GROUP /end SUB_GROUP /begin FUNCTION_LIST /end FUNCTION_LIST /begin REF_CHARACTERISTIC /end REF_CHARACTERISTIC /begin REF_MEASUREMENT CDD_HwTq8Meas.HwTq8PrevHwTq8 /end REF_MEASUREMENT /end GROUP
/begin GROUP CDD_HwTq8Meas.HwTq8PrevRollgCntr "MICROSAR RTE" /begin SUB_GROUP /end SUB_GROUP /begin FUNCTION_LIST /end FUNCTION_LIST /begin REF_CHARACTERISTIC /end REF_CHARACTERISTIC /begin REF_MEASUREMENT CDD_HwTq8Meas.HwTq8PrevRollgCntr /end REF_MEASUREMENT /end GROUP
/begin GROUP CDD_HwTq8Meas.HwTq8Qlfr.Val "MICROSAR RTE" /begin SUB_GROUP /end SUB_GROUP /begin FUNCTION_LIST /end FUNCTION_LIST /begin REF_CHARACTERISTIC /end REF_CHARACTERISTIC /begin REF_MEASUREMENT CDD_HwTq8Meas.HwTq8Qlfr.Val /end REF_MEASUREMENT /end GROUP
/begin GROUP CDD_HwTq8Meas.HwTq8RollgCntr.Val "MICROSAR RTE" /begin SUB_GROUP /end SUB_GROUP /begin FUNCTION_LIST /end FUNCTION_LIST /begin REF_CHARACTERISTIC /end REF_CHARACTERISTIC /begin REF_MEASUREMENT CDD_HwTq8Meas.HwTq8RollgCntr.Val /end REF_MEASUREMENT /end GROUP
/begin GROUP CDD_HwTq8Meas.PerInstanceMemories "MICROSAR RTE"
 /begin SUB_GROUP CDD_HwTq8Meas.HwTq8ComStsErrCntr CDD_HwTq8Meas.HwTq8IntSnsrErrCntr CDD_HwTq8Meas.HwTq8MsgMissRxCnt CDD_HwTq8Meas.HwTq8Offs CDD_HwTq8Meas.HwTq8PrevHwTq8 CDD_HwTq8Meas.HwTq8PrevRollgCntr CDD_HwTq8Meas.RackLimrCcwEot8 CDD_HwTq8Meas.RackLimrCwEot8 CDD_HwTq8Meas.RackLimrEot8Avl CDD_HwTq8Meas.RackLimrEot8Data0 CDD_HwTq8Meas.RackLimrEot8Data1 CDD_HwTq8Meas.RackLimrEot8Data2 CDD_HwTq8Meas.RackLimrEot8Id2DataReadCmpl CDD_HwTq8Meas.RackLimrEot8Id3DataReadCmpl CDD_HwTq8Meas.RackLimrEot8Id4DataReadCmpl /end SUB_GROUP
 /begin FUNCTION_LIST /end FUNCTION_LIST
 /begin REF_CHARACTERISTIC /end REF_CHARACTERISTIC
 /begin REF_MEASUREMENT /end REF_MEASUREMENT
/end GROUP
/begin GROUP CDD_HwTq8Meas.RackLimrCcwEot8 "MICROSAR RTE" /begin SUB_GROUP /end SUB_GROUP /begin FUNCTION_LIST /end FUNCTION_LIST /begin REF_CHARACTERISTIC /end REF_CHARACTERISTIC /begin REF_MEASUREMENT CDD_HwTq8Meas.RackLimrCcwEot8 /end REF_MEASUREMENT /end GROUP
/begin GROUP CDD_HwTq8Meas.RackLimrCcwEotSig8.Val "MICROSAR RTE" /begin SUB_GROUP /end SUB_GROUP /begin FUNCTION_LIST /end FUNCTION_LIST /begin REF_CHARACTERISTIC /end REF_CHARACTERISTIC /begin REF_MEASUREMENT CDD_HwTq8Meas.RackLimrCcwEotSig8.Val /end REF_MEASUREMENT /end GROUP
/begin GROUP CDD_HwTq8Meas.RackLimrCwEot8 "MICROSAR RTE" /begin SUB_GROUP /end SUB_GROUP /begin FUNCTION_LIST /end FUNCTION_LIST /begin REF_CHARACTERISTIC /end REF_CHARACTERISTIC /begin REF_MEASUREMENT CDD_HwTq8Meas.RackLimrCwEot8 /end REF_MEASUREMENT /end GROUP
/begin GROUP CDD_HwTq8Meas.RackLimrCwEotSig8.Val "MICROSAR RTE" /begin SUB_GROUP /end SUB_GROUP /begin FUNCTION_LIST /end FUNCTION_LIST /begin REF_CHARACTERISTIC /end REF_CHARACTERISTIC /begin REF_MEASUREMENT CDD_HwTq8Meas.RackLimrCwEotSig8.Val /end REF_MEASUREMENT /end GROUP
/begin GROUP CDD_HwTq8Meas.RackLimrEot8Avl "MICROSAR RTE" /begin SUB_GROUP /end SUB_GROUP /begin FUNCTION_LIST /end FUNCTION_LIST /begin REF_CHARACTERISTIC /end REF_CHARACTERISTIC /begin REF_MEASUREMENT CDD_HwTq8Meas.RackLimrEot8Avl /end REF_MEASUREMENT /end GROUP
/begin GROUP CDD_HwTq8Meas.RackLimrEot8Data0 "MICROSAR RTE" /begin SUB_GROUP /end SUB_GROUP /begin FUNCTION_LIST /end FUNCTION_LIST /begin REF_CHARACTERISTIC /end REF_CHARACTERISTIC /begin REF_MEASUREMENT CDD_HwTq8Meas.RackLimrEot8Data0 /end REF_MEASUREMENT /end GROUP
/begin GROUP CDD_HwTq8Meas.RackLimrEot8Data1 "MICROSAR RTE" /begin SUB_GROUP /end SUB_GROUP /begin FUNCTION_LIST /end FUNCTION_LIST /begin REF_CHARACTERISTIC /end REF_CHARACTERISTIC /begin REF_MEASUREMENT CDD_HwTq8Meas.RackLimrEot8Data1 /end REF_MEASUREMENT /end GROUP
/begin GROUP CDD_HwTq8Meas.RackLimrEot8Data2 "MICROSAR RTE" /begin SUB_GROUP /end SUB_GROUP /begin FUNCTION_LIST /end FUNCTION_LIST /begin REF_CHARACTERISTIC /end REF_CHARACTERISTIC /begin REF_MEASUREMENT CDD_HwTq8Meas.RackLimrEot8Data2 /end REF_MEASUREMENT /end GROUP
/begin GROUP CDD_HwTq8Meas.RackLimrEot8Id2DataReadCmpl "MICROSAR RTE" /begin SUB_GROUP /end SUB_GROUP /begin FUNCTION_LIST /end FUNCTION_LIST /begin REF_CHARACTERISTIC /end REF_CHARACTERISTIC /begin REF_MEASUREMENT CDD_HwTq8Meas.RackLimrEot8Id2DataReadCmpl /end REF_MEASUREMENT /end GROUP
/begin GROUP CDD_HwTq8Meas.RackLimrEot8Id3DataReadCmpl "MICROSAR RTE" /begin SUB_GROUP /end SUB_GROUP /begin FUNCTION_LIST /end FUNCTION_LIST /begin REF_CHARACTERISTIC /end REF_CHARACTERISTIC /begin REF_MEASUREMENT CDD_HwTq8Meas.RackLimrEot8Id3DataReadCmpl /end REF_MEASUREMENT /end GROUP
/begin GROUP CDD_HwTq8Meas.RackLimrEot8Id4DataReadCmpl "MICROSAR RTE" /begin SUB_GROUP /end SUB_GROUP /begin FUNCTION_LIST /end FUNCTION_LIST /begin REF_CHARACTERISTIC /end REF_CHARACTERISTIC /begin REF_MEASUREMENT CDD_HwTq8Meas.RackLimrEot8Id4DataReadCmpl /end REF_MEASUREMENT /end GROUP
/begin GROUP CDD_HwTq8Meas.RackLimrEotSig8Avl.Logl "MICROSAR RTE" /begin SUB_GROUP /end SUB_GROUP /begin FUNCTION_LIST /end FUNCTION_LIST /begin REF_CHARACTERISTIC /end REF_CHARACTERISTIC /begin REF_MEASUREMENT CDD_HwTq8Meas.RackLimrEotSig8Avl.Logl /end REF_MEASUREMENT /end GROUP
/begin GROUP CDD_HwTq8Meas.ReceiverPorts "MICROSAR RTE" /begin SUB_GROUP CDD_HwTq8Meas.HwTq8Polarity.Val /end SUB_GROUP /begin FUNCTION_LIST /end FUNCTION_LIST /begin REF_CHARACTERISTIC /end REF_CHARACTERISTIC /begin REF_MEASUREMENT /end REF_MEASUREMENT /end GROUP
/begin GROUP CDD_HwTq8Meas.SenderPorts "MICROSAR RTE"
 /begin SUB_GROUP CDD_HwTq8Meas.HwTq8.Val CDD_HwTq8Meas.HwTq8Qlfr.Val CDD_HwTq8Meas.HwTq8RollgCntr.Val CDD_HwTq8Meas.RackLimrCcwEotSig8.Val CDD_HwTq8Meas.RackLimrCwEotSig8.Val CDD_HwTq8Meas.RackLimrEotSig8Avl.Logl /end SUB_GROUP
 /begin FUNCTION_LIST /end FUNCTION_LIST
 /begin REF_CHARACTERISTIC /end REF_CHARACTERISTIC
 /begin REF_MEASUREMENT /end REF_MEASUREMENT
/end GROUP
/begin GROUP CDD_McuCoreCfgAndDiagc "MICROSAR RTE" /begin SUB_GROUP CDD_McuCoreCfgAndDiagc.PerInstanceMemories /end SUB_GROUP /begin FUNCTION_LIST /end FUNCTION_LIST /begin REF_CHARACTERISTIC /end REF_CHARACTERISTIC /begin REF_MEASUREMENT /end REF_MEASUREMENT /end GROUP
/begin GROUP CDD_McuCoreCfgAndDiagc.PerInstanceMemories "MICROSAR RTE" /begin SUB_GROUP CDD_McuCoreCfgAndDiagc.dMcuCoreCfgAndDiagcBistRunCmpl /end SUB_GROUP /begin FUNCTION_LIST /end FUNCTION_LIST /begin REF_CHARACTERISTIC /end REF_CHARACTERISTIC /begin REF_MEASUREMENT /end REF_MEASUREMENT /end GROUP
/begin GROUP CDD_McuCoreCfgAndDiagc.dMcuCoreCfgAndDiagcBistRunCmpl "MICROSAR RTE" /begin SUB_GROUP /end SUB_GROUP /begin FUNCTION_LIST /end FUNCTION_LIST /begin REF_CHARACTERISTIC /end REF_CHARACTERISTIC /begin REF_MEASUREMENT CDD_McuCoreCfgAndDiagc.dMcuCoreCfgAndDiagcBistRunCmpl /end REF_MEASUREMENT /end GROUP
/begin GROUP CDD_McuDiagc "MICROSAR RTE"
 /begin SUB_GROUP CDD_McuDiagc.CalibrationPorts CDD_McuDiagc.PerInstanceMemories CDD_McuDiagc.ReceiverPorts CDD_McuDiagc.SenderPorts /end SUB_GROUP
 /begin FUNCTION_LIST /end FUNCTION_LIST
 /begin REF_CHARACTERISTIC /end REF_CHARACTERISTIC
 /begin REF_MEASUREMENT /end REF_MEASUREMENT
/end GROUP
/begin GROUP CDD_McuDiagc.CalibrationPorts "MICROSAR RTE"
 /begin SUB_GROUP CDD_McuDiagc.McuDiagc2MilliSecCntrCompThd.Val CDD_McuDiagc.McuDiagcFltFailStep.Val CDD_McuDiagc.McuDiagcFltPassStep.Val /end SUB_GROUP
 /begin FUNCTION_LIST /end FUNCTION_LIST
 /begin REF_CHARACTERISTIC /end REF_CHARACTERISTIC
 /begin REF_MEASUREMENT /end REF_MEASUREMENT
/end GROUP
/begin GROUP CDD_McuDiagc.FastLoopCntr.Val "MICROSAR RTE" /begin SUB_GROUP /end SUB_GROUP /begin FUNCTION_LIST /end FUNCTION_LIST /begin REF_CHARACTERISTIC /end REF_CHARACTERISTIC /begin REF_MEASUREMENT CDD_McuDiagc.FastLoopCntr.Val /end REF_MEASUREMENT /end GROUP
/begin GROUP CDD_McuDiagc.FastLoopCntrDiagcCfgd "MICROSAR RTE" /begin SUB_GROUP /end SUB_GROUP /begin FUNCTION_LIST /end FUNCTION_LIST /begin REF_CHARACTERISTIC /end REF_CHARACTERISTIC /begin REF_MEASUREMENT CDD_McuDiagc.FastLoopCntrDiagcCfgd /end REF_MEASUREMENT /end GROUP
/begin GROUP CDD_McuDiagc.FastLoopCntrPrev "MICROSAR RTE" /begin SUB_GROUP /end SUB_GROUP /begin FUNCTION_LIST /end FUNCTION_LIST /begin REF_CHARACTERISTIC /end REF_CHARACTERISTIC /begin REF_MEASUREMENT CDD_McuDiagc.FastLoopCntrPrev /end REF_MEASUREMENT /end GROUP
/begin GROUP CDD_McuDiagc.LoopCntr2MilliSec.Val "MICROSAR RTE" /begin SUB_GROUP /end SUB_GROUP /begin FUNCTION_LIST /end FUNCTION_LIST /begin REF_CHARACTERISTIC /end REF_CHARACTERISTIC /begin REF_MEASUREMENT CDD_McuDiagc.LoopCntr2MilliSec.Val /end REF_MEASUREMENT /end GROUP
/begin GROUP CDD_McuDiagc.LoopCntr2MilliSecStore "MICROSAR RTE" /begin SUB_GROUP /end SUB_GROUP /begin FUNCTION_LIST /end FUNCTION_LIST /begin REF_CHARACTERISTIC /end REF_CHARACTERISTIC /begin REF_MEASUREMENT CDD_McuDiagc.LoopCntr2MilliSecStore /end REF_MEASUREMENT /end GROUP
/begin GROUP CDD_McuDiagc.LoopCntrPrev "MICROSAR RTE" /begin SUB_GROUP /end SUB_GROUP /begin FUNCTION_LIST /end FUNCTION_LIST /begin REF_CHARACTERISTIC /end REF_CHARACTERISTIC /begin REF_MEASUREMENT CDD_McuDiagc.LoopCntrPrev /end REF_MEASUREMENT /end GROUP
/begin GROUP CDD_McuDiagc.McuDiagc2MilliSecCntrCompThd.Val "MICROSAR RTE" /begin SUB_GROUP /end SUB_GROUP /begin FUNCTION_LIST /end FUNCTION_LIST /begin REF_CHARACTERISTIC CDD_McuDiagc.McuDiagc2MilliSecCntrCompThd.Val /end REF_CHARACTERISTIC /begin REF_MEASUREMENT /end REF_MEASUREMENT /end GROUP
/begin GROUP CDD_McuDiagc.McuDiagcFltFailStep.Val "MICROSAR RTE" /begin SUB_GROUP /end SUB_GROUP /begin FUNCTION_LIST /end FUNCTION_LIST /begin REF_CHARACTERISTIC CDD_McuDiagc.McuDiagcFltFailStep.Val /end REF_CHARACTERISTIC /begin REF_MEASUREMENT /end REF_MEASUREMENT /end GROUP
/begin GROUP CDD_McuDiagc.McuDiagcFltPassStep.Val "MICROSAR RTE" /begin SUB_GROUP /end SUB_GROUP /begin FUNCTION_LIST /end FUNCTION_LIST /begin REF_CHARACTERISTIC CDD_McuDiagc.McuDiagcFltPassStep.Val /end REF_CHARACTERISTIC /begin REF_MEASUREMENT /end REF_MEASUREMENT /end GROUP
/begin GROUP CDD_McuDiagc.PerInstanceMemories "MICROSAR RTE"
 /begin SUB_GROUP CDD_McuDiagc.FastLoopCntrDiagcCfgd CDD_McuDiagc.FastLoopCntrPrev CDD_McuDiagc.LoopCntr2MilliSecStore CDD_McuDiagc.LoopCntrPrev CDD_McuDiagc.dMcuDiagcFastLoopCntrMax CDD_McuDiagc.dMcuDiagcFastLoopCntrMin CDD_McuDiagc.dMcuDiagcLoopCntr2MilliSecMotCtrlDif /end SUB_GROUP
 /begin FUNCTION_LIST /end FUNCTION_LIST
 /begin REF_CHARACTERISTIC /end REF_CHARACTERISTIC
 /begin REF_MEASUREMENT /end REF_MEASUREMENT
/end GROUP
/begin GROUP CDD_McuDiagc.ReceiverPorts "MICROSAR RTE"
 /begin SUB_GROUP CDD_McuDiagc.FastLoopCntr.Val CDD_McuDiagc.SlowLoopCntr.Val /end SUB_GROUP
 /begin FUNCTION_LIST /end FUNCTION_LIST
 /begin REF_CHARACTERISTIC /end REF_CHARACTERISTIC
 /begin REF_MEASUREMENT /end REF_MEASUREMENT
/end GROUP
/begin GROUP CDD_McuDiagc.SenderPorts "MICROSAR RTE" /begin SUB_GROUP CDD_McuDiagc.LoopCntr2MilliSec.Val /end SUB_GROUP /begin FUNCTION_LIST /end FUNCTION_LIST /begin REF_CHARACTERISTIC /end REF_CHARACTERISTIC /begin REF_MEASUREMENT /end REF_MEASUREMENT /end GROUP
/begin GROUP CDD_McuDiagc.SlowLoopCntr.Val "MICROSAR RTE" /begin SUB_GROUP /end SUB_GROUP /begin FUNCTION_LIST /end FUNCTION_LIST /begin REF_CHARACTERISTIC /end REF_CHARACTERISTIC /begin REF_MEASUREMENT CDD_McuDiagc.SlowLoopCntr.Val /end REF_MEASUREMENT /end GROUP
/begin GROUP CDD_McuDiagc.dMcuDiagcFastLoopCntrMax "MICROSAR RTE" /begin SUB_GROUP /end SUB_GROUP /begin FUNCTION_LIST /end FUNCTION_LIST /begin REF_CHARACTERISTIC /end REF_CHARACTERISTIC /begin REF_MEASUREMENT CDD_McuDiagc.dMcuDiagcFastLoopCntrMax /end REF_MEASUREMENT /end GROUP
/begin GROUP CDD_McuDiagc.dMcuDiagcFastLoopCntrMin "MICROSAR RTE" /begin SUB_GROUP /end SUB_GROUP /begin FUNCTION_LIST /end FUNCTION_LIST /begin REF_CHARACTERISTIC /end REF_CHARACTERISTIC /begin REF_MEASUREMENT CDD_McuDiagc.dMcuDiagcFastLoopCntrMin /end REF_MEASUREMENT /end GROUP
/begin GROUP CDD_McuDiagc.dMcuDiagcLoopCntr2MilliSecMotCtrlDif "MICROSAR RTE" /begin SUB_GROUP /end SUB_GROUP /begin FUNCTION_LIST /end FUNCTION_LIST /begin REF_CHARACTERISTIC /end REF_CHARACTERISTIC /begin REF_MEASUREMENT CDD_McuDiagc.dMcuDiagcLoopCntr2MilliSecMotCtrlDif /end REF_MEASUREMENT /end GROUP
/begin GROUP CDD_MotAg5Meas "MICROSAR RTE"
 /begin SUB_GROUP CDD_MotAg5Meas.CalibrationPorts CDD_MotAg5Meas.PerInstanceMemories CDD_MotAg5Meas.ReceiverPorts CDD_MotAg5Meas.SenderPorts /end SUB_GROUP
 /begin FUNCTION_LIST /end FUNCTION_LIST
 /begin REF_CHARACTERISTIC /end REF_CHARACTERISTIC
 /begin REF_MEASUREMENT /end REF_MEASUREMENT
/end GROUP
/begin GROUP CDD_MotAg5Meas.CalibrationPorts "MICROSAR RTE"
 /begin SUB_GROUP CDD_MotAg5Meas.MotAg5MeasAmpSqdMaxThd.Val CDD_MotAg5Meas.MotAg5MeasAmpSqdMinThd.Val CDD_MotAg5Meas.MotAg5MeasLpFilFrq.Val CDD_MotAg5Meas.MotAg5MeasOffs.Val CDD_MotAg5Meas.MotAg5MeasRtAmpRecprLim.Val CDD_MotAg5Meas.MotAg5MeasRtFilEnaThd.Val CDD_MotAg5Meas.MotAg5MeasRtMotVelFilEnaThd.Val CDD_MotAg5Meas.MotAg5MeasRtOffsLim.Val CDD_MotAg5Meas.MotAg5MeasRtToNomRatLim.Val /end SUB_GROUP
 /begin FUNCTION_LIST /end FUNCTION_LIST
 /begin REF_CHARACTERISTIC /end REF_CHARACTERISTIC
 /begin REF_MEASUREMENT /end REF_MEASUREMENT
/end GROUP
/begin GROUP CDD_MotAg5Meas.MotAg5Cos.Val "MICROSAR RTE" /begin SUB_GROUP /end SUB_GROUP /begin FUNCTION_LIST /end FUNCTION_LIST /begin REF_CHARACTERISTIC /end REF_CHARACTERISTIC /begin REF_MEASUREMENT CDD_MotAg5Meas.MotAg5Cos.Val /end REF_MEASUREMENT /end GROUP
/begin GROUP CDD_MotAg5Meas.MotAg5CosAdcFaild.Logl "MICROSAR RTE" /begin SUB_GROUP /end SUB_GROUP /begin FUNCTION_LIST /end FUNCTION_LIST /begin REF_CHARACTERISTIC /end REF_CHARACTERISTIC /begin REF_MEASUREMENT CDD_MotAg5Meas.MotAg5CosAdcFaild.Logl /end REF_MEASUREMENT /end GROUP
/begin GROUP CDD_MotAg5Meas.MotAg5CosMaxLpFil "MICROSAR RTE" /begin SUB_GROUP /end SUB_GROUP /begin FUNCTION_LIST /end FUNCTION_LIST /begin REF_CHARACTERISTIC /end REF_CHARACTERISTIC
 /begin REF_MEASUREMENT CDD_MotAg5Meas.MotAg5CosMaxLpFil.FilGain CDD_MotAg5Meas.MotAg5CosMaxLpFil.FilSt /end REF_MEASUREMENT
/end GROUP
/begin GROUP CDD_MotAg5Meas.MotAg5CosMinLpFil "MICROSAR RTE" /begin SUB_GROUP /end SUB_GROUP /begin FUNCTION_LIST /end FUNCTION_LIST /begin REF_CHARACTERISTIC /end REF_CHARACTERISTIC
 /begin REF_MEASUREMENT CDD_MotAg5Meas.MotAg5CosMinLpFil.FilGain CDD_MotAg5Meas.MotAg5CosMinLpFil.FilSt /end REF_MEASUREMENT
/end GROUP
/begin GROUP CDD_MotAg5Meas.MotAg5CosRtAmpRecpr.Val "MICROSAR RTE" /begin SUB_GROUP /end SUB_GROUP /begin FUNCTION_LIST /end FUNCTION_LIST /begin REF_CHARACTERISTIC /end REF_CHARACTERISTIC /begin REF_MEASUREMENT CDD_MotAg5Meas.MotAg5CosRtAmpRecpr.Val /end REF_MEASUREMENT /end GROUP
/begin GROUP CDD_MotAg5Meas.MotAg5CosRtOffs.Val "MICROSAR RTE" /begin SUB_GROUP /end SUB_GROUP /begin FUNCTION_LIST /end FUNCTION_LIST /begin REF_CHARACTERISTIC /end REF_CHARACTERISTIC /begin REF_MEASUREMENT CDD_MotAg5Meas.MotAg5CosRtOffs.Val /end REF_MEASUREMENT /end GROUP
/**********************************************************************************************************************
* RECORD_LAYOUT
*********************************************************************************************************************/
/begin RECORD_LAYOUT RTE_RL_UBYTE FNC_VALUES 1 UBYTE ROW_DIR DIRECT /end RECORD_LAYOUT
/begin RECORD_LAYOUT RTE_RL_UWORD FNC_VALUES 1 UWORD ROW_DIR DIRECT /end RECORD_LAYOUT
/begin RECORD_LAYOUT RTE_RL_ULONG FNC_VALUES 1 ULONG ROW_DIR DIRECT /end RECORD_LAYOUT
/begin RECORD_LAYOUT RTE_RL_SWORD FNC_VALUES 1 SWORD ROW_DIR DIRECT /end RECORD_LAYOUT
/begin RECORD_LAYOUT RTE_RL_FLOAT32_IEEE FNC_VALUES 1 FLOAT32_IEEE ROW_DIR DIRECT /end RECORD_LAYOUT
/begin RECORD_LAYOUT RTE_RL_BOOLEAN FNC_VALUES 1 UBYTE ROW_DIR DIRECT /end RECORD_LAYOUT
/**********************************************************************************************************************
* COMPU_METHOD / COMPU_VTAB_RANGE
*********************************************************************************************************************/
/begin COMPU_METHOD RTE_CM_BOOLEAN "" TAB_VERB "%3.1" "" COMPU_TAB_REF RTE_CM_BOOLEAN /end COMPU_METHOD
/begin COMPU_VTAB_RANGE RTE_CM_BOOLEAN "" 2 0 0 "false" 1 255 "true" /end COMPU_VTAB_RANGE
/begin COMPU_METHOD RTE_CM_ENUM_SysSt1 "" TAB_VERB "%.1" "" COMPU_TAB_REF RTE_CM_ENUM_SysSt1 /end COMPU_METHOD
/begin COMPU_VTAB_RANGE RTE_CM_ENUM_SysSt1 "" 4 0 0 "SYSST_DI" 1 1 "SYSST_OFF" 2 2 "SYSST_ENA" 3 3 "SYSST_WRMININ" /end COMPU_VTAB_RANGE
/begin COMPU_METHOD RTE_CM_ENUM_SigQlfr1 "" TAB_VERB "%.1" "" COMPU_TAB_REF RTE_CM_ENUM_SigQlfr1 /end COMPU_METHOD
/begin COMPU_VTAB_RANGE RTE_CM_ENUM_SigQlfr1 "" 3 0 0 "SIGQLFR_NORES" 1 1 "SIGQLFR_PASSD" 2 2 "SIGQLFR_FAILD" /end COMPU_VTAB_RANGE
/begin COMPU_METHOD RTE_CM_ENUM_MotCurrEolCalSt2 "" TAB_VERB "%.1" "" COMPU_TAB_REF RTE_CM_ENUM_MotCurrEolCalSt2 /end COMPU_METHOD
/begin COMPU_VTAB_RANGE RTE_CM_ENUM_MotCurrEolCalSt2 "" 9 0 0 "MCECS_OFFSCMDSTRT" 1 1 "MCECS_OFFSCMDHI" 2 2 "MCECS_OFFSCMDLO" 3 3 "MCECS_OFFSCMDZERO" 4 4 "MCECS_OFFSCMDEND" 5 5 "MCECS_GAINCMDAD" 6 6 "MCECS_GAINCMDBE" 7 7 "MCECS_GAINCMDCF" 8 8 "MCECS_CMDSAFEST" /end COMPU_VTAB_RANGE
/begin COMPU_METHOD RTE_CM_Ford_VehYaw_W_Actl "" RAT_FUNC "%.1" "rad/s" COEFFS 0 5000 32500 0 0 1 STATUS_STRING_REF RTE_CM_ENUM_Ford_VehYaw_W_Actl /end COMPU_METHOD
/begin COMPU_VTAB_RANGE RTE_CM_ENUM_Ford_VehYaw_W_Actl "" 2 65534 65534 "CxFFFE_NoDataExists" 65535 65535 "CxFFFF_Faulty" /end COMPU_VTAB_RANGE
/begin COMPU_METHOD RTE_CM_ENUM_Ford_LatCtlLim_D_Stat "" TAB_VERB "%.1" "" COMPU_TAB_REF RTE_CM_ENUM_Ford_LatCtlLim_D_Stat /end COMPU_METHOD
/begin COMPU_VTAB_RANGE RTE_CM_ENUM_Ford_LatCtlLim_D_Stat "" 5 0 3 "RANGE" 0 0 "Cx0_LimitNotReached" 1 1 "Cx1_LimitClose" 2 2 "Cx2_LimitReached" 3 3 "Cx3_LimitWithDriverActive" /end COMPU_VTAB_RANGE
/begin COMPU_METHOD RTE_CM_ENUM_Ford_LatCtlSte_D_Stat "" TAB_VERB "%.1" "" COMPU_TAB_REF RTE_CM_ENUM_Ford_LatCtlSte_D_Stat /end COMPU_METHOD
/begin COMPU_VTAB_RANGE RTE_CM_ENUM_Ford_LatCtlSte_D_Stat "" 9 0 7 "RANGE" 0 0 "Cx0_Unavailable" 1 1 "Cx1_Available" 2 2 "Cx2_ContLatControlInProgress" 3 3 "Cx3_RampOut" 4 4 "Cx4_Denied" 5 5 "Cx5_NotUsed1" 6 6 "Cx6_NotUsed2" 7 7 "Cx7_NotUsed3" /end COMPU_VTAB_RANGE
/begin COMPU_METHOD RTE_CM_ENUM_HwAgSnsrTyp1 "" TAB_VERB "%.1" "" COMPU_TAB_REF RTE_CM_ENUM_HwAgSnsrTyp1 /end COMPU_METHOD
/begin COMPU_VTAB_RANGE RTE_CM_ENUM_HwAgSnsrTyp1 "" 2 0 0 "HWAGSNSRTYP_NOSNSR" 1 1 "HWAGSNSRTYP_A1335" /end COMPU_VTAB_RANGE
/begin COMPU_METHOD RTE_CM_ENUM_IvtrFetFltPha1 "" TAB_VERB "%.1" "" COMPU_TAB_REF RTE_CM_ENUM_IvtrFetFltPha1 /end COMPU_METHOD
/begin COMPU_VTAB_RANGE RTE_CM_ENUM_IvtrFetFltPha1 "" 4 0 0 "IVTRFETFLTPHA_NOPHASNGFETFLT" 1 1 "IVTRFETFLTPHA_PHAASNGFETFLT" 2 2 "IVTRFETFLTPHA_PHABSNGFETFLT" 4 4 "IVTRFETFLTPHA_PHACSNGFETFLT" /end COMPU_VTAB_RANGE
