/begin CHARACTERISTIC FordSysSt.FullAssiRampUpRate.Val "MICROSAR RTE" VALUE 0x0 RTE_RL_FLOAT32_IEEE 0 NO_COMPU_METHOD -3.402823466e+38 3.402823466e+38 SYMBOL_LINK "Rte_CalprmRom_CalRegn02Cmn_DEFAULT_RTE_CALPRM_GROUP.FullAssiRampUpRate_Val" 0 DISPLAY_IDENTIFIER FordSysSt.CalibrationPorts.FullAssiRampUpRate.Val /end CHARACTERISTIC
/begin CHARACTERISTIC FordSysSt.InitLimpHomeRamp.Val "MICROSAR RTE" VALUE 0x0 RTE_RL_FLOAT32_IEEE 0 NO_COMPU_METHOD -3.402823466e+38 3.402823466e+38 SYMBOL_LINK "Rte_CalprmRom_CalRegn02Cmn_DEFAULT_RTE_CALPRM_GROUP.InitLimpHomeRamp_Val" 0 DISPLAY_IDENTIFIER FordSysSt.CalibrationPorts.InitLimpHomeRamp.Val /end CHARACTERISTIC
/begin CHARACTERISTIC FordSysSt.InitLimpHomeScar.Val "MICROSAR RTE" VALUE 0x0 RTE_RL_FLOAT32_IEEE 0 NO_COMPU_METHOD -3.402823466e+38 3.402823466e+38 SYMBOL_LINK "Rte_CalprmRom_CalRegn02Cmn_DEFAULT_RTE_CALPRM_GROUP.InitLimpHomeScar_Val" 0 DISPLAY_IDENTIFIER FordSysSt.CalibrationPorts.InitLimpHomeScar.Val /end CHARACTERISTIC
/begin CHARACTERISTIC FordSysSt.LimdAssiRamp.Val "MICROSAR RTE" VALUE 0x0 RTE_RL_FLOAT32_IEEE 0 NO_COMPU_METHOD -3.402823466e+38 3.402823466e+38 SYMBOL_LINK "Rte_CalprmRom_CalRegn02Cmn_DEFAULT_RTE_CALPRM_GROUP.LimdAssiRamp_Val" 0 DISPLAY_IDENTIFIER FordSysSt.CalibrationPorts.LimdAssiRamp.Val /end CHARACTERISTIC
/begin CHARACTERISTIC FordSysSt.LimdAssiRampUpRate.Val "MICROSAR RTE" VALUE 0x0 RTE_RL_FLOAT32_IEEE 0 NO_COMPU_METHOD -3.402823466e+38 3.402823466e+38 SYMBOL_LINK "Rte_CalprmRom_CalRegn02Cmn_DEFAULT_RTE_CALPRM_GROUP.LimdAssiRampUpRate_Val" 0 DISPLAY_IDENTIFIER FordSysSt.CalibrationPorts.LimdAssiRampUpRate.Val /end CHARACTERISTIC
/begin CHARACTERISTIC FordSysSt.LimdAssiRampUpRateFaild.Val "MICROSAR RTE" VALUE 0x0 RTE_RL_FLOAT32_IEEE 0 NO_COMPU_METHOD -3.402823466e+38 3.402823466e+38 SYMBOL_LINK "Rte_CalprmRom_CalRegn02Cmn_DEFAULT_RTE_CALPRM_GROUP.LimdAssiRampUpRateFaild_Val" 0 DISPLAY_IDENTIFIER FordSysSt.CalibrationPorts.LimdAssiRampUpRateFaild.Val /end CHARACTERISTIC
/begin CHARACTERISTIC FordSysSt.LimdAssiScar.Val "MICROSAR RTE" VALUE 0x0 RTE_RL_FLOAT32_IEEE 0 NO_COMPU_METHOD -3.402823466e+38 3.402823466e+38 SYMBOL_LINK "Rte_CalprmRom_CalRegn02Cmn_DEFAULT_RTE_CALPRM_GROUP.LimdAssiScar_Val" 0 DISPLAY_IDENTIFIER FordSysSt.CalibrationPorts.LimdAssiScar.Val /end CHARACTERISTIC
/begin CHARACTERISTIC FordSysSt.NormLimpHomeRamp.Val "MICROSAR RTE" VALUE 0x0 RTE_RL_FLOAT32_IEEE 0 NO_COMPU_METHOD -3.402823466e+38 3.402823466e+38 SYMBOL_LINK "Rte_CalprmRom_CalRegn02Cmn_DEFAULT_RTE_CALPRM_GROUP.NormLimpHomeRamp_Val" 0 DISPLAY_IDENTIFIER FordSysSt.CalibrationPorts.NormLimpHomeRamp.Val /end CHARACTERISTIC
/begin CHARACTERISTIC FordSysSt.NormLimpHomeScar.Val "MICROSAR RTE" VALUE 0x0 RTE_RL_FLOAT32_IEEE 0 NO_COMPU_METHOD -3.402823466e+38 3.402823466e+38 SYMBOL_LINK "Rte_CalprmRom_CalRegn02Cmn_DEFAULT_RTE_CALPRM_GROUP.NormLimpHomeScar_Val" 0 DISPLAY_IDENTIFIER FordSysSt.CalibrationPorts.NormLimpHomeScar.Val /end CHARACTERISTIC
/begin CHARACTERISTIC FordSysSt.ShtdwnRamp.Val "MICROSAR RTE" VALUE 0x0 RTE_RL_FLOAT32_IEEE 0 NO_COMPU_METHOD -3.402823466e+38 3.402823466e+38 SYMBOL_LINK "Rte_CalprmRom_CalRegn02Cmn_DEFAULT_RTE_CALPRM_GROUP.ShtdwnRamp_Val" 0 DISPLAY_IDENTIFIER FordSysSt.CalibrationPorts.ShtdwnRamp.Val /end CHARACTERISTIC
/begin CHARACTERISTIC FordVehSpdArbn.FordVehSpdArbnDrvnWhl.Logl "MICROSAR RTE" VALUE 0x0 RTE_RL_BOOLEAN 0 RTE_CM_BOOLEAN 0 255 SYMBOL_LINK "Rte_CalprmRom_CalRegn02Cmn_DEFAULT_RTE_CALPRM_GROUP.FordVehSpdArbnDrvnWhl_Logl" 0 DISPLAY_IDENTIFIER FordVehSpdArbn.CalibrationPorts.FordVehSpdArbnDrvnWhl.Logl /end CHARACTERISTIC
/begin CHARACTERISTIC FordVehSpdArbn.FordVehSpdArbnTireCircumMax.Val "MICROSAR RTE" VALUE 0x0 RTE_RL_UWORD 0 NO_COMPU_METHOD 0 65535 SYMBOL_LINK "Rte_CalprmRom_CalRegn02Cmn_DEFAULT_RTE_CALPRM_GROUP.FordVehSpdArbnTireCircumMax_Val" 0 DISPLAY_IDENTIFIER FordVehSpdArbn.CalibrationPorts.FordVehSpdArbnTireCircumMax.Val /end CHARACTERISTIC
/begin CHARACTERISTIC FordVehSpdArbn.FordVehSpdArbnTireCircumMin.Val "MICROSAR RTE" VALUE 0x0 RTE_RL_UWORD 0 NO_COMPU_METHOD 0 65535 SYMBOL_LINK "Rte_CalprmRom_CalRegn02Cmn_DEFAULT_RTE_CALPRM_GROUP.FordVehSpdArbnTireCircumMin_Val" 0 DISPLAY_IDENTIFIER FordVehSpdArbn.CalibrationPorts.FordVehSpdArbnTireCircumMin.Val /end CHARACTERISTIC
/begin CHARACTERISTIC FordVltgIf.FordVltgIfActvParkAssiAsscTqMin.Val "MICROSAR RTE" VALUE 0x0 RTE_RL_FLOAT32_IEEE 0 NO_COMPU_METHOD -3.402823466e+38 3.402823466e+38 SYMBOL_LINK "Rte_CalprmRom_CalRegn02Cmn_DEFAULT_RTE_CALPRM_GROUP.FordVltgIfActvParkAssiAsscTqMin_Val" 0 DISPLAY_IDENTIFIER FordVltgIf.CalibrationPorts.FordVltgIfActvParkAssiAsscTqMin.Val /end CHARACTERISTIC
/begin CHARACTERISTIC FordVltgIf.FordVltgIfEPSBattVltgDifThd.Val "MICROSAR RTE" VALUE 0x0 RTE_RL_FLOAT32_IEEE 0 NO_COMPU_METHOD -3.402823466e+38 3.402823466e+38 SYMBOL_LINK "Rte_CalprmRom_CalRegn02Cmn_DEFAULT_RTE_CALPRM_GROUP.FordVltgIfEPSBattVltgDifThd_Val" 0 DISPLAY_IDENTIFIER FordVltgIf.CalibrationPorts.FordVltgIfEPSBattVltgDifThd.Val /end CHARACTERISTIC
/begin CHARACTERISTIC FordVltgIf.FordVltgIfEpsBattCurrLim.Val "MICROSAR RTE" VALUE 0x0 RTE_RL_FLOAT32_IEEE 0 NO_COMPU_METHOD -3.402823466e+38 3.402823466e+38 SYMBOL_LINK "Rte_CalprmRom_CalRegn02Cmn_DEFAULT_RTE_CALPRM_GROUP.FordVltgIfEpsBattCurrLim_Val" 0 DISPLAY_IDENTIFIER FordVltgIf.CalibrationPorts.FordVltgIfEpsBattCurrLim.Val /end CHARACTERISTIC
/begin CHARACTERISTIC FordVltgIf.FordVltgIfEpsCurrLim.Val "MICROSAR RTE" VALUE 0x0 RTE_RL_FLOAT32_IEEE 0 NO_COMPU_METHOD -3.402823466e+38 3.402823466e+38 SYMBOL_LINK "Rte_CalprmRom_CalRegn02Cmn_DEFAULT_RTE_CALPRM_GROUP.FordVltgIfEpsCurrLim_Val" 0 DISPLAY_IDENTIFIER FordVltgIf.CalibrationPorts.FordVltgIfEpsCurrLim.Val /end CHARACTERISTIC
/begin CHARACTERISTIC FordVltgIf.FordVltgIfEvasSteerAssiTqMin.Val "MICROSAR RTE" VALUE 0x0 RTE_RL_FLOAT32_IEEE 0 NO_COMPU_METHOD -3.402823466e+38 3.402823466e+38 SYMBOL_LINK "Rte_CalprmRom_CalRegn02Cmn_DEFAULT_RTE_CALPRM_GROUP.FordVltgIfEvasSteerAssiTqMin_Val" 0 DISPLAY_IDENTIFIER FordVltgIf.CalibrationPorts.FordVltgIfEvasSteerAssiTqMin.Val /end CHARACTERISTIC
/begin CHARACTERISTIC FordVltgIf.FordVltgIfFeatThdStsTiThd.Val "MICROSAR RTE" VALUE 0x0 RTE_RL_UWORD 0 NO_COMPU_METHOD 0 65535 SYMBOL_LINK "Rte_CalprmRom_CalRegn02Cmn_DEFAULT_RTE_CALPRM_GROUP.FordVltgIfFeatThdStsTiThd_Val" 0 DISPLAY_IDENTIFIER FordVltgIf.CalibrationPorts.FordVltgIfFeatThdStsTiThd.Val /end CHARACTERISTIC
/begin CHARACTERISTIC FordVltgIf.FordVltgIfHiVltgAssiRampDwnRate.Val "MICROSAR RTE" VALUE 0x0 RTE_RL_FLOAT32_IEEE 0 NO_COMPU_METHOD -3.402823466e+38 3.402823466e+38 SYMBOL_LINK "Rte_CalprmRom_CalRegn02Cmn_DEFAULT_RTE_CALPRM_GROUP.FordVltgIfHiVltgAssiRampDwnRate_Val" 0 DISPLAY_IDENTIFIER FordVltgIf.CalibrationPorts.FordVltgIfHiVltgAssiRampDwnRate.Val /end CHARACTERISTIC
/begin CHARACTERISTIC FordVltgIf.FordVltgIfHiVltgAssiRampUpRate.Val "MICROSAR RTE" VALUE 0x0 RTE_RL_FLOAT32_IEEE 0 NO_COMPU_METHOD -3.402823466e+38 3.402823466e+38 SYMBOL_LINK "Rte_CalprmRom_CalRegn02Cmn_DEFAULT_RTE_CALPRM_GROUP.FordVltgIfHiVltgAssiRampUpRate_Val" 0 DISPLAY_IDENTIFIER FordVltgIf.CalibrationPorts.FordVltgIfHiVltgAssiRampUpRate.Val /end CHARACTERISTIC
/begin CHARACTERISTIC FordVltgIf.FordVltgIfHiVltgInhbTiMax.Val "MICROSAR RTE" VALUE 0x0 RTE_RL_UWORD 0 NO_COMPU_METHOD 0 65535 SYMBOL_LINK "Rte_CalprmRom_CalRegn02Cmn_DEFAULT_RTE_CALPRM_GROUP.FordVltgIfHiVltgInhbTiMax_Val" 0 DISPLAY_IDENTIFIER FordVltgIf.CalibrationPorts.FordVltgIfHiVltgInhbTiMax.Val /end CHARACTERISTIC
/begin CHARACTERISTIC FordVltgIf.FordVltgIfHiVltgNoAssiRampDwnRate.Val "MICROSAR RTE" VALUE 0x0 RTE_RL_FLOAT32_IEEE 0 NO_COMPU_METHOD -3.402823466e+38 3.402823466e+38 SYMBOL_LINK "Rte_CalprmRom_CalRegn02Cmn_DEFAULT_RTE_CALPRM_GROUP.FordVltgIfHiVltgNoAssiRampDwnRate_Val" 0 DISPLAY_IDENTIFIER FordVltgIf.CalibrationPorts.FordVltgIfHiVltgNoAssiRampDwnRate.Val /end CHARACTERISTIC
/begin CHARACTERISTIC FordVltgIf.FordVltgIfHiVltgNoAssiRcvrTiMax.Val "MICROSAR RTE" VALUE 0x0 RTE_RL_ULONG 0 NO_COMPU_METHOD 0 4294967295 SYMBOL_LINK "Rte_CalprmRom_CalRegn02Cmn_DEFAULT_RTE_CALPRM_GROUP.FordVltgIfHiVltgNoAssiRcvrTiMax_Val" 0 DISPLAY_IDENTIFIER FordVltgIf.CalibrationPorts.FordVltgIfHiVltgNoAssiRcvrTiMax.Val /end CHARACTERISTIC
/begin CHARACTERISTIC FordVltgIf.FordVltgIfHiVltgRcvrTiMax.Val "MICROSAR RTE" VALUE 0x0 RTE_RL_ULONG 0 NO_COMPU_METHOD 0 4294967295 SYMBOL_LINK "Rte_CalprmRom_CalRegn02Cmn_DEFAULT_RTE_CALPRM_GROUP.FordVltgIfHiVltgRcvrTiMax_Val" 0 DISPLAY_IDENTIFIER FordVltgIf.CalibrationPorts.FordVltgIfHiVltgRcvrTiMax.Val /end CHARACTERISTIC
/begin CHARACTERISTIC FordVltgIf.FordVltgIfHiVltgThdHi.Val "MICROSAR RTE" VALUE 0x0 RTE_RL_FLOAT32_IEEE 0 NO_COMPU_METHOD -3.402823466e+38 3.402823466e+38 SYMBOL_LINK "Rte_CalprmRom_CalRegn02Cmn_DEFAULT_RTE_CALPRM_GROUP.FordVltgIfHiVltgThdHi_Val" 0 DISPLAY_IDENTIFIER FordVltgIf.CalibrationPorts.FordVltgIfHiVltgThdHi.Val /end CHARACTERISTIC
/begin CHARACTERISTIC FordVltgIf.FordVltgIfHiVltgThdLo.Val "MICROSAR RTE" VALUE 0x0 RTE_RL_FLOAT32_IEEE 0 NO_COMPU_METHOD -3.402823466e+38 3.402823466e+38 SYMBOL_LINK "Rte_CalprmRom_CalRegn02Cmn_DEFAULT_RTE_CALPRM_GROUP.FordVltgIfHiVltgThdLo_Val" 0 DISPLAY_IDENTIFIER FordVltgIf.CalibrationPorts.FordVltgIfHiVltgThdLo.Val /end CHARACTERISTIC
/begin CHARACTERISTIC FordVltgIf.FordVltgIfInhbBattVltgDiagcTiThd.Val "MICROSAR RTE" VALUE 0x0 RTE_RL_UWORD 0 NO_COMPU_METHOD 0 65535 SYMBOL_LINK "Rte_CalprmRom_CalRegn02Cmn_DEFAULT_RTE_CALPRM_GROUP.FordVltgIfInhbBattVltgDiagcTiThd_Val" 0 DISPLAY_IDENTIFIER FordVltgIf.CalibrationPorts.FordVltgIfInhbBattVltgDiagcTiThd.Val /end CHARACTERISTIC
/begin CHARACTERISTIC FordVltgIf.FordVltgIfLaneCentrAssiTqMin.Val "MICROSAR RTE" VALUE 0x0 RTE_RL_FLOAT32_IEEE 0 NO_COMPU_METHOD -3.402823466e+38 3.402823466e+38 SYMBOL_LINK "Rte_CalprmRom_CalRegn02Cmn_DEFAULT_RTE_CALPRM_GROUP.FordVltgIfLaneCentrAssiTqMin_Val" 0 DISPLAY_IDENTIFIER FordVltgIf.CalibrationPorts.FordVltgIfLaneCentrAssiTqMin.Val /end CHARACTERISTIC
/begin CHARACTERISTIC FordVltgIf.FordVltgIfLaneDprtrWarnAsscTqMin.Val "MICROSAR RTE" VALUE 0x0 RTE_RL_FLOAT32_IEEE 0 NO_COMPU_METHOD -3.402823466e+38 3.402823466e+38 SYMBOL_LINK "Rte_CalprmRom_CalRegn02Cmn_DEFAULT_RTE_CALPRM_GROUP.FordVltgIfLaneDprtrWarnAsscTqMin_Val" 0 DISPLAY_IDENTIFIER FordVltgIf.CalibrationPorts.FordVltgIfLaneDprtrWarnAsscTqMin.Val /end CHARACTERISTIC
/begin CHARACTERISTIC FordVltgIf.FordVltgIfLkaAsscTqMin.Val "MICROSAR RTE" VALUE 0x0 RTE_RL_FLOAT32_IEEE 0 NO_COMPU_METHOD -3.402823466e+38 3.402823466e+38 SYMBOL_LINK "Rte_CalprmRom_CalRegn02Cmn_DEFAULT_RTE_CALPRM_GROUP.FordVltgIfLkaAsscTqMin_Val" 0 DISPLAY_IDENTIFIER FordVltgIf.CalibrationPorts.FordVltgIfLkaAsscTqMin.Val /end CHARACTERISTIC
/begin CHARACTERISTIC FordVltgIf.FordVltgIfLoVltgAssiRampDwnRate.Val "MICROSAR RTE" VALUE 0x0 RTE_RL_FLOAT32_IEEE 0 NO_COMPU_METHOD -3.402823466e+38 3.402823466e+38 SYMBOL_LINK "Rte_CalprmRom_CalRegn02Cmn_DEFAULT_RTE_CALPRM_GROUP.FordVltgIfLoVltgAssiRampDwnRate_Val" 0 DISPLAY_IDENTIFIER FordVltgIf.CalibrationPorts.FordVltgIfLoVltgAssiRampDwnRate.Val /end CHARACTERISTIC
/begin CHARACTERISTIC FordVltgIf.FordVltgIfLoVltgAssiRampUpRate.Val "MICROSAR RTE" VALUE 0x0 RTE_RL_FLOAT32_IEEE 0 NO_COMPU_METHOD -3.402823466e+38 3.402823466e+38 SYMBOL_LINK "Rte_CalprmRom_CalRegn02Cmn_DEFAULT_RTE_CALPRM_GROUP.FordVltgIfLoVltgAssiRampUpRate_Val" 0 DISPLAY_IDENTIFIER FordVltgIf.CalibrationPorts.FordVltgIfLoVltgAssiRampUpRate.Val /end CHARACTERISTIC
/begin CHARACTERISTIC FordVltgIf.FordVltgIfLoVltgAssiScar.Val "MICROSAR RTE" VALUE 0x0 RTE_RL_FLOAT32_IEEE 0 NO_COMPU_METHOD -3.402823466e+38 3.402823466e+38 SYMBOL_LINK "Rte_CalprmRom_CalRegn02Cmn_DEFAULT_RTE_CALPRM_GROUP.FordVltgIfLoVltgAssiScar_Val" 0 DISPLAY_IDENTIFIER FordVltgIf.CalibrationPorts.FordVltgIfLoVltgAssiScar.Val /end CHARACTERISTIC
/begin CHARACTERISTIC FordVltgIf.FordVltgIfLoVltgInhbTiMax.Val "MICROSAR RTE" VALUE 0x0 RTE_RL_ULONG 0 NO_COMPU_METHOD 0 4294967295 SYMBOL_LINK "Rte_CalprmRom_CalRegn02Cmn_DEFAULT_RTE_CALPRM_GROUP.FordVltgIfLoVltgInhbTiMax_Val" 0 DISPLAY_IDENTIFIER FordVltgIf.CalibrationPorts.FordVltgIfLoVltgInhbTiMax.Val /end CHARACTERISTIC
/begin CHARACTERISTIC FordVltgIf.FordVltgIfLoVltgNoAssiRampDwnRate.Val "MICROSAR RTE" VALUE 0x0 RTE_RL_FLOAT32_IEEE 0 NO_COMPU_METHOD -3.402823466e+38 3.402823466e+38 SYMBOL_LINK "Rte_CalprmRom_CalRegn02Cmn_DEFAULT_RTE_CALPRM_GROUP.FordVltgIfLoVltgNoAssiRampDwnRate_Val" 0 DISPLAY_IDENTIFIER FordVltgIf.CalibrationPorts.FordVltgIfLoVltgNoAssiRampDwnRate.Val /end CHARACTERISTIC
/begin CHARACTERISTIC FordVltgIf.FordVltgIfLoVltgNoAssiRcvrTiMax.Val "MICROSAR RTE" VALUE 0x0 RTE_RL_UWORD 0 NO_COMPU_METHOD 0 65535 SYMBOL_LINK "Rte_CalprmRom_CalRegn02Cmn_DEFAULT_RTE_CALPRM_GROUP.FordVltgIfLoVltgNoAssiRcvrTiMax_Val" 0 DISPLAY_IDENTIFIER FordVltgIf.CalibrationPorts.FordVltgIfLoVltgNoAssiRcvrTiMax.Val /end CHARACTERISTIC
/begin CHARACTERISTIC FordVltgIf.FordVltgIfLoVltgRcvrTiMax.Val "MICROSAR RTE" VALUE 0x0 RTE_RL_ULONG 0 NO_COMPU_METHOD 0 4294967295 SYMBOL_LINK "Rte_CalprmRom_CalRegn02Cmn_DEFAULT_RTE_CALPRM_GROUP.FordVltgIfLoVltgRcvrTiMax_Val" 0 DISPLAY_IDENTIFIER FordVltgIf.CalibrationPorts.FordVltgIfLoVltgRcvrTiMax.Val /end CHARACTERISTIC
/begin CHARACTERISTIC FordVltgIf.FordVltgIfLoVltgThdHi.Val "MICROSAR RTE" VALUE 0x0 RTE_RL_FLOAT32_IEEE 0 NO_COMPU_METHOD -3.402823466e+38 3.402823466e+38 SYMBOL_LINK "Rte_CalprmRom_CalRegn02Cmn_DEFAULT_RTE_CALPRM_GROUP.FordVltgIfLoVltgThdHi_Val" 0 DISPLAY_IDENTIFIER FordVltgIf.CalibrationPorts.FordVltgIfLoVltgThdHi.Val /end CHARACTERISTIC
/begin CHARACTERISTIC FordVltgIf.FordVltgIfLoVltgThdLo.Val "MICROSAR RTE" VALUE 0x0 RTE_RL_FLOAT32_IEEE 0 NO_COMPU_METHOD -3.402823466e+38 3.402823466e+38 SYMBOL_LINK "Rte_CalprmRom_CalRegn02Cmn_DEFAULT_RTE_CALPRM_GROUP.FordVltgIfLoVltgThdLo_Val" 0 DISPLAY_IDENTIFIER FordVltgIf.CalibrationPorts.FordVltgIfLoVltgThdLo.Val /end CHARACTERISTIC
/begin CHARACTERISTIC FordVltgIf.FordVltgIfLoVltgThdMid.Val "MICROSAR RTE" VALUE 0x0 RTE_RL_FLOAT32_IEEE 0 NO_COMPU_METHOD -3.402823466e+38 3.402823466e+38 SYMBOL_LINK "Rte_CalprmRom_CalRegn02Cmn_DEFAULT_RTE_CALPRM_GROUP.FordVltgIfLoVltgThdMid_Val" 0 DISPLAY_IDENTIFIER FordVltgIf.CalibrationPorts.FordVltgIfLoVltgThdMid.Val /end CHARACTERISTIC
/begin CHARACTERISTIC FordVltgIf.FordVltgIfLoVltgThdMidToLoTiMax.Val "MICROSAR RTE" VALUE 0x0 RTE_RL_ULONG 0 NO_COMPU_METHOD 0 4294967295 SYMBOL_LINK "Rte_CalprmRom_CalRegn02Cmn_DEFAULT_RTE_CALPRM_GROUP.FordVltgIfLoVltgThdMidToLoTiMax_Val" 0 DISPLAY_IDENTIFIER FordVltgIf.CalibrationPorts.FordVltgIfLoVltgThdMidToLoTiMax.Val /end CHARACTERISTIC
/begin CHARACTERISTIC FordVltgIf.FordVltgIfLoVltgTqScaDwnRate.Val "MICROSAR RTE" VALUE 0x0 RTE_RL_FLOAT32_IEEE 0 NO_COMPU_METHOD -3.402823466e+38 3.402823466e+38 SYMBOL_LINK "Rte_CalprmRom_CalRegn02Cmn_DEFAULT_RTE_CALPRM_GROUP.FordVltgIfLoVltgTqScaDwnRate_Val" 0 DISPLAY_IDENTIFIER FordVltgIf.CalibrationPorts.FordVltgIfLoVltgTqScaDwnRate.Val /end CHARACTERISTIC
/begin CHARACTERISTIC FordVltgIf.FordVltgIfLoVltgTqScaUpRate.Val "MICROSAR RTE" VALUE 0x0 RTE_RL_FLOAT32_IEEE 0 NO_COMPU_METHOD -3.402823466e+38 3.402823466e+38 SYMBOL_LINK "Rte_CalprmRom_CalRegn02Cmn_DEFAULT_RTE_CALPRM_GROUP.FordVltgIfLoVltgTqScaUpRate_Val" 0 DISPLAY_IDENTIFIER FordVltgIf.CalibrationPorts.FordVltgIfLoVltgTqScaUpRate.Val /end CHARACTERISTIC
/begin CHARACTERISTIC FordVltgIf.FordVltgIfLoVltgTqScagFac.Val "MICROSAR RTE" VALUE 0x0 RTE_RL_FLOAT32_IEEE 0 NO_COMPU_METHOD -3.402823466e+38 3.402823466e+38 SYMBOL_LINK "Rte_CalprmRom_CalRegn02Cmn_DEFAULT_RTE_CALPRM_GROUP.FordVltgIfLoVltgTqScagFac_Val" 0 DISPLAY_IDENTIFIER FordVltgIf.CalibrationPorts.FordVltgIfLoVltgTqScagFac.Val /end CHARACTERISTIC
/begin CHARACTERISTIC FordVltgIf.FordVltgIfTrfcJamAsscTqMin.Val "MICROSAR RTE" VALUE 0x0 RTE_RL_FLOAT32_IEEE 0 NO_COMPU_METHOD -3.402823466e+38 3.402823466e+38 SYMBOL_LINK "Rte_CalprmRom_CalRegn02Cmn_DEFAULT_RTE_CALPRM_GROUP.FordVltgIfTrfcJamAsscTqMin_Val" 0 DISPLAY_IDENTIFIER FordVltgIf.CalibrationPorts.FordVltgIfTrfcJamAsscTqMin.Val /end CHARACTERISTIC
/begin CHARACTERISTIC FordVltgIf.FordVltgIfTrlrBackupAssiTqMin.Val "MICROSAR RTE" VALUE 0x0 RTE_RL_FLOAT32_IEEE 0 NO_COMPU_METHOD -3.402823466e+38 3.402823466e+38 SYMBOL_LINK "Rte_CalprmRom_CalRegn02Cmn_DEFAULT_RTE_CALPRM_GROUP.FordVltgIfTrlrBackupAssiTqMin_Val" 0 DISPLAY_IDENTIFIER FordVltgIf.CalibrationPorts.FordVltgIfTrlrBackupAssiTqMin.Val /end CHARACTERISTIC
/begin CHARACTERISTIC FordVltgIf.FordVltgIfVehBattCircR.Val "MICROSAR RTE" VALUE 0x0 RTE_RL_FLOAT32_IEEE 0 NO_COMPU_METHOD -3.402823466e+38 3.402823466e+38 SYMBOL_LINK "Rte_CalprmRom_CalRegn02Cmn_DEFAULT_RTE_CALPRM_GROUP.FordVltgIfVehBattCircR_Val" 0 DISPLAY_IDENTIFIER FordVltgIf.CalibrationPorts.FordVltgIfVehBattCircR.Val /end CHARACTERISTIC
/begin CHARACTERISTIC GateDrv0Ctrl.GateDrv0CtrlErrFilFrq.Val "MICROSAR RTE" VALUE 0x0 RTE_RL_FLOAT32_IEEE 0 NO_COMPU_METHOD -3.402823466e+38 3.402823466e+38 SYMBOL_LINK "Rte_CalprmRom_CalRegn01Cmn_DEFAULT_RTE_CALPRM_GROUP.GateDrv0CtrlErrFilFrq_Val" 0 DISPLAY_IDENTIFIER GateDrv0Ctrl.CalibrationPorts.GateDrv0CtrlErrFilFrq.Val /end CHARACTERISTIC
/begin CHARACTERISTIC GateDrv0Ctrl.GateDrv0CtrlErrOffs.Val "MICROSAR RTE" VALUE 0x0 RTE_RL_ULONG 0 NO_COMPU_METHOD 0 4294967295 SYMBOL_LINK "Rte_CalprmRom_CalRegn01Cmn_DEFAULT_RTE_CALPRM_GROUP.GateDrv0CtrlErrOffs_Val" 0 DISPLAY_IDENTIFIER GateDrv0Ctrl.CalibrationPorts.GateDrv0CtrlErrOffs.Val /end CHARACTERISTIC
/begin CHARACTERISTIC GateDrv0Ctrl.GateDrv0CtrlErrThd.Val "MICROSAR RTE" VALUE 0x0 RTE_RL_ULONG 0 NO_COMPU_METHOD 0 4294967295 SYMBOL_LINK "Rte_CalprmRom_CalRegn01Cmn_DEFAULT_RTE_CALPRM_GROUP.GateDrv0CtrlErrThd_Val" 0 DISPLAY_IDENTIFIER GateDrv0Ctrl.CalibrationPorts.GateDrv0CtrlErrThd.Val /end CHARACTERISTIC
/begin CHARACTERISTIC GateDrv0Ctrl.GateDrv0CtrlNtcNr0x050FailStep.Val "MICROSAR RTE" VALUE 0x0 RTE_RL_UWORD 0 NO_COMPU_METHOD 0 65535 SYMBOL_LINK "Rte_CalprmRom_CalRegn01Cmn_DEFAULT_RTE_CALPRM_GROUP.GateDrv0CtrlNtcNr0x050FailStep_Val" 0 DISPLAY_IDENTIFIER GateDrv0Ctrl.CalibrationPorts.GateDrv0CtrlNtcNr0x050FailStep.Val /end CHARACTERISTIC
/begin CHARACTERISTIC GateDrv0Ctrl.GateDrv0CtrlNtcNr0x050PassStep.Val "MICROSAR RTE" VALUE 0x0 RTE_RL_UWORD 0 NO_COMPU_METHOD 0 65535 SYMBOL_LINK "Rte_CalprmRom_CalRegn01Cmn_DEFAULT_RTE_CALPRM_GROUP.GateDrv0CtrlNtcNr0x050PassStep_Val" 0 DISPLAY_IDENTIFIER GateDrv0Ctrl.CalibrationPorts.GateDrv0CtrlNtcNr0x050PassStep.Val /end CHARACTERISTIC
/begin CHARACTERISTIC GateDrv0Ctrl.GateDrv0CtrlNtcNr0x051FailStep.Val "MICROSAR RTE" VALUE 0x0 RTE_RL_UWORD 0 NO_COMPU_METHOD 0 65535 SYMBOL_LINK "Rte_CalprmRom_CalRegn01Cmn_DEFAULT_RTE_CALPRM_GROUP.GateDrv0CtrlNtcNr0x051FailStep_Val" 0 DISPLAY_IDENTIFIER GateDrv0Ctrl.CalibrationPorts.GateDrv0CtrlNtcNr0x051FailStep.Val /end CHARACTERISTIC
/begin CHARACTERISTIC GateDrv0Ctrl.GateDrv0CtrlNtcNr0x051PassStep.Val "MICROSAR RTE" VALUE 0x0 RTE_RL_UWORD 0 NO_COMPU_METHOD 0 65535 SYMBOL_LINK "Rte_CalprmRom_CalRegn01Cmn_DEFAULT_RTE_CALPRM_GROUP.GateDrv0CtrlNtcNr0x051PassStep_Val" 0 DISPLAY_IDENTIFIER GateDrv0Ctrl.CalibrationPorts.GateDrv0CtrlNtcNr0x051PassStep.Val /end CHARACTERISTIC
/begin CHARACTERISTIC GateDrv0Ctrl.GateDrv0CtrlNtcNr0x055FailStep.Val "MICROSAR RTE" VALUE 0x0 RTE_RL_UWORD 0 NO_COMPU_METHOD 0 65535 SYMBOL_LINK "Rte_CalprmRom_CalRegn01Cmn_DEFAULT_RTE_CALPRM_GROUP.GateDrv0CtrlNtcNr0x055FailStep_Val" 0 DISPLAY_IDENTIFIER GateDrv0Ctrl.CalibrationPorts.GateDrv0CtrlNtcNr0x055FailStep.Val /end CHARACTERISTIC
/begin CHARACTERISTIC GateDrv0Ctrl.GateDrv0CtrlNtcNr0x055PassStep.Val "MICROSAR RTE" VALUE 0x0 RTE_RL_UWORD 0 NO_COMPU_METHOD 0 65535 SYMBOL_LINK "Rte_CalprmRom_CalRegn01Cmn_DEFAULT_RTE_CALPRM_GROUP.GateDrv0CtrlNtcNr0x055PassStep_Val" 0 DISPLAY_IDENTIFIER GateDrv0Ctrl.CalibrationPorts.GateDrv0CtrlNtcNr0x055PassStep.Val /end CHARACTERISTIC
/begin CHARACTERISTIC GateDrv0Ctrl.GateDrv0CtrlUnit0Cfg2WrVal.Val "MICROSAR RTE" VALUE 0x0 RTE_RL_UWORD 0 NO_COMPU_METHOD 0 65535 SYMBOL_LINK "Rte_CalprmRom_CalRegn01Cmn_DEFAULT_RTE_CALPRM_GROUP.GateDrv0CtrlUnit0Cfg2WrVal_Val" 0 DISPLAY_IDENTIFIER GateDrv0Ctrl.CalibrationPorts.GateDrv0CtrlUnit0Cfg2WrVal.Val /end CHARACTERISTIC
/begin CHARACTERISTIC GateDrv0Ctrl.GateDrv0CtrlUnit0Cfg3WrVal.Val "MICROSAR RTE" VALUE 0x0 RTE_RL_UWORD 0 NO_COMPU_METHOD 0 65535 SYMBOL_LINK "Rte_CalprmRom_CalRegn01Cmn_DEFAULT_RTE_CALPRM_GROUP.GateDrv0CtrlUnit0Cfg3WrVal_Val" 0 DISPLAY_IDENTIFIER GateDrv0Ctrl.CalibrationPorts.GateDrv0CtrlUnit0Cfg3WrVal.Val /end CHARACTERISTIC
/begin CHARACTERISTIC GateDrv0Ctrl.GateDrv0CtrlUnit0Cfg4WrVal.Val "MICROSAR RTE" VALUE 0x0 RTE_RL_UWORD 0 NO_COMPU_METHOD 0 65535 SYMBOL_LINK "Rte_CalprmRom_CalRegn01Cmn_DEFAULT_RTE_CALPRM_GROUP.GateDrv0CtrlUnit0Cfg4WrVal_Val" 0 DISPLAY_IDENTIFIER GateDrv0Ctrl.CalibrationPorts.GateDrv0CtrlUnit0Cfg4WrVal.Val /end CHARACTERISTIC
/begin CHARACTERISTIC GateDrv0Ctrl.GateDrv0CtrlUnit0Cfg7WrVal.Val "MICROSAR RTE" VALUE 0x0 RTE_RL_UWORD 0 NO_COMPU_METHOD 0 65535 SYMBOL_LINK "Rte_CalprmRom_CalRegn01Cmn_DEFAULT_RTE_CALPRM_GROUP.GateDrv0CtrlUnit0Cfg7WrVal_Val" 0 DISPLAY_IDENTIFIER GateDrv0Ctrl.CalibrationPorts.GateDrv0CtrlUnit0Cfg7WrVal.Val /end CHARACTERISTIC
/begin CHARACTERISTIC HiLoadStallLimr.HiLoadStallLimrMotTqCmdFetMtgtnEnaFilFrq.Val "MICROSAR RTE" VALUE 0x0 RTE_RL_FLOAT32_IEEE 0 NO_COMPU_METHOD -3.402823466e+38 3.402823466e+38 SYMBOL_LINK "Rte_CalprmRom_CalRegn02Inin00_DEFAULT_RTE_CALPRM_GROUP.HiLoadStallLimrMotTqCmdFetMtgtnEnaFilFrq_Val" 0 DISPLAY_IDENTIFIER HiLoadStallLimr.CalibrationPorts.HiLoadStallLimrMotTqCmdFetMtgtnEnaFilFrq.Val /end CHARACTERISTIC
/begin CHARACTERISTIC HiLoadStallLimr.HiLoadStallLimrMotTqCmdFilFrq.Val "MICROSAR RTE" VALUE 0x0 RTE_RL_FLOAT32_IEEE 0 NO_COMPU_METHOD -3.402823466e+38 3.402823466e+38 SYMBOL_LINK "Rte_CalprmRom_CalRegn02Inin00_DEFAULT_RTE_CALPRM_GROUP.HiLoadStallLimrMotTqCmdFilFrq_Val" 0 DISPLAY_IDENTIFIER HiLoadStallLimr.CalibrationPorts.HiLoadStallLimrMotTqCmdFilFrq.Val /end CHARACTERISTIC
/begin CHARACTERISTIC HiLoadStallLimr.HiLoadStallLimrMotVelMgnThd.Ary1D "MICROSAR RTE" VAL_BLK 0x0 RTE_RL_FLOAT32_IEEE 0 NO_COMPU_METHOD -3.402823466e+38 3.402823466e+38 MATRIX_DIM 2 1 1 SYMBOL_LINK "Rte_CalprmRom_CalRegn02Inin00_DEFAULT_RTE_CALPRM_GROUP.HiLoadStallLimrMotVelMgnThd_Ary1D" 0 DISPLAY_IDENTIFIER HiLoadStallLimr.CalibrationPorts.HiLoadStallLimrMotVelMgnThd.Ary1D /end CHARACTERISTIC
/begin CHARACTERISTIC HiLoadStallLimr.HiLoadStallLimrStallMotTqCmdFetMtgtnLimX.Ary1D "MICROSAR RTE" VAL_BLK 0x0 RTE_RL_UWORD 0 NO_COMPU_METHOD 0 65535 MATRIX_DIM 6 1 1 SYMBOL_LINK "Rte_CalprmRom_CalRegn02Inin00_DEFAULT_RTE_CALPRM_GROUP.HiLoadStallLimrStallMotTqCmdFetMtgtnLimX_Ary1D" 0 DISPLAY_IDENTIFIER HiLoadStallLimr.CalibrationPorts.HiLoadStallLimrStallMotTqCmdFetMtgtnLimX.Ary1D /end CHARACTERISTIC
/begin CHARACTERISTIC HiLoadStallLimr.HiLoadStallLimrStallMotTqCmdFetMtgtnLimY.Ary1D "MICROSAR RTE" VAL_BLK 0x0 RTE_RL_UWORD 0 NO_COMPU_METHOD 0 65535 MATRIX_DIM 6 1 1 SYMBOL_LINK "Rte_CalprmRom_CalRegn02Inin00_DEFAULT_RTE_CALPRM_GROUP.HiLoadStallLimrStallMotTqCmdFetMtgtnLimY_Ary1D" 0 DISPLAY_IDENTIFIER HiLoadStallLimr.CalibrationPorts.HiLoadStallLimrStallMotTqCmdFetMtgtnLimY.Ary1D /end CHARACTERISTIC
/begin CHARACTERISTIC HiLoadStallLimr.HiLoadStallLimrStallMotTqCmdLimX.Ary1D "MICROSAR RTE" VAL_BLK 0x0 RTE_RL_UWORD 0 NO_COMPU_METHOD 0 65535 MATRIX_DIM 6 1 1 SYMBOL_LINK "Rte_CalprmRom_CalRegn02Inin00_DEFAULT_RTE_CALPRM_GROUP.HiLoadStallLimrStallMotTqCmdLimX_Ary1D" 0 DISPLAY_IDENTIFIER HiLoadStallLimr.CalibrationPorts.HiLoadStallLimrStallMotTqCmdLimX.Ary1D /end CHARACTERISTIC
/begin CHARACTERISTIC HiLoadStallLimr.HiLoadStallLimrStallMotTqCmdLimY.Ary1D "MICROSAR RTE" VAL_BLK 0x0 RTE_RL_UWORD 0 NO_COMPU_METHOD 0 65535 MATRIX_DIM 6 1 1 SYMBOL_LINK "Rte_CalprmRom_CalRegn02Inin00_DEFAULT_RTE_CALPRM_GROUP.HiLoadStallLimrStallMotTqCmdLimY_Ary1D" 0 DISPLAY_IDENTIFIER HiLoadStallLimr.CalibrationPorts.HiLoadStallLimrStallMotTqCmdLimY.Ary1D /end CHARACTERISTIC
/begin CHARACTERISTIC HiLoadStallLimr.HiLoadStallLimrStallMotTqLimSlewRate.Ary1D "MICROSAR RTE" VAL_BLK 0x0 RTE_RL_FLOAT32_IEEE 0 NO_COMPU_METHOD -3.402823466e+38 3.402823466e+38 MATRIX_DIM 2 1 1 SYMBOL_LINK "Rte_CalprmRom_CalRegn02Inin00_DEFAULT_RTE_CALPRM_GROUP.HiLoadStallLimrStallMotTqLimSlewRate_Ary1D" 0 DISPLAY_IDENTIFIER HiLoadStallLimr.CalibrationPorts.HiLoadStallLimrStallMotTqLimSlewRate.Ary1D /end CHARACTERISTIC
/begin CHARACTERISTIC HiLoadStallLimr.HiLoadStallLimrStallThermLimSca.Val "MICROSAR RTE" VALUE 0x0 RTE_RL_FLOAT32_IEEE 0 NO_COMPU_METHOD -3.402823466e+38 3.402823466e+38 SYMBOL_LINK "Rte_CalprmRom_CalRegn02Inin00_DEFAULT_RTE_CALPRM_GROUP.HiLoadStallLimrStallThermLimSca_Val" 0 DISPLAY_IDENTIFIER HiLoadStallLimr.CalibrationPorts.HiLoadStallLimrStallThermLimSca.Val /end CHARACTERISTIC
/begin CHARACTERISTIC HwAg1Meas.HwAg1MeasHwAg1IfFltFailStep.Val "MICROSAR RTE" VALUE 0x0 RTE_RL_UWORD 0 NO_COMPU_METHOD 0 65535 SYMBOL_LINK "Rte_CalprmRom_CalRegn01Inin00_DEFAULT_RTE_CALPRM_GROUP.HwAg1MeasHwAg1IfFltFailStep_Val" 0 DISPLAY_IDENTIFIER HwAg1Meas.CalibrationPorts.HwAg1MeasHwAg1IfFltFailStep.Val /end CHARACTERISTIC
/begin CHARACTERISTIC HwAg1Meas.HwAg1MeasHwAg1IfFltPassStep.Val "MICROSAR RTE" VALUE 0x0 RTE_RL_UWORD 0 NO_COMPU_METHOD 0 65535 SYMBOL_LINK "Rte_CalprmRom_CalRegn01Inin00_DEFAULT_RTE_CALPRM_GROUP.HwAg1MeasHwAg1IfFltPassStep_Val" 0 DISPLAY_IDENTIFIER HwAg1Meas.CalibrationPorts.HwAg1MeasHwAg1IfFltPassStep.Val /end CHARACTERISTIC
/begin CHARACTERISTIC HwAg1Meas.HwAg1MeasHwAg1Snsr0PrtclFltFailStep.Val "MICROSAR RTE" VALUE 0x0 RTE_RL_UWORD 0 NO_COMPU_METHOD 0 65535 SYMBOL_LINK "Rte_CalprmRom_CalRegn01Inin00_DEFAULT_RTE_CALPRM_GROUP.HwAg1MeasHwAg1Snsr0PrtclFltFailStep_Val" 0 DISPLAY_IDENTIFIER HwAg1Meas.CalibrationPorts.HwAg1MeasHwAg1Snsr0PrtclFltFailStep.Val /end CHARACTERISTIC
/begin MEASUREMENT FordMsg4B0BusHiSpd.LaneKeepAssiEnad.Logl "MICROSAR RTE" UBYTE RTE_CM_BOOLEAN 0 0 0 255 ECU_ADDRESS 0 SYMBOL_LINK "Rte_CustDiag_FordLaneKeepAssiEnad_Logl" 0 DISPLAY_IDENTIFIER FordMsg4B0BusHiSpd.ReceiverPorts.LaneKeepAssiEnad.Logl /end MEASUREMENT
/begin MEASUREMENT FordMsg4B0BusHiSpd.MsgFltNtcDiagcRefTi "It is used as the reference time to calculate the elapsed time in NTC diagnostic during which the value in the message is equal to 511" ULONG NO_COMPU_METHOD 0 0 0 4294967295 ECU_ADDRESS 0 SYMBOL_LINK "Rte_FordMsg4B0BusHiSpd_MsgFltNtcDiagcRefTi" 0 DISPLAY_IDENTIFIER FordMsg4B0BusHiSpd.PerInstanceMemories.MsgFltNtcDiagcRefTi /end MEASUREMENT
/begin MEASUREMENT FordMsg4B0BusHiSpd.MsgFltRefTi "It is used as the reference time to calculate the elapsed time during 'which the value in the message is equal to 511" ULONG NO_COMPU_METHOD 0 0 0 4294967295 ECU_ADDRESS 0 SYMBOL_LINK "Rte_FordMsg4B0BusHiSpd_MsgFltRefTi" 0 DISPLAY_IDENTIFIER FordMsg4B0BusHiSpd.PerInstanceMemories.MsgFltRefTi /end MEASUREMENT
/begin MEASUREMENT FordMsg4B0BusHiSpd.MsgMissNtcDiagcRefTi "'It is used as the reference time to calculate the elapsed time in NTC diagnostic during which the message is missing.'" ULONG NO_COMPU_METHOD 0 0 0 4294967295 ECU_ADDRESS 0 SYMBOL_LINK "Rte_FordMsg4B0BusHiSpd_MsgMissNtcDiagcRefTi" 0 DISPLAY_IDENTIFIER FordMsg4B0BusHiSpd.PerInstanceMemories.MsgMissNtcDiagcRefTi /end MEASUREMENT
/begin MEASUREMENT FordMsg4B0BusHiSpd.MsgNoDataExistNtcDiagcRefTi "It is used as the reference time to calculate the elapsed time in NTC diagnostic during which the value in the message is equal to 510" ULONG NO_COMPU_METHOD 0 0 0 4294967295 ECU_ADDRESS 0 SYMBOL_LINK "Rte_FordMsg4B0BusHiSpd_MsgNoDataExistNtcDiagcRefTi" 0 DISPLAY_IDENTIFIER FordMsg4B0BusHiSpd.PerInstanceMemories.MsgNoDataExistNtcDiagcRefTi /end MEASUREMENT
/begin MEASUREMENT FordMsg4B0BusHiSpd.MsgNoDataExistRefTi "It is used as the reference time to calculate the elapsed time during which the value in the message is equal to 510" ULONG NO_COMPU_METHOD 0 0 0 4294967295 ECU_ADDRESS 0 SYMBOL_LINK "Rte_FordMsg4B0BusHiSpd_MsgNoDataExistRefTi" 0 DISPLAY_IDENTIFIER FordMsg4B0BusHiSpd.PerInstanceMemories.MsgNoDataExistRefTi /end MEASUREMENT
/begin MEASUREMENT FordMsg4B0BusHiSpd.MsgNotRxdRefTi "It is used as the reference time to calculate the elapsed time durig which the message is not received" ULONG NO_COMPU_METHOD 0 0 0 4294967295 ECU_ADDRESS 0 SYMBOL_LINK "Rte_FordMsg4B0BusHiSpd_MsgNotRxdRefTi" 0 DISPLAY_IDENTIFIER FordMsg4B0BusHiSpd.PerInstanceMemories.MsgNotRxdRefTi /end MEASUREMENT
/begin MEASUREMENT FordMsg4B0BusHiSpd.MsgRxdNtcDiagcRefTi "It is used as the reference time to calculate the elapsed time in NTC diagnostic during which the message is received" ULONG NO_COMPU_METHOD 0 0 0 4294967295 ECU_ADDRESS 0 SYMBOL_LINK "Rte_FordMsg4B0BusHiSpd_MsgRxdNtcDiagcRefTi" 0 DISPLAY_IDENTIFIER FordMsg4B0BusHiSpd.PerInstanceMemories.MsgRxdNtcDiagcRefTi /end MEASUREMENT
/begin MEASUREMENT FordMsg4B0BusHiSpd.MsgVldNtcDiagcRefTi "It is used as the reference time to calculate the elapsed time in NTC diagnostic during which the value in the message is less than 510" ULONG NO_COMPU_METHOD 0 0 0 4294967295 ECU_ADDRESS 0 SYMBOL_LINK "Rte_FordMsg4B0BusHiSpd_MsgVldNtcDiagcRefTi" 0 DISPLAY_IDENTIFIER FordMsg4B0BusHiSpd.PerInstanceMemories.MsgVldNtcDiagcRefTi /end MEASUREMENT
/begin MEASUREMENT FordMsg4B0BusHiSpd.MsgVldRefTi "It is used as the reference time to calculate the elapsed time during which the value in the message is less than 510" ULONG NO_COMPU_METHOD 0 0 0 4294967295 ECU_ADDRESS 0 SYMBOL_LINK "Rte_FordMsg4B0BusHiSpd_MsgVldRefTi" 0 DISPLAY_IDENTIFIER FordMsg4B0BusHiSpd.PerInstanceMemories.MsgVldRefTi /end MEASUREMENT
/begin MEASUREMENT FordMsg4B0BusHiSpd.TrfcJamAssiEnad.Logl "MICROSAR RTE" UBYTE RTE_CM_BOOLEAN 0 0 0 255 ECU_ADDRESS 0 SYMBOL_LINK "Rte_CustDiag_FordTrfcJamAssiEnad_Logl" 0 DISPLAY_IDENTIFIER FordMsg4B0BusHiSpd.ReceiverPorts.TrfcJamAssiEnad.Logl /end MEASUREMENT
/begin MEASUREMENT FordMsg5B5BusHiSpd.Ford_PSCM_AutoSarNMControl.Val "MICROSAR RTE" UBYTE NO_COMPU_METHOD 0 0 0 255 ECU_ADDRESS 0 SYMBOL_LINK "Rte_FordMsg5B5BusHiSpd_Ford_PSCM_AutoSarNMControl_Val" 0 DISPLAY_IDENTIFIER FordMsg5B5BusHiSpd.SenderPorts.Ford_PSCM_AutoSarNMControl.Val /end MEASUREMENT
/begin MEASUREMENT FordMsg5B5BusHiSpd.Ford_PSCM_AutoSarNMNodeId.Val "MICROSAR RTE" UBYTE NO_COMPU_METHOD 0 0 0 255 ECU_ADDRESS 0 SYMBOL_LINK "Rte_FordMsg5B5BusHiSpd_Ford_PSCM_AutoSarNMNodeId_Val" 0 DISPLAY_IDENTIFIER FordMsg5B5BusHiSpd.SenderPorts.Ford_PSCM_AutoSarNMNodeId.Val /end MEASUREMENT
/begin MEASUREMENT FordMsg5B5BusHiSpd.Ford_PSCM_AutoSarNMReserved1.Val "MICROSAR RTE" UBYTE NO_COMPU_METHOD 0 0 0 255 ECU_ADDRESS 0 SYMBOL_LINK "Rte_FordMsg5B5BusHiSpd_Ford_PSCM_AutoSarNMReserved1_Val" 0 DISPLAY_IDENTIFIER FordMsg5B5BusHiSpd.SenderPorts.Ford_PSCM_AutoSarNMReserved1.Val /end MEASUREMENT
/begin MEASUREMENT FordMsg5B5BusHiSpd.Ford_PSCM_AutoSarNMReserved2.Val "MICROSAR RTE" UBYTE NO_COMPU_METHOD 0 0 0 255 ECU_ADDRESS 0 SYMBOL_LINK "Rte_FordMsg5B5BusHiSpd_Ford_PSCM_AutoSarNMReserved2_Val" 0 DISPLAY_IDENTIFIER FordMsg5B5BusHiSpd.SenderPorts.Ford_PSCM_AutoSarNMReserved2.Val /end MEASUREMENT
/begin MEASUREMENT FordMsg5B5BusHiSpd.Ford_PSCM_AutoSarNMReserved3.Val "MICROSAR RTE" UBYTE NO_COMPU_METHOD 0 0 0 255 ECU_ADDRESS 0 SYMBOL_LINK "Rte_FordMsg5B5BusHiSpd_Ford_PSCM_AutoSarNMReserved3_Val" 0 DISPLAY_IDENTIFIER FordMsg5B5BusHiSpd.SenderPorts.Ford_PSCM_AutoSarNMReserved3.Val /end MEASUREMENT
/begin MEASUREMENT FordMsg5B5BusHiSpd.Ford_PSCM_AutoSarNMReserved4.Val "MICROSAR RTE" UBYTE NO_COMPU_METHOD 0 0 0 255 ECU_ADDRESS 0 SYMBOL_LINK "Rte_FordMsg5B5BusHiSpd_Ford_PSCM_AutoSarNMReserved4_Val" 0 DISPLAY_IDENTIFIER FordMsg5B5BusHiSpd.SenderPorts.Ford_PSCM_AutoSarNMReserved4.Val /end MEASUREMENT
/begin MEASUREMENT FordMsg5B5BusHiSpd.Ford_PSCM_GWNMProxy.Val "MICROSAR RTE" UBYTE NO_COMPU_METHOD 0 0 0 255 ECU_ADDRESS 0 SYMBOL_LINK "Rte_FordMsg5B5BusHiSpd_Ford_PSCM_GWNMProxy_Val" 0 DISPLAY_IDENTIFIER FordMsg5B5BusHiSpd.SenderPorts.Ford_PSCM_GWNMProxy.Val /end MEASUREMENT
/begin MEASUREMENT FordMsg5B5BusHiSpd.Ford_PSCM_GWOnBoardTester.Val "MICROSAR RTE" UBYTE NO_COMPU_METHOD 0 0 0 255 ECU_ADDRESS 0 SYMBOL_LINK "Rte_FordMsg5B5BusHiSpd_Ford_PSCM_GWOnBoardTester_Val" 0 DISPLAY_IDENTIFIER FordMsg5B5BusHiSpd.SenderPorts.Ford_PSCM_GWOnBoardTester.Val /end MEASUREMENT
/begin MEASUREMENT FordMsg5B5BusHiSpd.PwrSteerCtrlModlArNmCtrlPrev "MICROSAR RTE" UBYTE NO_COMPU_METHOD 0 0 0 255 ECU_ADDRESS 0 SYMBOL_LINK "Rte_FordMsg5B5BusHiSpd_PwrSteerCtrlModlArNmCtrlPrev" 0 DISPLAY_IDENTIFIER FordMsg5B5BusHiSpd.PerInstanceMemories.PwrSteerCtrlModlArNmCtrlPrev /end MEASUREMENT
/begin MEASUREMENT FordMsg5B5BusHiSpd.PwrSteerCtrlModlArNmNodIdnPrev "MICROSAR RTE" UBYTE NO_COMPU_METHOD 0 0 0 255 ECU_ADDRESS 0 SYMBOL_LINK "Rte_FordMsg5B5BusHiSpd_PwrSteerCtrlModlArNmNodIdnPrev" 0 DISPLAY_IDENTIFIER FordMsg5B5BusHiSpd.PerInstanceMemories.PwrSteerCtrlModlArNmNodIdnPrev /end MEASUREMENT
/begin MEASUREMENT FordMsg5B5BusHiSpd.PwrSteerCtrlModlArNmResd1Prev "MICROSAR RTE" UBYTE NO_COMPU_METHOD 0 0 0 255 ECU_ADDRESS 0 SYMBOL_LINK "Rte_FordMsg5B5BusHiSpd_PwrSteerCtrlModlArNmResd1Prev" 0 DISPLAY_IDENTIFIER FordMsg5B5BusHiSpd.PerInstanceMemories.PwrSteerCtrlModlArNmResd1Prev /end MEASUREMENT
/begin MEASUREMENT FordMsg5B5BusHiSpd.PwrSteerCtrlModlArNmResd2Prev "MICROSAR RTE" UBYTE NO_COMPU_METHOD 0 0 0 255 ECU_ADDRESS 0 SYMBOL_LINK "Rte_FordMsg5B5BusHiSpd_PwrSteerCtrlModlArNmResd2Prev" 0 DISPLAY_IDENTIFIER FordMsg5B5BusHiSpd.PerInstanceMemories.PwrSteerCtrlModlArNmResd2Prev /end MEASUREMENT
/begin MEASUREMENT FordMsg5B5BusHiSpd.PwrSteerCtrlModlArNmResd3Prev "MICROSAR RTE" UBYTE NO_COMPU_METHOD 0 0 0 255 ECU_ADDRESS 0 SYMBOL_LINK "Rte_FordMsg5B5BusHiSpd_PwrSteerCtrlModlArNmResd3Prev" 0 DISPLAY_IDENTIFIER FordMsg5B5BusHiSpd.PerInstanceMemories.PwrSteerCtrlModlArNmResd3Prev /end MEASUREMENT
/begin MEASUREMENT FordMsg5B5BusHiSpd.PwrSteerCtrlModlArNmResd4Prev "MICROSAR RTE" UBYTE NO_COMPU_METHOD 0 0 0 255 ECU_ADDRESS 0 SYMBOL_LINK "Rte_FordMsg5B5BusHiSpd_PwrSteerCtrlModlArNmResd4Prev" 0 DISPLAY_IDENTIFIER FordMsg5B5BusHiSpd.PerInstanceMemories.PwrSteerCtrlModlArNmResd4Prev /end MEASUREMENT
/begin MEASUREMENT FordMsg5B5BusHiSpd.PwrSteerCtrlModlGatewyNmOnBdTestPrev "MICROSAR RTE" UBYTE NO_COMPU_METHOD 0 0 0 255 ECU_ADDRESS 0 SYMBOL_LINK "Rte_FordMsg5B5BusHiSpd_PwrSteerCtrlModlGatewyNmOnBdTestPrev" 0 DISPLAY_IDENTIFIER FordMsg5B5BusHiSpd.PerInstanceMemories.PwrSteerCtrlModlGatewyNmOnBdTestPrev /end MEASUREMENT
/begin MEASUREMENT FordMsg5B5BusHiSpd.PwrSteerCtrlModlGatewyNmProxyPrev "MICROSAR RTE" UBYTE NO_COMPU_METHOD 0 0 0 255 ECU_ADDRESS 0 SYMBOL_LINK "Rte_FordMsg5B5BusHiSpd_PwrSteerCtrlModlGatewyNmProxyPrev" 0 DISPLAY_IDENTIFIER FordMsg5B5BusHiSpd.PerInstanceMemories.PwrSteerCtrlModlGatewyNmProxyPrev /end MEASUREMENT
/begin MEASUREMENT FordSysSt.EngOnSerlComSrvDft.Logl "MICROSAR RTE" UBYTE RTE_CM_BOOLEAN 0 0 0 255 ECU_ADDRESS 0 SYMBOL_LINK "Rte_CmnMfgSrv_SysStReqEnaOvrd_Logl" 0 DISPLAY_IDENTIFIER FordSysSt.ReceiverPorts.EngOnSerlComSrvDft.Logl /end MEASUREMENT
/begin MEASUREMENT FordSysSt.FordEpsFailr.Ford_EPAS_Failure "MICROSAR RTE" UBYTE RTE_CM_ENUM_Ford_EPAS_Failure 0 0 0 3 ECU_ADDRESS 0 SYMBOL_LINK "Rte_FordSysSt_FordEpsFailr_Ford_EPAS_Failure" 0 DISPLAY_IDENTIFIER FordSysSt.SenderPorts.FordEpsFailr.Ford_EPAS_Failure /end MEASUREMENT
/begin MEASUREMENT FordSysSt.FordEpsFailrPrev "MICROSAR RTE" UBYTE RTE_CM_ENUM_Ford_EPAS_Failure 0 0 0 3 ECU_ADDRESS 0 SYMBOL_LINK "Rte_FordSysSt_FordEpsFailrPrev" 0 DISPLAY_IDENTIFIER FordSysSt.PerInstanceMemories.FordEpsFailrPrev /end MEASUREMENT
/begin MEASUREMENT FordSysSt.FordEpsSysSt.Val "MICROSAR RTE" UBYTE RTE_CM_ENUM_FordEpsSysSt1 0 0 0 255 ECU_ADDRESS 0 SYMBOL_LINK "Rte_FordSysSt_FordEpsSysSt_Val" 0 DISPLAY_IDENTIFIER FordSysSt.SenderPorts.FordEpsSysSt.Val /end MEASUREMENT
/begin MEASUREMENT FordSysSt.FordEpsSysStPrev "MICROSAR RTE" UBYTE RTE_CM_ENUM_FordEpsSysSt1 0 0 0 255 ECU_ADDRESS 0 SYMBOL_LINK "Rte_FordSysSt_FordEpsSysStPrev" 0 DISPLAY_IDENTIFIER FordSysSt.PerInstanceMemories.FordEpsSysStPrev /end MEASUREMENT
/begin MEASUREMENT FordSysSt.FordPwrSplyEnaReq.Logl "MICROSAR RTE" UBYTE RTE_CM_BOOLEAN 0 0 0 255 ECU_ADDRESS 0 SYMBOL_LINK "Rte_FordSysSt_FordPwrSplyEnaReq_Logl" 0 DISPLAY_IDENTIFIER FordSysSt.SenderPorts.FordPwrSplyEnaReq.Logl /end MEASUREMENT
/begin MEASUREMENT FordSysSt.FordSteerModlSts.Ford_SteMdule_D_Stat "MICROSAR RTE" UBYTE RTE_CM_ENUM_Ford_SteMdule_D_Stat 0 0 0 7 ECU_ADDRESS 0 SYMBOL_LINK "Rte_FordSysSt_FordSteerModlSts_Ford_SteMdule_D_Stat" 0 DISPLAY_IDENTIFIER FordSysSt.SenderPorts.FordSteerModlSts.Ford_SteMdule_D_Stat /end MEASUREMENT
/begin MEASUREMENT FordSysSt.FordSteerModlStsPrev "MICROSAR RTE" UBYTE RTE_CM_ENUM_Ford_SteMdule_D_Stat 0 0 0 7 ECU_ADDRESS 0 SYMBOL_LINK "Rte_FordSysSt_FordSteerModlStsPrev" 0 DISPLAY_IDENTIFIER FordSysSt.PerInstanceMemories.FordSteerModlStsPrev /end MEASUREMENT
/begin MEASUREMENT FordSysSt.FordVehPwrpkTqSts.Ford_PwPckTq_D_Stat "MICROSAR RTE" UBYTE RTE_CM_ENUM_Ford_PwPckTq_D_Stat 0 0 0 3 ECU_ADDRESS 0 SYMBOL_LINK "Rte_FordMsg167BusHiSpd_FordVehPwrpkTqSts_Ford_PwPckTq_D_Stat" 0 DISPLAY_IDENTIFIER FordSysSt.ReceiverPorts.FordVehPwrpkTqSts.Ford_PwPckTq_D_Stat /end MEASUREMENT
/begin MEASUREMENT FordSysSt.FordVehSpd.Val "MICROSAR RTE" FLOAT32_IEEE NO_COMPU_METHOD 0 0 -3.402823466e+38 3.402823466e+38 ECU_ADDRESS 0 SYMBOL_LINK "Rte_ImcSigArbn_VehSpdImcCorrd_Val" 0 DISPLAY_IDENTIFIER FordSysSt.ReceiverPorts.FordVehSpd.Val /end MEASUREMENT
/begin MEASUREMENT FordSysSt.FordVehSpdVld.Logl "MICROSAR RTE" UBYTE RTE_CM_BOOLEAN 0 0 0 255 ECU_ADDRESS 0 SYMBOL_LINK "Rte_VehSigCdng_VehSpdVld_Logl" 0 DISPLAY_IDENTIFIER FordSysSt.ReceiverPorts.FordVehSpdVld.Logl /end MEASUREMENT
/begin MEASUREMENT FordSysSt.FordVltgOperRamp "MICROSAR RTE" FLOAT32_IEEE NO_COMPU_METHOD 0 0 -3.402823466e+38 3.402823466e+38 ECU_ADDRESS 0 SYMBOL_LINK "Rte_FordSysSt_FordVltgOperRamp" 0 DISPLAY_IDENTIFIER FordSysSt.PerInstanceMemories.FordVltgOperRamp /end MEASUREMENT
/begin MEASUREMENT FordSysSt.FordVltgOperRamp.Val "MICROSAR RTE" FLOAT32_IEEE NO_COMPU_METHOD 0 0 -3.402823466e+38 3.402823466e+38 ECU_ADDRESS 0 SYMBOL_LINK "Rte_FordVltgIf_FordVltgOperRamp_Val" 0 DISPLAY_IDENTIFIER FordSysSt.ReceiverPorts.FordVltgOperRamp.Val /end MEASUREMENT
/begin MEASUREMENT FordSysSt.FordVltgOperScar "MICROSAR RTE" FLOAT32_IEEE NO_COMPU_METHOD 0 0 -3.402823466e+38 3.402823466e+38 ECU_ADDRESS 0 SYMBOL_LINK "Rte_FordSysSt_FordVltgOperScar" 0 DISPLAY_IDENTIFIER FordSysSt.PerInstanceMemories.FordVltgOperScar /end MEASUREMENT
/begin MEASUREMENT FordSysSt.FordVltgOperScar.Val "MICROSAR RTE" FLOAT32_IEEE NO_COMPU_METHOD 0 0 -3.402823466e+38 3.402823466e+38 ECU_ADDRESS 0 SYMBOL_LINK "Rte_FordVltgIf_FordVltgOperScar_Val" 0 DISPLAY_IDENTIFIER FordSysSt.ReceiverPorts.FordVltgOperScar.Val /end MEASUREMENT
/begin MEASUREMENT FordSysSt.FordVltgOperSt.Val "MICROSAR RTE" UBYTE RTE_CM_ENUM_FordVltgOperSt1 0 0 0 255 ECU_ADDRESS 0 SYMBOL_LINK "Rte_FordVltgIf_FordVltgOperSt_Val" 0 DISPLAY_IDENTIFIER FordSysSt.ReceiverPorts.FordVltgOperSt.Val /end MEASUREMENT
/begin MEASUREMENT FordSysSt.LoaSt.Val "MICROSAR RTE" UBYTE RTE_CM_ENUM_LoaSt1 0 0 0 255 ECU_ADDRESS 0 SYMBOL_LINK "Rte_LoaMgr_LoaSt_Val" 0 DISPLAY_IDENTIFIER FordSysSt.ReceiverPorts.LoaSt.Val /end MEASUREMENT
/begin MEASUREMENT FordSysSt.OperRampRate.Val "MICROSAR RTE" FLOAT32_IEEE NO_COMPU_METHOD 0 0 -3.402823466e+38 3.402823466e+38 ECU_ADDRESS 0 SYMBOL_LINK "Rte_FordSysSt_OperRampRate_Val" 0 DISPLAY_IDENTIFIER FordSysSt.SenderPorts.OperRampRate.Val /end MEASUREMENT
/begin MEASUREMENT FordSysSt.OperRampRatePrev "MICROSAR RTE" FLOAT32_IEEE NO_COMPU_METHOD 0 0 -3.402823466e+38 3.402823466e+38 ECU_ADDRESS 0 SYMBOL_LINK "Rte_FordSysSt_OperRampRatePrev" 0 DISPLAY_IDENTIFIER FordSysSt.PerInstanceMemories.OperRampRatePrev /end MEASUREMENT
/begin MEASUREMENT FordSysSt.OperScaFctr.Val "MICROSAR RTE" FLOAT32_IEEE NO_COMPU_METHOD 0 0 -3.402823466e+38 3.402823466e+38 ECU_ADDRESS 0 SYMBOL_LINK "Rte_FordSysSt_OperScaFctr_Val" 0 DISPLAY_IDENTIFIER FordSysSt.SenderPorts.OperScaFctr.Val /end MEASUREMENT
/begin MEASUREMENT FordSysSt.OperScaFctrPrev "MICROSAR RTE" FLOAT32_IEEE NO_COMPU_METHOD 0 0 -3.402823466e+38 3.402823466e+38 ECU_ADDRESS 0 SYMBOL_LINK "Rte_FordSysSt_OperScaFctrPrev" 0 DISPLAY_IDENTIFIER FordSysSt.PerInstanceMemories.OperScaFctrPrev /end MEASUREMENT
/begin MEASUREMENT FordSysSt.SysSt.Val "MICROSAR RTE" UBYTE RTE_CM_ENUM_SysSt1 0 0 0 255 ECU_ADDRESS 0 SYMBOL_LINK "Rte_SysStMod_SysSt_Val" 0 DISPLAY_IDENTIFIER FordSysSt.ReceiverPorts.SysSt.Val /end MEASUREMENT
/begin MEASUREMENT FordSysSt.SysStReqEna.Logl "MICROSAR RTE" UBYTE RTE_CM_BOOLEAN 0 0 0 255 ECU_ADDRESS 0 SYMBOL_LINK "Rte_FordSysSt_SysStReqEna_Logl" 0 DISPLAY_IDENTIFIER FordSysSt.SenderPorts.SysStReqEna.Logl /end MEASUREMENT
/begin MEASUREMENT FordSysSt.SysStReqEnaOvrd.Logl "MICROSAR RTE" UBYTE RTE_CM_BOOLEAN 0 0 0 255 ECU_ADDRESS 0 SYMBOL_LINK "Rte_CmnMfgSrv_SysStReqEnaOvrd_Logl" 0 DISPLAY_IDENTIFIER FordSysSt.ReceiverPorts.SysStReqEnaOvrd.Logl /end MEASUREMENT
/begin MEASUREMENT FordSysSt.SysStReqEnaPrev "MICROSAR RTE" UBYTE RTE_CM_BOOLEAN 0 0 0 255 ECU_ADDRESS 0 SYMBOL_LINK "Rte_FordSysSt_SysStReqEnaPrev" 0 DISPLAY_IDENTIFIER FordSysSt.PerInstanceMemories.SysStReqEnaPrev /end MEASUREMENT
/begin MEASUREMENT FordSysSt.SysStWrmIninCmpl.Logl "MICROSAR RTE" UBYTE RTE_CM_BOOLEAN 0 0 0 255 ECU_ADDRESS 0 SYMBOL_LINK "Rte_PwrUpSeq_SysStWrmIninCmpl_Logl" 0 DISPLAY_IDENTIFIER FordSysSt.ReceiverPorts.SysStWrmIninCmpl.Logl /end MEASUREMENT
/begin MEASUREMENT FordVehSpdArbn.FordAbsModlPrsnt.Logl "MICROSAR RTE" UBYTE RTE_CM_BOOLEAN 0 0 0 255 ECU_ADDRESS 0 SYMBOL_LINK "Rte_CustDiag_FordAbsPrsnt_Logl" 0 DISPLAY_IDENTIFIER FordVehSpdArbn.ReceiverPorts.FordAbsModlPrsnt.Logl /end MEASUREMENT
/begin MEASUREMENT FordVehSpdArbn.FordEscModlPrsnt.Logl "MICROSAR RTE" UBYTE RTE_CM_BOOLEAN 0 0 0 255 ECU_ADDRESS 0 SYMBOL_LINK "Rte_CustDiag_FordEscPrsnt_Logl" 0 DISPLAY_IDENTIFIER FordVehSpdArbn.ReceiverPorts.FordEscModlPrsnt.Logl /end MEASUREMENT
/begin MEASUREMENT FordVehSpdArbn.FordVehFrntLeWhlSpd.Val "MICROSAR RTE" FLOAT32_IEEE NO_COMPU_METHOD 0 0 -3.402823466e+38 3.402823466e+38 ECU_ADDRESS 0 SYMBOL_LINK "Rte_FordMsg217BusHiSpd_FordVehFrntLeWhlSpd_Val" 0 DISPLAY_IDENTIFIER FordVehSpdArbn.ReceiverPorts.FordVehFrntLeWhlSpd.Val /end MEASUREMENT
/begin MEASUREMENT FordVehSpdArbn.FordVehFrntLeWhlSpdVld.Logl "MICROSAR RTE" UBYTE RTE_CM_BOOLEAN 0 0 0 255 ECU_ADDRESS 0 SYMBOL_LINK "Rte_FordMsg217BusHiSpd_FordVehFrntLeWhlSpdVld_Logl" 0 DISPLAY_IDENTIFIER FordVehSpdArbn.ReceiverPorts.FordVehFrntLeWhlSpdVld.Logl /end MEASUREMENT
/begin MEASUREMENT FordVehSpdArbn.FordVehFrntRiWhlSpd.Val "MICROSAR RTE" FLOAT32_IEEE NO_COMPU_METHOD 0 0 -3.402823466e+38 3.402823466e+38 ECU_ADDRESS 0 SYMBOL_LINK "Rte_FordMsg217BusHiSpd_FordVehFrntRiWhlSpd_Val" 0 DISPLAY_IDENTIFIER FordVehSpdArbn.ReceiverPorts.FordVehFrntRiWhlSpd.Val /end MEASUREMENT
/begin MEASUREMENT FordVehSpdArbn.FordVehFrntRiWhlSpdVld.Logl "MICROSAR RTE" UBYTE RTE_CM_BOOLEAN 0 0 0 255 ECU_ADDRESS 0 SYMBOL_LINK "Rte_FordMsg217BusHiSpd_FordVehFrntRiWhlSpdVld_Logl" 0 DISPLAY_IDENTIFIER FordVehSpdArbn.ReceiverPorts.FordVehFrntRiWhlSpdVld.Logl /end MEASUREMENT
/begin MEASUREMENT FordVehSpdArbn.FordVehReLeWhlSpd.Val "MICROSAR RTE" FLOAT32_IEEE NO_COMPU_METHOD 0 0 -3.402823466e+38 3.402823466e+38 ECU_ADDRESS 0 SYMBOL_LINK "Rte_FordMsg217BusHiSpd_FordVehReLeWhlSpd_Val" 0 DISPLAY_IDENTIFIER FordVehSpdArbn.ReceiverPorts.FordVehReLeWhlSpd.Val /end MEASUREMENT
/begin MEASUREMENT FordVehSpdArbn.FordVehReLeWhlSpdVld.Logl "MICROSAR RTE" UBYTE RTE_CM_BOOLEAN 0 0 0 255 ECU_ADDRESS 0 SYMBOL_LINK "Rte_FordMsg217BusHiSpd_FordVehReLeWhlSpdVld_Logl" 0 DISPLAY_IDENTIFIER FordVehSpdArbn.ReceiverPorts.FordVehReLeWhlSpdVld.Logl /end MEASUREMENT
/begin MEASUREMENT FordVehSpdArbn.FordVehReRiWhlSpd.Val "MICROSAR RTE" FLOAT32_IEEE NO_COMPU_METHOD 0 0 -3.402823466e+38 3.402823466e+38 ECU_ADDRESS 0 SYMBOL_LINK "Rte_FordMsg217BusHiSpd_FordVehReRiWhlSpd_Val" 0 DISPLAY_IDENTIFIER FordVehSpdArbn.ReceiverPorts.FordVehReRiWhlSpd.Val /end MEASUREMENT
/begin MEASUREMENT FordVehSpdArbn.FordVehReRiWhlSpdVld.Logl "MICROSAR RTE" UBYTE RTE_CM_BOOLEAN 0 0 0 255 ECU_ADDRESS 0 SYMBOL_LINK "Rte_FordMsg217BusHiSpd_FordVehReRiWhlSpdVld_Logl" 0 DISPLAY_IDENTIFIER FordVehSpdArbn.ReceiverPorts.FordVehReRiWhlSpdVld.Logl /end MEASUREMENT
/begin MEASUREMENT FordVehSpdArbn.FordVehSpd.Val "MICROSAR RTE" FLOAT32_IEEE NO_COMPU_METHOD 0 0 -3.402823466e+38 3.402823466e+38 ECU_ADDRESS 0 SYMBOL_LINK "Rte_FordVehSpdArbn_FordVehSpd_Val" 0 DISPLAY_IDENTIFIER FordVehSpdArbn.SenderPorts.FordVehSpd.Val /end MEASUREMENT
/begin MEASUREMENT FordVehSpdArbn.FordVehSpdBrkModl.Val "MICROSAR RTE" FLOAT32_IEEE NO_COMPU_METHOD 0 0 -3.402823466e+38 3.402823466e+38 ECU_ADDRESS 0 SYMBOL_LINK "Rte_FordMsg415BusHiSpd_FordVehSpdBrkModl_Val" 0 DISPLAY_IDENTIFIER FordVehSpdArbn.ReceiverPorts.FordVehSpdBrkModl.Val /end MEASUREMENT
/begin MEASUREMENT FordVehSpdArbn.FordVehSpdBrkModlLoQlyVld.Logl "MICROSAR RTE" UBYTE RTE_CM_BOOLEAN 0 0 0 255 ECU_ADDRESS 0 SYMBOL_LINK "Rte_FordMsg415BusHiSpd_FordVehSpdBrkModlLoQlyVld_Logl" 0 DISPLAY_IDENTIFIER FordVehSpdArbn.ReceiverPorts.FordVehSpdBrkModlLoQlyVld.Logl /end MEASUREMENT
/begin MEASUREMENT FordVehSpdArbn.FordVehSpdBrkModlVld.Logl "MICROSAR RTE" UBYTE RTE_CM_BOOLEAN 0 0 0 255 ECU_ADDRESS 0 SYMBOL_LINK "Rte_FordMsg415BusHiSpd_FordVehSpdBrkModlVld_Logl" 0 DISPLAY_IDENTIFIER FordVehSpdArbn.ReceiverPorts.FordVehSpdBrkModlVld.Logl /end MEASUREMENT
/begin MEASUREMENT FordVehSpdArbn.FordVehSpdEngModl.Val "MICROSAR RTE" FLOAT32_IEEE NO_COMPU_METHOD 0 0 -3.402823466e+38 3.402823466e+38 ECU_ADDRESS 0 SYMBOL_LINK "Rte_FordMsg202BusHiSpd_FordVehSpdEngModl_Val" 0 DISPLAY_IDENTIFIER FordVehSpdArbn.ReceiverPorts.FordVehSpdEngModl.Val /end MEASUREMENT
/begin MEASUREMENT FordVehSpdArbn.FordVehSpdEngModlLoQlyVld.Logl "MICROSAR RTE" UBYTE RTE_CM_BOOLEAN 0 0 0 255 ECU_ADDRESS 0 SYMBOL_LINK "Rte_FordMsg202BusHiSpd_FordVehSpdEngModLoQlyVld_Logl" 0 DISPLAY_IDENTIFIER FordVehSpdArbn.ReceiverPorts.FordVehSpdEngModlLoQlyVld.Logl /end MEASUREMENT
/begin MEASUREMENT FordVehSpdArbn.FordVehSpdEngModlVld.Logl "MICROSAR RTE" UBYTE RTE_CM_BOOLEAN 0 0 0 255 ECU_ADDRESS 0 SYMBOL_LINK "Rte_FordMsg202BusHiSpd_FordVehSpdEngModlVld_Logl" 0 DISPLAY_IDENTIFIER FordVehSpdArbn.ReceiverPorts.FordVehSpdEngModlVld.Logl /end MEASUREMENT
/begin MEASUREMENT FordVehSpdArbn.FordVehSpdLoQly.Val "MICROSAR RTE" FLOAT32_IEEE NO_COMPU_METHOD 0 0 -3.402823466e+38 3.402823466e+38 ECU_ADDRESS 0 SYMBOL_LINK "Rte_FordVehSpdArbn_FordVehSpdLoQly_Val" 0 DISPLAY_IDENTIFIER FordVehSpdArbn.SenderPorts.FordVehSpdLoQly.Val /end MEASUREMENT
/begin MEASUREMENT FordVehSpdArbn.FordVehSpdLoQlyVld.Logl "MICROSAR RTE" UBYTE RTE_CM_BOOLEAN 0 0 0 255 ECU_ADDRESS 0 SYMBOL_LINK "Rte_FordVehSpdArbn_FordVehSpdLoQlyVld_Logl" 0 DISPLAY_IDENTIFIER FordVehSpdArbn.SenderPorts.FordVehSpdLoQlyVld.Logl /end MEASUREMENT
/begin MEASUREMENT FordVehSpdArbn.FordVehSpdVld.Logl "MICROSAR RTE" UBYTE RTE_CM_BOOLEAN 0 0 0 255 ECU_ADDRESS 0 SYMBOL_LINK "Rte_FordVehSpdArbn_FordVehSpdVld_Logl" 0 DISPLAY_IDENTIFIER FordVehSpdArbn.SenderPorts.FordVehSpdVld.Logl /end MEASUREMENT
/begin MEASUREMENT FordVehSpdArbn.FordVehTireCircum "MICROSAR RTE" UWORD NO_COMPU_METHOD 0 0 0 65535 ECU_ADDRESS 0 SYMBOL_LINK "Rte_FordVehSpdArbn_FordVehTireCircum" 0 DISPLAY_IDENTIFIER FordVehSpdArbn.PerInstanceMemories.FordVehTireCircum /end MEASUREMENT
/begin MEASUREMENT FordVehSpdArbn.FordVehTireCircumIn.Val "MICROSAR RTE" FLOAT32_IEEE NO_COMPU_METHOD 0 0 -3.402823466e+38 3.402823466e+38 ECU_ADDRESS 0 SYMBOL_LINK "Rte_FordMsg40ABusHiSpd_FordVehTireCircum_Val" 0 DISPLAY_IDENTIFIER FordVehSpdArbn.ReceiverPorts.FordVehTireCircumIn.Val /end MEASUREMENT
/begin MEASUREMENT FordVltgIf.BattRtnCurr.Val "MICROSAR RTE" FLOAT32_IEEE NO_COMPU_METHOD 0 0 -3.402823466e+38 3.402823466e+38 ECU_ADDRESS 0 SYMBOL_LINK "Rte_ElecPwrCns_SplyCurrEstim_Val" 0 DISPLAY_IDENTIFIER FordVltgIf.ReceiverPorts.BattRtnCurr.Val /end MEASUREMENT
/begin MEASUREMENT FordVltgIf.BattVltg.Val "MICROSAR RTE" FLOAT32_IEEE NO_COMPU_METHOD 0 0 -3.402823466e+38 3.402823466e+38 ECU_ADDRESS 0 SYMBOL_LINK "Rte_BattVltg_BrdgVltg_Val" 0 DISPLAY_IDENTIFIER FordVltgIf.ReceiverPorts.BattVltg.Val /end MEASUREMENT
/begin MEASUREMENT FordVltgIf.FeatThdStsRefTi "For Software to keep track of Feature Threshold Status Reference Time" ULONG NO_COMPU_METHOD 0 0 0 4294967295 ECU_ADDRESS 0 SYMBOL_LINK "Rte_FordVltgIf_FeatThdStsRefTi" 0 DISPLAY_IDENTIFIER FordVltgIf.PerInstanceMemories.FeatThdStsRefTi /end MEASUREMENT
/begin MEASUREMENT FordVltgIf.FordActvParkAssiEnad.Logl "MICROSAR RTE" UBYTE RTE_CM_BOOLEAN 0 0 0 255 ECU_ADDRESS 0 SYMBOL_LINK "Rte_CustDiag_FordActvParkAssiEnad_Logl" 0 DISPLAY_IDENTIFIER FordVltgIf.ReceiverPorts.FordActvParkAssiEnad.Logl /end MEASUREMENT
/begin MEASUREMENT FordVltgIf.FordEpsCurr.Val "MICROSAR RTE" FLOAT32_IEEE NO_COMPU_METHOD 0 0 -3.402823466e+38 3.402823466e+38 ECU_ADDRESS 0 SYMBOL_LINK "Rte_FordVltgIf_FordEpsCurr_Val" 0 DISPLAY_IDENTIFIER FordVltgIf.SenderPorts.FordEpsCurr.Val /end MEASUREMENT
/begin MEASUREMENT FordVltgIf.FordEpsCurrVal.Logl "MICROSAR RTE" UBYTE RTE_CM_BOOLEAN 0 0 0 255 ECU_ADDRESS 0 SYMBOL_LINK "Rte_FordVltgIf_FordEpsCurrVal_Logl" 0 DISPLAY_IDENTIFIER FordVltgIf.SenderPorts.FordEpsCurrVal.Logl /end MEASUREMENT
/begin MEASUREMENT FordVltgIf.FordEpsVltg.Val "MICROSAR RTE" FLOAT32_IEEE NO_COMPU_METHOD 0 0 -3.402823466e+38 3.402823466e+38 ECU_ADDRESS 0 SYMBOL_LINK "Rte_FordVltgIf_FordEpsVltg_Val" 0 DISPLAY_IDENTIFIER FordVltgIf.SenderPorts.FordEpsVltg.Val /end MEASUREMENT
/begin MEASUREMENT FordVltgIf.FordEpsVltgVal.Logl "MICROSAR RTE" UBYTE RTE_CM_BOOLEAN 0 0 0 255 ECU_ADDRESS 0 SYMBOL_LINK "Rte_FordVltgIf_FordEpsVltgVal_Logl" 0 DISPLAY_IDENTIFIER FordVltgIf.SenderPorts.FordEpsVltgVal.Logl /end MEASUREMENT
/begin MEASUREMENT FordVltgIf.FordEvasSteerAssiEnad.Logl "MICROSAR RTE" UBYTE RTE_CM_BOOLEAN 0 0 0 255 ECU_ADDRESS 0 SYMBOL_LINK "Rte_CustDiag_FordEvasSteerAssiEnad_Logl" 0 DISPLAY_IDENTIFIER FordVltgIf.ReceiverPorts.FordEvasSteerAssiEnad.Logl /end MEASUREMENT
/begin MEASUREMENT FordVltgIf.FordFeatThdSts.Logl "MICROSAR RTE" UBYTE RTE_CM_BOOLEAN 0 0 0 255 ECU_ADDRESS 0 SYMBOL_LINK "Rte_FordVltgIf_FordFeatThdSts_Logl" 0 DISPLAY_IDENTIFIER FordVltgIf.SenderPorts.FordFeatThdSts.Logl /end MEASUREMENT
/begin MEASUREMENT FordVltgIf.FordInhbBattVltgDiagc.Logl "MICROSAR RTE" UBYTE RTE_CM_BOOLEAN 0 0 0 255 ECU_ADDRESS 0 SYMBOL_LINK "Rte_FordVltgIf_FordInhbBattVltgDiagc_Logl" 0 DISPLAY_IDENTIFIER FordVltgIf.SenderPorts.FordInhbBattVltgDiagc.Logl /end MEASUREMENT
/begin MEASUREMENT FordVltgIf.FordLaneCentrAssiEnad.Logl "MICROSAR RTE" UBYTE RTE_CM_BOOLEAN 0 0 0 255 ECU_ADDRESS 0 SYMBOL_LINK "Rte_CustDiag_FordLaneCentrAssiEnad_Logl" 0 DISPLAY_IDENTIFIER FordVltgIf.ReceiverPorts.FordLaneCentrAssiEnad.Logl /end MEASUREMENT
/begin MEASUREMENT FordVltgIf.FordLaneDprtrWarnEnad.Logl "MICROSAR RTE" UBYTE RTE_CM_BOOLEAN 0 0 0 255 ECU_ADDRESS 0 SYMBOL_LINK "Rte_CustDiag_FordLaneDprtrWarnEnad_Logl" 0 DISPLAY_IDENTIFIER FordVltgIf.ReceiverPorts.FordLaneDprtrWarnEnad.Logl /end MEASUREMENT
/begin MEASUREMENT FordVltgIf.FordLaneKeepAssiEnad.Logl "MICROSAR RTE" UBYTE RTE_CM_BOOLEAN 0 0 0 255 ECU_ADDRESS 0 SYMBOL_LINK "Rte_CustDiag_FordLaneKeepAssiEnad_Logl" 0 DISPLAY_IDENTIFIER FordVltgIf.ReceiverPorts.FordLaneKeepAssiEnad.Logl /end MEASUREMENT
/begin MEASUREMENT FordVltgIf.FordMaxAsscTq.Val "MICROSAR RTE" FLOAT32_IEEE NO_COMPU_METHOD 0 0 -3.402823466e+38 3.402823466e+38 ECU_ADDRESS 0 SYMBOL_LINK "Rte_FordHwTqCdng_FordMaxAsscTq_Val" 0 DISPLAY_IDENTIFIER FordVltgIf.ReceiverPorts.FordMaxAsscTq.Val /end MEASUREMENT
/begin MEASUREMENT FordVltgIf.FordMaxBattCurr.Val "MICROSAR RTE" FLOAT32_IEEE NO_COMPU_METHOD 0 0 -3.402823466e+38 3.402823466e+38 ECU_ADDRESS 0 SYMBOL_LINK "Rte_FordVltgIf_FordMaxBattCurr_Val" 0 DISPLAY_IDENTIFIER FordVltgIf.SenderPorts.FordMaxBattCurr.Val /end MEASUREMENT
/begin MEASUREMENT FordVltgIf.FordMinBattVltg.Val "MICROSAR RTE" FLOAT32_IEEE NO_COMPU_METHOD 0 0 -3.402823466e+38 3.402823466e+38 ECU_ADDRESS 0 SYMBOL_LINK "Rte_FordVltgIf_FordMinBattVltg_Val" 0 DISPLAY_IDENTIFIER FordVltgIf.SenderPorts.FordMinBattVltg.Val /end MEASUREMENT
/begin MEASUREMENT FordVltgIf.FordStrtStopSt.Val "MICROSAR RTE" FLOAT32_IEEE NO_COMPU_METHOD 0 0 -3.402823466e+38 3.402823466e+38 ECU_ADDRESS 0 SYMBOL_LINK "Rte_FordVltgIf_FordStrtStopSt_Val" 0 DISPLAY_IDENTIFIER FordVltgIf.ReceiverPorts.FordStrtStopSt.Val /end MEASUREMENT
/begin MEASUREMENT FordVltgIf.FordSysSt.Val "MICROSAR RTE" UBYTE RTE_CM_ENUM_SysSt1 0 0 0 255 ECU_ADDRESS 0 SYMBOL_LINK "Rte_SysStMod_SysSt_Val" 0 DISPLAY_IDENTIFIER FordVltgIf.ReceiverPorts.FordSysSt.Val /end MEASUREMENT
/begin MEASUREMENT FordVltgIf.FordTrfcJamAssiEnad.Logl "MICROSAR RTE" UBYTE RTE_CM_BOOLEAN 0 0 0 255 ECU_ADDRESS 0 SYMBOL_LINK "Rte_CustDiag_FordTrfcJamAssiEnad_Logl" 0 DISPLAY_IDENTIFIER FordVltgIf.ReceiverPorts.FordTrfcJamAssiEnad.Logl /end MEASUREMENT
/begin MEASUREMENT FordVltgIf.FordTrlrBackupAssiEnad.Logl "MICROSAR RTE" UBYTE RTE_CM_BOOLEAN 0 0 0 255 ECU_ADDRESS 0 SYMBOL_LINK "Rte_FordVltgIf_FordTrlrBackupAssiEnad_Logl" 0 DISPLAY_IDENTIFIER FordVltgIf.ReceiverPorts.FordTrlrBackupAssiEnad.Logl /end MEASUREMENT
/begin MEASUREMENT FordVltgIf.FordVehElecPwrSts.Ford_ElPw_D_Stat "MICROSAR RTE" UBYTE RTE_CM_ENUM_Ford_ElPw_D_Stat 0 0 0 7 ECU_ADDRESS 0 SYMBOL_LINK "Rte_FordMsg167BusHiSpd_FordVehElecPwrSts_Ford_ElPw_D_Stat" 0 DISPLAY_IDENTIFIER FordVltgIf.ReceiverPorts.FordVehElecPwrSts.Ford_ElPw_D_Stat /end MEASUREMENT
/begin MEASUREMENT FordVltgIf.FordVehIgnStsQly.Ford_Ignition_Status "MICROSAR RTE" UBYTE RTE_CM_ENUM_Ford_Ignition_Status 0 0 0 15 ECU_ADDRESS 0 SYMBOL_LINK "Rte_FordMsg3B3BusHiSpd_FordVehIgnSts_Ford_Ignition_Status" 0 DISPLAY_IDENTIFIER FordVltgIf.ReceiverPorts.FordVehIgnStsQly.Ford_Ignition_Status /end MEASUREMENT
/begin MEASUREMENT FordVltgIf.FordVehPwrpkTqSts.Ford_PwPckTq_D_Stat "MICROSAR RTE" UBYTE RTE_CM_ENUM_Ford_PwPckTq_D_Stat 0 0 0 3 ECU_ADDRESS 0 SYMBOL_LINK "Rte_FordMsg167BusHiSpd_FordVehPwrpkTqSts_Ford_PwPckTq_D_Stat" 0 DISPLAY_IDENTIFIER FordVltgIf.ReceiverPorts.FordVehPwrpkTqSts.Ford_PwPckTq_D_Stat /end MEASUREMENT
/begin MEASUREMENT FordVltgIf.FordVehSpd.Val "MICROSAR RTE" FLOAT32_IEEE NO_COMPU_METHOD 0 0 -3.402823466e+38 3.402823466e+38 ECU_ADDRESS 0 SYMBOL_LINK "Rte_ImcSigArbn_VehSpdImcCorrd_Val" 0 DISPLAY_IDENTIFIER FordVltgIf.ReceiverPorts.FordVehSpd.Val /end MEASUREMENT
/begin MEASUREMENT FordVltgIf.FordVehSpdVld.Logl "MICROSAR RTE" UBYTE RTE_CM_BOOLEAN 0 0 0 255 ECU_ADDRESS 0 SYMBOL_LINK "Rte_VehSigCdng_VehSpdVld_Logl" 0 DISPLAY_IDENTIFIER FordVltgIf.ReceiverPorts.FordVehSpdVld.Logl /end MEASUREMENT
/begin MEASUREMENT FordVltgIf.FordVltgOperRamp.Val "MICROSAR RTE" FLOAT32_IEEE NO_COMPU_METHOD 0 0 -3.402823466e+38 3.402823466e+38 ECU_ADDRESS 0 SYMBOL_LINK "Rte_FordVltgIf_FordVltgOperRamp_Val" 0 DISPLAY_IDENTIFIER FordVltgIf.SenderPorts.FordVltgOperRamp.Val /end MEASUREMENT
/begin MEASUREMENT FordVltgIf.FordVltgOperScar.Val "MICROSAR RTE" FLOAT32_IEEE NO_COMPU_METHOD 0 0 -3.402823466e+38 3.402823466e+38 ECU_ADDRESS 0 SYMBOL_LINK "Rte_FordVltgIf_FordVltgOperScar_Val" 0 DISPLAY_IDENTIFIER FordVltgIf.SenderPorts.FordVltgOperScar.Val /end MEASUREMENT
/begin MEASUREMENT FordVltgIf.FordVltgOperSt.Val "MICROSAR RTE" UBYTE RTE_CM_ENUM_FordVltgOperSt1 0 0 0 255 ECU_ADDRESS 0 SYMBOL_LINK "Rte_FordVltgIf_FordVltgOperSt_Val" 0 DISPLAY_IDENTIFIER FordVltgIf.SenderPorts.FordVltgOperSt.Val /end MEASUREMENT
/begin MEASUREMENT FordVltgIf.HiToLoChk "For Software to keep track of High To Low Check" UBYTE NO_COMPU_METHOD 0 0 0 255 ECU_ADDRESS 0 SYMBOL_LINK "Rte_FordVltgIf_HiToLoChk" 0 DISPLAY_IDENTIFIER FordVltgIf.PerInstanceMemories.HiToLoChk /end MEASUREMENT
/begin MEASUREMENT FordVltgIf.HiToMidChk "For Software to keep track of High To Middle Check" UBYTE NO_COMPU_METHOD 0 0 0 255 ECU_ADDRESS 0 SYMBOL_LINK "Rte_FordVltgIf_HiToMidChk" 0 DISPLAY_IDENTIFIER FordVltgIf.PerInstanceMemories.HiToMidChk /end MEASUREMENT
/begin MEASUREMENT FordVltgIf.HiVltgInhbRefTi "For Software to keep track of High Voltage  Inhibit Reference Time" ULONG NO_COMPU_METHOD 0 0 0 4294967295 ECU_ADDRESS 0 SYMBOL_LINK "Rte_FordVltgIf_HiVltgInhbRefTi" 0 DISPLAY_IDENTIFIER FordVltgIf.PerInstanceMemories.HiVltgInhbRefTi /end MEASUREMENT
/begin MEASUREMENT FordVltgIf.HiVltgNoAssiRcvrRefTi "For Software to keep track of High Voltage No Assist Recover Reference Time" ULONG NO_COMPU_METHOD 0 0 0 4294967295 ECU_ADDRESS 0 SYMBOL_LINK "Rte_FordVltgIf_HiVltgNoAssiRcvrRefTi" 0 DISPLAY_IDENTIFIER FordVltgIf.PerInstanceMemories.HiVltgNoAssiRcvrRefTi /end MEASUREMENT
/begin MEASUREMENT FordVltgIf.HiVltgRcvrRefTi "For Software to keep track of High Voltage  Recover Reference Time" ULONG NO_COMPU_METHOD 0 0 0 4294967295 ECU_ADDRESS 0 SYMBOL_LINK "Rte_FordVltgIf_HiVltgRcvrRefTi" 0 DISPLAY_IDENTIFIER FordVltgIf.PerInstanceMemories.HiVltgRcvrRefTi /end MEASUREMENT
/begin MEASUREMENT FordVltgIf.HiVltgRcvrTiMaxRefTi "For Software to keep track of High Voltage  Recover Time Maximum Reference Time" ULONG NO_COMPU_METHOD 0 0 0 4294967295 ECU_ADDRESS 0 SYMBOL_LINK "Rte_FordVltgIf_HiVltgRcvrTiMaxRefTi" 0 DISPLAY_IDENTIFIER FordVltgIf.PerInstanceMemories.HiVltgRcvrTiMaxRefTi /end MEASUREMENT
/begin MEASUREMENT FordVltgIf.InhbBattVltgDiagcRefTi "For Software to keep track of Inhibit Battery Voltage  Diagnostic Reference Time" ULONG NO_COMPU_METHOD 0 0 0 4294967295 ECU_ADDRESS 0 SYMBOL_LINK "Rte_FordVltgIf_InhbBattVltgDiagcRefTi" 0 DISPLAY_IDENTIFIER FordVltgIf.PerInstanceMemories.InhbBattVltgDiagcRefTi /end MEASUREMENT
/begin MEASUREMENT FordVltgIf.LoToHiChk "For Software to keep track of Low To High Check" UBYTE NO_COMPU_METHOD 0 0 0 255 ECU_ADDRESS 0 SYMBOL_LINK "Rte_FordVltgIf_LoToHiChk" 0 DISPLAY_IDENTIFIER FordVltgIf.PerInstanceMemories.LoToHiChk /end MEASUREMENT
/begin MEASUREMENT FordVltgIf.LoToMidChk "For Software to keep track of Low To Middle Check" UBYTE NO_COMPU_METHOD 0 0 0 255 ECU_ADDRESS 0 SYMBOL_LINK "Rte_FordVltgIf_LoToMidChk" 0 DISPLAY_IDENTIFIER FordVltgIf.PerInstanceMemories.LoToMidChk /end MEASUREMENT
/begin MEASUREMENT FordVltgIf.LoVltgInhbRefTi1 "For Software to keep track of Low Voltage  Inhibit Reference Time 1" ULONG NO_COMPU_METHOD 0 0 0 4294967295 ECU_ADDRESS 0 SYMBOL_LINK "Rte_FordVltgIf_LoVltgInhbRefTi1" 0 DISPLAY_IDENTIFIER FordVltgIf.PerInstanceMemories.LoVltgInhbRefTi1 /end MEASUREMENT
/begin MEASUREMENT FordVltgIf.LoVltgInhbRefTi2 "For Software to keep track of Low Voltage  Inhibit Reference Time 2" ULONG NO_COMPU_METHOD 0 0 0 4294967295 ECU_ADDRESS 0 SYMBOL_LINK "Rte_FordVltgIf_LoVltgInhbRefTi2" 0 DISPLAY_IDENTIFIER FordVltgIf.PerInstanceMemories.LoVltgInhbRefTi2 /end MEASUREMENT
/begin MEASUREMENT FordVltgIf.LoVltgInhbRefTi3 "For Software to keep track of Low Voltage  Inhibit Reference Time 3" ULONG NO_COMPU_METHOD 0 0 0 4294967295 ECU_ADDRESS 0 SYMBOL_LINK "Rte_FordVltgIf_LoVltgInhbRefTi3" 0 DISPLAY_IDENTIFIER FordVltgIf.PerInstanceMemories.LoVltgInhbRefTi3 /end MEASUREMENT
/begin MEASUREMENT FordVltgIf.LoVltgNoAssiRcvrRefTi "For Software to keep track of Low Voltage No Assist Recover Reference Time" ULONG NO_COMPU_METHOD 0 0 0 4294967295 ECU_ADDRESS 0 SYMBOL_LINK "Rte_FordVltgIf_LoVltgNoAssiRcvrRefTi" 0 DISPLAY_IDENTIFIER FordVltgIf.PerInstanceMemories.LoVltgNoAssiRcvrRefTi /end MEASUREMENT
/begin MEASUREMENT FordVltgIf.LoVltgRcvrRefTi "For Software to keep track of Low Voltage  Recover Reference Time" ULONG NO_COMPU_METHOD 0 0 0 4294967295 ECU_ADDRESS 0 SYMBOL_LINK "Rte_FordVltgIf_LoVltgRcvrRefTi" 0 DISPLAY_IDENTIFIER FordVltgIf.PerInstanceMemories.LoVltgRcvrRefTi /end MEASUREMENT
/begin MEASUREMENT FordVltgIf.LoVltgRcvrTiMaxRefTi "For Software to keep track of Low Voltage  Recover Time Maximum Reference Time" ULONG NO_COMPU_METHOD 0 0 0 4294967295 ECU_ADDRESS 0 SYMBOL_LINK "Rte_FordVltgIf_LoVltgRcvrTiMaxRefTi" 0 DISPLAY_IDENTIFIER FordVltgIf.PerInstanceMemories.LoVltgRcvrTiMaxRefTi /end MEASUREMENT
/begin MEASUREMENT FordVltgIf.LoVltgThdMidToLoRefTi "For Software to keep track of Low Voltage  Threshold Middle To Low Reference Time" ULONG NO_COMPU_METHOD 0 0 0 4294967295 ECU_ADDRESS 0 SYMBOL_LINK "Rte_FordVltgIf_LoVltgThdMidToLoRefTi" 0 DISPLAY_IDENTIFIER FordVltgIf.PerInstanceMemories.LoVltgThdMidToLoRefTi /end MEASUREMENT
/begin MEASUREMENT FordVltgIf.LoVltgThdMidToLoRefTmr "For Software to keep track of Low Voltage  Threshold Middle To Low Reference Timer" ULONG NO_COMPU_METHOD 0 0 0 4294967295 ECU_ADDRESS 0 SYMBOL_LINK "Rte_FordVltgIf_LoVltgThdMidToLoRefTmr" 0 DISPLAY_IDENTIFIER FordVltgIf.PerInstanceMemories.LoVltgThdMidToLoRefTmr /end MEASUREMENT
/begin MEASUREMENT FordVltgIf.MaxEpsBattCurrPrev "For Software to keep track of Maximum EPS Battery Current Previous" FLOAT32_IEEE NO_COMPU_METHOD 0 0 -3.402823466e+38 3.402823466e+38 ECU_ADDRESS 0 SYMBOL_LINK "Rte_FordVltgIf_MaxEpsBattCurrPrev" 0 DISPLAY_IDENTIFIER FordVltgIf.PerInstanceMemories.MaxEpsBattCurrPrev /end MEASUREMENT
/begin MEASUREMENT FordVltgIf.MidToHiChk "For Software to keep track of Middle To High Check" UBYTE NO_COMPU_METHOD 0 0 0 255 ECU_ADDRESS 0 SYMBOL_LINK "Rte_FordVltgIf_MidToHiChk" 0 DISPLAY_IDENTIFIER FordVltgIf.PerInstanceMemories.MidToHiChk /end MEASUREMENT
/begin MEASUREMENT FordVltgIf.MidToLoChk "For Software to keep track of Middle To Low Check" UBYTE NO_COMPU_METHOD 0 0 0 255 ECU_ADDRESS 0 SYMBOL_LINK "Rte_FordVltgIf_MidToLoChk" 0 DISPLAY_IDENTIFIER FordVltgIf.PerInstanceMemories.MidToLoChk /end MEASUREMENT
/begin MEASUREMENT FordVltgIf.MinBattVltgPrev "For Software to keep track of Minimum Battery Voltage  Previous" FLOAT32_IEEE NO_COMPU_METHOD 0 0 -3.402823466e+38 3.402823466e+38 ECU_ADDRESS 0 SYMBOL_LINK "Rte_FordVltgIf_MinBattVltgPrev" 0 DISPLAY_IDENTIFIER FordVltgIf.PerInstanceMemories.MinBattVltgPrev /end MEASUREMENT
/begin MEASUREMENT FordVltgIf.PrevVltgOperRamp "For Software to keep track of Previous Voltage  Operation Ramp" FLOAT32_IEEE NO_COMPU_METHOD 0 0 -3.402823466e+38 3.402823466e+38 ECU_ADDRESS 0 SYMBOL_LINK "Rte_FordVltgIf_PrevVltgOperRamp" 0 DISPLAY_IDENTIFIER FordVltgIf.PerInstanceMemories.PrevVltgOperRamp /end MEASUREMENT
/begin MEASUREMENT FordVltgIf.PrevVltgOperScar "For Software to keep track of Previous Voltage  Operation Scaler" FLOAT32_IEEE NO_COMPU_METHOD 0 0 -3.402823466e+38 3.402823466e+38 ECU_ADDRESS 0 SYMBOL_LINK "Rte_FordVltgIf_PrevVltgOperScar" 0 DISPLAY_IDENTIFIER FordVltgIf.PerInstanceMemories.PrevVltgOperScar /end MEASUREMENT
/begin MEASUREMENT GateDrv0Ctrl.DiagcStsIvtr1Inactv.Logl "MICROSAR RTE" UBYTE RTE_CM_BOOLEAN 0 0 0 255 ECU_ADDRESS 0 SYMBOL_LINK "Rte_GateDrv0Ctrl_DiagcStsIvtr1Inactv_Logl" 0 DISPLAY_IDENTIFIER GateDrv0Ctrl.SenderPorts.DiagcStsIvtr1Inactv.Logl /end MEASUREMENT
/begin MEASUREMENT GateDrv0Ctrl.GateDrv0CfgCnt "MICROSAR RTE" UBYTE NO_COMPU_METHOD 0 0 0 255 ECU_ADDRESS 0 SYMBOL_LINK "Rte_GateDrv0Ctrl_GateDrv0CfgCnt" 0 DISPLAY_IDENTIFIER GateDrv0Ctrl.PerInstanceMemories.GateDrv0CfgCnt /end MEASUREMENT
/begin MEASUREMENT GateDrv0Ctrl.GateDrv0CfgSecAtmpt "MICROSAR RTE" UBYTE RTE_CM_BOOLEAN 0 0 0 255 ECU_ADDRESS 0 SYMBOL_LINK "Rte_GateDrv0Ctrl_GateDrv0CfgSecAtmpt" 0 DISPLAY_IDENTIFIER GateDrv0Ctrl.PerInstanceMemories.GateDrv0CfgSecAtmpt /end MEASUREMENT
/begin MEASUREMENT GateDrv0Ctrl.GateDrv0Diag0Val "MICROSAR RTE" UWORD NO_COMPU_METHOD 0 0 0 65535 ECU_ADDRESS 0 SYMBOL_LINK "Rte_GateDrv0Ctrl_GateDrv0Diag0Val" 0 DISPLAY_IDENTIFIER GateDrv0Ctrl.PerInstanceMemories.GateDrv0Diag0Val /end MEASUREMENT
/begin MEASUREMENT GateDrv0Ctrl.GateDrv0Diag1Val "MICROSAR RTE" UWORD NO_COMPU_METHOD 0 0 0 65535 ECU_ADDRESS 0 SYMBOL_LINK "Rte_GateDrv0Ctrl_GateDrv0Diag1Val" 0 DISPLAY_IDENTIFIER GateDrv0Ctrl.PerInstanceMemories.GateDrv0Diag1Val /end MEASUREMENT
/begin MEASUREMENT GateDrv0Ctrl.GateDrv0Diag2Val "MICROSAR RTE" UWORD NO_COMPU_METHOD 0 0 0 65535 ECU_ADDRESS 0 SYMBOL_LINK "Rte_GateDrv0Ctrl_GateDrv0Diag2Val" 0 DISPLAY_IDENTIFIER GateDrv0Ctrl.PerInstanceMemories.GateDrv0Diag2Val /end MEASUREMENT
/begin MEASUREMENT GateDrv0Ctrl.GateDrv0OffStChkIdx "MICROSAR RTE" UBYTE NO_COMPU_METHOD 0 0 0 255 ECU_ADDRESS 0 SYMBOL_LINK "Rte_GateDrv0Ctrl_GateDrv0OffStChkIdx" 0 DISPLAY_IDENTIFIER GateDrv0Ctrl.PerInstanceMemories.GateDrv0OffStChkIdx /end MEASUREMENT
/begin MEASUREMENT GateDrv0Ctrl.GateDrv0OffStChkSecAtmpt "MICROSAR RTE" UBYTE RTE_CM_BOOLEAN 0 0 0 255 ECU_ADDRESS 0 SYMBOL_LINK "Rte_GateDrv0Ctrl_GateDrv0OffStChkSecAtmpt" 0 DISPLAY_IDENTIFIER GateDrv0Ctrl.PerInstanceMemories.GateDrv0OffStChkSecAtmpt /end MEASUREMENT
/begin MEASUREMENT GateDrv0Ctrl.GateDrv0OffStCnt "MICROSAR RTE" UBYTE NO_COMPU_METHOD 0 0 0 255 ECU_ADDRESS 0 SYMBOL_LINK "Rte_GateDrv0Ctrl_GateDrv0OffStCnt" 0 DISPLAY_IDENTIFIER GateDrv0Ctrl.PerInstanceMemories.GateDrv0OffStCnt /end MEASUREMENT
/begin MEASUREMENT GateDrv0Ctrl.GateDrv0PhaAFilLp.FilGain "MICROSAR RTE" FLOAT32_IEEE NO_COMPU_METHOD 0 0 -3.402823466e+38 3.402823466e+38 ECU_ADDRESS 0 SYMBOL_LINK "Rte_GateDrv0Ctrl_GateDrv0PhaAFilLp.FilGain" 0 DISPLAY_IDENTIFIER GateDrv0Ctrl.PerInstanceMemories.GateDrv0PhaAFilLp.FilGain /end MEASUREMENT
/begin MEASUREMENT GateDrv0Ctrl.GateDrv0PhaAFilLp.FilSt "MICROSAR RTE" FLOAT32_IEEE NO_COMPU_METHOD 0 0 -3.402823466e+38 3.402823466e+38 ECU_ADDRESS 0 SYMBOL_LINK "Rte_GateDrv0Ctrl_GateDrv0PhaAFilLp.FilSt" 0 DISPLAY_IDENTIFIER GateDrv0Ctrl.PerInstanceMemories.GateDrv0PhaAFilLp.FilSt /end MEASUREMENT
/begin MEASUREMENT GateDrv0Ctrl.GateDrv0PhaBFilLp.FilGain "MICROSAR RTE" FLOAT32_IEEE NO_COMPU_METHOD 0 0 -3.402823466e+38 3.402823466e+38 ECU_ADDRESS 0 SYMBOL_LINK "Rte_GateDrv0Ctrl_GateDrv0PhaBFilLp.FilGain" 0 DISPLAY_IDENTIFIER GateDrv0Ctrl.PerInstanceMemories.GateDrv0PhaBFilLp.FilGain /end MEASUREMENT
/begin MEASUREMENT GateDrv0Ctrl.GateDrv0PhaBFilLp.FilSt "MICROSAR RTE" FLOAT32_IEEE NO_COMPU_METHOD 0 0 -3.402823466e+38 3.402823466e+38 ECU_ADDRESS 0 SYMBOL_LINK "Rte_GateDrv0Ctrl_GateDrv0PhaBFilLp.FilSt" 0 DISPLAY_IDENTIFIER GateDrv0Ctrl.PerInstanceMemories.GateDrv0PhaBFilLp.FilSt /end MEASUREMENT
/begin MEASUREMENT GateDrv0Ctrl.GateDrv0PhaCFilLp.FilGain "MICROSAR RTE" FLOAT32_IEEE NO_COMPU_METHOD 0 0 -3.402823466e+38 3.402823466e+38 ECU_ADDRESS 0 SYMBOL_LINK "Rte_GateDrv0Ctrl_GateDrv0PhaCFilLp.FilGain" 0 DISPLAY_IDENTIFIER GateDrv0Ctrl.PerInstanceMemories.GateDrv0PhaCFilLp.FilGain /end MEASUREMENT
/begin MEASUREMENT GateDrv0Ctrl.GateDrv0PhaCFilLp.FilSt "MICROSAR RTE" FLOAT32_IEEE NO_COMPU_METHOD 0 0 -3.402823466e+38 3.402823466e+38 ECU_ADDRESS 0 SYMBOL_LINK "Rte_GateDrv0Ctrl_GateDrv0PhaCFilLp.FilSt" 0 DISPLAY_IDENTIFIER GateDrv0Ctrl.PerInstanceMemories.GateDrv0PhaCFilLp.FilSt /end MEASUREMENT
/begin MEASUREMENT GateDrv0Ctrl.GateDrv0PhaOnTiSumAPrev "MICROSAR RTE" ULONG NO_COMPU_METHOD 0 0 0 4294967295 ECU_ADDRESS 0 SYMBOL_LINK "Rte_GateDrv0Ctrl_GateDrv0PhaOnTiSumAPrev" 0 DISPLAY_IDENTIFIER GateDrv0Ctrl.PerInstanceMemories.GateDrv0PhaOnTiSumAPrev /end MEASUREMENT
/begin MEASUREMENT GateDrv0Ctrl.GateDrv0PhaOnTiSumBPrev "MICROSAR RTE" ULONG NO_COMPU_METHOD 0 0 0 4294967295 ECU_ADDRESS 0 SYMBOL_LINK "Rte_GateDrv0Ctrl_GateDrv0PhaOnTiSumBPrev" 0 DISPLAY_IDENTIFIER GateDrv0Ctrl.PerInstanceMemories.GateDrv0PhaOnTiSumBPrev /end MEASUREMENT
/begin MEASUREMENT GateDrv0Ctrl.GateDrv0PhaOnTiSumCPrev "MICROSAR RTE" ULONG NO_COMPU_METHOD 0 0 0 4294967295 ECU_ADDRESS 0 SYMBOL_LINK "Rte_GateDrv0Ctrl_GateDrv0PhaOnTiSumCPrev" 0 DISPLAY_IDENTIFIER GateDrv0Ctrl.PerInstanceMemories.GateDrv0PhaOnTiSumCPrev /end MEASUREMENT
/begin MEASUREMENT GateDrv0Ctrl.GateDrv0SpiErrSecAtmpt "MICROSAR RTE" UBYTE RTE_CM_BOOLEAN 0 0 0 255 ECU_ADDRESS 0 SYMBOL_LINK "Rte_GateDrv0Ctrl_GateDrv0SpiErrSecAtmpt" 0 DISPLAY_IDENTIFIER GateDrv0Ctrl.PerInstanceMemories.GateDrv0SpiErrSecAtmpt /end MEASUREMENT
/begin MEASUREMENT GateDrv0Ctrl.GateDrv0SpiTrsmErrCntr "MICROSAR RTE" ULONG NO_COMPU_METHOD 0 0 0 4294967295 ECU_ADDRESS 0 SYMBOL_LINK "Rte_GateDrv0Ctrl_GateDrv0SpiTrsmErrCntr" 0 DISPLAY_IDENTIFIER GateDrv0Ctrl.PerInstanceMemories.GateDrv0SpiTrsmErrCntr /end MEASUREMENT
/begin MEASUREMENT GateDrv0Ctrl.GateDrv0St "MICROSAR RTE" UBYTE NO_COMPU_METHOD 0 0 0 255 ECU_ADDRESS 0 SYMBOL_LINK "Rte_GateDrv0Ctrl_GateDrv0St" 0 DISPLAY_IDENTIFIER GateDrv0Ctrl.PerInstanceMemories.GateDrv0St /end MEASUREMENT
/begin MEASUREMENT GateDrv0Ctrl.GateDrv0StsVal "MICROSAR RTE" UWORD NO_COMPU_METHOD 0 0 0 65535 ECU_ADDRESS 0 SYMBOL_LINK "Rte_GateDrv0Ctrl_GateDrv0StsVal" 0 DISPLAY_IDENTIFIER GateDrv0Ctrl.PerInstanceMemories.GateDrv0StsVal /end MEASUREMENT
/begin MEASUREMENT GateDrv0Ctrl.GateDrv0VrfyRes0Val "MICROSAR RTE" UWORD NO_COMPU_METHOD 0 0 0 65535 ECU_ADDRESS 0 SYMBOL_LINK "Rte_GateDrv0Ctrl_GateDrv0VrfyRes0Val" 0 DISPLAY_IDENTIFIER GateDrv0Ctrl.PerInstanceMemories.GateDrv0VrfyRes0Val /end MEASUREMENT
/begin MEASUREMENT GateDrv0Ctrl.GateDrv0VrfyRes1Val "MICROSAR RTE" UWORD NO_COMPU_METHOD 0 0 0 65535 ECU_ADDRESS 0 SYMBOL_LINK "Rte_GateDrv0Ctrl_GateDrv0VrfyRes1Val" 0 DISPLAY_IDENTIFIER GateDrv0Ctrl.PerInstanceMemories.GateDrv0VrfyRes1Val /end MEASUREMENT
/begin MEASUREMENT GateDrv0Ctrl.Ivtr0BootstrpSplyFltPrmVal "MICROSAR RTE" UBYTE NO_COMPU_METHOD 0 0 0 255 ECU_ADDRESS 0 SYMBOL_LINK "Rte_GateDrv0Ctrl_Ivtr0BootstrpSplyFltPrmVal" 0 DISPLAY_IDENTIFIER GateDrv0Ctrl.PerInstanceMemories.Ivtr0BootstrpSplyFltPrmVal /end MEASUREMENT
/begin MEASUREMENT GateDrv0Ctrl.Ivtr0GenericFltPrmVal "MICROSAR RTE" UBYTE NO_COMPU_METHOD 0 0 0 255 ECU_ADDRESS 0 SYMBOL_LINK "Rte_GateDrv0Ctrl_Ivtr0GenericFltPrmVal" 0 DISPLAY_IDENTIFIER GateDrv0Ctrl.PerInstanceMemories.Ivtr0GenericFltPrmVal /end MEASUREMENT
/begin MEASUREMENT GateDrv0Ctrl.Ivtr0InactvSts "MICROSAR RTE" UBYTE RTE_CM_BOOLEAN 0 0 0 255 ECU_ADDRESS 0 SYMBOL_LINK "Rte_GateDrv0Ctrl_Ivtr0InactvSts" 0 DISPLAY_IDENTIFIER GateDrv0Ctrl.PerInstanceMemories.Ivtr0InactvSts /end MEASUREMENT
/begin MEASUREMENT GateDrv0Ctrl.Ivtr0OffStChkCmpl "MICROSAR RTE" UBYTE RTE_CM_BOOLEAN 0 0 0 255 ECU_ADDRESS 0 SYMBOL_LINK "Rte_GateDrv0Ctrl_Ivtr0OffStChkCmpl" 0 DISPLAY_IDENTIFIER GateDrv0Ctrl.PerInstanceMemories.Ivtr0OffStChkCmpl /end MEASUREMENT
/begin MEASUREMENT GateDrv0Ctrl.Ivtr1PwrDiscnctFltSts.Logl "MICROSAR RTE" UBYTE RTE_CM_BOOLEAN 0 0 0 255 ECU_ADDRESS 0 SYMBOL_LINK "Rte_GateDrv0Ctrl_Ivtr1PwrDiscnctFltSts_Logl" 0 DISPLAY_IDENTIFIER GateDrv0Ctrl.ReceiverPorts.Ivtr1PwrDiscnctFltSts.Logl /end MEASUREMENT
/begin MEASUREMENT GateDrv0Ctrl.IvtrFetFltPha.Val "MICROSAR RTE" UBYTE RTE_CM_ENUM_IvtrFetFltPha1 0 0 0 255 ECU_ADDRESS 0 SYMBOL_LINK "Rte_GateDrv0Ctrl_IvtrFetFltPha_Val" 0 DISPLAY_IDENTIFIER GateDrv0Ctrl.SenderPorts.IvtrFetFltPha.Val /end MEASUREMENT
/begin MEASUREMENT GateDrv0Ctrl.IvtrFetFltPhaDataStore "MICROSAR RTE" UBYTE RTE_CM_ENUM_IvtrFetFltPha1 0 0 0 255 ECU_ADDRESS 0 SYMBOL_LINK "Rte_GateDrv0Ctrl_IvtrFetFltPhaDataStore" 0 DISPLAY_IDENTIFIER GateDrv0Ctrl.PerInstanceMemories.IvtrFetFltPhaDataStore /end MEASUREMENT
/begin MEASUREMENT GateDrv0Ctrl.IvtrFetFltTyp.Val "MICROSAR RTE" UBYTE RTE_CM_ENUM_IvtrFetFltTyp1 0 0 0 255 ECU_ADDRESS 0 SYMBOL_LINK "Rte_GateDrv0Ctrl_IvtrFetFltTyp_Val" 0 DISPLAY_IDENTIFIER GateDrv0Ctrl.SenderPorts.IvtrFetFltTyp.Val /end MEASUREMENT
/begin MEASUREMENT GateDrv0Ctrl.IvtrFetFltTypDataStore "MICROSAR RTE" UBYTE RTE_CM_ENUM_IvtrFetFltTyp1 0 0 0 255 ECU_ADDRESS 0 SYMBOL_LINK "Rte_GateDrv0Ctrl_IvtrFetFltTypDataStore" 0 DISPLAY_IDENTIFIER GateDrv0Ctrl.PerInstanceMemories.IvtrFetFltTypDataStore /end MEASUREMENT
/begin MEASUREMENT GateDrv0Ctrl.MotDrvErrA.Val "MICROSAR RTE" FLOAT32_IEEE NO_COMPU_METHOD 0 0 -3.402823466e+38 3.402823466e+38 ECU_ADDRESS 0 SYMBOL_LINK "Rte_GateDrv0Ctrl_MotDrvErrA_Val" 0 DISPLAY_IDENTIFIER GateDrv0Ctrl.SenderPorts.MotDrvErrA.Val /end MEASUREMENT
/begin MEASUREMENT GateDrv0Ctrl.MotDrvErrB.Val "MICROSAR RTE" FLOAT32_IEEE NO_COMPU_METHOD 0 0 -3.402823466e+38 3.402823466e+38 ECU_ADDRESS 0 SYMBOL_LINK "Rte_GateDrv0Ctrl_MotDrvErrB_Val" 0 DISPLAY_IDENTIFIER GateDrv0Ctrl.SenderPorts.MotDrvErrB.Val /end MEASUREMENT
/begin MEASUREMENT GateDrv0Ctrl.MotDrvErrC.Val "MICROSAR RTE" FLOAT32_IEEE NO_COMPU_METHOD 0 0 -3.402823466e+38 3.402823466e+38 ECU_ADDRESS 0 SYMBOL_LINK "Rte_GateDrv0Ctrl_MotDrvErrC_Val" 0 DISPLAY_IDENTIFIER GateDrv0Ctrl.SenderPorts.MotDrvErrC.Val /end MEASUREMENT
/begin MEASUREMENT GateDrv0Ctrl.MotDrvr0IninTestCmpl.Logl "MICROSAR RTE" UBYTE RTE_CM_BOOLEAN 0 0 0 255 ECU_ADDRESS 0 SYMBOL_LINK "Rte_GateDrv0Ctrl_MotDrvr0IninTestCmpl_Logl" 0 DISPLAY_IDENTIFIER GateDrv0Ctrl.SenderPorts.MotDrvr0IninTestCmpl.Logl /end MEASUREMENT
/begin MEASUREMENT GateDrv0Ctrl.PhaOnTiMeasdA.Val "MICROSAR RTE" ULONG NO_COMPU_METHOD 0 0 0 4294967295 ECU_ADDRESS 0 SYMBOL_LINK "Rte_CDD_GtmCfgAndUse_PhaOnTiMeasdA_Val" 0 DISPLAY_IDENTIFIER GateDrv0Ctrl.ReceiverPorts.PhaOnTiMeasdA.Val /end MEASUREMENT
/begin MEASUREMENT GateDrv0Ctrl.PhaOnTiMeasdB.Val "MICROSAR RTE" ULONG NO_COMPU_METHOD 0 0 0 4294967295 ECU_ADDRESS 0 SYMBOL_LINK "Rte_CDD_GtmCfgAndUse_PhaOnTiMeasdB_Val" 0 DISPLAY_IDENTIFIER GateDrv0Ctrl.ReceiverPorts.PhaOnTiMeasdB.Val /end MEASUREMENT
/begin MEASUREMENT GateDrv0Ctrl.PhaOnTiMeasdC.Val "MICROSAR RTE" ULONG NO_COMPU_METHOD 0 0 0 4294967295 ECU_ADDRESS 0 SYMBOL_LINK "Rte_CDD_GtmCfgAndUse_PhaOnTiMeasdC_Val" 0 DISPLAY_IDENTIFIER GateDrv0Ctrl.ReceiverPorts.PhaOnTiMeasdC.Val /end MEASUREMENT
/begin MEASUREMENT GateDrv0Ctrl.PhaOnTiSumA.Val "MICROSAR RTE" ULONG NO_COMPU_METHOD 0 0 0 4294967295 ECU_ADDRESS 0 SYMBOL_LINK "Rte_CDD_MotCtrlMgr_PhaOnTiSumA_Val" 0 DISPLAY_IDENTIFIER GateDrv0Ctrl.ReceiverPorts.PhaOnTiSumA.Val /end MEASUREMENT
/begin MEASUREMENT GateDrv0Ctrl.PhaOnTiSumB.Val "MICROSAR RTE" ULONG NO_COMPU_METHOD 0 0 0 4294967295 ECU_ADDRESS 0 SYMBOL_LINK "Rte_CDD_MotCtrlMgr_PhaOnTiSumB_Val" 0 DISPLAY_IDENTIFIER GateDrv0Ctrl.ReceiverPorts.PhaOnTiSumB.Val /end MEASUREMENT
/begin MEASUREMENT GateDrv0Ctrl.PhaOnTiSumC.Val "MICROSAR RTE" ULONG NO_COMPU_METHOD 0 0 0 4294967295 ECU_ADDRESS 0 SYMBOL_LINK "Rte_CDD_MotCtrlMgr_PhaOnTiSumC_Val" 0 DISPLAY_IDENTIFIER GateDrv0Ctrl.ReceiverPorts.PhaOnTiSumC.Val /end MEASUREMENT
/begin MEASUREMENT GateDrv0Ctrl.StrtUpSt.Val "MICROSAR RTE" UBYTE NO_COMPU_METHOD 0 0 0 255 ECU_ADDRESS 0 SYMBOL_LINK "Rte_PwrUpSeq_StrtUpSt_Val" 0 DISPLAY_IDENTIFIER GateDrv0Ctrl.ReceiverPorts.StrtUpSt.Val /end MEASUREMENT
/begin MEASUREMENT GateDrv0Ctrl.SysSt.Val "MICROSAR RTE" UBYTE RTE_CM_ENUM_SysSt1 0 0 0 255 ECU_ADDRESS 0 SYMBOL_LINK "Rte_SysStMod_SysSt_Val" 0 DISPLAY_IDENTIFIER GateDrv0Ctrl.ReceiverPorts.SysSt.Val /end MEASUREMENT
/begin MEASUREMENT GateDrv0Ctrl.dGateDrv0CtrlGateDrv0Diag0Val "MICROSAR RTE" UWORD NO_COMPU_METHOD 0 0 0 65535 ECU_ADDRESS 0 SYMBOL_LINK "Rte_GateDrv0Ctrl_dGateDrv0CtrlGateDrv0Diag0Val" 0 DISPLAY_IDENTIFIER GateDrv0Ctrl.PerInstanceMemories.dGateDrv0CtrlGateDrv0Diag0Val /end MEASUREMENT
/begin MEASUREMENT GateDrv0Ctrl.dGateDrv0CtrlGateDrv0Diag1Val "MICROSAR RTE" UWORD NO_COMPU_METHOD 0 0 0 65535 ECU_ADDRESS 0 SYMBOL_LINK "Rte_GateDrv0Ctrl_dGateDrv0CtrlGateDrv0Diag1Val" 0 DISPLAY_IDENTIFIER GateDrv0Ctrl.PerInstanceMemories.dGateDrv0CtrlGateDrv0Diag1Val /end MEASUREMENT
/begin MEASUREMENT GateDrv0Ctrl.dGateDrv0CtrlGateDrv0Diag2Val "MICROSAR RTE" UWORD NO_COMPU_METHOD 0 0 0 65535 ECU_ADDRESS 0 SYMBOL_LINK "Rte_GateDrv0Ctrl_dGateDrv0CtrlGateDrv0Diag2Val" 0 DISPLAY_IDENTIFIER GateDrv0Ctrl.PerInstanceMemories.dGateDrv0CtrlGateDrv0Diag2Val /end MEASUREMENT
/begin MEASUREMENT GateDrv0Ctrl.dGateDrv0CtrlGateDrv0OffsStVrfyPrmBitIdx "MICROSAR RTE" UBYTE NO_COMPU_METHOD 0 0 0 255 ECU_ADDRESS 0 SYMBOL_LINK "Rte_GateDrv0Ctrl_dGateDrv0CtrlGateDrv0OffsStVrfyPrmBitIdx" 0 DISPLAY_IDENTIFIER GateDrv0Ctrl.PerInstanceMemories.dGateDrv0CtrlGateDrv0OffsStVrfyPrmBitIdx /end MEASUREMENT
/begin MEASUREMENT GateDrv0Ctrl.dGateDrv0CtrlGateDrv0PhaOnTiSumAExp "MICROSAR RTE" ULONG NO_COMPU_METHOD 0 0 0 4294967295 ECU_ADDRESS 0 SYMBOL_LINK "Rte_GateDrv0Ctrl_dGateDrv0CtrlGateDrv0PhaOnTiSumAExp" 0 DISPLAY_IDENTIFIER GateDrv0Ctrl.PerInstanceMemories.dGateDrv0CtrlGateDrv0PhaOnTiSumAExp /end MEASUREMENT
/begin MEASUREMENT GateDrv0Ctrl.dGateDrv0CtrlGateDrv0PhaOnTiSumBExp "MICROSAR RTE" ULONG NO_COMPU_METHOD 0 0 0 4294967295 ECU_ADDRESS 0 SYMBOL_LINK "Rte_GateDrv0Ctrl_dGateDrv0CtrlGateDrv0PhaOnTiSumBExp" 0 DISPLAY_IDENTIFIER GateDrv0Ctrl.PerInstanceMemories.dGateDrv0CtrlGateDrv0PhaOnTiSumBExp /end MEASUREMENT
/begin MEASUREMENT GateDrv0Ctrl.dGateDrv0CtrlGateDrv0PhaOnTiSumCExp "MICROSAR RTE" ULONG NO_COMPU_METHOD 0 0 0 4294967295 ECU_ADDRESS 0 SYMBOL_LINK "Rte_GateDrv0Ctrl_dGateDrv0CtrlGateDrv0PhaOnTiSumCExp" 0 DISPLAY_IDENTIFIER GateDrv0Ctrl.PerInstanceMemories.dGateDrv0CtrlGateDrv0PhaOnTiSumCExp /end MEASUREMENT
/begin MEASUREMENT GateDrv0Ctrl.dGateDrv0CtrlGateDrv0StsVal "MICROSAR RTE" UWORD NO_COMPU_METHOD 0 0 0 65535 ECU_ADDRESS 0 SYMBOL_LINK "Rte_GateDrv0Ctrl_dGateDrv0CtrlGateDrv0StsVal" 0 DISPLAY_IDENTIFIER GateDrv0Ctrl.PerInstanceMemories.dGateDrv0CtrlGateDrv0StsVal /end MEASUREMENT
/begin MEASUREMENT GateDrv0Ctrl.dGateDrv0CtrlGateDrv0VrfyRes0Val "MICROSAR RTE" UWORD NO_COMPU_METHOD 0 0 0 65535 ECU_ADDRESS 0 SYMBOL_LINK "Rte_GateDrv0Ctrl_dGateDrv0CtrlGateDrv0VrfyRes0Val" 0 DISPLAY_IDENTIFIER GateDrv0Ctrl.PerInstanceMemories.dGateDrv0CtrlGateDrv0VrfyRes0Val /end MEASUREMENT
/begin MEASUREMENT GateDrv0Ctrl.dGateDrv0CtrlGateDrv0VrfyRes1Val "MICROSAR RTE" UWORD NO_COMPU_METHOD 0 0 0 65535 ECU_ADDRESS 0 SYMBOL_LINK "Rte_GateDrv0Ctrl_dGateDrv0CtrlGateDrv0VrfyRes1Val" 0 DISPLAY_IDENTIFIER GateDrv0Ctrl.PerInstanceMemories.dGateDrv0CtrlGateDrv0VrfyRes1Val /end MEASUREMENT
/begin MEASUREMENT HiLoadStallLimr.DualEcuFltMtgtnEna.Logl "MICROSAR RTE" UBYTE RTE_CM_BOOLEAN 0 0 0 255 ECU_ADDRESS 0 SYMBOL_LINK "Rte_DualCtrlrOutpMgr_DualEcuFltMtgtnEna_Logl" 0 DISPLAY_IDENTIFIER HiLoadStallLimr.ReceiverPorts.DualEcuFltMtgtnEna.Logl /end MEASUREMENT
/begin MEASUREMENT HiLoadStallLimr.FetLoaMtgtnCalIdx "MICROSAR RTE" UBYTE NO_COMPU_METHOD 0 0 0 255 ECU_ADDRESS 0 SYMBOL_LINK "Rte_HiLoadStallLimr_FetLoaMtgtnCalIdx" 0 DISPLAY_IDENTIFIER HiLoadStallLimr.PerInstanceMemories.FetLoaMtgtnCalIdx /end MEASUREMENT
/begin MEASUREMENT HiLoadStallLimr.MotAndThermProtnLoaMod.Val "MICROSAR RTE" UBYTE NO_COMPU_METHOD 0 0 0 255 ECU_ADDRESS 0 SYMBOL_LINK "Rte_LoaMgr_MotAndThermProtnLoaMod_Val" 0 DISPLAY_IDENTIFIER HiLoadStallLimr.ReceiverPorts.MotAndThermProtnLoaMod.Val /end MEASUREMENT
/begin MEASUREMENT HiLoadStallLimr.MotTqCmdLimdPreStall.Val "MICROSAR RTE" FLOAT32_IEEE NO_COMPU_METHOD 0 0 -3.402823466e+38 3.402823466e+38 ECU_ADDRESS 0 SYMBOL_LINK "Rte_AssiSumLim_MotTqCmdLimdPreStall_Val" 0 DISPLAY_IDENTIFIER HiLoadStallLimr.ReceiverPorts.MotTqCmdLimdPreStall.Val /end MEASUREMENT
/begin MEASUREMENT HiLoadStallLimr.MotVelCrf.Val "MICROSAR RTE" FLOAT32_IEEE NO_COMPU_METHOD 0 0 -3.402823466e+38 3.402823466e+38 ECU_ADDRESS 0 SYMBOL_LINK "Rte_ImcSigArbn_MotVelCrfImcCorrd_Val" 0 DISPLAY_IDENTIFIER HiLoadStallLimr.ReceiverPorts.MotVelCrf.Val /end MEASUREMENT
/begin MEASUREMENT HiLoadStallLimr.StallMotTqCmdFetMtgtnFil.FilGain "MICROSAR RTE" FLOAT32_IEEE NO_COMPU_METHOD 0 0 -3.402823466e+38 3.402823466e+38 ECU_ADDRESS 0 SYMBOL_LINK "Rte_HiLoadStallLimr_StallMotTqCmdFetMtgtnFil.FilGain" 0 DISPLAY_IDENTIFIER HiLoadStallLimr.PerInstanceMemories.StallMotTqCmdFetMtgtnFil.FilGain /end MEASUREMENT
/begin MEASUREMENT HiLoadStallLimr.StallMotTqCmdFetMtgtnFil.FilSt "MICROSAR RTE" FLOAT32_IEEE NO_COMPU_METHOD 0 0 -3.402823466e+38 3.402823466e+38 ECU_ADDRESS 0 SYMBOL_LINK "Rte_HiLoadStallLimr_StallMotTqCmdFetMtgtnFil.FilSt" 0 DISPLAY_IDENTIFIER HiLoadStallLimr.PerInstanceMemories.StallMotTqCmdFetMtgtnFil.FilSt /end MEASUREMENT
/begin MEASUREMENT HiLoadStallLimr.StallMotTqCmdFil.FilGain "MICROSAR RTE" FLOAT32_IEEE NO_COMPU_METHOD 0 0 -3.402823466e+38 3.402823466e+38 ECU_ADDRESS 0 SYMBOL_LINK "Rte_HiLoadStallLimr_StallMotTqCmdFil.FilGain" 0 DISPLAY_IDENTIFIER HiLoadStallLimr.PerInstanceMemories.StallMotTqCmdFil.FilGain /end MEASUREMENT
/begin MEASUREMENT HiLoadStallLimr.StallMotTqCmdFil.FilSt "MICROSAR RTE" FLOAT32_IEEE NO_COMPU_METHOD 0 0 -3.402823466e+38 3.402823466e+38 ECU_ADDRESS 0 SYMBOL_LINK "Rte_HiLoadStallLimr_StallMotTqCmdFil.FilSt" 0 DISPLAY_IDENTIFIER HiLoadStallLimr.PerInstanceMemories.StallMotTqCmdFil.FilSt /end MEASUREMENT
/begin MEASUREMENT HiLoadStallLimr.StallMotTqLim.Val "MICROSAR RTE" FLOAT32_IEEE NO_COMPU_METHOD 0 0 -3.402823466e+38 3.402823466e+38 ECU_ADDRESS 0 SYMBOL_LINK "Rte_HiLoadStallLimr_StallMotTqLim_Val" 0 DISPLAY_IDENTIFIER HiLoadStallLimr.SenderPorts.StallMotTqLim.Val /end MEASUREMENT
/begin MEASUREMENT HiLoadStallLimr.StallMotTqLimDi.Logl "MICROSAR RTE" UBYTE RTE_CM_BOOLEAN 0 0 0 255 ECU_ADDRESS 0 SYMBOL_LINK "Rte_CmnMfgSrv_StallMotTqLimDi_Logl" 0 DISPLAY_IDENTIFIER HiLoadStallLimr.ReceiverPorts.StallMotTqLimDi.Logl /end MEASUREMENT
/begin MEASUREMENT HiLoadStallLimr.StallMotTqLimFetMtgtnPrev "MICROSAR RTE" FLOAT32_IEEE NO_COMPU_METHOD 0 0 -3.402823466e+38 3.402823466e+38 ECU_ADDRESS 0 SYMBOL_LINK "Rte_HiLoadStallLimr_StallMotTqLimFetMtgtnPrev" 0 DISPLAY_IDENTIFIER HiLoadStallLimr.PerInstanceMemories.StallMotTqLimFetMtgtnPrev /end MEASUREMENT
/begin MEASUREMENT HiLoadStallLimr.StallMotTqLimPrev "MICROSAR RTE" FLOAT32_IEEE NO_COMPU_METHOD 0 0 -3.402823466e+38 3.402823466e+38 ECU_ADDRESS 0 SYMBOL_LINK "Rte_HiLoadStallLimr_StallMotTqLimPrev" 0 DISPLAY_IDENTIFIER HiLoadStallLimr.PerInstanceMemories.StallMotTqLimPrev /end MEASUREMENT
/begin MEASUREMENT HiLoadStallLimr.dHiLoadStallLimrStallMotTqCmd "MICROSAR RTE" FLOAT32_IEEE NO_COMPU_METHOD 0 0 -3.402823466e+38 3.402823466e+38 ECU_ADDRESS 0 SYMBOL_LINK "Rte_HiLoadStallLimr_dHiLoadStallLimrStallMotTqCmd" 0 DISPLAY_IDENTIFIER HiLoadStallLimr.PerInstanceMemories.dHiLoadStallLimrStallMotTqCmd /end MEASUREMENT
/begin MEASUREMENT HiLoadStallLimr.dHiLoadStallLimrStallMotTqCmdFild "MICROSAR RTE" FLOAT32_IEEE NO_COMPU_METHOD 0 0 -3.402823466e+38 3.402823466e+38 ECU_ADDRESS 0 SYMBOL_LINK "Rte_HiLoadStallLimr_dHiLoadStallLimrStallMotTqCmdFild" 0 DISPLAY_IDENTIFIER HiLoadStallLimr.PerInstanceMemories.dHiLoadStallLimrStallMotTqCmdFild /end MEASUREMENT
/begin MEASUREMENT HiLoadStallLimr.dHiLoadStallLimrStallMotTqLim "MICROSAR RTE" FLOAT32_IEEE NO_COMPU_METHOD 0 0 -3.402823466e+38 3.402823466e+38 ECU_ADDRESS 0 SYMBOL_LINK "Rte_HiLoadStallLimr_dHiLoadStallLimrStallMotTqLim" 0 DISPLAY_IDENTIFIER HiLoadStallLimr.PerInstanceMemories.dHiLoadStallLimrStallMotTqLim /end MEASUREMENT
/begin MEASUREMENT HwAg1Meas.HwAg1.Val "MICROSAR RTE" FLOAT32_IEEE NO_COMPU_METHOD 0 0 -3.402823466e+38 3.402823466e+38 ECU_ADDRESS 0 SYMBOL_LINK "Rte_HwAg1Meas_HwAg1_Val" 0 DISPLAY_IDENTIFIER HwAg1Meas.SenderPorts.HwAg1.Val /end MEASUREMENT
/begin MEASUREMENT HwAg1Meas.HwAg1IfFltLtch "MICROSAR RTE" UBYTE RTE_CM_BOOLEAN 0 0 0 255 ECU_ADDRESS 0 SYMBOL_LINK "Rte_HwAg1Meas_HwAg1IfFltLtch" 0 DISPLAY_IDENTIFIER HwAg1Meas.PerInstanceMemories.HwAg1IfFltLtch /end MEASUREMENT
/begin MEASUREMENT HwAg1Meas.HwAg1InitStepSeqNrCmpl "MICROSAR RTE" UBYTE RTE_CM_BOOLEAN 0 0 0 255 ECU_ADDRESS 0 SYMBOL_LINK "Rte_HwAg1Meas_HwAg1InitStepSeqNrCmpl" 0 DISPLAY_IDENTIFIER HwAg1Meas.PerInstanceMemories.HwAg1InitStepSeqNrCmpl /end MEASUREMENT
/begin MEASUREMENT HwAg1Meas.HwAg1LtchClr "MICROSAR RTE" UBYTE RTE_CM_BOOLEAN 0 0 0 255 ECU_ADDRESS 0 SYMBOL_LINK "Rte_HwAg1Meas_HwAg1LtchClr" 0 DISPLAY_IDENTIFIER HwAg1Meas.PerInstanceMemories.HwAg1LtchClr /end MEASUREMENT
/begin GROUP FordMsg4B0BusHiSpd.LaneKeepAssiEnad.Logl "MICROSAR RTE" /begin SUB_GROUP /end SUB_GROUP /begin FUNCTION_LIST /end FUNCTION_LIST /begin REF_CHARACTERISTIC /end REF_CHARACTERISTIC /begin REF_MEASUREMENT FordMsg4B0BusHiSpd.LaneKeepAssiEnad.Logl /end REF_MEASUREMENT /end GROUP
/begin GROUP FordMsg4B0BusHiSpd.MsgFltNtcDiagcRefTi "MICROSAR RTE" /begin SUB_GROUP /end SUB_GROUP /begin FUNCTION_LIST /end FUNCTION_LIST /begin REF_CHARACTERISTIC /end REF_CHARACTERISTIC /begin REF_MEASUREMENT FordMsg4B0BusHiSpd.MsgFltNtcDiagcRefTi /end REF_MEASUREMENT /end GROUP
/begin GROUP FordMsg4B0BusHiSpd.MsgFltRefTi "MICROSAR RTE" /begin SUB_GROUP /end SUB_GROUP /begin FUNCTION_LIST /end FUNCTION_LIST /begin REF_CHARACTERISTIC /end REF_CHARACTERISTIC /begin REF_MEASUREMENT FordMsg4B0BusHiSpd.MsgFltRefTi /end REF_MEASUREMENT /end GROUP
/begin GROUP FordMsg4B0BusHiSpd.MsgMissNtcDiagcRefTi "MICROSAR RTE" /begin SUB_GROUP /end SUB_GROUP /begin FUNCTION_LIST /end FUNCTION_LIST /begin REF_CHARACTERISTIC /end REF_CHARACTERISTIC /begin REF_MEASUREMENT FordMsg4B0BusHiSpd.MsgMissNtcDiagcRefTi /end REF_MEASUREMENT /end GROUP
/begin GROUP FordMsg4B0BusHiSpd.MsgNoDataExistNtcDiagcRefTi "MICROSAR RTE" /begin SUB_GROUP /end SUB_GROUP /begin FUNCTION_LIST /end FUNCTION_LIST /begin REF_CHARACTERISTIC /end REF_CHARACTERISTIC /begin REF_MEASUREMENT FordMsg4B0BusHiSpd.MsgNoDataExistNtcDiagcRefTi /end REF_MEASUREMENT /end GROUP
/begin GROUP FordMsg4B0BusHiSpd.MsgNoDataExistRefTi "MICROSAR RTE" /begin SUB_GROUP /end SUB_GROUP /begin FUNCTION_LIST /end FUNCTION_LIST /begin REF_CHARACTERISTIC /end REF_CHARACTERISTIC /begin REF_MEASUREMENT FordMsg4B0BusHiSpd.MsgNoDataExistRefTi /end REF_MEASUREMENT /end GROUP
/begin GROUP FordMsg4B0BusHiSpd.MsgNotRxdRefTi "MICROSAR RTE" /begin SUB_GROUP /end SUB_GROUP /begin FUNCTION_LIST /end FUNCTION_LIST /begin REF_CHARACTERISTIC /end REF_CHARACTERISTIC /begin REF_MEASUREMENT FordMsg4B0BusHiSpd.MsgNotRxdRefTi /end REF_MEASUREMENT /end GROUP
/begin GROUP FordMsg4B0BusHiSpd.MsgRxdNtcDiagcRefTi "MICROSAR RTE" /begin SUB_GROUP /end SUB_GROUP /begin FUNCTION_LIST /end FUNCTION_LIST /begin REF_CHARACTERISTIC /end REF_CHARACTERISTIC /begin REF_MEASUREMENT FordMsg4B0BusHiSpd.MsgRxdNtcDiagcRefTi /end REF_MEASUREMENT /end GROUP
/begin GROUP FordMsg4B0BusHiSpd.MsgVldNtcDiagcRefTi "MICROSAR RTE" /begin SUB_GROUP /end SUB_GROUP /begin FUNCTION_LIST /end FUNCTION_LIST /begin REF_CHARACTERISTIC /end REF_CHARACTERISTIC /begin REF_MEASUREMENT FordMsg4B0BusHiSpd.MsgVldNtcDiagcRefTi /end REF_MEASUREMENT /end GROUP
/begin GROUP FordMsg4B0BusHiSpd.MsgVldRefTi "MICROSAR RTE" /begin SUB_GROUP /end SUB_GROUP /begin FUNCTION_LIST /end FUNCTION_LIST /begin REF_CHARACTERISTIC /end REF_CHARACTERISTIC /begin REF_MEASUREMENT FordMsg4B0BusHiSpd.MsgVldRefTi /end REF_MEASUREMENT /end GROUP
/begin GROUP FordMsg4B0BusHiSpd.PerInstanceMemories "MICROSAR RTE"
 /begin SUB_GROUP FordMsg4B0BusHiSpd.CanDtcInhbRefTi FordMsg4B0BusHiSpd.ClrDiagcFlgProxyPrev FordMsg4B0BusHiSpd.FordMsg4B0Miss FordMsg4B0BusHiSpd.FordVehYawStabyRawPrev FordMsg4B0BusHiSpd.FordVehYawStabyVldPrev FordMsg4B0BusHiSpd.IniVehYawStabyInvld FordMsg4B0BusHiSpd.MsgFltNtcDiagcRefTi FordMsg4B0BusHiSpd.MsgFltRefTi FordMsg4B0BusHiSpd.MsgMissNtcDiagcRefTi FordMsg4B0BusHiSpd.MsgNoDataExistNtcDiagcRefTi FordMsg4B0BusHiSpd.MsgNoDataExistRefTi FordMsg4B0BusHiSpd.MsgNotRxdRefTi FordMsg4B0BusHiSpd.MsgRxdNtcDiagcRefTi FordMsg4B0BusHiSpd.MsgVldNtcDiagcRefTi FordMsg4B0BusHiSpd.MsgVldRefTi /end SUB_GROUP
 /begin FUNCTION_LIST /end FUNCTION_LIST
 /begin REF_CHARACTERISTIC /end REF_CHARACTERISTIC
 /begin REF_MEASUREMENT /end REF_MEASUREMENT
/end GROUP
/begin GROUP FordMsg4B0BusHiSpd.ReceiverPorts "MICROSAR RTE"
 /begin SUB_GROUP FordMsg4B0BusHiSpd.ClrDiagcFlgProxy.Val FordMsg4B0BusHiSpd.FordBrkOscnRednEnad.Logl FordMsg4B0BusHiSpd.FordCanDtcInhb.Logl FordMsg4B0BusHiSpd.FordEpsLifeCycMod.Val FordMsg4B0BusHiSpd.FordEvasSteerAssiEnad.Logl FordMsg4B0BusHiSpd.FordLaneCentrAssiEnad.Logl FordMsg4B0BusHiSpd.FordTqSteerCmpEnad.Logl FordMsg4B0BusHiSpd.LaneDetnWarnEnad.Logl FordMsg4B0BusHiSpd.LaneKeepAssiEnad.Logl FordMsg4B0BusHiSpd.TrfcJamAssiEnad.Logl /end SUB_GROUP
 /begin FUNCTION_LIST /end FUNCTION_LIST
 /begin REF_CHARACTERISTIC /end REF_CHARACTERISTIC
 /begin REF_MEASUREMENT /end REF_MEASUREMENT
/end GROUP
/begin GROUP FordMsg4B0BusHiSpd.SenderPorts "MICROSAR RTE"
 /begin SUB_GROUP FordMsg4B0BusHiSpd.FordVehYawStabyRaw.Val FordMsg4B0BusHiSpd.FordVehYawStabyVld.Logl /end SUB_GROUP
 /begin FUNCTION_LIST /end FUNCTION_LIST
 /begin REF_CHARACTERISTIC /end REF_CHARACTERISTIC
 /begin REF_MEASUREMENT /end REF_MEASUREMENT
/end GROUP
/begin GROUP FordMsg4B0BusHiSpd.TrfcJamAssiEnad.Logl "MICROSAR RTE" /begin SUB_GROUP /end SUB_GROUP /begin FUNCTION_LIST /end FUNCTION_LIST /begin REF_CHARACTERISTIC /end REF_CHARACTERISTIC /begin REF_MEASUREMENT FordMsg4B0BusHiSpd.TrfcJamAssiEnad.Logl /end REF_MEASUREMENT /end GROUP
/begin GROUP FordMsg5B5BusHiSpd "MICROSAR RTE"
 /begin SUB_GROUP FordMsg5B5BusHiSpd.PerInstanceMemories FordMsg5B5BusHiSpd.SenderPorts /end SUB_GROUP
 /begin FUNCTION_LIST /end FUNCTION_LIST
 /begin REF_CHARACTERISTIC /end REF_CHARACTERISTIC
 /begin REF_MEASUREMENT /end REF_MEASUREMENT
/end GROUP
/begin GROUP FordMsg5B5BusHiSpd.Ford_PSCM_AutoSarNMControl.Val "MICROSAR RTE" /begin SUB_GROUP /end SUB_GROUP /begin FUNCTION_LIST /end FUNCTION_LIST /begin REF_CHARACTERISTIC /end REF_CHARACTERISTIC /begin REF_MEASUREMENT FordMsg5B5BusHiSpd.Ford_PSCM_AutoSarNMControl.Val /end REF_MEASUREMENT /end GROUP
/begin GROUP FordMsg5B5BusHiSpd.Ford_PSCM_AutoSarNMNodeId.Val "MICROSAR RTE" /begin SUB_GROUP /end SUB_GROUP /begin FUNCTION_LIST /end FUNCTION_LIST /begin REF_CHARACTERISTIC /end REF_CHARACTERISTIC /begin REF_MEASUREMENT FordMsg5B5BusHiSpd.Ford_PSCM_AutoSarNMNodeId.Val /end REF_MEASUREMENT /end GROUP
/begin GROUP FordMsg5B5BusHiSpd.Ford_PSCM_AutoSarNMReserved1.Val "MICROSAR RTE" /begin SUB_GROUP /end SUB_GROUP /begin FUNCTION_LIST /end FUNCTION_LIST /begin REF_CHARACTERISTIC /end REF_CHARACTERISTIC /begin REF_MEASUREMENT FordMsg5B5BusHiSpd.Ford_PSCM_AutoSarNMReserved1.Val /end REF_MEASUREMENT /end GROUP
/begin GROUP FordMsg5B5BusHiSpd.Ford_PSCM_AutoSarNMReserved2.Val "MICROSAR RTE" /begin SUB_GROUP /end SUB_GROUP /begin FUNCTION_LIST /end FUNCTION_LIST /begin REF_CHARACTERISTIC /end REF_CHARACTERISTIC /begin REF_MEASUREMENT FordMsg5B5BusHiSpd.Ford_PSCM_AutoSarNMReserved2.Val /end REF_MEASUREMENT /end GROUP
/begin GROUP FordMsg5B5BusHiSpd.Ford_PSCM_AutoSarNMReserved3.Val "MICROSAR RTE" /begin SUB_GROUP /end SUB_GROUP /begin FUNCTION_LIST /end FUNCTION_LIST /begin REF_CHARACTERISTIC /end REF_CHARACTERISTIC /begin REF_MEASUREMENT FordMsg5B5BusHiSpd.Ford_PSCM_AutoSarNMReserved3.Val /end REF_MEASUREMENT /end GROUP
/begin GROUP FordMsg5B5BusHiSpd.Ford_PSCM_AutoSarNMReserved4.Val "MICROSAR RTE" /begin SUB_GROUP /end SUB_GROUP /begin FUNCTION_LIST /end FUNCTION_LIST /begin REF_CHARACTERISTIC /end REF_CHARACTERISTIC /begin REF_MEASUREMENT FordMsg5B5BusHiSpd.Ford_PSCM_AutoSarNMReserved4.Val /end REF_MEASUREMENT /end GROUP
/begin GROUP FordMsg5B5BusHiSpd.Ford_PSCM_GWNMProxy.Val "MICROSAR RTE" /begin SUB_GROUP /end SUB_GROUP /begin FUNCTION_LIST /end FUNCTION_LIST /begin REF_CHARACTERISTIC /end REF_CHARACTERISTIC /begin REF_MEASUREMENT FordMsg5B5BusHiSpd.Ford_PSCM_GWNMProxy.Val /end REF_MEASUREMENT /end GROUP
/begin GROUP FordMsg5B5BusHiSpd.Ford_PSCM_GWOnBoardTester.Val "MICROSAR RTE" /begin SUB_GROUP /end SUB_GROUP /begin FUNCTION_LIST /end FUNCTION_LIST /begin REF_CHARACTERISTIC /end REF_CHARACTERISTIC /begin REF_MEASUREMENT FordMsg5B5BusHiSpd.Ford_PSCM_GWOnBoardTester.Val /end REF_MEASUREMENT /end GROUP
/begin GROUP FordMsg5B5BusHiSpd.PerInstanceMemories "MICROSAR RTE"
 /begin SUB_GROUP FordMsg5B5BusHiSpd.PwrSteerCtrlModlArNmCtrlPrev FordMsg5B5BusHiSpd.PwrSteerCtrlModlArNmNodIdnPrev FordMsg5B5BusHiSpd.PwrSteerCtrlModlArNmResd1Prev FordMsg5B5BusHiSpd.PwrSteerCtrlModlArNmResd2Prev FordMsg5B5BusHiSpd.PwrSteerCtrlModlArNmResd3Prev FordMsg5B5BusHiSpd.PwrSteerCtrlModlArNmResd4Prev FordMsg5B5BusHiSpd.PwrSteerCtrlModlGatewyNmOnBdTestPrev FordMsg5B5BusHiSpd.PwrSteerCtrlModlGatewyNmProxyPrev /end SUB_GROUP
 /begin FUNCTION_LIST /end FUNCTION_LIST
 /begin REF_CHARACTERISTIC /end REF_CHARACTERISTIC
 /begin REF_MEASUREMENT /end REF_MEASUREMENT
/end GROUP
/begin GROUP FordMsg5B5BusHiSpd.PwrSteerCtrlModlArNmCtrlPrev "MICROSAR RTE" /begin SUB_GROUP /end SUB_GROUP /begin FUNCTION_LIST /end FUNCTION_LIST /begin REF_CHARACTERISTIC /end REF_CHARACTERISTIC /begin REF_MEASUREMENT FordMsg5B5BusHiSpd.PwrSteerCtrlModlArNmCtrlPrev /end REF_MEASUREMENT /end GROUP
/begin GROUP FordMsg5B5BusHiSpd.PwrSteerCtrlModlArNmNodIdnPrev "MICROSAR RTE" /begin SUB_GROUP /end SUB_GROUP /begin FUNCTION_LIST /end FUNCTION_LIST /begin REF_CHARACTERISTIC /end REF_CHARACTERISTIC /begin REF_MEASUREMENT FordMsg5B5BusHiSpd.PwrSteerCtrlModlArNmNodIdnPrev /end REF_MEASUREMENT /end GROUP
/begin GROUP FordMsg5B5BusHiSpd.PwrSteerCtrlModlArNmResd1Prev "MICROSAR RTE" /begin SUB_GROUP /end SUB_GROUP /begin FUNCTION_LIST /end FUNCTION_LIST /begin REF_CHARACTERISTIC /end REF_CHARACTERISTIC /begin REF_MEASUREMENT FordMsg5B5BusHiSpd.PwrSteerCtrlModlArNmResd1Prev /end REF_MEASUREMENT /end GROUP
/begin GROUP FordMsg5B5BusHiSpd.PwrSteerCtrlModlArNmResd2Prev "MICROSAR RTE" /begin SUB_GROUP /end SUB_GROUP /begin FUNCTION_LIST /end FUNCTION_LIST /begin REF_CHARACTERISTIC /end REF_CHARACTERISTIC /begin REF_MEASUREMENT FordMsg5B5BusHiSpd.PwrSteerCtrlModlArNmResd2Prev /end REF_MEASUREMENT /end GROUP
/begin GROUP FordMsg5B5BusHiSpd.PwrSteerCtrlModlArNmResd3Prev "MICROSAR RTE" /begin SUB_GROUP /end SUB_GROUP /begin FUNCTION_LIST /end FUNCTION_LIST /begin REF_CHARACTERISTIC /end REF_CHARACTERISTIC /begin REF_MEASUREMENT FordMsg5B5BusHiSpd.PwrSteerCtrlModlArNmResd3Prev /end REF_MEASUREMENT /end GROUP
/begin GROUP FordMsg5B5BusHiSpd.PwrSteerCtrlModlArNmResd4Prev "MICROSAR RTE" /begin SUB_GROUP /end SUB_GROUP /begin FUNCTION_LIST /end FUNCTION_LIST /begin REF_CHARACTERISTIC /end REF_CHARACTERISTIC /begin REF_MEASUREMENT FordMsg5B5BusHiSpd.PwrSteerCtrlModlArNmResd4Prev /end REF_MEASUREMENT /end GROUP
/begin GROUP FordMsg5B5BusHiSpd.PwrSteerCtrlModlGatewyNmOnBdTestPrev "MICROSAR RTE" /begin SUB_GROUP /end SUB_GROUP /begin FUNCTION_LIST /end FUNCTION_LIST /begin REF_CHARACTERISTIC /end REF_CHARACTERISTIC /begin REF_MEASUREMENT FordMsg5B5BusHiSpd.PwrSteerCtrlModlGatewyNmOnBdTestPrev /end REF_MEASUREMENT /end GROUP
/begin GROUP FordMsg5B5BusHiSpd.PwrSteerCtrlModlGatewyNmProxyPrev "MICROSAR RTE" /begin SUB_GROUP /end SUB_GROUP /begin FUNCTION_LIST /end FUNCTION_LIST /begin REF_CHARACTERISTIC /end REF_CHARACTERISTIC /begin REF_MEASUREMENT FordMsg5B5BusHiSpd.PwrSteerCtrlModlGatewyNmProxyPrev /end REF_MEASUREMENT /end GROUP
/begin GROUP FordMsg5B5BusHiSpd.SenderPorts "MICROSAR RTE"
 /begin SUB_GROUP FordMsg5B5BusHiSpd.Ford_PSCM_AutoSarNMControl.Val FordMsg5B5BusHiSpd.Ford_PSCM_AutoSarNMNodeId.Val FordMsg5B5BusHiSpd.Ford_PSCM_AutoSarNMReserved1.Val FordMsg5B5BusHiSpd.Ford_PSCM_AutoSarNMReserved2.Val FordMsg5B5BusHiSpd.Ford_PSCM_AutoSarNMReserved3.Val FordMsg5B5BusHiSpd.Ford_PSCM_AutoSarNMReserved4.Val FordMsg5B5BusHiSpd.Ford_PSCM_GWNMProxy.Val FordMsg5B5BusHiSpd.Ford_PSCM_GWOnBoardTester.Val /end SUB_GROUP
 /begin FUNCTION_LIST /end FUNCTION_LIST
 /begin REF_CHARACTERISTIC /end REF_CHARACTERISTIC
 /begin REF_MEASUREMENT /end REF_MEASUREMENT
/end GROUP
/begin GROUP FordSysSt "MICROSAR RTE"
 /begin SUB_GROUP FordSysSt.CalibrationPorts FordSysSt.PerInstanceMemories FordSysSt.ReceiverPorts FordSysSt.SenderPorts /end SUB_GROUP
 /begin FUNCTION_LIST /end FUNCTION_LIST
 /begin REF_CHARACTERISTIC /end REF_CHARACTERISTIC
 /begin REF_MEASUREMENT /end REF_MEASUREMENT
/end GROUP
/begin GROUP FordSysSt.CalibrationPorts "MICROSAR RTE"
 /begin SUB_GROUP FordSysSt.FullAssiRampUpRate.Val FordSysSt.InitLimpHomeRamp.Val FordSysSt.InitLimpHomeScar.Val FordSysSt.LimdAssiRamp.Val FordSysSt.LimdAssiRampUpRate.Val FordSysSt.LimdAssiRampUpRateFaild.Val FordSysSt.LimdAssiScar.Val FordSysSt.NormLimpHomeRamp.Val FordSysSt.NormLimpHomeScar.Val FordSysSt.ShtdwnRamp.Val /end SUB_GROUP
 /begin FUNCTION_LIST /end FUNCTION_LIST
 /begin REF_CHARACTERISTIC /end REF_CHARACTERISTIC
 /begin REF_MEASUREMENT /end REF_MEASUREMENT
/end GROUP
/begin GROUP FordSysSt.EngOnSerlComSrvDft.Logl "MICROSAR RTE" /begin SUB_GROUP /end SUB_GROUP /begin FUNCTION_LIST /end FUNCTION_LIST /begin REF_CHARACTERISTIC /end REF_CHARACTERISTIC /begin REF_MEASUREMENT FordSysSt.EngOnSerlComSrvDft.Logl /end REF_MEASUREMENT /end GROUP
/begin GROUP FordSysSt.FordEpsFailr.Ford_EPAS_Failure "MICROSAR RTE" /begin SUB_GROUP /end SUB_GROUP /begin FUNCTION_LIST /end FUNCTION_LIST /begin REF_CHARACTERISTIC /end REF_CHARACTERISTIC /begin REF_MEASUREMENT FordSysSt.FordEpsFailr.Ford_EPAS_Failure /end REF_MEASUREMENT /end GROUP
/begin GROUP FordSysSt.FordEpsFailrPrev "MICROSAR RTE" /begin SUB_GROUP /end SUB_GROUP /begin FUNCTION_LIST /end FUNCTION_LIST /begin REF_CHARACTERISTIC /end REF_CHARACTERISTIC /begin REF_MEASUREMENT FordSysSt.FordEpsFailrPrev /end REF_MEASUREMENT /end GROUP
/begin GROUP FordSysSt.FordEpsSysSt.Val "MICROSAR RTE" /begin SUB_GROUP /end SUB_GROUP /begin FUNCTION_LIST /end FUNCTION_LIST /begin REF_CHARACTERISTIC /end REF_CHARACTERISTIC /begin REF_MEASUREMENT FordSysSt.FordEpsSysSt.Val /end REF_MEASUREMENT /end GROUP
/begin GROUP FordSysSt.FordEpsSysStPrev "MICROSAR RTE" /begin SUB_GROUP /end SUB_GROUP /begin FUNCTION_LIST /end FUNCTION_LIST /begin REF_CHARACTERISTIC /end REF_CHARACTERISTIC /begin REF_MEASUREMENT FordSysSt.FordEpsSysStPrev /end REF_MEASUREMENT /end GROUP
/begin GROUP FordSysSt.FordPwrSplyEnaReq.Logl "MICROSAR RTE" /begin SUB_GROUP /end SUB_GROUP /begin FUNCTION_LIST /end FUNCTION_LIST /begin REF_CHARACTERISTIC /end REF_CHARACTERISTIC /begin REF_MEASUREMENT FordSysSt.FordPwrSplyEnaReq.Logl /end REF_MEASUREMENT /end GROUP
/begin GROUP FordSysSt.FordSteerModlSts.Ford_SteMdule_D_Stat "MICROSAR RTE" /begin SUB_GROUP /end SUB_GROUP /begin FUNCTION_LIST /end FUNCTION_LIST /begin REF_CHARACTERISTIC /end REF_CHARACTERISTIC /begin REF_MEASUREMENT FordSysSt.FordSteerModlSts.Ford_SteMdule_D_Stat /end REF_MEASUREMENT /end GROUP
/begin GROUP FordSysSt.FordSteerModlStsPrev "MICROSAR RTE" /begin SUB_GROUP /end SUB_GROUP /begin FUNCTION_LIST /end FUNCTION_LIST /begin REF_CHARACTERISTIC /end REF_CHARACTERISTIC /begin REF_MEASUREMENT FordSysSt.FordSteerModlStsPrev /end REF_MEASUREMENT /end GROUP
/begin GROUP FordSysSt.FordVehPwrpkTqSts.Ford_PwPckTq_D_Stat "MICROSAR RTE" /begin SUB_GROUP /end SUB_GROUP /begin FUNCTION_LIST /end FUNCTION_LIST /begin REF_CHARACTERISTIC /end REF_CHARACTERISTIC /begin REF_MEASUREMENT FordSysSt.FordVehPwrpkTqSts.Ford_PwPckTq_D_Stat /end REF_MEASUREMENT /end GROUP
/begin GROUP FordSysSt.FordVehSpd.Val "MICROSAR RTE" /begin SUB_GROUP /end SUB_GROUP /begin FUNCTION_LIST /end FUNCTION_LIST /begin REF_CHARACTERISTIC /end REF_CHARACTERISTIC /begin REF_MEASUREMENT FordSysSt.FordVehSpd.Val /end REF_MEASUREMENT /end GROUP
/begin GROUP FordSysSt.FordVehSpdVld.Logl "MICROSAR RTE" /begin SUB_GROUP /end SUB_GROUP /begin FUNCTION_LIST /end FUNCTION_LIST /begin REF_CHARACTERISTIC /end REF_CHARACTERISTIC /begin REF_MEASUREMENT FordSysSt.FordVehSpdVld.Logl /end REF_MEASUREMENT /end GROUP
/begin GROUP FordSysSt.FordVltgOperRamp "MICROSAR RTE" /begin SUB_GROUP /end SUB_GROUP /begin FUNCTION_LIST /end FUNCTION_LIST /begin REF_CHARACTERISTIC /end REF_CHARACTERISTIC /begin REF_MEASUREMENT FordSysSt.FordVltgOperRamp /end REF_MEASUREMENT /end GROUP
/begin GROUP FordSysSt.FordVltgOperRamp.Val "MICROSAR RTE" /begin SUB_GROUP /end SUB_GROUP /begin FUNCTION_LIST /end FUNCTION_LIST /begin REF_CHARACTERISTIC /end REF_CHARACTERISTIC /begin REF_MEASUREMENT FordSysSt.FordVltgOperRamp.Val /end REF_MEASUREMENT /end GROUP
/begin GROUP FordSysSt.FordVltgOperScar "MICROSAR RTE" /begin SUB_GROUP /end SUB_GROUP /begin FUNCTION_LIST /end FUNCTION_LIST /begin REF_CHARACTERISTIC /end REF_CHARACTERISTIC /begin REF_MEASUREMENT FordSysSt.FordVltgOperScar /end REF_MEASUREMENT /end GROUP
/begin GROUP FordSysSt.FordVltgOperScar.Val "MICROSAR RTE" /begin SUB_GROUP /end SUB_GROUP /begin FUNCTION_LIST /end FUNCTION_LIST /begin REF_CHARACTERISTIC /end REF_CHARACTERISTIC /begin REF_MEASUREMENT FordSysSt.FordVltgOperScar.Val /end REF_MEASUREMENT /end GROUP
/begin GROUP FordSysSt.FordVltgOperSt.Val "MICROSAR RTE" /begin SUB_GROUP /end SUB_GROUP /begin FUNCTION_LIST /end FUNCTION_LIST /begin REF_CHARACTERISTIC /end REF_CHARACTERISTIC /begin REF_MEASUREMENT FordSysSt.FordVltgOperSt.Val /end REF_MEASUREMENT /end GROUP
/begin GROUP FordSysSt.FullAssiRampUpRate.Val "MICROSAR RTE" /begin SUB_GROUP /end SUB_GROUP /begin FUNCTION_LIST /end FUNCTION_LIST /begin REF_CHARACTERISTIC FordSysSt.FullAssiRampUpRate.Val /end REF_CHARACTERISTIC /begin REF_MEASUREMENT /end REF_MEASUREMENT /end GROUP
/begin GROUP FordSysSt.InitLimpHomeRamp.Val "MICROSAR RTE" /begin SUB_GROUP /end SUB_GROUP /begin FUNCTION_LIST /end FUNCTION_LIST /begin REF_CHARACTERISTIC FordSysSt.InitLimpHomeRamp.Val /end REF_CHARACTERISTIC /begin REF_MEASUREMENT /end REF_MEASUREMENT /end GROUP
/begin GROUP FordSysSt.InitLimpHomeScar.Val "MICROSAR RTE" /begin SUB_GROUP /end SUB_GROUP /begin FUNCTION_LIST /end FUNCTION_LIST /begin REF_CHARACTERISTIC FordSysSt.InitLimpHomeScar.Val /end REF_CHARACTERISTIC /begin REF_MEASUREMENT /end REF_MEASUREMENT /end GROUP
/begin GROUP FordSysSt.LimdAssiRamp.Val "MICROSAR RTE" /begin SUB_GROUP /end SUB_GROUP /begin FUNCTION_LIST /end FUNCTION_LIST /begin REF_CHARACTERISTIC FordSysSt.LimdAssiRamp.Val /end REF_CHARACTERISTIC /begin REF_MEASUREMENT /end REF_MEASUREMENT /end GROUP
/begin GROUP FordSysSt.LimdAssiRampUpRate.Val "MICROSAR RTE" /begin SUB_GROUP /end SUB_GROUP /begin FUNCTION_LIST /end FUNCTION_LIST /begin REF_CHARACTERISTIC FordSysSt.LimdAssiRampUpRate.Val /end REF_CHARACTERISTIC /begin REF_MEASUREMENT /end REF_MEASUREMENT /end GROUP
/begin GROUP FordSysSt.LimdAssiRampUpRateFaild.Val "MICROSAR RTE" /begin SUB_GROUP /end SUB_GROUP /begin FUNCTION_LIST /end FUNCTION_LIST /begin REF_CHARACTERISTIC FordSysSt.LimdAssiRampUpRateFaild.Val /end REF_CHARACTERISTIC /begin REF_MEASUREMENT /end REF_MEASUREMENT /end GROUP
/begin GROUP FordSysSt.LimdAssiScar.Val "MICROSAR RTE" /begin SUB_GROUP /end SUB_GROUP /begin FUNCTION_LIST /end FUNCTION_LIST /begin REF_CHARACTERISTIC FordSysSt.LimdAssiScar.Val /end REF_CHARACTERISTIC /begin REF_MEASUREMENT /end REF_MEASUREMENT /end GROUP
/begin GROUP FordSysSt.LoaSt.Val "MICROSAR RTE" /begin SUB_GROUP /end SUB_GROUP /begin FUNCTION_LIST /end FUNCTION_LIST /begin REF_CHARACTERISTIC /end REF_CHARACTERISTIC /begin REF_MEASUREMENT FordSysSt.LoaSt.Val /end REF_MEASUREMENT /end GROUP
/begin GROUP FordSysSt.NormLimpHomeRamp.Val "MICROSAR RTE" /begin SUB_GROUP /end SUB_GROUP /begin FUNCTION_LIST /end FUNCTION_LIST /begin REF_CHARACTERISTIC FordSysSt.NormLimpHomeRamp.Val /end REF_CHARACTERISTIC /begin REF_MEASUREMENT /end REF_MEASUREMENT /end GROUP
/begin GROUP FordSysSt.NormLimpHomeScar.Val "MICROSAR RTE" /begin SUB_GROUP /end SUB_GROUP /begin FUNCTION_LIST /end FUNCTION_LIST /begin REF_CHARACTERISTIC FordSysSt.NormLimpHomeScar.Val /end REF_CHARACTERISTIC /begin REF_MEASUREMENT /end REF_MEASUREMENT /end GROUP
/begin GROUP FordSysSt.OperRampRate.Val "MICROSAR RTE" /begin SUB_GROUP /end SUB_GROUP /begin FUNCTION_LIST /end FUNCTION_LIST /begin REF_CHARACTERISTIC /end REF_CHARACTERISTIC /begin REF_MEASUREMENT FordSysSt.OperRampRate.Val /end REF_MEASUREMENT /end GROUP
/begin GROUP FordSysSt.OperRampRatePrev "MICROSAR RTE" /begin SUB_GROUP /end SUB_GROUP /begin FUNCTION_LIST /end FUNCTION_LIST /begin REF_CHARACTERISTIC /end REF_CHARACTERISTIC /begin REF_MEASUREMENT FordSysSt.OperRampRatePrev /end REF_MEASUREMENT /end GROUP
/begin GROUP FordSysSt.OperScaFctr.Val "MICROSAR RTE" /begin SUB_GROUP /end SUB_GROUP /begin FUNCTION_LIST /end FUNCTION_LIST /begin REF_CHARACTERISTIC /end REF_CHARACTERISTIC /begin REF_MEASUREMENT FordSysSt.OperScaFctr.Val /end REF_MEASUREMENT /end GROUP
/begin GROUP FordSysSt.OperScaFctrPrev "MICROSAR RTE" /begin SUB_GROUP /end SUB_GROUP /begin FUNCTION_LIST /end FUNCTION_LIST /begin REF_CHARACTERISTIC /end REF_CHARACTERISTIC /begin REF_MEASUREMENT FordSysSt.OperScaFctrPrev /end REF_MEASUREMENT /end GROUP
/begin GROUP FordSysSt.PerInstanceMemories "MICROSAR RTE"
 /begin SUB_GROUP FordSysSt.FordEpsFailrPrev FordSysSt.FordEpsSysStPrev FordSysSt.FordSteerModlStsPrev FordSysSt.FordVltgOperRamp FordSysSt.FordVltgOperScar FordSysSt.OperRampRatePrev FordSysSt.OperScaFctrPrev FordSysSt.SysStReqEnaPrev /end SUB_GROUP
 /begin FUNCTION_LIST /end FUNCTION_LIST
 /begin REF_CHARACTERISTIC /end REF_CHARACTERISTIC
 /begin REF_MEASUREMENT /end REF_MEASUREMENT
/end GROUP
/begin GROUP FordSysSt.ReceiverPorts "MICROSAR RTE"
 /begin SUB_GROUP FordSysSt.EngOnSerlComSrvDft.Logl FordSysSt.FordVehPwrpkTqSts.Ford_PwPckTq_D_Stat FordSysSt.FordVehSpd.Val FordSysSt.FordVehSpdVld.Logl FordSysSt.FordVltgOperRamp.Val FordSysSt.FordVltgOperScar.Val FordSysSt.FordVltgOperSt.Val FordSysSt.LoaSt.Val FordSysSt.SysSt.Val FordSysSt.SysStReqEnaOvrd.Logl FordSysSt.SysStWrmIninCmpl.Logl /end SUB_GROUP
 /begin FUNCTION_LIST /end FUNCTION_LIST
 /begin REF_CHARACTERISTIC /end REF_CHARACTERISTIC
 /begin REF_MEASUREMENT /end REF_MEASUREMENT
/end GROUP
/begin GROUP FordSysSt.SenderPorts "MICROSAR RTE"
 /begin SUB_GROUP FordSysSt.FordEpsFailr.Ford_EPAS_Failure FordSysSt.FordEpsSysSt.Val FordSysSt.FordPwrSplyEnaReq.Logl FordSysSt.FordSteerModlSts.Ford_SteMdule_D_Stat FordSysSt.OperRampRate.Val FordSysSt.OperScaFctr.Val FordSysSt.SysStReqEna.Logl /end SUB_GROUP
 /begin FUNCTION_LIST /end FUNCTION_LIST
 /begin REF_CHARACTERISTIC /end REF_CHARACTERISTIC
 /begin REF_MEASUREMENT /end REF_MEASUREMENT
/end GROUP
/begin GROUP FordSysSt.ShtdwnRamp.Val "MICROSAR RTE" /begin SUB_GROUP /end SUB_GROUP /begin FUNCTION_LIST /end FUNCTION_LIST /begin REF_CHARACTERISTIC FordSysSt.ShtdwnRamp.Val /end REF_CHARACTERISTIC /begin REF_MEASUREMENT /end REF_MEASUREMENT /end GROUP
/begin GROUP FordSysSt.SysSt.Val "MICROSAR RTE" /begin SUB_GROUP /end SUB_GROUP /begin FUNCTION_LIST /end FUNCTION_LIST /begin REF_CHARACTERISTIC /end REF_CHARACTERISTIC /begin REF_MEASUREMENT FordSysSt.SysSt.Val /end REF_MEASUREMENT /end GROUP
/begin GROUP FordSysSt.SysStReqEna.Logl "MICROSAR RTE" /begin SUB_GROUP /end SUB_GROUP /begin FUNCTION_LIST /end FUNCTION_LIST /begin REF_CHARACTERISTIC /end REF_CHARACTERISTIC /begin REF_MEASUREMENT FordSysSt.SysStReqEna.Logl /end REF_MEASUREMENT /end GROUP
/begin GROUP FordSysSt.SysStReqEnaOvrd.Logl "MICROSAR RTE" /begin SUB_GROUP /end SUB_GROUP /begin FUNCTION_LIST /end FUNCTION_LIST /begin REF_CHARACTERISTIC /end REF_CHARACTERISTIC /begin REF_MEASUREMENT FordSysSt.SysStReqEnaOvrd.Logl /end REF_MEASUREMENT /end GROUP
/begin GROUP FordSysSt.SysStReqEnaPrev "MICROSAR RTE" /begin SUB_GROUP /end SUB_GROUP /begin FUNCTION_LIST /end FUNCTION_LIST /begin REF_CHARACTERISTIC /end REF_CHARACTERISTIC /begin REF_MEASUREMENT FordSysSt.SysStReqEnaPrev /end REF_MEASUREMENT /end GROUP
/begin GROUP FordSysSt.SysStWrmIninCmpl.Logl "MICROSAR RTE" /begin SUB_GROUP /end SUB_GROUP /begin FUNCTION_LIST /end FUNCTION_LIST /begin REF_CHARACTERISTIC /end REF_CHARACTERISTIC /begin REF_MEASUREMENT FordSysSt.SysStWrmIninCmpl.Logl /end REF_MEASUREMENT /end GROUP
/begin GROUP FordVehSpdArbn "MICROSAR RTE"
 /begin SUB_GROUP FordVehSpdArbn.CalibrationPorts FordVehSpdArbn.PerInstanceMemories FordVehSpdArbn.ReceiverPorts FordVehSpdArbn.SenderPorts /end SUB_GROUP
 /begin FUNCTION_LIST /end FUNCTION_LIST
 /begin REF_CHARACTERISTIC /end REF_CHARACTERISTIC
 /begin REF_MEASUREMENT /end REF_MEASUREMENT
/end GROUP
/begin GROUP FordVehSpdArbn.CalibrationPorts "MICROSAR RTE"
 /begin SUB_GROUP FordVehSpdArbn.FordVehSpdArbnDrvnWhl.Logl FordVehSpdArbn.FordVehSpdArbnTireCircumMax.Val FordVehSpdArbn.FordVehSpdArbnTireCircumMin.Val /end SUB_GROUP
 /begin FUNCTION_LIST /end FUNCTION_LIST
 /begin REF_CHARACTERISTIC /end REF_CHARACTERISTIC
 /begin REF_MEASUREMENT /end REF_MEASUREMENT
/end GROUP
/begin GROUP FordVehSpdArbn.FordAbsModlPrsnt.Logl "MICROSAR RTE" /begin SUB_GROUP /end SUB_GROUP /begin FUNCTION_LIST /end FUNCTION_LIST /begin REF_CHARACTERISTIC /end REF_CHARACTERISTIC /begin REF_MEASUREMENT FordVehSpdArbn.FordAbsModlPrsnt.Logl /end REF_MEASUREMENT /end GROUP
/begin GROUP FordVehSpdArbn.FordEscModlPrsnt.Logl "MICROSAR RTE" /begin SUB_GROUP /end SUB_GROUP /begin FUNCTION_LIST /end FUNCTION_LIST /begin REF_CHARACTERISTIC /end REF_CHARACTERISTIC /begin REF_MEASUREMENT FordVehSpdArbn.FordEscModlPrsnt.Logl /end REF_MEASUREMENT /end GROUP
/begin GROUP FordVehSpdArbn.FordVehFrntLeWhlSpd.Val "MICROSAR RTE" /begin SUB_GROUP /end SUB_GROUP /begin FUNCTION_LIST /end FUNCTION_LIST /begin REF_CHARACTERISTIC /end REF_CHARACTERISTIC /begin REF_MEASUREMENT FordVehSpdArbn.FordVehFrntLeWhlSpd.Val /end REF_MEASUREMENT /end GROUP
/begin GROUP FordVehSpdArbn.FordVehFrntLeWhlSpdVld.Logl "MICROSAR RTE" /begin SUB_GROUP /end SUB_GROUP /begin FUNCTION_LIST /end FUNCTION_LIST /begin REF_CHARACTERISTIC /end REF_CHARACTERISTIC /begin REF_MEASUREMENT FordVehSpdArbn.FordVehFrntLeWhlSpdVld.Logl /end REF_MEASUREMENT /end GROUP
/begin GROUP FordVehSpdArbn.FordVehFrntRiWhlSpd.Val "MICROSAR RTE" /begin SUB_GROUP /end SUB_GROUP /begin FUNCTION_LIST /end FUNCTION_LIST /begin REF_CHARACTERISTIC /end REF_CHARACTERISTIC /begin REF_MEASUREMENT FordVehSpdArbn.FordVehFrntRiWhlSpd.Val /end REF_MEASUREMENT /end GROUP
/begin GROUP FordVehSpdArbn.FordVehFrntRiWhlSpdVld.Logl "MICROSAR RTE" /begin SUB_GROUP /end SUB_GROUP /begin FUNCTION_LIST /end FUNCTION_LIST /begin REF_CHARACTERISTIC /end REF_CHARACTERISTIC /begin REF_MEASUREMENT FordVehSpdArbn.FordVehFrntRiWhlSpdVld.Logl /end REF_MEASUREMENT /end GROUP
/begin GROUP FordVehSpdArbn.FordVehReLeWhlSpd.Val "MICROSAR RTE" /begin SUB_GROUP /end SUB_GROUP /begin FUNCTION_LIST /end FUNCTION_LIST /begin REF_CHARACTERISTIC /end REF_CHARACTERISTIC /begin REF_MEASUREMENT FordVehSpdArbn.FordVehReLeWhlSpd.Val /end REF_MEASUREMENT /end GROUP
/begin GROUP FordVehSpdArbn.FordVehReLeWhlSpdVld.Logl "MICROSAR RTE" /begin SUB_GROUP /end SUB_GROUP /begin FUNCTION_LIST /end FUNCTION_LIST /begin REF_CHARACTERISTIC /end REF_CHARACTERISTIC /begin REF_MEASUREMENT FordVehSpdArbn.FordVehReLeWhlSpdVld.Logl /end REF_MEASUREMENT /end GROUP
/begin GROUP FordVehSpdArbn.FordVehReRiWhlSpd.Val "MICROSAR RTE" /begin SUB_GROUP /end SUB_GROUP /begin FUNCTION_LIST /end FUNCTION_LIST /begin REF_CHARACTERISTIC /end REF_CHARACTERISTIC /begin REF_MEASUREMENT FordVehSpdArbn.FordVehReRiWhlSpd.Val /end REF_MEASUREMENT /end GROUP
/begin GROUP FordVehSpdArbn.FordVehReRiWhlSpdVld.Logl "MICROSAR RTE" /begin SUB_GROUP /end SUB_GROUP /begin FUNCTION_LIST /end FUNCTION_LIST /begin REF_CHARACTERISTIC /end REF_CHARACTERISTIC /begin REF_MEASUREMENT FordVehSpdArbn.FordVehReRiWhlSpdVld.Logl /end REF_MEASUREMENT /end GROUP
/begin GROUP FordVehSpdArbn.FordVehSpd.Val "MICROSAR RTE" /begin SUB_GROUP /end SUB_GROUP /begin FUNCTION_LIST /end FUNCTION_LIST /begin REF_CHARACTERISTIC /end REF_CHARACTERISTIC /begin REF_MEASUREMENT FordVehSpdArbn.FordVehSpd.Val /end REF_MEASUREMENT /end GROUP
/begin GROUP FordVehSpdArbn.FordVehSpdArbnDrvnWhl.Logl "MICROSAR RTE" /begin SUB_GROUP /end SUB_GROUP /begin FUNCTION_LIST /end FUNCTION_LIST /begin REF_CHARACTERISTIC FordVehSpdArbn.FordVehSpdArbnDrvnWhl.Logl /end REF_CHARACTERISTIC /begin REF_MEASUREMENT /end REF_MEASUREMENT /end GROUP
/begin GROUP FordVehSpdArbn.FordVehSpdArbnTireCircumMax.Val "MICROSAR RTE" /begin SUB_GROUP /end SUB_GROUP /begin FUNCTION_LIST /end FUNCTION_LIST /begin REF_CHARACTERISTIC FordVehSpdArbn.FordVehSpdArbnTireCircumMax.Val /end REF_CHARACTERISTIC /begin REF_MEASUREMENT /end REF_MEASUREMENT /end GROUP
/begin GROUP FordVehSpdArbn.FordVehSpdArbnTireCircumMin.Val "MICROSAR RTE" /begin SUB_GROUP /end SUB_GROUP /begin FUNCTION_LIST /end FUNCTION_LIST /begin REF_CHARACTERISTIC FordVehSpdArbn.FordVehSpdArbnTireCircumMin.Val /end REF_CHARACTERISTIC /begin REF_MEASUREMENT /end REF_MEASUREMENT /end GROUP
/begin GROUP FordVehSpdArbn.FordVehSpdBrkModl.Val "MICROSAR RTE" /begin SUB_GROUP /end SUB_GROUP /begin FUNCTION_LIST /end FUNCTION_LIST /begin REF_CHARACTERISTIC /end REF_CHARACTERISTIC /begin REF_MEASUREMENT FordVehSpdArbn.FordVehSpdBrkModl.Val /end REF_MEASUREMENT /end GROUP
/begin GROUP FordVehSpdArbn.FordVehSpdBrkModlLoQlyVld.Logl "MICROSAR RTE" /begin SUB_GROUP /end SUB_GROUP /begin FUNCTION_LIST /end FUNCTION_LIST /begin REF_CHARACTERISTIC /end REF_CHARACTERISTIC /begin REF_MEASUREMENT FordVehSpdArbn.FordVehSpdBrkModlLoQlyVld.Logl /end REF_MEASUREMENT /end GROUP
/begin GROUP FordVehSpdArbn.FordVehSpdBrkModlVld.Logl "MICROSAR RTE" /begin SUB_GROUP /end SUB_GROUP /begin FUNCTION_LIST /end FUNCTION_LIST /begin REF_CHARACTERISTIC /end REF_CHARACTERISTIC /begin REF_MEASUREMENT FordVehSpdArbn.FordVehSpdBrkModlVld.Logl /end REF_MEASUREMENT /end GROUP
/begin GROUP FordVehSpdArbn.FordVehSpdEngModl.Val "MICROSAR RTE" /begin SUB_GROUP /end SUB_GROUP /begin FUNCTION_LIST /end FUNCTION_LIST /begin REF_CHARACTERISTIC /end REF_CHARACTERISTIC /begin REF_MEASUREMENT FordVehSpdArbn.FordVehSpdEngModl.Val /end REF_MEASUREMENT /end GROUP
/begin GROUP FordVehSpdArbn.FordVehSpdEngModlLoQlyVld.Logl "MICROSAR RTE" /begin SUB_GROUP /end SUB_GROUP /begin FUNCTION_LIST /end FUNCTION_LIST /begin REF_CHARACTERISTIC /end REF_CHARACTERISTIC /begin REF_MEASUREMENT FordVehSpdArbn.FordVehSpdEngModlLoQlyVld.Logl /end REF_MEASUREMENT /end GROUP
/begin GROUP FordVehSpdArbn.FordVehSpdEngModlVld.Logl "MICROSAR RTE" /begin SUB_GROUP /end SUB_GROUP /begin FUNCTION_LIST /end FUNCTION_LIST /begin REF_CHARACTERISTIC /end REF_CHARACTERISTIC /begin REF_MEASUREMENT FordVehSpdArbn.FordVehSpdEngModlVld.Logl /end REF_MEASUREMENT /end GROUP
/begin GROUP FordVehSpdArbn.FordVehSpdLoQly.Val "MICROSAR RTE" /begin SUB_GROUP /end SUB_GROUP /begin FUNCTION_LIST /end FUNCTION_LIST /begin REF_CHARACTERISTIC /end REF_CHARACTERISTIC /begin REF_MEASUREMENT FordVehSpdArbn.FordVehSpdLoQly.Val /end REF_MEASUREMENT /end GROUP
/begin GROUP FordVehSpdArbn.FordVehSpdLoQlyVld.Logl "MICROSAR RTE" /begin SUB_GROUP /end SUB_GROUP /begin FUNCTION_LIST /end FUNCTION_LIST /begin REF_CHARACTERISTIC /end REF_CHARACTERISTIC /begin REF_MEASUREMENT FordVehSpdArbn.FordVehSpdLoQlyVld.Logl /end REF_MEASUREMENT /end GROUP
/begin GROUP FordVehSpdArbn.FordVehSpdVld.Logl "MICROSAR RTE" /begin SUB_GROUP /end SUB_GROUP /begin FUNCTION_LIST /end FUNCTION_LIST /begin REF_CHARACTERISTIC /end REF_CHARACTERISTIC /begin REF_MEASUREMENT FordVehSpdArbn.FordVehSpdVld.Logl /end REF_MEASUREMENT /end GROUP
/begin GROUP FordVehSpdArbn.FordVehTireCircum "MICROSAR RTE" /begin SUB_GROUP /end SUB_GROUP /begin FUNCTION_LIST /end FUNCTION_LIST /begin REF_CHARACTERISTIC /end REF_CHARACTERISTIC /begin REF_MEASUREMENT FordVehSpdArbn.FordVehTireCircum /end REF_MEASUREMENT /end GROUP
/begin GROUP FordVehSpdArbn.FordVehTireCircumIn.Val "MICROSAR RTE" /begin SUB_GROUP /end SUB_GROUP /begin FUNCTION_LIST /end FUNCTION_LIST /begin REF_CHARACTERISTIC /end REF_CHARACTERISTIC /begin REF_MEASUREMENT FordVehSpdArbn.FordVehTireCircumIn.Val /end REF_MEASUREMENT /end GROUP
/begin GROUP FordVehSpdArbn.PerInstanceMemories "MICROSAR RTE" /begin SUB_GROUP FordVehSpdArbn.FordVehTireCircum /end SUB_GROUP /begin FUNCTION_LIST /end FUNCTION_LIST /begin REF_CHARACTERISTIC /end REF_CHARACTERISTIC /begin REF_MEASUREMENT /end REF_MEASUREMENT /end GROUP
/begin GROUP FordVehSpdArbn.ReceiverPorts "MICROSAR RTE"
 /begin SUB_GROUP FordVehSpdArbn.FordAbsModlPrsnt.Logl FordVehSpdArbn.FordEscModlPrsnt.Logl FordVehSpdArbn.FordVehFrntLeWhlSpd.Val FordVehSpdArbn.FordVehFrntLeWhlSpdVld.Logl FordVehSpdArbn.FordVehFrntRiWhlSpd.Val FordVehSpdArbn.FordVehFrntRiWhlSpdVld.Logl FordVehSpdArbn.FordVehReLeWhlSpd.Val FordVehSpdArbn.FordVehReLeWhlSpdVld.Logl FordVehSpdArbn.FordVehReRiWhlSpd.Val FordVehSpdArbn.FordVehReRiWhlSpdVld.Logl FordVehSpdArbn.FordVehSpdBrkModl.Val FordVehSpdArbn.FordVehSpdBrkModlLoQlyVld.Logl FordVehSpdArbn.FordVehSpdBrkModlVld.Logl FordVehSpdArbn.FordVehSpdEngModl.Val FordVehSpdArbn.FordVehSpdEngModlLoQlyVld.Logl FordVehSpdArbn.FordVehSpdEngModlVld.Logl FordVehSpdArbn.FordVehTireCircumIn.Val /end SUB_GROUP
 /begin FUNCTION_LIST /end FUNCTION_LIST
 /begin REF_CHARACTERISTIC /end REF_CHARACTERISTIC
 /begin REF_MEASUREMENT /end REF_MEASUREMENT
/end GROUP
/begin GROUP FordVehSpdArbn.SenderPorts "MICROSAR RTE"
 /begin SUB_GROUP FordVehSpdArbn.FordVehSpd.Val FordVehSpdArbn.FordVehSpdLoQly.Val FordVehSpdArbn.FordVehSpdLoQlyVld.Logl FordVehSpdArbn.FordVehSpdVld.Logl /end SUB_GROUP
 /begin FUNCTION_LIST /end FUNCTION_LIST
 /begin REF_CHARACTERISTIC /end REF_CHARACTERISTIC
 /begin REF_MEASUREMENT /end REF_MEASUREMENT
/end GROUP
/begin GROUP FordVltgIf "MICROSAR RTE"
 /begin SUB_GROUP FordVltgIf.CalibrationPorts FordVltgIf.PerInstanceMemories FordVltgIf.ReceiverPorts FordVltgIf.SenderPorts /end SUB_GROUP
 /begin FUNCTION_LIST /end FUNCTION_LIST
 /begin REF_CHARACTERISTIC /end REF_CHARACTERISTIC
 /begin REF_MEASUREMENT /end REF_MEASUREMENT
/end GROUP
/begin GROUP FordVltgIf.BattRtnCurr.Val "MICROSAR RTE" /begin SUB_GROUP /end SUB_GROUP /begin FUNCTION_LIST /end FUNCTION_LIST /begin REF_CHARACTERISTIC /end REF_CHARACTERISTIC /begin REF_MEASUREMENT FordVltgIf.BattRtnCurr.Val /end REF_MEASUREMENT /end GROUP
/begin GROUP FordVltgIf.BattVltg.Val "MICROSAR RTE" /begin SUB_GROUP /end SUB_GROUP /begin FUNCTION_LIST /end FUNCTION_LIST /begin REF_CHARACTERISTIC /end REF_CHARACTERISTIC /begin REF_MEASUREMENT FordVltgIf.BattVltg.Val /end REF_MEASUREMENT /end GROUP
/begin GROUP FordVltgIf.CalibrationPorts "MICROSAR RTE"
 /begin SUB_GROUP FordVltgIf.FordVltgIfActvParkAssiAsscTqMin.Val FordVltgIf.FordVltgIfEPSBattVltgDifThd.Val FordVltgIf.FordVltgIfEpsBattCurrLim.Val FordVltgIf.FordVltgIfEpsCurrLim.Val FordVltgIf.FordVltgIfEvasSteerAssiTqMin.Val FordVltgIf.FordVltgIfFeatThdStsTiThd.Val FordVltgIf.FordVltgIfHiVltgAssiRampDwnRate.Val FordVltgIf.FordVltgIfHiVltgAssiRampUpRate.Val FordVltgIf.FordVltgIfHiVltgInhbTiMax.Val FordVltgIf.FordVltgIfHiVltgNoAssiRampDwnRate.Val FordVltgIf.FordVltgIfHiVltgNoAssiRcvrTiMax.Val FordVltgIf.FordVltgIfHiVltgRcvrTiMax.Val FordVltgIf.FordVltgIfHiVltgThdHi.Val FordVltgIf.FordVltgIfHiVltgThdLo.Val FordVltgIf.FordVltgIfInhbBattVltgDiagcTiThd.Val FordVltgIf.FordVltgIfLaneCentrAssiTqMin.Val FordVltgIf.FordVltgIfLaneDprtrWarnAsscTqMin.Val FordVltgIf.FordVltgIfLkaAsscTqMin.Val FordVltgIf.FordVltgIfLoVltgAssiRampDwnRate.Val FordVltgIf.FordVltgIfLoVltgAssiRampUpRate.Val FordVltgIf.FordVltgIfLoVltgAssiScar.Val FordVltgIf.FordVltgIfLoVltgInhbTiMax.Val FordVltgIf.FordVltgIfLoVltgNoAssiRampDwnRate.Val FordVltgIf.FordVltgIfLoVltgNoAssiRcvrTiMax.Val FordVltgIf.FordVltgIfLoVltgRcvrTiMax.Val FordVltgIf.FordVltgIfLoVltgThdHi.Val FordVltgIf.FordVltgIfLoVltgThdLo.Val FordVltgIf.FordVltgIfLoVltgThdMid.Val FordVltgIf.FordVltgIfLoVltgThdMidToLoTiMax.Val FordVltgIf.FordVltgIfLoVltgTqScaDwnRate.Val FordVltgIf.FordVltgIfLoVltgTqScaUpRate.Val FordVltgIf.FordVltgIfLoVltgTqScagFac.Val FordVltgIf.FordVltgIfTrfcJamAsscTqMin.Val FordVltgIf.FordVltgIfTrlrBackupAssiTqMin.Val FordVltgIf.FordVltgIfVehBattCircR.Val /end SUB_GROUP
 /begin FUNCTION_LIST /end FUNCTION_LIST
 /begin REF_CHARACTERISTIC /end REF_CHARACTERISTIC
 /begin REF_MEASUREMENT /end REF_MEASUREMENT
/end GROUP
/begin GROUP FordVltgIf.FeatThdStsRefTi "MICROSAR RTE" /begin SUB_GROUP /end SUB_GROUP /begin FUNCTION_LIST /end FUNCTION_LIST /begin REF_CHARACTERISTIC /end REF_CHARACTERISTIC /begin REF_MEASUREMENT FordVltgIf.FeatThdStsRefTi /end REF_MEASUREMENT /end GROUP
/begin GROUP FordVltgIf.FordActvParkAssiEnad.Logl "MICROSAR RTE" /begin SUB_GROUP /end SUB_GROUP /begin FUNCTION_LIST /end FUNCTION_LIST /begin REF_CHARACTERISTIC /end REF_CHARACTERISTIC /begin REF_MEASUREMENT FordVltgIf.FordActvParkAssiEnad.Logl /end REF_MEASUREMENT /end GROUP
/begin GROUP FordVltgIf.FordEpsCurr.Val "MICROSAR RTE" /begin SUB_GROUP /end SUB_GROUP /begin FUNCTION_LIST /end FUNCTION_LIST /begin REF_CHARACTERISTIC /end REF_CHARACTERISTIC /begin REF_MEASUREMENT FordVltgIf.FordEpsCurr.Val /end REF_MEASUREMENT /end GROUP
/begin GROUP FordVltgIf.FordEpsCurrVal.Logl "MICROSAR RTE" /begin SUB_GROUP /end SUB_GROUP /begin FUNCTION_LIST /end FUNCTION_LIST /begin REF_CHARACTERISTIC /end REF_CHARACTERISTIC /begin REF_MEASUREMENT FordVltgIf.FordEpsCurrVal.Logl /end REF_MEASUREMENT /end GROUP
/begin GROUP FordVltgIf.FordEpsVltg.Val "MICROSAR RTE" /begin SUB_GROUP /end SUB_GROUP /begin FUNCTION_LIST /end FUNCTION_LIST /begin REF_CHARACTERISTIC /end REF_CHARACTERISTIC /begin REF_MEASUREMENT FordVltgIf.FordEpsVltg.Val /end REF_MEASUREMENT /end GROUP
/begin GROUP FordVltgIf.FordEpsVltgVal.Logl "MICROSAR RTE" /begin SUB_GROUP /end SUB_GROUP /begin FUNCTION_LIST /end FUNCTION_LIST /begin REF_CHARACTERISTIC /end REF_CHARACTERISTIC /begin REF_MEASUREMENT FordVltgIf.FordEpsVltgVal.Logl /end REF_MEASUREMENT /end GROUP
/begin GROUP FordVltgIf.FordEvasSteerAssiEnad.Logl "MICROSAR RTE" /begin SUB_GROUP /end SUB_GROUP /begin FUNCTION_LIST /end FUNCTION_LIST /begin REF_CHARACTERISTIC /end REF_CHARACTERISTIC /begin REF_MEASUREMENT FordVltgIf.FordEvasSteerAssiEnad.Logl /end REF_MEASUREMENT /end GROUP
/begin GROUP FordVltgIf.FordFeatThdSts.Logl "MICROSAR RTE" /begin SUB_GROUP /end SUB_GROUP /begin FUNCTION_LIST /end FUNCTION_LIST /begin REF_CHARACTERISTIC /end REF_CHARACTERISTIC /begin REF_MEASUREMENT FordVltgIf.FordFeatThdSts.Logl /end REF_MEASUREMENT /end GROUP
/begin GROUP FordVltgIf.FordInhbBattVltgDiagc.Logl "MICROSAR RTE" /begin SUB_GROUP /end SUB_GROUP /begin FUNCTION_LIST /end FUNCTION_LIST /begin REF_CHARACTERISTIC /end REF_CHARACTERISTIC /begin REF_MEASUREMENT FordVltgIf.FordInhbBattVltgDiagc.Logl /end REF_MEASUREMENT /end GROUP
/begin GROUP FordVltgIf.FordLaneCentrAssiEnad.Logl "MICROSAR RTE" /begin SUB_GROUP /end SUB_GROUP /begin FUNCTION_LIST /end FUNCTION_LIST /begin REF_CHARACTERISTIC /end REF_CHARACTERISTIC /begin REF_MEASUREMENT FordVltgIf.FordLaneCentrAssiEnad.Logl /end REF_MEASUREMENT /end GROUP
/begin GROUP FordVltgIf.FordLaneDprtrWarnEnad.Logl "MICROSAR RTE" /begin SUB_GROUP /end SUB_GROUP /begin FUNCTION_LIST /end FUNCTION_LIST /begin REF_CHARACTERISTIC /end REF_CHARACTERISTIC /begin REF_MEASUREMENT FordVltgIf.FordLaneDprtrWarnEnad.Logl /end REF_MEASUREMENT /end GROUP
/begin GROUP FordVltgIf.FordLaneKeepAssiEnad.Logl "MICROSAR RTE" /begin SUB_GROUP /end SUB_GROUP /begin FUNCTION_LIST /end FUNCTION_LIST /begin REF_CHARACTERISTIC /end REF_CHARACTERISTIC /begin REF_MEASUREMENT FordVltgIf.FordLaneKeepAssiEnad.Logl /end REF_MEASUREMENT /end GROUP
/begin GROUP FordVltgIf.FordMaxAsscTq.Val "MICROSAR RTE" /begin SUB_GROUP /end SUB_GROUP /begin FUNCTION_LIST /end FUNCTION_LIST /begin REF_CHARACTERISTIC /end REF_CHARACTERISTIC /begin REF_MEASUREMENT FordVltgIf.FordMaxAsscTq.Val /end REF_MEASUREMENT /end GROUP
/begin GROUP FordVltgIf.FordMaxBattCurr.Val "MICROSAR RTE" /begin SUB_GROUP /end SUB_GROUP /begin FUNCTION_LIST /end FUNCTION_LIST /begin REF_CHARACTERISTIC /end REF_CHARACTERISTIC /begin REF_MEASUREMENT FordVltgIf.FordMaxBattCurr.Val /end REF_MEASUREMENT /end GROUP
/begin GROUP FordVltgIf.FordMinBattVltg.Val "MICROSAR RTE" /begin SUB_GROUP /end SUB_GROUP /begin FUNCTION_LIST /end FUNCTION_LIST /begin REF_CHARACTERISTIC /end REF_CHARACTERISTIC /begin REF_MEASUREMENT FordVltgIf.FordMinBattVltg.Val /end REF_MEASUREMENT /end GROUP
/begin GROUP FordVltgIf.FordStrtStopSt.Val "MICROSAR RTE" /begin SUB_GROUP /end SUB_GROUP /begin FUNCTION_LIST /end FUNCTION_LIST /begin REF_CHARACTERISTIC /end REF_CHARACTERISTIC /begin REF_MEASUREMENT FordVltgIf.FordStrtStopSt.Val /end REF_MEASUREMENT /end GROUP
/begin GROUP FordVltgIf.FordSysSt.Val "MICROSAR RTE" /begin SUB_GROUP /end SUB_GROUP /begin FUNCTION_LIST /end FUNCTION_LIST /begin REF_CHARACTERISTIC /end REF_CHARACTERISTIC /begin REF_MEASUREMENT FordVltgIf.FordSysSt.Val /end REF_MEASUREMENT /end GROUP
/begin GROUP FordVltgIf.FordTrfcJamAssiEnad.Logl "MICROSAR RTE" /begin SUB_GROUP /end SUB_GROUP /begin FUNCTION_LIST /end FUNCTION_LIST /begin REF_CHARACTERISTIC /end REF_CHARACTERISTIC /begin REF_MEASUREMENT FordVltgIf.FordTrfcJamAssiEnad.Logl /end REF_MEASUREMENT /end GROUP
/begin GROUP FordVltgIf.FordTrlrBackupAssiEnad.Logl "MICROSAR RTE" /begin SUB_GROUP /end SUB_GROUP /begin FUNCTION_LIST /end FUNCTION_LIST /begin REF_CHARACTERISTIC /end REF_CHARACTERISTIC /begin REF_MEASUREMENT FordVltgIf.FordTrlrBackupAssiEnad.Logl /end REF_MEASUREMENT /end GROUP
/begin GROUP FordVltgIf.FordVehElecPwrSts.Ford_ElPw_D_Stat "MICROSAR RTE" /begin SUB_GROUP /end SUB_GROUP /begin FUNCTION_LIST /end FUNCTION_LIST /begin REF_CHARACTERISTIC /end REF_CHARACTERISTIC /begin REF_MEASUREMENT FordVltgIf.FordVehElecPwrSts.Ford_ElPw_D_Stat /end REF_MEASUREMENT /end GROUP
/begin GROUP FordVltgIf.FordVehIgnStsQly.Ford_Ignition_Status "MICROSAR RTE" /begin SUB_GROUP /end SUB_GROUP /begin FUNCTION_LIST /end FUNCTION_LIST /begin REF_CHARACTERISTIC /end REF_CHARACTERISTIC /begin REF_MEASUREMENT FordVltgIf.FordVehIgnStsQly.Ford_Ignition_Status /end REF_MEASUREMENT /end GROUP
/begin GROUP FordVltgIf.FordVehPwrpkTqSts.Ford_PwPckTq_D_Stat "MICROSAR RTE" /begin SUB_GROUP /end SUB_GROUP /begin FUNCTION_LIST /end FUNCTION_LIST /begin REF_CHARACTERISTIC /end REF_CHARACTERISTIC /begin REF_MEASUREMENT FordVltgIf.FordVehPwrpkTqSts.Ford_PwPckTq_D_Stat /end REF_MEASUREMENT /end GROUP
/begin GROUP FordVltgIf.FordVehSpd.Val "MICROSAR RTE" /begin SUB_GROUP /end SUB_GROUP /begin FUNCTION_LIST /end FUNCTION_LIST /begin REF_CHARACTERISTIC /end REF_CHARACTERISTIC /begin REF_MEASUREMENT FordVltgIf.FordVehSpd.Val /end REF_MEASUREMENT /end GROUP
/begin GROUP FordVltgIf.FordVehSpdVld.Logl "MICROSAR RTE" /begin SUB_GROUP /end SUB_GROUP /begin FUNCTION_LIST /end FUNCTION_LIST /begin REF_CHARACTERISTIC /end REF_CHARACTERISTIC /begin REF_MEASUREMENT FordVltgIf.FordVehSpdVld.Logl /end REF_MEASUREMENT /end GROUP
/begin GROUP FordVltgIf.FordVltgIfActvParkAssiAsscTqMin.Val "MICROSAR RTE" /begin SUB_GROUP /end SUB_GROUP /begin FUNCTION_LIST /end FUNCTION_LIST /begin REF_CHARACTERISTIC FordVltgIf.FordVltgIfActvParkAssiAsscTqMin.Val /end REF_CHARACTERISTIC /begin REF_MEASUREMENT /end REF_MEASUREMENT /end GROUP
/begin GROUP FordVltgIf.FordVltgIfEPSBattVltgDifThd.Val "MICROSAR RTE" /begin SUB_GROUP /end SUB_GROUP /begin FUNCTION_LIST /end FUNCTION_LIST /begin REF_CHARACTERISTIC FordVltgIf.FordVltgIfEPSBattVltgDifThd.Val /end REF_CHARACTERISTIC /begin REF_MEASUREMENT /end REF_MEASUREMENT /end GROUP
/begin GROUP FordVltgIf.FordVltgIfEpsBattCurrLim.Val "MICROSAR RTE" /begin SUB_GROUP /end SUB_GROUP /begin FUNCTION_LIST /end FUNCTION_LIST /begin REF_CHARACTERISTIC FordVltgIf.FordVltgIfEpsBattCurrLim.Val /end REF_CHARACTERISTIC /begin REF_MEASUREMENT /end REF_MEASUREMENT /end GROUP
/begin GROUP FordVltgIf.FordVltgIfEpsCurrLim.Val "MICROSAR RTE" /begin SUB_GROUP /end SUB_GROUP /begin FUNCTION_LIST /end FUNCTION_LIST /begin REF_CHARACTERISTIC FordVltgIf.FordVltgIfEpsCurrLim.Val /end REF_CHARACTERISTIC /begin REF_MEASUREMENT /end REF_MEASUREMENT /end GROUP
/begin GROUP FordVltgIf.FordVltgIfEvasSteerAssiTqMin.Val "MICROSAR RTE" /begin SUB_GROUP /end SUB_GROUP /begin FUNCTION_LIST /end FUNCTION_LIST /begin REF_CHARACTERISTIC FordVltgIf.FordVltgIfEvasSteerAssiTqMin.Val /end REF_CHARACTERISTIC /begin REF_MEASUREMENT /end REF_MEASUREMENT /end GROUP
/begin GROUP FordVltgIf.FordVltgIfFeatThdStsTiThd.Val "MICROSAR RTE" /begin SUB_GROUP /end SUB_GROUP /begin FUNCTION_LIST /end FUNCTION_LIST /begin REF_CHARACTERISTIC FordVltgIf.FordVltgIfFeatThdStsTiThd.Val /end REF_CHARACTERISTIC /begin REF_MEASUREMENT /end REF_MEASUREMENT /end GROUP
/begin GROUP FordVltgIf.FordVltgIfHiVltgAssiRampDwnRate.Val "MICROSAR RTE" /begin SUB_GROUP /end SUB_GROUP /begin FUNCTION_LIST /end FUNCTION_LIST /begin REF_CHARACTERISTIC FordVltgIf.FordVltgIfHiVltgAssiRampDwnRate.Val /end REF_CHARACTERISTIC /begin REF_MEASUREMENT /end REF_MEASUREMENT /end GROUP
/begin GROUP FordVltgIf.FordVltgIfHiVltgAssiRampUpRate.Val "MICROSAR RTE" /begin SUB_GROUP /end SUB_GROUP /begin FUNCTION_LIST /end FUNCTION_LIST /begin REF_CHARACTERISTIC FordVltgIf.FordVltgIfHiVltgAssiRampUpRate.Val /end REF_CHARACTERISTIC /begin REF_MEASUREMENT /end REF_MEASUREMENT /end GROUP
/begin GROUP FordVltgIf.FordVltgIfHiVltgInhbTiMax.Val "MICROSAR RTE" /begin SUB_GROUP /end SUB_GROUP /begin FUNCTION_LIST /end FUNCTION_LIST /begin REF_CHARACTERISTIC FordVltgIf.FordVltgIfHiVltgInhbTiMax.Val /end REF_CHARACTERISTIC /begin REF_MEASUREMENT /end REF_MEASUREMENT /end GROUP
/begin GROUP FordVltgIf.FordVltgIfHiVltgNoAssiRampDwnRate.Val "MICROSAR RTE" /begin SUB_GROUP /end SUB_GROUP /begin FUNCTION_LIST /end FUNCTION_LIST /begin REF_CHARACTERISTIC FordVltgIf.FordVltgIfHiVltgNoAssiRampDwnRate.Val /end REF_CHARACTERISTIC /begin REF_MEASUREMENT /end REF_MEASUREMENT /end GROUP
/begin GROUP FordVltgIf.FordVltgIfHiVltgNoAssiRcvrTiMax.Val "MICROSAR RTE" /begin SUB_GROUP /end SUB_GROUP /begin FUNCTION_LIST /end FUNCTION_LIST /begin REF_CHARACTERISTIC FordVltgIf.FordVltgIfHiVltgNoAssiRcvrTiMax.Val /end REF_CHARACTERISTIC /begin REF_MEASUREMENT /end REF_MEASUREMENT /end GROUP
/begin GROUP FordVltgIf.FordVltgIfHiVltgRcvrTiMax.Val "MICROSAR RTE" /begin SUB_GROUP /end SUB_GROUP /begin FUNCTION_LIST /end FUNCTION_LIST /begin REF_CHARACTERISTIC FordVltgIf.FordVltgIfHiVltgRcvrTiMax.Val /end REF_CHARACTERISTIC /begin REF_MEASUREMENT /end REF_MEASUREMENT /end GROUP
/begin GROUP FordVltgIf.FordVltgIfHiVltgThdHi.Val "MICROSAR RTE" /begin SUB_GROUP /end SUB_GROUP /begin FUNCTION_LIST /end FUNCTION_LIST /begin REF_CHARACTERISTIC FordVltgIf.FordVltgIfHiVltgThdHi.Val /end REF_CHARACTERISTIC /begin REF_MEASUREMENT /end REF_MEASUREMENT /end GROUP
/begin GROUP FordVltgIf.FordVltgIfHiVltgThdLo.Val "MICROSAR RTE" /begin SUB_GROUP /end SUB_GROUP /begin FUNCTION_LIST /end FUNCTION_LIST /begin REF_CHARACTERISTIC FordVltgIf.FordVltgIfHiVltgThdLo.Val /end REF_CHARACTERISTIC /begin REF_MEASUREMENT /end REF_MEASUREMENT /end GROUP
/begin GROUP FordVltgIf.FordVltgIfInhbBattVltgDiagcTiThd.Val "MICROSAR RTE" /begin SUB_GROUP /end SUB_GROUP /begin FUNCTION_LIST /end FUNCTION_LIST /begin REF_CHARACTERISTIC FordVltgIf.FordVltgIfInhbBattVltgDiagcTiThd.Val /end REF_CHARACTERISTIC /begin REF_MEASUREMENT /end REF_MEASUREMENT /end GROUP
/begin GROUP FordVltgIf.FordVltgIfLaneCentrAssiTqMin.Val "MICROSAR RTE" /begin SUB_GROUP /end SUB_GROUP /begin FUNCTION_LIST /end FUNCTION_LIST /begin REF_CHARACTERISTIC FordVltgIf.FordVltgIfLaneCentrAssiTqMin.Val /end REF_CHARACTERISTIC /begin REF_MEASUREMENT /end REF_MEASUREMENT /end GROUP
/begin GROUP FordVltgIf.FordVltgIfLaneDprtrWarnAsscTqMin.Val "MICROSAR RTE" /begin SUB_GROUP /end SUB_GROUP /begin FUNCTION_LIST /end FUNCTION_LIST /begin REF_CHARACTERISTIC FordVltgIf.FordVltgIfLaneDprtrWarnAsscTqMin.Val /end REF_CHARACTERISTIC /begin REF_MEASUREMENT /end REF_MEASUREMENT /end GROUP
/begin GROUP FordVltgIf.FordVltgIfLkaAsscTqMin.Val "MICROSAR RTE" /begin SUB_GROUP /end SUB_GROUP /begin FUNCTION_LIST /end FUNCTION_LIST /begin REF_CHARACTERISTIC FordVltgIf.FordVltgIfLkaAsscTqMin.Val /end REF_CHARACTERISTIC /begin REF_MEASUREMENT /end REF_MEASUREMENT /end GROUP
/begin GROUP FordVltgIf.FordVltgIfLoVltgAssiRampDwnRate.Val "MICROSAR RTE" /begin SUB_GROUP /end SUB_GROUP /begin FUNCTION_LIST /end FUNCTION_LIST /begin REF_CHARACTERISTIC FordVltgIf.FordVltgIfLoVltgAssiRampDwnRate.Val /end REF_CHARACTERISTIC /begin REF_MEASUREMENT /end REF_MEASUREMENT /end GROUP
/begin GROUP FordVltgIf.FordVltgIfLoVltgAssiRampUpRate.Val "MICROSAR RTE" /begin SUB_GROUP /end SUB_GROUP /begin FUNCTION_LIST /end FUNCTION_LIST /begin REF_CHARACTERISTIC FordVltgIf.FordVltgIfLoVltgAssiRampUpRate.Val /end REF_CHARACTERISTIC /begin REF_MEASUREMENT /end REF_MEASUREMENT /end GROUP
/begin GROUP FordVltgIf.FordVltgIfLoVltgAssiScar.Val "MICROSAR RTE" /begin SUB_GROUP /end SUB_GROUP /begin FUNCTION_LIST /end FUNCTION_LIST /begin REF_CHARACTERISTIC FordVltgIf.FordVltgIfLoVltgAssiScar.Val /end REF_CHARACTERISTIC /begin REF_MEASUREMENT /end REF_MEASUREMENT /end GROUP
/begin GROUP FordVltgIf.FordVltgIfLoVltgInhbTiMax.Val "MICROSAR RTE" /begin SUB_GROUP /end SUB_GROUP /begin FUNCTION_LIST /end FUNCTION_LIST /begin REF_CHARACTERISTIC FordVltgIf.FordVltgIfLoVltgInhbTiMax.Val /end REF_CHARACTERISTIC /begin REF_MEASUREMENT /end REF_MEASUREMENT /end GROUP
/begin GROUP FordVltgIf.FordVltgIfLoVltgNoAssiRampDwnRate.Val "MICROSAR RTE" /begin SUB_GROUP /end SUB_GROUP /begin FUNCTION_LIST /end FUNCTION_LIST /begin REF_CHARACTERISTIC FordVltgIf.FordVltgIfLoVltgNoAssiRampDwnRate.Val /end REF_CHARACTERISTIC /begin REF_MEASUREMENT /end REF_MEASUREMENT /end GROUP
/begin GROUP FordVltgIf.FordVltgIfLoVltgNoAssiRcvrTiMax.Val "MICROSAR RTE" /begin SUB_GROUP /end SUB_GROUP /begin FUNCTION_LIST /end FUNCTION_LIST /begin REF_CHARACTERISTIC FordVltgIf.FordVltgIfLoVltgNoAssiRcvrTiMax.Val /end REF_CHARACTERISTIC /begin REF_MEASUREMENT /end REF_MEASUREMENT /end GROUP
/begin GROUP FordVltgIf.FordVltgIfLoVltgRcvrTiMax.Val "MICROSAR RTE" /begin SUB_GROUP /end SUB_GROUP /begin FUNCTION_LIST /end FUNCTION_LIST /begin REF_CHARACTERISTIC FordVltgIf.FordVltgIfLoVltgRcvrTiMax.Val /end REF_CHARACTERISTIC /begin REF_MEASUREMENT /end REF_MEASUREMENT /end GROUP
/begin GROUP FordVltgIf.FordVltgIfLoVltgThdHi.Val "MICROSAR RTE" /begin SUB_GROUP /end SUB_GROUP /begin FUNCTION_LIST /end FUNCTION_LIST /begin REF_CHARACTERISTIC FordVltgIf.FordVltgIfLoVltgThdHi.Val /end REF_CHARACTERISTIC /begin REF_MEASUREMENT /end REF_MEASUREMENT /end GROUP
/begin GROUP FordVltgIf.FordVltgIfLoVltgThdLo.Val "MICROSAR RTE" /begin SUB_GROUP /end SUB_GROUP /begin FUNCTION_LIST /end FUNCTION_LIST /begin REF_CHARACTERISTIC FordVltgIf.FordVltgIfLoVltgThdLo.Val /end REF_CHARACTERISTIC /begin REF_MEASUREMENT /end REF_MEASUREMENT /end GROUP
/begin GROUP FordVltgIf.FordVltgIfLoVltgThdMid.Val "MICROSAR RTE" /begin SUB_GROUP /end SUB_GROUP /begin FUNCTION_LIST /end FUNCTION_LIST /begin REF_CHARACTERISTIC FordVltgIf.FordVltgIfLoVltgThdMid.Val /end REF_CHARACTERISTIC /begin REF_MEASUREMENT /end REF_MEASUREMENT /end GROUP
/begin GROUP FordVltgIf.FordVltgIfLoVltgThdMidToLoTiMax.Val "MICROSAR RTE" /begin SUB_GROUP /end SUB_GROUP /begin FUNCTION_LIST /end FUNCTION_LIST /begin REF_CHARACTERISTIC FordVltgIf.FordVltgIfLoVltgThdMidToLoTiMax.Val /end REF_CHARACTERISTIC /begin REF_MEASUREMENT /end REF_MEASUREMENT /end GROUP
/begin GROUP FordVltgIf.FordVltgIfLoVltgTqScaDwnRate.Val "MICROSAR RTE" /begin SUB_GROUP /end SUB_GROUP /begin FUNCTION_LIST /end FUNCTION_LIST /begin REF_CHARACTERISTIC FordVltgIf.FordVltgIfLoVltgTqScaDwnRate.Val /end REF_CHARACTERISTIC /begin REF_MEASUREMENT /end REF_MEASUREMENT /end GROUP
/begin GROUP FordVltgIf.FordVltgIfLoVltgTqScaUpRate.Val "MICROSAR RTE" /begin SUB_GROUP /end SUB_GROUP /begin FUNCTION_LIST /end FUNCTION_LIST /begin REF_CHARACTERISTIC FordVltgIf.FordVltgIfLoVltgTqScaUpRate.Val /end REF_CHARACTERISTIC /begin REF_MEASUREMENT /end REF_MEASUREMENT /end GROUP
/begin GROUP FordVltgIf.FordVltgIfLoVltgTqScagFac.Val "MICROSAR RTE" /begin SUB_GROUP /end SUB_GROUP /begin FUNCTION_LIST /end FUNCTION_LIST /begin REF_CHARACTERISTIC FordVltgIf.FordVltgIfLoVltgTqScagFac.Val /end REF_CHARACTERISTIC /begin REF_MEASUREMENT /end REF_MEASUREMENT /end GROUP
/begin GROUP FordVltgIf.FordVltgIfTrfcJamAsscTqMin.Val "MICROSAR RTE" /begin SUB_GROUP /end SUB_GROUP /begin FUNCTION_LIST /end FUNCTION_LIST /begin REF_CHARACTERISTIC FordVltgIf.FordVltgIfTrfcJamAsscTqMin.Val /end REF_CHARACTERISTIC /begin REF_MEASUREMENT /end REF_MEASUREMENT /end GROUP
/begin GROUP FordVltgIf.FordVltgIfTrlrBackupAssiTqMin.Val "MICROSAR RTE" /begin SUB_GROUP /end SUB_GROUP /begin FUNCTION_LIST /end FUNCTION_LIST /begin REF_CHARACTERISTIC FordVltgIf.FordVltgIfTrlrBackupAssiTqMin.Val /end REF_CHARACTERISTIC /begin REF_MEASUREMENT /end REF_MEASUREMENT /end GROUP
/begin GROUP FordVltgIf.FordVltgIfVehBattCircR.Val "MICROSAR RTE" /begin SUB_GROUP /end SUB_GROUP /begin FUNCTION_LIST /end FUNCTION_LIST /begin REF_CHARACTERISTIC FordVltgIf.FordVltgIfVehBattCircR.Val /end REF_CHARACTERISTIC /begin REF_MEASUREMENT /end REF_MEASUREMENT /end GROUP
/begin GROUP FordVltgIf.FordVltgOperRamp.Val "MICROSAR RTE" /begin SUB_GROUP /end SUB_GROUP /begin FUNCTION_LIST /end FUNCTION_LIST /begin REF_CHARACTERISTIC /end REF_CHARACTERISTIC /begin REF_MEASUREMENT FordVltgIf.FordVltgOperRamp.Val /end REF_MEASUREMENT /end GROUP
/begin GROUP FordVltgIf.FordVltgOperScar.Val "MICROSAR RTE" /begin SUB_GROUP /end SUB_GROUP /begin FUNCTION_LIST /end FUNCTION_LIST /begin REF_CHARACTERISTIC /end REF_CHARACTERISTIC /begin REF_MEASUREMENT FordVltgIf.FordVltgOperScar.Val /end REF_MEASUREMENT /end GROUP
/begin GROUP FordVltgIf.FordVltgOperSt.Val "MICROSAR RTE" /begin SUB_GROUP /end SUB_GROUP /begin FUNCTION_LIST /end FUNCTION_LIST /begin REF_CHARACTERISTIC /end REF_CHARACTERISTIC /begin REF_MEASUREMENT FordVltgIf.FordVltgOperSt.Val /end REF_MEASUREMENT /end GROUP
/begin GROUP FordVltgIf.HiToLoChk "MICROSAR RTE" /begin SUB_GROUP /end SUB_GROUP /begin FUNCTION_LIST /end FUNCTION_LIST /begin REF_CHARACTERISTIC /end REF_CHARACTERISTIC /begin REF_MEASUREMENT FordVltgIf.HiToLoChk /end REF_MEASUREMENT /end GROUP
/begin GROUP FordVltgIf.HiToMidChk "MICROSAR RTE" /begin SUB_GROUP /end SUB_GROUP /begin FUNCTION_LIST /end FUNCTION_LIST /begin REF_CHARACTERISTIC /end REF_CHARACTERISTIC /begin REF_MEASUREMENT FordVltgIf.HiToMidChk /end REF_MEASUREMENT /end GROUP
/begin GROUP FordVltgIf.HiVltgInhbRefTi "MICROSAR RTE" /begin SUB_GROUP /end SUB_GROUP /begin FUNCTION_LIST /end FUNCTION_LIST /begin REF_CHARACTERISTIC /end REF_CHARACTERISTIC /begin REF_MEASUREMENT FordVltgIf.HiVltgInhbRefTi /end REF_MEASUREMENT /end GROUP
/begin GROUP FordVltgIf.HiVltgNoAssiRcvrRefTi "MICROSAR RTE" /begin SUB_GROUP /end SUB_GROUP /begin FUNCTION_LIST /end FUNCTION_LIST /begin REF_CHARACTERISTIC /end REF_CHARACTERISTIC /begin REF_MEASUREMENT FordVltgIf.HiVltgNoAssiRcvrRefTi /end REF_MEASUREMENT /end GROUP
/begin GROUP FordVltgIf.HiVltgRcvrRefTi "MICROSAR RTE" /begin SUB_GROUP /end SUB_GROUP /begin FUNCTION_LIST /end FUNCTION_LIST /begin REF_CHARACTERISTIC /end REF_CHARACTERISTIC /begin REF_MEASUREMENT FordVltgIf.HiVltgRcvrRefTi /end REF_MEASUREMENT /end GROUP
/begin GROUP FordVltgIf.HiVltgRcvrTiMaxRefTi "MICROSAR RTE" /begin SUB_GROUP /end SUB_GROUP /begin FUNCTION_LIST /end FUNCTION_LIST /begin REF_CHARACTERISTIC /end REF_CHARACTERISTIC /begin REF_MEASUREMENT FordVltgIf.HiVltgRcvrTiMaxRefTi /end REF_MEASUREMENT /end GROUP
/begin GROUP FordVltgIf.InhbBattVltgDiagcRefTi "MICROSAR RTE" /begin SUB_GROUP /end SUB_GROUP /begin FUNCTION_LIST /end FUNCTION_LIST /begin REF_CHARACTERISTIC /end REF_CHARACTERISTIC /begin REF_MEASUREMENT FordVltgIf.InhbBattVltgDiagcRefTi /end REF_MEASUREMENT /end GROUP
/begin GROUP FordVltgIf.LoToHiChk "MICROSAR RTE" /begin SUB_GROUP /end SUB_GROUP /begin FUNCTION_LIST /end FUNCTION_LIST /begin REF_CHARACTERISTIC /end REF_CHARACTERISTIC /begin REF_MEASUREMENT FordVltgIf.LoToHiChk /end REF_MEASUREMENT /end GROUP
/begin GROUP FordVltgIf.LoToMidChk "MICROSAR RTE" /begin SUB_GROUP /end SUB_GROUP /begin FUNCTION_LIST /end FUNCTION_LIST /begin REF_CHARACTERISTIC /end REF_CHARACTERISTIC /begin REF_MEASUREMENT FordVltgIf.LoToMidChk /end REF_MEASUREMENT /end GROUP
/begin GROUP FordVltgIf.LoVltgInhbRefTi1 "MICROSAR RTE" /begin SUB_GROUP /end SUB_GROUP /begin FUNCTION_LIST /end FUNCTION_LIST /begin REF_CHARACTERISTIC /end REF_CHARACTERISTIC /begin REF_MEASUREMENT FordVltgIf.LoVltgInhbRefTi1 /end REF_MEASUREMENT /end GROUP
/begin GROUP FordVltgIf.LoVltgInhbRefTi2 "MICROSAR RTE" /begin SUB_GROUP /end SUB_GROUP /begin FUNCTION_LIST /end FUNCTION_LIST /begin REF_CHARACTERISTIC /end REF_CHARACTERISTIC /begin REF_MEASUREMENT FordVltgIf.LoVltgInhbRefTi2 /end REF_MEASUREMENT /end GROUP
/begin GROUP FordVltgIf.LoVltgInhbRefTi3 "MICROSAR RTE" /begin SUB_GROUP /end SUB_GROUP /begin FUNCTION_LIST /end FUNCTION_LIST /begin REF_CHARACTERISTIC /end REF_CHARACTERISTIC /begin REF_MEASUREMENT FordVltgIf.LoVltgInhbRefTi3 /end REF_MEASUREMENT /end GROUP
/begin GROUP FordVltgIf.LoVltgNoAssiRcvrRefTi "MICROSAR RTE" /begin SUB_GROUP /end SUB_GROUP /begin FUNCTION_LIST /end FUNCTION_LIST /begin REF_CHARACTERISTIC /end REF_CHARACTERISTIC /begin REF_MEASUREMENT FordVltgIf.LoVltgNoAssiRcvrRefTi /end REF_MEASUREMENT /end GROUP
/begin GROUP FordVltgIf.LoVltgRcvrRefTi "MICROSAR RTE" /begin SUB_GROUP /end SUB_GROUP /begin FUNCTION_LIST /end FUNCTION_LIST /begin REF_CHARACTERISTIC /end REF_CHARACTERISTIC /begin REF_MEASUREMENT FordVltgIf.LoVltgRcvrRefTi /end REF_MEASUREMENT /end GROUP
/begin GROUP FordVltgIf.LoVltgRcvrTiMaxRefTi "MICROSAR RTE" /begin SUB_GROUP /end SUB_GROUP /begin FUNCTION_LIST /end FUNCTION_LIST /begin REF_CHARACTERISTIC /end REF_CHARACTERISTIC /begin REF_MEASUREMENT FordVltgIf.LoVltgRcvrTiMaxRefTi /end REF_MEASUREMENT /end GROUP
/begin GROUP FordVltgIf.LoVltgThdMidToLoRefTi "MICROSAR RTE" /begin SUB_GROUP /end SUB_GROUP /begin FUNCTION_LIST /end FUNCTION_LIST /begin REF_CHARACTERISTIC /end REF_CHARACTERISTIC /begin REF_MEASUREMENT FordVltgIf.LoVltgThdMidToLoRefTi /end REF_MEASUREMENT /end GROUP
/begin GROUP FordVltgIf.LoVltgThdMidToLoRefTmr "MICROSAR RTE" /begin SUB_GROUP /end SUB_GROUP /begin FUNCTION_LIST /end FUNCTION_LIST /begin REF_CHARACTERISTIC /end REF_CHARACTERISTIC /begin REF_MEASUREMENT FordVltgIf.LoVltgThdMidToLoRefTmr /end REF_MEASUREMENT /end GROUP
/begin GROUP FordVltgIf.MaxEpsBattCurrPrev "MICROSAR RTE" /begin SUB_GROUP /end SUB_GROUP /begin FUNCTION_LIST /end FUNCTION_LIST /begin REF_CHARACTERISTIC /end REF_CHARACTERISTIC /begin REF_MEASUREMENT FordVltgIf.MaxEpsBattCurrPrev /end REF_MEASUREMENT /end GROUP
/begin GROUP FordVltgIf.MidToHiChk "MICROSAR RTE" /begin SUB_GROUP /end SUB_GROUP /begin FUNCTION_LIST /end FUNCTION_LIST /begin REF_CHARACTERISTIC /end REF_CHARACTERISTIC /begin REF_MEASUREMENT FordVltgIf.MidToHiChk /end REF_MEASUREMENT /end GROUP
/begin GROUP FordVltgIf.MidToLoChk "MICROSAR RTE" /begin SUB_GROUP /end SUB_GROUP /begin FUNCTION_LIST /end FUNCTION_LIST /begin REF_CHARACTERISTIC /end REF_CHARACTERISTIC /begin REF_MEASUREMENT FordVltgIf.MidToLoChk /end REF_MEASUREMENT /end GROUP
/begin GROUP FordVltgIf.MinBattVltgPrev "MICROSAR RTE" /begin SUB_GROUP /end SUB_GROUP /begin FUNCTION_LIST /end FUNCTION_LIST /begin REF_CHARACTERISTIC /end REF_CHARACTERISTIC /begin REF_MEASUREMENT FordVltgIf.MinBattVltgPrev /end REF_MEASUREMENT /end GROUP
/begin GROUP FordVltgIf.PerInstanceMemories "MICROSAR RTE"
 /begin SUB_GROUP FordVltgIf.FeatThdStsRefTi FordVltgIf.HiToLoChk FordVltgIf.HiToMidChk FordVltgIf.HiVltgInhbRefTi FordVltgIf.HiVltgNoAssiRcvrRefTi FordVltgIf.HiVltgRcvrRefTi FordVltgIf.HiVltgRcvrTiMaxRefTi FordVltgIf.InhbBattVltgDiagcRefTi FordVltgIf.LoToHiChk FordVltgIf.LoToMidChk FordVltgIf.LoVltgInhbRefTi1 FordVltgIf.LoVltgInhbRefTi2 FordVltgIf.LoVltgInhbRefTi3 FordVltgIf.LoVltgNoAssiRcvrRefTi FordVltgIf.LoVltgRcvrRefTi FordVltgIf.LoVltgRcvrTiMaxRefTi FordVltgIf.LoVltgThdMidToLoRefTi FordVltgIf.LoVltgThdMidToLoRefTmr FordVltgIf.MaxEpsBattCurrPrev FordVltgIf.MidToHiChk FordVltgIf.MidToLoChk FordVltgIf.MinBattVltgPrev FordVltgIf.PrevVltgOperRamp FordVltgIf.PrevVltgOperScar /end SUB_GROUP
 /begin FUNCTION_LIST /end FUNCTION_LIST
 /begin REF_CHARACTERISTIC /end REF_CHARACTERISTIC
 /begin REF_MEASUREMENT /end REF_MEASUREMENT
/end GROUP
/begin GROUP FordVltgIf.PrevVltgOperRamp "MICROSAR RTE" /begin SUB_GROUP /end SUB_GROUP /begin FUNCTION_LIST /end FUNCTION_LIST /begin REF_CHARACTERISTIC /end REF_CHARACTERISTIC /begin REF_MEASUREMENT FordVltgIf.PrevVltgOperRamp /end REF_MEASUREMENT /end GROUP
/begin GROUP FordVltgIf.PrevVltgOperScar "MICROSAR RTE" /begin SUB_GROUP /end SUB_GROUP /begin FUNCTION_LIST /end FUNCTION_LIST /begin REF_CHARACTERISTIC /end REF_CHARACTERISTIC /begin REF_MEASUREMENT FordVltgIf.PrevVltgOperScar /end REF_MEASUREMENT /end GROUP
/begin GROUP FordVltgIf.ReceiverPorts "MICROSAR RTE"
 /begin SUB_GROUP FordVltgIf.BattRtnCurr.Val FordVltgIf.BattVltg.Val FordVltgIf.FordActvParkAssiEnad.Logl FordVltgIf.FordEvasSteerAssiEnad.Logl FordVltgIf.FordLaneCentrAssiEnad.Logl FordVltgIf.FordLaneDprtrWarnEnad.Logl FordVltgIf.FordLaneKeepAssiEnad.Logl FordVltgIf.FordMaxAsscTq.Val FordVltgIf.FordStrtStopSt.Val FordVltgIf.FordSysSt.Val FordVltgIf.FordTrfcJamAssiEnad.Logl FordVltgIf.FordTrlrBackupAssiEnad.Logl FordVltgIf.FordVehElecPwrSts.Ford_ElPw_D_Stat FordVltgIf.FordVehIgnStsQly.Ford_Ignition_Status FordVltgIf.FordVehPwrpkTqSts.Ford_PwPckTq_D_Stat FordVltgIf.FordVehSpd.Val FordVltgIf.FordVehSpdVld.Logl /end SUB_GROUP
 /begin FUNCTION_LIST /end FUNCTION_LIST
 /begin REF_CHARACTERISTIC /end REF_CHARACTERISTIC
 /begin REF_MEASUREMENT /end REF_MEASUREMENT
/end GROUP
/begin GROUP FordVltgIf.SenderPorts "MICROSAR RTE"
 /begin SUB_GROUP FordVltgIf.FordEpsCurr.Val FordVltgIf.FordEpsCurrVal.Logl FordVltgIf.FordEpsVltg.Val FordVltgIf.FordEpsVltgVal.Logl FordVltgIf.FordFeatThdSts.Logl FordVltgIf.FordInhbBattVltgDiagc.Logl FordVltgIf.FordMaxBattCurr.Val FordVltgIf.FordMinBattVltg.Val FordVltgIf.FordVltgOperRamp.Val FordVltgIf.FordVltgOperScar.Val FordVltgIf.FordVltgOperSt.Val /end SUB_GROUP
 /begin FUNCTION_LIST /end FUNCTION_LIST
 /begin REF_CHARACTERISTIC /end REF_CHARACTERISTIC
 /begin REF_MEASUREMENT /end REF_MEASUREMENT
/end GROUP
/begin GROUP GateDrv0Ctrl "MICROSAR RTE"
 /begin SUB_GROUP GateDrv0Ctrl.CalibrationPorts GateDrv0Ctrl.PerInstanceMemories GateDrv0Ctrl.ReceiverPorts GateDrv0Ctrl.SenderPorts /end SUB_GROUP
 /begin FUNCTION_LIST /end FUNCTION_LIST
 /begin REF_CHARACTERISTIC /end REF_CHARACTERISTIC
 /begin REF_MEASUREMENT /end REF_MEASUREMENT
/end GROUP
/begin GROUP GateDrv0Ctrl.CalibrationPorts "MICROSAR RTE"
 /begin SUB_GROUP GateDrv0Ctrl.GateDrv0CtrlErrFilFrq.Val GateDrv0Ctrl.GateDrv0CtrlErrOffs.Val GateDrv0Ctrl.GateDrv0CtrlErrThd.Val GateDrv0Ctrl.GateDrv0CtrlNtcNr0x050FailStep.Val GateDrv0Ctrl.GateDrv0CtrlNtcNr0x050PassStep.Val GateDrv0Ctrl.GateDrv0CtrlNtcNr0x051FailStep.Val GateDrv0Ctrl.GateDrv0CtrlNtcNr0x051PassStep.Val GateDrv0Ctrl.GateDrv0CtrlNtcNr0x055FailStep.Val GateDrv0Ctrl.GateDrv0CtrlNtcNr0x055PassStep.Val GateDrv0Ctrl.GateDrv0CtrlUnit0Cfg2WrVal.Val GateDrv0Ctrl.GateDrv0CtrlUnit0Cfg3WrVal.Val GateDrv0Ctrl.GateDrv0CtrlUnit0Cfg4WrVal.Val GateDrv0Ctrl.GateDrv0CtrlUnit0Cfg7WrVal.Val /end SUB_GROUP
 /begin FUNCTION_LIST /end FUNCTION_LIST
 /begin REF_CHARACTERISTIC /end REF_CHARACTERISTIC
 /begin REF_MEASUREMENT /end REF_MEASUREMENT
/end GROUP
/begin GROUP GateDrv0Ctrl.DiagcStsIvtr1Inactv.Logl "MICROSAR RTE" /begin SUB_GROUP /end SUB_GROUP /begin FUNCTION_LIST /end FUNCTION_LIST /begin REF_CHARACTERISTIC /end REF_CHARACTERISTIC /begin REF_MEASUREMENT GateDrv0Ctrl.DiagcStsIvtr1Inactv.Logl /end REF_MEASUREMENT /end GROUP
/begin GROUP GateDrv0Ctrl.GateDrv0CfgCnt "MICROSAR RTE" /begin SUB_GROUP /end SUB_GROUP /begin FUNCTION_LIST /end FUNCTION_LIST /begin REF_CHARACTERISTIC /end REF_CHARACTERISTIC /begin REF_MEASUREMENT GateDrv0Ctrl.GateDrv0CfgCnt /end REF_MEASUREMENT /end GROUP
/begin GROUP GateDrv0Ctrl.GateDrv0CfgSecAtmpt "MICROSAR RTE" /begin SUB_GROUP /end SUB_GROUP /begin FUNCTION_LIST /end FUNCTION_LIST /begin REF_CHARACTERISTIC /end REF_CHARACTERISTIC /begin REF_MEASUREMENT GateDrv0Ctrl.GateDrv0CfgSecAtmpt /end REF_MEASUREMENT /end GROUP
/begin GROUP GateDrv0Ctrl.GateDrv0CtrlErrFilFrq.Val "MICROSAR RTE" /begin SUB_GROUP /end SUB_GROUP /begin FUNCTION_LIST /end FUNCTION_LIST /begin REF_CHARACTERISTIC GateDrv0Ctrl.GateDrv0CtrlErrFilFrq.Val /end REF_CHARACTERISTIC /begin REF_MEASUREMENT /end REF_MEASUREMENT /end GROUP
/begin GROUP GateDrv0Ctrl.GateDrv0CtrlErrOffs.Val "MICROSAR RTE" /begin SUB_GROUP /end SUB_GROUP /begin FUNCTION_LIST /end FUNCTION_LIST /begin REF_CHARACTERISTIC GateDrv0Ctrl.GateDrv0CtrlErrOffs.Val /end REF_CHARACTERISTIC /begin REF_MEASUREMENT /end REF_MEASUREMENT /end GROUP
/begin GROUP GateDrv0Ctrl.GateDrv0CtrlErrThd.Val "MICROSAR RTE" /begin SUB_GROUP /end SUB_GROUP /begin FUNCTION_LIST /end FUNCTION_LIST /begin REF_CHARACTERISTIC GateDrv0Ctrl.GateDrv0CtrlErrThd.Val /end REF_CHARACTERISTIC /begin REF_MEASUREMENT /end REF_MEASUREMENT /end GROUP
/begin GROUP GateDrv0Ctrl.GateDrv0CtrlNtcNr0x050FailStep.Val "MICROSAR RTE" /begin SUB_GROUP /end SUB_GROUP /begin FUNCTION_LIST /end FUNCTION_LIST /begin REF_CHARACTERISTIC GateDrv0Ctrl.GateDrv0CtrlNtcNr0x050FailStep.Val /end REF_CHARACTERISTIC /begin REF_MEASUREMENT /end REF_MEASUREMENT /end GROUP
/begin GROUP GateDrv0Ctrl.GateDrv0CtrlNtcNr0x050PassStep.Val "MICROSAR RTE" /begin SUB_GROUP /end SUB_GROUP /begin FUNCTION_LIST /end FUNCTION_LIST /begin REF_CHARACTERISTIC GateDrv0Ctrl.GateDrv0CtrlNtcNr0x050PassStep.Val /end REF_CHARACTERISTIC /begin REF_MEASUREMENT /end REF_MEASUREMENT /end GROUP
/begin GROUP GateDrv0Ctrl.GateDrv0CtrlNtcNr0x051FailStep.Val "MICROSAR RTE" /begin SUB_GROUP /end SUB_GROUP /begin FUNCTION_LIST /end FUNCTION_LIST /begin REF_CHARACTERISTIC GateDrv0Ctrl.GateDrv0CtrlNtcNr0x051FailStep.Val /end REF_CHARACTERISTIC /begin REF_MEASUREMENT /end REF_MEASUREMENT /end GROUP
/begin GROUP GateDrv0Ctrl.GateDrv0CtrlNtcNr0x051PassStep.Val "MICROSAR RTE" /begin SUB_GROUP /end SUB_GROUP /begin FUNCTION_LIST /end FUNCTION_LIST /begin REF_CHARACTERISTIC GateDrv0Ctrl.GateDrv0CtrlNtcNr0x051PassStep.Val /end REF_CHARACTERISTIC /begin REF_MEASUREMENT /end REF_MEASUREMENT /end GROUP
/begin GROUP GateDrv0Ctrl.GateDrv0CtrlNtcNr0x055FailStep.Val "MICROSAR RTE" /begin SUB_GROUP /end SUB_GROUP /begin FUNCTION_LIST /end FUNCTION_LIST /begin REF_CHARACTERISTIC GateDrv0Ctrl.GateDrv0CtrlNtcNr0x055FailStep.Val /end REF_CHARACTERISTIC /begin REF_MEASUREMENT /end REF_MEASUREMENT /end GROUP
/begin GROUP GateDrv0Ctrl.GateDrv0CtrlNtcNr0x055PassStep.Val "MICROSAR RTE" /begin SUB_GROUP /end SUB_GROUP /begin FUNCTION_LIST /end FUNCTION_LIST /begin REF_CHARACTERISTIC GateDrv0Ctrl.GateDrv0CtrlNtcNr0x055PassStep.Val /end REF_CHARACTERISTIC /begin REF_MEASUREMENT /end REF_MEASUREMENT /end GROUP
/begin GROUP GateDrv0Ctrl.GateDrv0CtrlUnit0Cfg2WrVal.Val "MICROSAR RTE" /begin SUB_GROUP /end SUB_GROUP /begin FUNCTION_LIST /end FUNCTION_LIST /begin REF_CHARACTERISTIC GateDrv0Ctrl.GateDrv0CtrlUnit0Cfg2WrVal.Val /end REF_CHARACTERISTIC /begin REF_MEASUREMENT /end REF_MEASUREMENT /end GROUP
/begin GROUP GateDrv0Ctrl.GateDrv0CtrlUnit0Cfg3WrVal.Val "MICROSAR RTE" /begin SUB_GROUP /end SUB_GROUP /begin FUNCTION_LIST /end FUNCTION_LIST /begin REF_CHARACTERISTIC GateDrv0Ctrl.GateDrv0CtrlUnit0Cfg3WrVal.Val /end REF_CHARACTERISTIC /begin REF_MEASUREMENT /end REF_MEASUREMENT /end GROUP
/begin GROUP GateDrv0Ctrl.GateDrv0CtrlUnit0Cfg4WrVal.Val "MICROSAR RTE" /begin SUB_GROUP /end SUB_GROUP /begin FUNCTION_LIST /end FUNCTION_LIST /begin REF_CHARACTERISTIC GateDrv0Ctrl.GateDrv0CtrlUnit0Cfg4WrVal.Val /end REF_CHARACTERISTIC /begin REF_MEASUREMENT /end REF_MEASUREMENT /end GROUP
/begin GROUP GateDrv0Ctrl.GateDrv0CtrlUnit0Cfg7WrVal.Val "MICROSAR RTE" /begin SUB_GROUP /end SUB_GROUP /begin FUNCTION_LIST /end FUNCTION_LIST /begin REF_CHARACTERISTIC GateDrv0Ctrl.GateDrv0CtrlUnit0Cfg7WrVal.Val /end REF_CHARACTERISTIC /begin REF_MEASUREMENT /end REF_MEASUREMENT /end GROUP
/begin GROUP GateDrv0Ctrl.GateDrv0Diag0Val "MICROSAR RTE" /begin SUB_GROUP /end SUB_GROUP /begin FUNCTION_LIST /end FUNCTION_LIST /begin REF_CHARACTERISTIC /end REF_CHARACTERISTIC /begin REF_MEASUREMENT GateDrv0Ctrl.GateDrv0Diag0Val /end REF_MEASUREMENT /end GROUP
/begin GROUP GateDrv0Ctrl.GateDrv0Diag1Val "MICROSAR RTE" /begin SUB_GROUP /end SUB_GROUP /begin FUNCTION_LIST /end FUNCTION_LIST /begin REF_CHARACTERISTIC /end REF_CHARACTERISTIC /begin REF_MEASUREMENT GateDrv0Ctrl.GateDrv0Diag1Val /end REF_MEASUREMENT /end GROUP
/begin GROUP GateDrv0Ctrl.GateDrv0Diag2Val "MICROSAR RTE" /begin SUB_GROUP /end SUB_GROUP /begin FUNCTION_LIST /end FUNCTION_LIST /begin REF_CHARACTERISTIC /end REF_CHARACTERISTIC /begin REF_MEASUREMENT GateDrv0Ctrl.GateDrv0Diag2Val /end REF_MEASUREMENT /end GROUP
/begin GROUP GateDrv0Ctrl.GateDrv0OffStChkIdx "MICROSAR RTE" /begin SUB_GROUP /end SUB_GROUP /begin FUNCTION_LIST /end FUNCTION_LIST /begin REF_CHARACTERISTIC /end REF_CHARACTERISTIC /begin REF_MEASUREMENT GateDrv0Ctrl.GateDrv0OffStChkIdx /end REF_MEASUREMENT /end GROUP
/begin GROUP GateDrv0Ctrl.GateDrv0OffStChkSecAtmpt "MICROSAR RTE" /begin SUB_GROUP /end SUB_GROUP /begin FUNCTION_LIST /end FUNCTION_LIST /begin REF_CHARACTERISTIC /end REF_CHARACTERISTIC /begin REF_MEASUREMENT GateDrv0Ctrl.GateDrv0OffStChkSecAtmpt /end REF_MEASUREMENT /end GROUP
/begin GROUP GateDrv0Ctrl.GateDrv0OffStCnt "MICROSAR RTE" /begin SUB_GROUP /end SUB_GROUP /begin FUNCTION_LIST /end FUNCTION_LIST /begin REF_CHARACTERISTIC /end REF_CHARACTERISTIC /begin REF_MEASUREMENT GateDrv0Ctrl.GateDrv0OffStCnt /end REF_MEASUREMENT /end GROUP
/begin GROUP GateDrv0Ctrl.GateDrv0PhaAFilLp "MICROSAR RTE" /begin SUB_GROUP /end SUB_GROUP /begin FUNCTION_LIST /end FUNCTION_LIST /begin REF_CHARACTERISTIC /end REF_CHARACTERISTIC
 /begin REF_MEASUREMENT GateDrv0Ctrl.GateDrv0PhaAFilLp.FilGain GateDrv0Ctrl.GateDrv0PhaAFilLp.FilSt /end REF_MEASUREMENT
/end GROUP
/begin GROUP GateDrv0Ctrl.GateDrv0PhaBFilLp "MICROSAR RTE" /begin SUB_GROUP /end SUB_GROUP /begin FUNCTION_LIST /end FUNCTION_LIST /begin REF_CHARACTERISTIC /end REF_CHARACTERISTIC
 /begin REF_MEASUREMENT GateDrv0Ctrl.GateDrv0PhaBFilLp.FilGain GateDrv0Ctrl.GateDrv0PhaBFilLp.FilSt /end REF_MEASUREMENT
/end GROUP
/begin GROUP GateDrv0Ctrl.GateDrv0PhaCFilLp "MICROSAR RTE" /begin SUB_GROUP /end SUB_GROUP /begin FUNCTION_LIST /end FUNCTION_LIST /begin REF_CHARACTERISTIC /end REF_CHARACTERISTIC
 /begin REF_MEASUREMENT GateDrv0Ctrl.GateDrv0PhaCFilLp.FilGain GateDrv0Ctrl.GateDrv0PhaCFilLp.FilSt /end REF_MEASUREMENT
/end GROUP
/begin GROUP GateDrv0Ctrl.GateDrv0PhaOnTiSumAPrev "MICROSAR RTE" /begin SUB_GROUP /end SUB_GROUP /begin FUNCTION_LIST /end FUNCTION_LIST /begin REF_CHARACTERISTIC /end REF_CHARACTERISTIC /begin REF_MEASUREMENT GateDrv0Ctrl.GateDrv0PhaOnTiSumAPrev /end REF_MEASUREMENT /end GROUP
/begin GROUP GateDrv0Ctrl.GateDrv0PhaOnTiSumBPrev "MICROSAR RTE" /begin SUB_GROUP /end SUB_GROUP /begin FUNCTION_LIST /end FUNCTION_LIST /begin REF_CHARACTERISTIC /end REF_CHARACTERISTIC /begin REF_MEASUREMENT GateDrv0Ctrl.GateDrv0PhaOnTiSumBPrev /end REF_MEASUREMENT /end GROUP
/begin GROUP GateDrv0Ctrl.GateDrv0PhaOnTiSumCPrev "MICROSAR RTE" /begin SUB_GROUP /end SUB_GROUP /begin FUNCTION_LIST /end FUNCTION_LIST /begin REF_CHARACTERISTIC /end REF_CHARACTERISTIC /begin REF_MEASUREMENT GateDrv0Ctrl.GateDrv0PhaOnTiSumCPrev /end REF_MEASUREMENT /end GROUP
/begin GROUP GateDrv0Ctrl.GateDrv0SpiErrSecAtmpt "MICROSAR RTE" /begin SUB_GROUP /end SUB_GROUP /begin FUNCTION_LIST /end FUNCTION_LIST /begin REF_CHARACTERISTIC /end REF_CHARACTERISTIC /begin REF_MEASUREMENT GateDrv0Ctrl.GateDrv0SpiErrSecAtmpt /end REF_MEASUREMENT /end GROUP
/begin GROUP GateDrv0Ctrl.GateDrv0SpiTrsmErrCntr "MICROSAR RTE" /begin SUB_GROUP /end SUB_GROUP /begin FUNCTION_LIST /end FUNCTION_LIST /begin REF_CHARACTERISTIC /end REF_CHARACTERISTIC /begin REF_MEASUREMENT GateDrv0Ctrl.GateDrv0SpiTrsmErrCntr /end REF_MEASUREMENT /end GROUP
/begin GROUP GateDrv0Ctrl.GateDrv0St "MICROSAR RTE" /begin SUB_GROUP /end SUB_GROUP /begin FUNCTION_LIST /end FUNCTION_LIST /begin REF_CHARACTERISTIC /end REF_CHARACTERISTIC /begin REF_MEASUREMENT GateDrv0Ctrl.GateDrv0St /end REF_MEASUREMENT /end GROUP
/begin GROUP GateDrv0Ctrl.GateDrv0StsVal "MICROSAR RTE" /begin SUB_GROUP /end SUB_GROUP /begin FUNCTION_LIST /end FUNCTION_LIST /begin REF_CHARACTERISTIC /end REF_CHARACTERISTIC /begin REF_MEASUREMENT GateDrv0Ctrl.GateDrv0StsVal /end REF_MEASUREMENT /end GROUP
/begin GROUP GateDrv0Ctrl.GateDrv0VrfyRes0Val "MICROSAR RTE" /begin SUB_GROUP /end SUB_GROUP /begin FUNCTION_LIST /end FUNCTION_LIST /begin REF_CHARACTERISTIC /end REF_CHARACTERISTIC /begin REF_MEASUREMENT GateDrv0Ctrl.GateDrv0VrfyRes0Val /end REF_MEASUREMENT /end GROUP
/begin GROUP GateDrv0Ctrl.GateDrv0VrfyRes1Val "MICROSAR RTE" /begin SUB_GROUP /end SUB_GROUP /begin FUNCTION_LIST /end FUNCTION_LIST /begin REF_CHARACTERISTIC /end REF_CHARACTERISTIC /begin REF_MEASUREMENT GateDrv0Ctrl.GateDrv0VrfyRes1Val /end REF_MEASUREMENT /end GROUP
/begin GROUP GateDrv0Ctrl.Ivtr0BootstrpSplyFltPrmVal "MICROSAR RTE" /begin SUB_GROUP /end SUB_GROUP /begin FUNCTION_LIST /end FUNCTION_LIST /begin REF_CHARACTERISTIC /end REF_CHARACTERISTIC /begin REF_MEASUREMENT GateDrv0Ctrl.Ivtr0BootstrpSplyFltPrmVal /end REF_MEASUREMENT /end GROUP
/begin GROUP GateDrv0Ctrl.Ivtr0GenericFltPrmVal "MICROSAR RTE" /begin SUB_GROUP /end SUB_GROUP /begin FUNCTION_LIST /end FUNCTION_LIST /begin REF_CHARACTERISTIC /end REF_CHARACTERISTIC /begin REF_MEASUREMENT GateDrv0Ctrl.Ivtr0GenericFltPrmVal /end REF_MEASUREMENT /end GROUP
/begin GROUP GateDrv0Ctrl.Ivtr0InactvSts "MICROSAR RTE" /begin SUB_GROUP /end SUB_GROUP /begin FUNCTION_LIST /end FUNCTION_LIST /begin REF_CHARACTERISTIC /end REF_CHARACTERISTIC /begin REF_MEASUREMENT GateDrv0Ctrl.Ivtr0InactvSts /end REF_MEASUREMENT /end GROUP
/begin GROUP GateDrv0Ctrl.Ivtr0OffStChkCmpl "MICROSAR RTE" /begin SUB_GROUP /end SUB_GROUP /begin FUNCTION_LIST /end FUNCTION_LIST /begin REF_CHARACTERISTIC /end REF_CHARACTERISTIC /begin REF_MEASUREMENT GateDrv0Ctrl.Ivtr0OffStChkCmpl /end REF_MEASUREMENT /end GROUP
/begin GROUP GateDrv0Ctrl.Ivtr1PwrDiscnctFltSts.Logl "MICROSAR RTE" /begin SUB_GROUP /end SUB_GROUP /begin FUNCTION_LIST /end FUNCTION_LIST /begin REF_CHARACTERISTIC /end REF_CHARACTERISTIC /begin REF_MEASUREMENT GateDrv0Ctrl.Ivtr1PwrDiscnctFltSts.Logl /end REF_MEASUREMENT /end GROUP
/begin GROUP GateDrv0Ctrl.IvtrFetFltPha.Val "MICROSAR RTE" /begin SUB_GROUP /end SUB_GROUP /begin FUNCTION_LIST /end FUNCTION_LIST /begin REF_CHARACTERISTIC /end REF_CHARACTERISTIC /begin REF_MEASUREMENT GateDrv0Ctrl.IvtrFetFltPha.Val /end REF_MEASUREMENT /end GROUP
/begin GROUP GateDrv0Ctrl.IvtrFetFltPhaDataStore "MICROSAR RTE" /begin SUB_GROUP /end SUB_GROUP /begin FUNCTION_LIST /end FUNCTION_LIST /begin REF_CHARACTERISTIC /end REF_CHARACTERISTIC /begin REF_MEASUREMENT GateDrv0Ctrl.IvtrFetFltPhaDataStore /end REF_MEASUREMENT /end GROUP
/begin GROUP GateDrv0Ctrl.IvtrFetFltTyp.Val "MICROSAR RTE" /begin SUB_GROUP /end SUB_GROUP /begin FUNCTION_LIST /end FUNCTION_LIST /begin REF_CHARACTERISTIC /end REF_CHARACTERISTIC /begin REF_MEASUREMENT GateDrv0Ctrl.IvtrFetFltTyp.Val /end REF_MEASUREMENT /end GROUP
/begin GROUP GateDrv0Ctrl.IvtrFetFltTypDataStore "MICROSAR RTE" /begin SUB_GROUP /end SUB_GROUP /begin FUNCTION_LIST /end FUNCTION_LIST /begin REF_CHARACTERISTIC /end REF_CHARACTERISTIC /begin REF_MEASUREMENT GateDrv0Ctrl.IvtrFetFltTypDataStore /end REF_MEASUREMENT /end GROUP
/begin GROUP GateDrv0Ctrl.MotDrvErrA.Val "MICROSAR RTE" /begin SUB_GROUP /end SUB_GROUP /begin FUNCTION_LIST /end FUNCTION_LIST /begin REF_CHARACTERISTIC /end REF_CHARACTERISTIC /begin REF_MEASUREMENT GateDrv0Ctrl.MotDrvErrA.Val /end REF_MEASUREMENT /end GROUP
/begin GROUP GateDrv0Ctrl.MotDrvErrB.Val "MICROSAR RTE" /begin SUB_GROUP /end SUB_GROUP /begin FUNCTION_LIST /end FUNCTION_LIST /begin REF_CHARACTERISTIC /end REF_CHARACTERISTIC /begin REF_MEASUREMENT GateDrv0Ctrl.MotDrvErrB.Val /end REF_MEASUREMENT /end GROUP
/begin GROUP GateDrv0Ctrl.MotDrvErrC.Val "MICROSAR RTE" /begin SUB_GROUP /end SUB_GROUP /begin FUNCTION_LIST /end FUNCTION_LIST /begin REF_CHARACTERISTIC /end REF_CHARACTERISTIC /begin REF_MEASUREMENT GateDrv0Ctrl.MotDrvErrC.Val /end REF_MEASUREMENT /end GROUP
/begin GROUP GateDrv0Ctrl.MotDrvr0IninTestCmpl.Logl "MICROSAR RTE" /begin SUB_GROUP /end SUB_GROUP /begin FUNCTION_LIST /end FUNCTION_LIST /begin REF_CHARACTERISTIC /end REF_CHARACTERISTIC /begin REF_MEASUREMENT GateDrv0Ctrl.MotDrvr0IninTestCmpl.Logl /end REF_MEASUREMENT /end GROUP
/begin GROUP GateDrv0Ctrl.PerInstanceMemories "MICROSAR RTE"
 /begin SUB_GROUP GateDrv0Ctrl.GateDrv0CfgCnt GateDrv0Ctrl.GateDrv0CfgSecAtmpt GateDrv0Ctrl.GateDrv0Diag0Val GateDrv0Ctrl.GateDrv0Diag1Val GateDrv0Ctrl.GateDrv0Diag2Val GateDrv0Ctrl.GateDrv0OffStChkIdx GateDrv0Ctrl.GateDrv0OffStChkSecAtmpt GateDrv0Ctrl.GateDrv0OffStCnt GateDrv0Ctrl.GateDrv0PhaAFilLp GateDrv0Ctrl.GateDrv0PhaBFilLp GateDrv0Ctrl.GateDrv0PhaCFilLp GateDrv0Ctrl.GateDrv0PhaOnTiSumAPrev GateDrv0Ctrl.GateDrv0PhaOnTiSumBPrev GateDrv0Ctrl.GateDrv0PhaOnTiSumCPrev GateDrv0Ctrl.GateDrv0SpiErrSecAtmpt GateDrv0Ctrl.GateDrv0SpiTrsmErrCntr GateDrv0Ctrl.GateDrv0St GateDrv0Ctrl.GateDrv0StsVal GateDrv0Ctrl.GateDrv0VrfyRes0Val GateDrv0Ctrl.GateDrv0VrfyRes1Val GateDrv0Ctrl.Ivtr0BootstrpSplyFltPrmVal GateDrv0Ctrl.Ivtr0GenericFltPrmVal GateDrv0Ctrl.Ivtr0InactvSts GateDrv0Ctrl.Ivtr0OffStChkCmpl GateDrv0Ctrl.IvtrFetFltPhaDataStore GateDrv0Ctrl.IvtrFetFltTypDataStore GateDrv0Ctrl.dGateDrv0CtrlGateDrv0Diag0Val GateDrv0Ctrl.dGateDrv0CtrlGateDrv0Diag1Val GateDrv0Ctrl.dGateDrv0CtrlGateDrv0Diag2Val GateDrv0Ctrl.dGateDrv0CtrlGateDrv0OffsStVrfyPrmBitIdx GateDrv0Ctrl.dGateDrv0CtrlGateDrv0PhaOnTiSumAExp GateDrv0Ctrl.dGateDrv0CtrlGateDrv0PhaOnTiSumBExp GateDrv0Ctrl.dGateDrv0CtrlGateDrv0PhaOnTiSumCExp GateDrv0Ctrl.dGateDrv0CtrlGateDrv0StsVal GateDrv0Ctrl.dGateDrv0CtrlGateDrv0VrfyRes0Val GateDrv0Ctrl.dGateDrv0CtrlGateDrv0VrfyRes1Val /end SUB_GROUP
 /begin FUNCTION_LIST /end FUNCTION_LIST
 /begin REF_CHARACTERISTIC /end REF_CHARACTERISTIC
 /begin REF_MEASUREMENT /end REF_MEASUREMENT
/end GROUP
/begin GROUP GateDrv0Ctrl.PhaOnTiMeasdA.Val "MICROSAR RTE" /begin SUB_GROUP /end SUB_GROUP /begin FUNCTION_LIST /end FUNCTION_LIST /begin REF_CHARACTERISTIC /end REF_CHARACTERISTIC /begin REF_MEASUREMENT GateDrv0Ctrl.PhaOnTiMeasdA.Val /end REF_MEASUREMENT /end GROUP
/begin GROUP GateDrv0Ctrl.PhaOnTiMeasdB.Val "MICROSAR RTE" /begin SUB_GROUP /end SUB_GROUP /begin FUNCTION_LIST /end FUNCTION_LIST /begin REF_CHARACTERISTIC /end REF_CHARACTERISTIC /begin REF_MEASUREMENT GateDrv0Ctrl.PhaOnTiMeasdB.Val /end REF_MEASUREMENT /end GROUP
/begin GROUP GateDrv0Ctrl.PhaOnTiMeasdC.Val "MICROSAR RTE" /begin SUB_GROUP /end SUB_GROUP /begin FUNCTION_LIST /end FUNCTION_LIST /begin REF_CHARACTERISTIC /end REF_CHARACTERISTIC /begin REF_MEASUREMENT GateDrv0Ctrl.PhaOnTiMeasdC.Val /end REF_MEASUREMENT /end GROUP
/begin GROUP GateDrv0Ctrl.PhaOnTiSumA.Val "MICROSAR RTE" /begin SUB_GROUP /end SUB_GROUP /begin FUNCTION_LIST /end FUNCTION_LIST /begin REF_CHARACTERISTIC /end REF_CHARACTERISTIC /begin REF_MEASUREMENT GateDrv0Ctrl.PhaOnTiSumA.Val /end REF_MEASUREMENT /end GROUP
/begin GROUP GateDrv0Ctrl.PhaOnTiSumB.Val "MICROSAR RTE" /begin SUB_GROUP /end SUB_GROUP /begin FUNCTION_LIST /end FUNCTION_LIST /begin REF_CHARACTERISTIC /end REF_CHARACTERISTIC /begin REF_MEASUREMENT GateDrv0Ctrl.PhaOnTiSumB.Val /end REF_MEASUREMENT /end GROUP
/begin GROUP GateDrv0Ctrl.PhaOnTiSumC.Val "MICROSAR RTE" /begin SUB_GROUP /end SUB_GROUP /begin FUNCTION_LIST /end FUNCTION_LIST /begin REF_CHARACTERISTIC /end REF_CHARACTERISTIC /begin REF_MEASUREMENT GateDrv0Ctrl.PhaOnTiSumC.Val /end REF_MEASUREMENT /end GROUP
/begin GROUP GateDrv0Ctrl.ReceiverPorts "MICROSAR RTE"
 /begin SUB_GROUP GateDrv0Ctrl.Ivtr1PwrDiscnctFltSts.Logl GateDrv0Ctrl.PhaOnTiMeasdA.Val GateDrv0Ctrl.PhaOnTiMeasdB.Val GateDrv0Ctrl.PhaOnTiMeasdC.Val GateDrv0Ctrl.PhaOnTiSumA.Val GateDrv0Ctrl.PhaOnTiSumB.Val GateDrv0Ctrl.PhaOnTiSumC.Val GateDrv0Ctrl.StrtUpSt.Val GateDrv0Ctrl.SysSt.Val /end SUB_GROUP
 /begin FUNCTION_LIST /end FUNCTION_LIST
 /begin REF_CHARACTERISTIC /end REF_CHARACTERISTIC
 /begin REF_MEASUREMENT /end REF_MEASUREMENT
/end GROUP
/begin GROUP GateDrv0Ctrl.SenderPorts "MICROSAR RTE"
 /begin SUB_GROUP GateDrv0Ctrl.DiagcStsIvtr1Inactv.Logl GateDrv0Ctrl.IvtrFetFltPha.Val GateDrv0Ctrl.IvtrFetFltTyp.Val GateDrv0Ctrl.MotDrvErrA.Val GateDrv0Ctrl.MotDrvErrB.Val GateDrv0Ctrl.MotDrvErrC.Val GateDrv0Ctrl.MotDrvr0IninTestCmpl.Logl /end SUB_GROUP
 /begin FUNCTION_LIST /end FUNCTION_LIST
 /begin REF_CHARACTERISTIC /end REF_CHARACTERISTIC
 /begin REF_MEASUREMENT /end REF_MEASUREMENT
/end GROUP
/begin GROUP GateDrv0Ctrl.StrtUpSt.Val "MICROSAR RTE" /begin SUB_GROUP /end SUB_GROUP /begin FUNCTION_LIST /end FUNCTION_LIST /begin REF_CHARACTERISTIC /end REF_CHARACTERISTIC /begin REF_MEASUREMENT GateDrv0Ctrl.StrtUpSt.Val /end REF_MEASUREMENT /end GROUP
/begin GROUP GateDrv0Ctrl.SysSt.Val "MICROSAR RTE" /begin SUB_GROUP /end SUB_GROUP /begin FUNCTION_LIST /end FUNCTION_LIST /begin REF_CHARACTERISTIC /end REF_CHARACTERISTIC /begin REF_MEASUREMENT GateDrv0Ctrl.SysSt.Val /end REF_MEASUREMENT /end GROUP
/begin GROUP GateDrv0Ctrl.dGateDrv0CtrlGateDrv0Diag0Val "MICROSAR RTE" /begin SUB_GROUP /end SUB_GROUP /begin FUNCTION_LIST /end FUNCTION_LIST /begin REF_CHARACTERISTIC /end REF_CHARACTERISTIC /begin REF_MEASUREMENT GateDrv0Ctrl.dGateDrv0CtrlGateDrv0Diag0Val /end REF_MEASUREMENT /end GROUP
/begin GROUP GateDrv0Ctrl.dGateDrv0CtrlGateDrv0Diag1Val "MICROSAR RTE" /begin SUB_GROUP /end SUB_GROUP /begin FUNCTION_LIST /end FUNCTION_LIST /begin REF_CHARACTERISTIC /end REF_CHARACTERISTIC /begin REF_MEASUREMENT GateDrv0Ctrl.dGateDrv0CtrlGateDrv0Diag1Val /end REF_MEASUREMENT /end GROUP
/begin GROUP GateDrv0Ctrl.dGateDrv0CtrlGateDrv0Diag2Val "MICROSAR RTE" /begin SUB_GROUP /end SUB_GROUP /begin FUNCTION_LIST /end FUNCTION_LIST /begin REF_CHARACTERISTIC /end REF_CHARACTERISTIC /begin REF_MEASUREMENT GateDrv0Ctrl.dGateDrv0CtrlGateDrv0Diag2Val /end REF_MEASUREMENT /end GROUP
/begin GROUP GateDrv0Ctrl.dGateDrv0CtrlGateDrv0OffsStVrfyPrmBitIdx "MICROSAR RTE" /begin SUB_GROUP /end SUB_GROUP /begin FUNCTION_LIST /end FUNCTION_LIST /begin REF_CHARACTERISTIC /end REF_CHARACTERISTIC /begin REF_MEASUREMENT GateDrv0Ctrl.dGateDrv0CtrlGateDrv0OffsStVrfyPrmBitIdx /end REF_MEASUREMENT /end GROUP
/begin GROUP GateDrv0Ctrl.dGateDrv0CtrlGateDrv0PhaOnTiSumAExp "MICROSAR RTE" /begin SUB_GROUP /end SUB_GROUP /begin FUNCTION_LIST /end FUNCTION_LIST /begin REF_CHARACTERISTIC /end REF_CHARACTERISTIC /begin REF_MEASUREMENT GateDrv0Ctrl.dGateDrv0CtrlGateDrv0PhaOnTiSumAExp /end REF_MEASUREMENT /end GROUP
/begin GROUP GateDrv0Ctrl.dGateDrv0CtrlGateDrv0PhaOnTiSumBExp "MICROSAR RTE" /begin SUB_GROUP /end SUB_GROUP /begin FUNCTION_LIST /end FUNCTION_LIST /begin REF_CHARACTERISTIC /end REF_CHARACTERISTIC /begin REF_MEASUREMENT GateDrv0Ctrl.dGateDrv0CtrlGateDrv0PhaOnTiSumBExp /end REF_MEASUREMENT /end GROUP
/begin GROUP GateDrv0Ctrl.dGateDrv0CtrlGateDrv0PhaOnTiSumCExp "MICROSAR RTE" /begin SUB_GROUP /end SUB_GROUP /begin FUNCTION_LIST /end FUNCTION_LIST /begin REF_CHARACTERISTIC /end REF_CHARACTERISTIC /begin REF_MEASUREMENT GateDrv0Ctrl.dGateDrv0CtrlGateDrv0PhaOnTiSumCExp /end REF_MEASUREMENT /end GROUP
/begin GROUP GateDrv0Ctrl.dGateDrv0CtrlGateDrv0StsVal "MICROSAR RTE" /begin SUB_GROUP /end SUB_GROUP /begin FUNCTION_LIST /end FUNCTION_LIST /begin REF_CHARACTERISTIC /end REF_CHARACTERISTIC /begin REF_MEASUREMENT GateDrv0Ctrl.dGateDrv0CtrlGateDrv0StsVal /end REF_MEASUREMENT /end GROUP
/begin GROUP GateDrv0Ctrl.dGateDrv0CtrlGateDrv0VrfyRes0Val "MICROSAR RTE" /begin SUB_GROUP /end SUB_GROUP /begin FUNCTION_LIST /end FUNCTION_LIST /begin REF_CHARACTERISTIC /end REF_CHARACTERISTIC /begin REF_MEASUREMENT GateDrv0Ctrl.dGateDrv0CtrlGateDrv0VrfyRes0Val /end REF_MEASUREMENT /end GROUP
/begin GROUP GateDrv0Ctrl.dGateDrv0CtrlGateDrv0VrfyRes1Val "MICROSAR RTE" /begin SUB_GROUP /end SUB_GROUP /begin FUNCTION_LIST /end FUNCTION_LIST /begin REF_CHARACTERISTIC /end REF_CHARACTERISTIC /begin REF_MEASUREMENT GateDrv0Ctrl.dGateDrv0CtrlGateDrv0VrfyRes1Val /end REF_MEASUREMENT /end GROUP
/begin GROUP HiLoadStallLimr "MICROSAR RTE"
 /begin SUB_GROUP HiLoadStallLimr.CalibrationPorts HiLoadStallLimr.PerInstanceMemories HiLoadStallLimr.ReceiverPorts HiLoadStallLimr.SenderPorts /end SUB_GROUP
 /begin FUNCTION_LIST /end FUNCTION_LIST
 /begin REF_CHARACTERISTIC /end REF_CHARACTERISTIC
 /begin REF_MEASUREMENT /end REF_MEASUREMENT
/end GROUP
/begin GROUP HiLoadStallLimr.CalibrationPorts "MICROSAR RTE"
 /begin SUB_GROUP HiLoadStallLimr.HiLoadStallLimrMotTqCmdFetMtgtnEnaFilFrq.Val HiLoadStallLimr.HiLoadStallLimrMotTqCmdFilFrq.Val HiLoadStallLimr.HiLoadStallLimrMotVelMgnThd.Ary1D HiLoadStallLimr.HiLoadStallLimrStallMotTqCmdFetMtgtnLimX.Ary1D HiLoadStallLimr.HiLoadStallLimrStallMotTqCmdFetMtgtnLimY.Ary1D HiLoadStallLimr.HiLoadStallLimrStallMotTqCmdLimX.Ary1D HiLoadStallLimr.HiLoadStallLimrStallMotTqCmdLimY.Ary1D HiLoadStallLimr.HiLoadStallLimrStallMotTqLimSlewRate.Ary1D HiLoadStallLimr.HiLoadStallLimrStallThermLimSca.Val /end SUB_GROUP
 /begin FUNCTION_LIST /end FUNCTION_LIST
 /begin REF_CHARACTERISTIC /end REF_CHARACTERISTIC
 /begin REF_MEASUREMENT /end REF_MEASUREMENT
/end GROUP
/begin GROUP HiLoadStallLimr.DualEcuFltMtgtnEna.Logl "MICROSAR RTE" /begin SUB_GROUP /end SUB_GROUP /begin FUNCTION_LIST /end FUNCTION_LIST /begin REF_CHARACTERISTIC /end REF_CHARACTERISTIC /begin REF_MEASUREMENT HiLoadStallLimr.DualEcuFltMtgtnEna.Logl /end REF_MEASUREMENT /end GROUP
/begin GROUP HiLoadStallLimr.FetLoaMtgtnCalIdx "MICROSAR RTE" /begin SUB_GROUP /end SUB_GROUP /begin FUNCTION_LIST /end FUNCTION_LIST /begin REF_CHARACTERISTIC /end REF_CHARACTERISTIC /begin REF_MEASUREMENT HiLoadStallLimr.FetLoaMtgtnCalIdx /end REF_MEASUREMENT /end GROUP
/begin GROUP HiLoadStallLimr.HiLoadStallLimrMotTqCmdFetMtgtnEnaFilFrq.Val "MICROSAR RTE" /begin SUB_GROUP /end SUB_GROUP /begin FUNCTION_LIST /end FUNCTION_LIST
 /begin REF_CHARACTERISTIC HiLoadStallLimr.HiLoadStallLimrMotTqCmdFetMtgtnEnaFilFrq.Val /end REF_CHARACTERISTIC
 /begin REF_MEASUREMENT /end REF_MEASUREMENT
/end GROUP
/begin GROUP HiLoadStallLimr.HiLoadStallLimrMotTqCmdFilFrq.Val "MICROSAR RTE" /begin SUB_GROUP /end SUB_GROUP /begin FUNCTION_LIST /end FUNCTION_LIST /begin REF_CHARACTERISTIC HiLoadStallLimr.HiLoadStallLimrMotTqCmdFilFrq.Val /end REF_CHARACTERISTIC /begin REF_MEASUREMENT /end REF_MEASUREMENT /end GROUP
/begin GROUP HiLoadStallLimr.HiLoadStallLimrMotVelMgnThd.Ary1D "MICROSAR RTE" /begin SUB_GROUP /end SUB_GROUP /begin FUNCTION_LIST /end FUNCTION_LIST /begin REF_CHARACTERISTIC HiLoadStallLimr.HiLoadStallLimrMotVelMgnThd.Ary1D /end REF_CHARACTERISTIC /begin REF_MEASUREMENT /end REF_MEASUREMENT /end GROUP
/begin GROUP HiLoadStallLimr.HiLoadStallLimrStallMotTqCmdFetMtgtnLimX.Ary1D "MICROSAR RTE" /begin SUB_GROUP /end SUB_GROUP /begin FUNCTION_LIST /end FUNCTION_LIST
 /begin REF_CHARACTERISTIC HiLoadStallLimr.HiLoadStallLimrStallMotTqCmdFetMtgtnLimX.Ary1D /end REF_CHARACTERISTIC
 /begin REF_MEASUREMENT /end REF_MEASUREMENT
/end GROUP
/begin GROUP HiLoadStallLimr.HiLoadStallLimrStallMotTqCmdFetMtgtnLimY.Ary1D "MICROSAR RTE" /begin SUB_GROUP /end SUB_GROUP /begin FUNCTION_LIST /end FUNCTION_LIST
 /begin REF_CHARACTERISTIC HiLoadStallLimr.HiLoadStallLimrStallMotTqCmdFetMtgtnLimY.Ary1D /end REF_CHARACTERISTIC
 /begin REF_MEASUREMENT /end REF_MEASUREMENT
/end GROUP
/begin GROUP HiLoadStallLimr.HiLoadStallLimrStallMotTqCmdLimX.Ary1D "MICROSAR RTE" /begin SUB_GROUP /end SUB_GROUP /begin FUNCTION_LIST /end FUNCTION_LIST /begin REF_CHARACTERISTIC HiLoadStallLimr.HiLoadStallLimrStallMotTqCmdLimX.Ary1D /end REF_CHARACTERISTIC /begin REF_MEASUREMENT /end REF_MEASUREMENT /end GROUP
/begin GROUP HiLoadStallLimr.HiLoadStallLimrStallMotTqCmdLimY.Ary1D "MICROSAR RTE" /begin SUB_GROUP /end SUB_GROUP /begin FUNCTION_LIST /end FUNCTION_LIST /begin REF_CHARACTERISTIC HiLoadStallLimr.HiLoadStallLimrStallMotTqCmdLimY.Ary1D /end REF_CHARACTERISTIC /begin REF_MEASUREMENT /end REF_MEASUREMENT /end GROUP
/begin GROUP HiLoadStallLimr.HiLoadStallLimrStallMotTqLimSlewRate.Ary1D "MICROSAR RTE" /begin SUB_GROUP /end SUB_GROUP /begin FUNCTION_LIST /end FUNCTION_LIST /begin REF_CHARACTERISTIC HiLoadStallLimr.HiLoadStallLimrStallMotTqLimSlewRate.Ary1D /end REF_CHARACTERISTIC /begin REF_MEASUREMENT /end REF_MEASUREMENT /end GROUP
/begin GROUP HiLoadStallLimr.HiLoadStallLimrStallThermLimSca.Val "MICROSAR RTE" /begin SUB_GROUP /end SUB_GROUP /begin FUNCTION_LIST /end FUNCTION_LIST /begin REF_CHARACTERISTIC HiLoadStallLimr.HiLoadStallLimrStallThermLimSca.Val /end REF_CHARACTERISTIC /begin REF_MEASUREMENT /end REF_MEASUREMENT /end GROUP
/begin GROUP HiLoadStallLimr.MotAndThermProtnLoaMod.Val "MICROSAR RTE" /begin SUB_GROUP /end SUB_GROUP /begin FUNCTION_LIST /end FUNCTION_LIST /begin REF_CHARACTERISTIC /end REF_CHARACTERISTIC /begin REF_MEASUREMENT HiLoadStallLimr.MotAndThermProtnLoaMod.Val /end REF_MEASUREMENT /end GROUP
/begin GROUP HiLoadStallLimr.MotTqCmdLimdPreStall.Val "MICROSAR RTE" /begin SUB_GROUP /end SUB_GROUP /begin FUNCTION_LIST /end FUNCTION_LIST /begin REF_CHARACTERISTIC /end REF_CHARACTERISTIC /begin REF_MEASUREMENT HiLoadStallLimr.MotTqCmdLimdPreStall.Val /end REF_MEASUREMENT /end GROUP
/begin GROUP HiLoadStallLimr.MotVelCrf.Val "MICROSAR RTE" /begin SUB_GROUP /end SUB_GROUP /begin FUNCTION_LIST /end FUNCTION_LIST /begin REF_CHARACTERISTIC /end REF_CHARACTERISTIC /begin REF_MEASUREMENT HiLoadStallLimr.MotVelCrf.Val /end REF_MEASUREMENT /end GROUP
/begin GROUP HiLoadStallLimr.PerInstanceMemories "MICROSAR RTE"
 /begin SUB_GROUP HiLoadStallLimr.FetLoaMtgtnCalIdx HiLoadStallLimr.StallMotTqCmdFetMtgtnFil HiLoadStallLimr.StallMotTqCmdFil HiLoadStallLimr.StallMotTqLimFetMtgtnPrev HiLoadStallLimr.StallMotTqLimPrev HiLoadStallLimr.dHiLoadStallLimrStallMotTqCmd HiLoadStallLimr.dHiLoadStallLimrStallMotTqCmdFild HiLoadStallLimr.dHiLoadStallLimrStallMotTqLim /end SUB_GROUP
 /begin FUNCTION_LIST /end FUNCTION_LIST
 /begin REF_CHARACTERISTIC /end REF_CHARACTERISTIC
 /begin REF_MEASUREMENT /end REF_MEASUREMENT
/end GROUP
/begin GROUP HiLoadStallLimr.ReceiverPorts "MICROSAR RTE"
 /begin SUB_GROUP HiLoadStallLimr.DualEcuFltMtgtnEna.Logl HiLoadStallLimr.MotAndThermProtnLoaMod.Val HiLoadStallLimr.MotTqCmdLimdPreStall.Val HiLoadStallLimr.MotVelCrf.Val HiLoadStallLimr.StallMotTqLimDi.Logl /end SUB_GROUP
 /begin FUNCTION_LIST /end FUNCTION_LIST
 /begin REF_CHARACTERISTIC /end REF_CHARACTERISTIC
 /begin REF_MEASUREMENT /end REF_MEASUREMENT
/end GROUP
/begin GROUP HiLoadStallLimr.SenderPorts "MICROSAR RTE" /begin SUB_GROUP HiLoadStallLimr.StallMotTqLim.Val /end SUB_GROUP /begin FUNCTION_LIST /end FUNCTION_LIST /begin REF_CHARACTERISTIC /end REF_CHARACTERISTIC /begin REF_MEASUREMENT /end REF_MEASUREMENT /end GROUP
/begin GROUP HiLoadStallLimr.StallMotTqCmdFetMtgtnFil "MICROSAR RTE" /begin SUB_GROUP /end SUB_GROUP /begin FUNCTION_LIST /end FUNCTION_LIST /begin REF_CHARACTERISTIC /end REF_CHARACTERISTIC
 /begin REF_MEASUREMENT HiLoadStallLimr.StallMotTqCmdFetMtgtnFil.FilGain HiLoadStallLimr.StallMotTqCmdFetMtgtnFil.FilSt /end REF_MEASUREMENT
/end GROUP
/begin GROUP HiLoadStallLimr.StallMotTqCmdFil "MICROSAR RTE" /begin SUB_GROUP /end SUB_GROUP /begin FUNCTION_LIST /end FUNCTION_LIST /begin REF_CHARACTERISTIC /end REF_CHARACTERISTIC
 /begin REF_MEASUREMENT HiLoadStallLimr.StallMotTqCmdFil.FilGain HiLoadStallLimr.StallMotTqCmdFil.FilSt /end REF_MEASUREMENT
/end GROUP
/begin GROUP HiLoadStallLimr.StallMotTqLim.Val "MICROSAR RTE" /begin SUB_GROUP /end SUB_GROUP /begin FUNCTION_LIST /end FUNCTION_LIST /begin REF_CHARACTERISTIC /end REF_CHARACTERISTIC /begin REF_MEASUREMENT HiLoadStallLimr.StallMotTqLim.Val /end REF_MEASUREMENT /end GROUP
/begin GROUP HiLoadStallLimr.StallMotTqLimDi.Logl "MICROSAR RTE" /begin SUB_GROUP /end SUB_GROUP /begin FUNCTION_LIST /end FUNCTION_LIST /begin REF_CHARACTERISTIC /end REF_CHARACTERISTIC /begin REF_MEASUREMENT HiLoadStallLimr.StallMotTqLimDi.Logl /end REF_MEASUREMENT /end GROUP
/begin GROUP HiLoadStallLimr.StallMotTqLimFetMtgtnPrev "MICROSAR RTE" /begin SUB_GROUP /end SUB_GROUP /begin FUNCTION_LIST /end FUNCTION_LIST /begin REF_CHARACTERISTIC /end REF_CHARACTERISTIC /begin REF_MEASUREMENT HiLoadStallLimr.StallMotTqLimFetMtgtnPrev /end REF_MEASUREMENT /end GROUP
/begin GROUP HiLoadStallLimr.StallMotTqLimPrev "MICROSAR RTE" /begin SUB_GROUP /end SUB_GROUP /begin FUNCTION_LIST /end FUNCTION_LIST /begin REF_CHARACTERISTIC /end REF_CHARACTERISTIC /begin REF_MEASUREMENT HiLoadStallLimr.StallMotTqLimPrev /end REF_MEASUREMENT /end GROUP
/begin GROUP HiLoadStallLimr.dHiLoadStallLimrStallMotTqCmd "MICROSAR RTE" /begin SUB_GROUP /end SUB_GROUP /begin FUNCTION_LIST /end FUNCTION_LIST /begin REF_CHARACTERISTIC /end REF_CHARACTERISTIC /begin REF_MEASUREMENT HiLoadStallLimr.dHiLoadStallLimrStallMotTqCmd /end REF_MEASUREMENT /end GROUP
/begin GROUP HiLoadStallLimr.dHiLoadStallLimrStallMotTqCmdFild "MICROSAR RTE" /begin SUB_GROUP /end SUB_GROUP /begin FUNCTION_LIST /end FUNCTION_LIST /begin REF_CHARACTERISTIC /end REF_CHARACTERISTIC /begin REF_MEASUREMENT HiLoadStallLimr.dHiLoadStallLimrStallMotTqCmdFild /end REF_MEASUREMENT /end GROUP
/begin GROUP HiLoadStallLimr.dHiLoadStallLimrStallMotTqLim "MICROSAR RTE" /begin SUB_GROUP /end SUB_GROUP /begin FUNCTION_LIST /end FUNCTION_LIST /begin REF_CHARACTERISTIC /end REF_CHARACTERISTIC /begin REF_MEASUREMENT HiLoadStallLimr.dHiLoadStallLimrStallMotTqLim /end REF_MEASUREMENT /end GROUP
/begin GROUP HwAg1Meas "MICROSAR RTE"
 /begin SUB_GROUP HwAg1Meas.CalibrationPorts HwAg1Meas.PerInstanceMemories HwAg1Meas.ReceiverPorts HwAg1Meas.SenderPorts /end SUB_GROUP
 /begin FUNCTION_LIST /end FUNCTION_LIST
 /begin REF_CHARACTERISTIC /end REF_CHARACTERISTIC
 /begin REF_MEASUREMENT /end REF_MEASUREMENT
/end GROUP
/begin GROUP HwAg1Meas.CalibrationPorts "MICROSAR RTE"
 /begin SUB_GROUP HwAg1Meas.HwAg1MeasHwAg1IfFltFailStep.Val HwAg1Meas.HwAg1MeasHwAg1IfFltPassStep.Val HwAg1Meas.HwAg1MeasHwAg1Snsr0PrtclFltFailStep.Val HwAg1Meas.HwAg1MeasHwAg1Snsr0PrtclFltPassStep.Val HwAg1Meas.HwAg1MeasHwAg1Snsr1PrtclFltFailStep.Val HwAg1Meas.HwAg1MeasHwAg1Snsr1PrtclFltPassStep.Val HwAg1Meas.HwAg1MeasSnsr0Rev.Ary1D HwAg1Meas.HwAg1MeasSnsr1Rev.Ary1D HwAg1Meas.HwAg1MeasStep.Ary1D HwAg1Meas.HwAg1MeasVrnrErrThd.Val /end SUB_GROUP
 /begin FUNCTION_LIST /end FUNCTION_LIST
 /begin REF_CHARACTERISTIC /end REF_CHARACTERISTIC
 /begin REF_MEASUREMENT /end REF_MEASUREMENT
/end GROUP
/begin GROUP HwAg1Meas.HwAg1.Val "MICROSAR RTE" /begin SUB_GROUP /end SUB_GROUP /begin FUNCTION_LIST /end FUNCTION_LIST /begin REF_CHARACTERISTIC /end REF_CHARACTERISTIC /begin REF_MEASUREMENT HwAg1Meas.HwAg1.Val /end REF_MEASUREMENT /end GROUP
/begin GROUP HwAg1Meas.HwAg1IfFltLtch "MICROSAR RTE" /begin SUB_GROUP /end SUB_GROUP /begin FUNCTION_LIST /end FUNCTION_LIST /begin REF_CHARACTERISTIC /end REF_CHARACTERISTIC /begin REF_MEASUREMENT HwAg1Meas.HwAg1IfFltLtch /end REF_MEASUREMENT /end GROUP
/begin GROUP HwAg1Meas.HwAg1InitStepSeqNrCmpl "MICROSAR RTE" /begin SUB_GROUP /end SUB_GROUP /begin FUNCTION_LIST /end FUNCTION_LIST /begin REF_CHARACTERISTIC /end REF_CHARACTERISTIC /begin REF_MEASUREMENT HwAg1Meas.HwAg1InitStepSeqNrCmpl /end REF_MEASUREMENT /end GROUP
/begin GROUP HwAg1Meas.HwAg1LtchClr "MICROSAR RTE" /begin SUB_GROUP /end SUB_GROUP /begin FUNCTION_LIST /end FUNCTION_LIST /begin REF_CHARACTERISTIC /end REF_CHARACTERISTIC /begin REF_MEASUREMENT HwAg1Meas.HwAg1LtchClr /end REF_MEASUREMENT /end GROUP
/begin GROUP HwAg1Meas.HwAg1MeasHwAg1IfFltFailStep.Val "MICROSAR RTE" /begin SUB_GROUP /end SUB_GROUP /begin FUNCTION_LIST /end FUNCTION_LIST /begin REF_CHARACTERISTIC HwAg1Meas.HwAg1MeasHwAg1IfFltFailStep.Val /end REF_CHARACTERISTIC /begin REF_MEASUREMENT /end REF_MEASUREMENT /end GROUP
/begin GROUP HwAg1Meas.HwAg1MeasHwAg1IfFltPassStep.Val "MICROSAR RTE" /begin SUB_GROUP /end SUB_GROUP /begin FUNCTION_LIST /end FUNCTION_LIST /begin REF_CHARACTERISTIC HwAg1Meas.HwAg1MeasHwAg1IfFltPassStep.Val /end REF_CHARACTERISTIC /begin REF_MEASUREMENT /end REF_MEASUREMENT /end GROUP
/begin GROUP HwAg1Meas.HwAg1MeasHwAg1Snsr0PrtclFltFailStep.Val "MICROSAR RTE" /begin SUB_GROUP /end SUB_GROUP /begin FUNCTION_LIST /end FUNCTION_LIST /begin REF_CHARACTERISTIC HwAg1Meas.HwAg1MeasHwAg1Snsr0PrtclFltFailStep.Val /end REF_CHARACTERISTIC /begin REF_MEASUREMENT /end REF_MEASUREMENT /end GROUP
/begin RECORD_LAYOUT RTE_RL_UWORD FNC_VALUES 1 UWORD ROW_DIR DIRECT /end RECORD_LAYOUT
/begin RECORD_LAYOUT RTE_RL_ULONG FNC_VALUES 1 ULONG ROW_DIR DIRECT /end RECORD_LAYOUT
/begin RECORD_LAYOUT RTE_RL_FLOAT32_IEEE FNC_VALUES 1 FLOAT32_IEEE ROW_DIR DIRECT /end RECORD_LAYOUT
/begin RECORD_LAYOUT RTE_RL_BOOLEAN FNC_VALUES 1 UBYTE ROW_DIR DIRECT /end RECORD_LAYOUT
/**********************************************************************************************************************
* COMPU_METHOD / COMPU_VTAB_RANGE
*********************************************************************************************************************/
/begin COMPU_METHOD RTE_CM_BOOLEAN "" TAB_VERB "%3.1" "" COMPU_TAB_REF RTE_CM_BOOLEAN /end COMPU_METHOD
/begin COMPU_VTAB_RANGE RTE_CM_BOOLEAN "" 2 0 0 "false" 1 255 "true" /end COMPU_VTAB_RANGE
/begin COMPU_METHOD RTE_CM_ENUM_SysSt1 "" TAB_VERB "%.1" "" COMPU_TAB_REF RTE_CM_ENUM_SysSt1 /end COMPU_METHOD
/begin COMPU_VTAB_RANGE RTE_CM_ENUM_SysSt1 "" 4 0 0 "SYSST_DI" 1 1 "SYSST_OFF" 2 2 "SYSST_ENA" 3 3 "SYSST_WRMININ" /end COMPU_VTAB_RANGE
/begin COMPU_METHOD RTE_CM_ENUM_IvtrFetFltPha1 "" TAB_VERB "%.1" "" COMPU_TAB_REF RTE_CM_ENUM_IvtrFetFltPha1 /end COMPU_METHOD
/begin COMPU_VTAB_RANGE RTE_CM_ENUM_IvtrFetFltPha1 "" 4 0 0 "IVTRFETFLTPHA_NOPHASNGFETFLT" 1 1 "IVTRFETFLTPHA_PHAASNGFETFLT" 2 2 "IVTRFETFLTPHA_PHABSNGFETFLT" 4 4 "IVTRFETFLTPHA_PHACSNGFETFLT" /end COMPU_VTAB_RANGE
/begin COMPU_METHOD RTE_CM_ENUM_IvtrFetFltTyp1 "" TAB_VERB "%.1" "" COMPU_TAB_REF RTE_CM_ENUM_IvtrFetFltTyp1 /end COMPU_METHOD
/begin COMPU_VTAB_RANGE RTE_CM_ENUM_IvtrFetFltTyp1 "" 4 0 0 "IVTRFETFLTTYP_NOFETFLT" 1 1 "IVTRFETFLTTYP_LOWRFETFLT" 2 2 "IVTRFETFLTTYP_UPPRFETFLT" 4 4 "IVTRFETFLTTYP_MPLFETFLT" /end COMPU_VTAB_RANGE
/begin COMPU_METHOD RTE_CM_ENUM_FordEpsSysSt1 "" TAB_VERB "%.1" "" COMPU_TAB_REF RTE_CM_ENUM_FordEpsSysSt1 /end COMPU_METHOD
/begin COMPU_VTAB_RANGE RTE_CM_ENUM_FordEpsSysSt1 "" 9 0 0 "FORDEPSSYSST_EPS_ININ" 1 1 "FORDEPSSYSST_EPS_NORM_OP_LIMD_ASSI" 2 2 "FORDEPSSYSST_EPS_NORM_OP_FULL_ASSI" 3 3 "FORDEPSSYSST_EPS_SYST_FAILR_LIMPHOME" 4 4 "FORDEPSSYSST_EPS_SYST_FAILR_LIMPASIDE" 5 5 "FORDEPSSYSST_EPS_SYST_FAILR_RAMPOUT" 6 6 "FORDEPSSYSST_EPS_SYST_FAILR_ASSISTOFF" 7 7 "FORDEPSSYSST_EPS_SHTDWN" 8 8 "FORDEPSSYSST_EPS_PWRDWN" /end COMPU_VTAB_RANGE
/begin COMPU_METHOD RTE_CM_ENUM_Ford_ElPw_D_Stat "" TAB_VERB "%.1" "" COMPU_TAB_REF RTE_CM_ENUM_Ford_ElPw_D_Stat /end COMPU_METHOD
/begin COMPU_VTAB_RANGE RTE_CM_ENUM_Ford_ElPw_D_Stat "" 9 0 7 "RANGE" 0 0 "Cx0_Not_Supported" 1 1 "Cx1_Supported" 2 2 "Cx2_Not_Supported_Imminent" 3 3 "Cx3_LV_Event_In_Progress" 4 4 "Cx4_Fault_Limited" 5 5 "Cx5_NotUsed_1" 6 6 "Cx6_NotUsed_2" 7 7 "Cx7_NotUsed_3" /end COMPU_VTAB_RANGE
/begin COMPU_METHOD RTE_CM_ENUM_Ford_Ignition_Status "" TAB_VERB "%.1" "" COMPU_TAB_REF RTE_CM_ENUM_Ford_Ignition_Status /end COMPU_METHOD
/begin COMPU_VTAB_RANGE RTE_CM_ENUM_Ford_Ignition_Status "" 7 0 15 "RANGE" 0 0 "Cx0_Unknown" 1 1 "Cx1_Off" 2 2 "Cx2_Accessory" 4 4 "Cx4_Run" 8 8 "Cx8_Start" 15 15 "CxF_Invalid" /end COMPU_VTAB_RANGE
/begin COMPU_METHOD RTE_CM_ENUM_Ford_PwPckTq_D_Stat "" TAB_VERB "%.1" "" COMPU_TAB_REF RTE_CM_ENUM_Ford_PwPckTq_D_Stat /end COMPU_METHOD
/begin COMPU_VTAB_RANGE RTE_CM_ENUM_Ford_PwPckTq_D_Stat "" 5 0 3 "RANGE" 0 0 "Cx0_PwPckOff_TqNotAvailable" 1 1 "Cx1_PwPckOn_TqNotAvailable" 2 2 "Cx2_StartInPrgrss_TqNotAvail" 3 3 "Cx3_PwPckOn_TqAvailable" /end COMPU_VTAB_RANGE
/begin COMPU_METHOD RTE_CM_ENUM_Ford_EPAS_Failure "" TAB_VERB "%.1" "" COMPU_TAB_REF RTE_CM_ENUM_Ford_EPAS_Failure /end COMPU_METHOD
/begin COMPU_VTAB_RANGE RTE_CM_ENUM_Ford_EPAS_Failure "" 5 0 3 "RANGE" 0 0 "Cx0_EPAS_OK_NO_MESSAGE" 1 1 "Cx1_POWER_STRG_ASSIST_FAULT" 2 2 "Cx2_SERVICE_POWER_STEERING" 3 3 "Cx3_SERVICE_POWER_STEERING_NOW" /end COMPU_VTAB_RANGE
/begin COMPU_METHOD RTE_CM_ENUM_Ford_SteMdule_D_Stat "" TAB_VERB "%.1" "" COMPU_TAB_REF RTE_CM_ENUM_Ford_SteMdule_D_Stat /end COMPU_METHOD
/begin COMPU_VTAB_RANGE RTE_CM_ENUM_Ford_SteMdule_D_Stat "" 9 0 7 "RANGE" 0 0 "Cx0_EPAS_Initialization" 1 1 "Cx1_Normal_Op_Limited_Assist" 2 2 "Cx2_Normal_Op_Full_Assist" 3 3 "Cx3_EPAS_Shutdown" 4 4 "Cx4_System_Failure" 5 5 "Cx5_EPAS_Failure2" 6 6 "Cx6_EPAS_Failure3" 7 7 "Cx7_NotUsed" /end COMPU_VTAB_RANGE
/begin COMPU_METHOD RTE_CM_ENUM_FordVltgOperSt1 "" TAB_VERB "%.1" "" COMPU_TAB_REF RTE_CM_ENUM_FordVltgOperSt1 /end COMPU_METHOD
/begin COMPU_VTAB_RANGE RTE_CM_ENUM_FordVltgOperSt1 "" 7 0 0 "FORDVLTGOPERST_NORMVLTGOP" 1 1 "FORDVLTGOPERST_LOVLTGOP_MONR" 2 2 "FORDVLTGOPERST_LOVLTGOP_HICURR" 3 3 "FORDVLTGOPERST_LOVLTGOP_TQSCAG" 4 4 "FORDVLTGOPERST_LOVLTGOP_NOASSI" 5 5 "FORDVLTGOPERST_HIVLTGOP" 6 6 "FORDVLTGOPERST_HIVLTG_NOASSI" /end COMPU_VTAB_RANGE
/begin COMPU_METHOD RTE_CM_ENUM_LoaSt1 "" TAB_VERB "%.1" "" COMPU_TAB_REF RTE_CM_ENUM_LoaSt1 /end COMPU_METHOD
/begin COMPU_VTAB_RANGE RTE_CM_ENUM_LoaSt1 "" 6 0 0 "LOAST_NORM" 1 1 "LOAST_LIMD" 2 2 "LOAST_SWBASDMTGTN" 3 3 "LOAST_FADEOUT" 4 4 "LOAST_CTRLDSHTDWNREQD" 5 5 "LOAST_IMDTSHTDWNREQD" /end COMPU_VTAB_RANGE
