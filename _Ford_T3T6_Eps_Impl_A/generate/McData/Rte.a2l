/begin CHARACTERISTIC CalRegn01Cmn.DutyCycThermProtnLstTblValNonStall.Ary2D "MICROSAR RTE" VAL_BLK 0x0 RTE_RL_UWORD 0 NO_COMPU_METHOD 0 65535 MATRIX_DIM 5 2 1 SYMBOL_LINK "Rte_CalprmRom_CalRegn01Cmn_DEFAULT_RTE_CALPRM_GROUP.DutyCycThermProtnLstTblValNonStall_Ary2D" 0 DISPLAY_IDENTIFIER CalRegn01Cmn.CalibrationPorts.DutyCycThermProtnLstTblValNonStall.Ary2D /end CHARACTERISTIC
/begin CHARACTERISTIC CalRegn01Cmn.DutyCycThermProtnLstTblValStall.Ary2D "MICROSAR RTE" VAL_BLK 0x0 RTE_RL_UWORD 0 NO_COMPU_METHOD 0 65535 MATRIX_DIM 5 2 1 SYMBOL_LINK "Rte_CalprmRom_CalRegn01Cmn_DEFAULT_RTE_CALPRM_GROUP.DutyCycThermProtnLstTblValStall_Ary2D" 0 DISPLAY_IDENTIFIER CalRegn01Cmn.CalibrationPorts.DutyCycThermProtnLstTblValStall.Ary2D /end CHARACTERISTIC
/begin CHARACTERISTIC CalRegn01Cmn.DutyCycThermProtnMotPrTSeln.Logl "MICROSAR RTE" VALUE 0x0 RTE_RL_BOOLEAN 0 RTE_CM_BOOLEAN 0 255 SYMBOL_LINK "Rte_CalprmRom_CalRegn01Cmn_DEFAULT_RTE_CALPRM_GROUP.DutyCycThermProtnMotPrTSeln_Logl" 0 DISPLAY_IDENTIFIER CalRegn01Cmn.CalibrationPorts.DutyCycThermProtnMotPrTSeln.Logl /end CHARACTERISTIC
/begin CHARACTERISTIC CalRegn01Cmn.DutyCycThermProtnMplr1FetMtgtnNonStallTblY.Ary1D "MICROSAR RTE" VAL_BLK 0x0 RTE_RL_UWORD 0 NO_COMPU_METHOD 0 65535 MATRIX_DIM 5 1 1 SYMBOL_LINK "Rte_CalprmRom_CalRegn01Cmn_DEFAULT_RTE_CALPRM_GROUP.DutyCycThermProtnMplr1FetMtgtnNonStallTblY_Ary1D" 0 DISPLAY_IDENTIFIER CalRegn01Cmn.CalibrationPorts.DutyCycThermProtnMplr1FetMtgtnNonStallTblY.Ary1D /end CHARACTERISTIC
/begin CHARACTERISTIC CalRegn01Cmn.DutyCycThermProtnMplr1FetMtgtnStallTblY.Ary1D "MICROSAR RTE" VAL_BLK 0x0 RTE_RL_UWORD 0 NO_COMPU_METHOD 0 65535 MATRIX_DIM 5 1 1 SYMBOL_LINK "Rte_CalprmRom_CalRegn01Cmn_DEFAULT_RTE_CALPRM_GROUP.DutyCycThermProtnMplr1FetMtgtnStallTblY_Ary1D" 0 DISPLAY_IDENTIFIER CalRegn01Cmn.CalibrationPorts.DutyCycThermProtnMplr1FetMtgtnStallTblY.Ary1D /end CHARACTERISTIC
/begin CHARACTERISTIC CalRegn01Cmn.DutyCycThermProtnMplr1NonStallTblY.Ary1D "MICROSAR RTE" VAL_BLK 0x0 RTE_RL_UWORD 0 NO_COMPU_METHOD 0 65535 MATRIX_DIM 5 1 1 SYMBOL_LINK "Rte_CalprmRom_CalRegn01Cmn_DEFAULT_RTE_CALPRM_GROUP.DutyCycThermProtnMplr1NonStallTblY_Ary1D" 0 DISPLAY_IDENTIFIER CalRegn01Cmn.CalibrationPorts.DutyCycThermProtnMplr1NonStallTblY.Ary1D /end CHARACTERISTIC
/begin CHARACTERISTIC CalRegn01Cmn.DutyCycThermProtnMplr1StallTblY.Ary1D "MICROSAR RTE" VAL_BLK 0x0 RTE_RL_UWORD 0 NO_COMPU_METHOD 0 65535 MATRIX_DIM 5 1 1 SYMBOL_LINK "Rte_CalprmRom_CalRegn01Cmn_DEFAULT_RTE_CALPRM_GROUP.DutyCycThermProtnMplr1StallTblY_Ary1D" 0 DISPLAY_IDENTIFIER CalRegn01Cmn.CalibrationPorts.DutyCycThermProtnMplr1StallTblY.Ary1D /end CHARACTERISTIC
/begin CHARACTERISTIC CalRegn01Cmn.DutyCycThermProtnMplr2FetMtgtnNonStallTblY.Ary1D "MICROSAR RTE" VAL_BLK 0x0 RTE_RL_UWORD 0 NO_COMPU_METHOD 0 65535 MATRIX_DIM 5 1 1 SYMBOL_LINK "Rte_CalprmRom_CalRegn01Cmn_DEFAULT_RTE_CALPRM_GROUP.DutyCycThermProtnMplr2FetMtgtnNonStallTblY_Ary1D" 0 DISPLAY_IDENTIFIER CalRegn01Cmn.CalibrationPorts.DutyCycThermProtnMplr2FetMtgtnNonStallTblY.Ary1D /end CHARACTERISTIC
/begin CHARACTERISTIC CalRegn01Cmn.DutyCycThermProtnMplr2FetMtgtnStallTblY.Ary1D "MICROSAR RTE" VAL_BLK 0x0 RTE_RL_UWORD 0 NO_COMPU_METHOD 0 65535 MATRIX_DIM 5 1 1 SYMBOL_LINK "Rte_CalprmRom_CalRegn01Cmn_DEFAULT_RTE_CALPRM_GROUP.DutyCycThermProtnMplr2FetMtgtnStallTblY_Ary1D" 0 DISPLAY_IDENTIFIER CalRegn01Cmn.CalibrationPorts.DutyCycThermProtnMplr2FetMtgtnStallTblY.Ary1D /end CHARACTERISTIC
/begin CHARACTERISTIC CalRegn01Cmn.DutyCycThermProtnMplr2NonStallTblY.Ary1D "MICROSAR RTE" VAL_BLK 0x0 RTE_RL_UWORD 0 NO_COMPU_METHOD 0 65535 MATRIX_DIM 5 1 1 SYMBOL_LINK "Rte_CalprmRom_CalRegn01Cmn_DEFAULT_RTE_CALPRM_GROUP.DutyCycThermProtnMplr2NonStallTblY_Ary1D" 0 DISPLAY_IDENTIFIER CalRegn01Cmn.CalibrationPorts.DutyCycThermProtnMplr2NonStallTblY.Ary1D /end CHARACTERISTIC
/begin CHARACTERISTIC CalRegn01Cmn.DutyCycThermProtnMplr2StallTblY.Ary1D "MICROSAR RTE" VAL_BLK 0x0 RTE_RL_UWORD 0 NO_COMPU_METHOD 0 65535 MATRIX_DIM 5 1 1 SYMBOL_LINK "Rte_CalprmRom_CalRegn01Cmn_DEFAULT_RTE_CALPRM_GROUP.DutyCycThermProtnMplr2StallTblY_Ary1D" 0 DISPLAY_IDENTIFIER CalRegn01Cmn.CalibrationPorts.DutyCycThermProtnMplr2StallTblY.Ary1D /end CHARACTERISTIC
/begin CHARACTERISTIC CalRegn01Cmn.DutyCycThermProtnMplr3FetMtgtnNonStallTblY.Ary1D "MICROSAR RTE" VAL_BLK 0x0 RTE_RL_UWORD 0 NO_COMPU_METHOD 0 65535 MATRIX_DIM 5 1 1 SYMBOL_LINK "Rte_CalprmRom_CalRegn01Cmn_DEFAULT_RTE_CALPRM_GROUP.DutyCycThermProtnMplr3FetMtgtnNonStallTblY_Ary1D" 0 DISPLAY_IDENTIFIER CalRegn01Cmn.CalibrationPorts.DutyCycThermProtnMplr3FetMtgtnNonStallTblY.Ary1D /end CHARACTERISTIC
/begin CHARACTERISTIC CalRegn01Cmn.DutyCycThermProtnMplr3FetMtgtnStallTblY.Ary1D "MICROSAR RTE" VAL_BLK 0x0 RTE_RL_UWORD 0 NO_COMPU_METHOD 0 65535 MATRIX_DIM 5 1 1 SYMBOL_LINK "Rte_CalprmRom_CalRegn01Cmn_DEFAULT_RTE_CALPRM_GROUP.DutyCycThermProtnMplr3FetMtgtnStallTblY_Ary1D" 0 DISPLAY_IDENTIFIER CalRegn01Cmn.CalibrationPorts.DutyCycThermProtnMplr3FetMtgtnStallTblY.Ary1D /end CHARACTERISTIC
/begin CHARACTERISTIC CalRegn01Cmn.DutyCycThermProtnMplr3NonStallTblY.Ary1D "MICROSAR RTE" VAL_BLK 0x0 RTE_RL_UWORD 0 NO_COMPU_METHOD 0 65535 MATRIX_DIM 5 1 1 SYMBOL_LINK "Rte_CalprmRom_CalRegn01Cmn_DEFAULT_RTE_CALPRM_GROUP.DutyCycThermProtnMplr3NonStallTblY_Ary1D" 0 DISPLAY_IDENTIFIER CalRegn01Cmn.CalibrationPorts.DutyCycThermProtnMplr3NonStallTblY.Ary1D /end CHARACTERISTIC
/begin CHARACTERISTIC CalRegn01Cmn.DutyCycThermProtnMplr3StallTblY.Ary1D "MICROSAR RTE" VAL_BLK 0x0 RTE_RL_UWORD 0 NO_COMPU_METHOD 0 65535 MATRIX_DIM 5 1 1 SYMBOL_LINK "Rte_CalprmRom_CalRegn01Cmn_DEFAULT_RTE_CALPRM_GROUP.DutyCycThermProtnMplr3StallTblY_Ary1D" 0 DISPLAY_IDENTIFIER CalRegn01Cmn.CalibrationPorts.DutyCycThermProtnMplr3StallTblY.Ary1D /end CHARACTERISTIC
/begin CHARACTERISTIC CalRegn01Cmn.DutyCycThermProtnMplr4FetMtgtnNonStallTblY.Ary1D "MICROSAR RTE" VAL_BLK 0x0 RTE_RL_UWORD 0 NO_COMPU_METHOD 0 65535 MATRIX_DIM 5 1 1 SYMBOL_LINK "Rte_CalprmRom_CalRegn01Cmn_DEFAULT_RTE_CALPRM_GROUP.DutyCycThermProtnMplr4FetMtgtnNonStallTblY_Ary1D" 0 DISPLAY_IDENTIFIER CalRegn01Cmn.CalibrationPorts.DutyCycThermProtnMplr4FetMtgtnNonStallTblY.Ary1D /end CHARACTERISTIC
/begin CHARACTERISTIC CalRegn01Cmn.DutyCycThermProtnMplr4FetMtgtnStallTblY.Ary1D "MICROSAR RTE" VAL_BLK 0x0 RTE_RL_UWORD 0 NO_COMPU_METHOD 0 65535 MATRIX_DIM 5 1 1 SYMBOL_LINK "Rte_CalprmRom_CalRegn01Cmn_DEFAULT_RTE_CALPRM_GROUP.DutyCycThermProtnMplr4FetMtgtnStallTblY_Ary1D" 0 DISPLAY_IDENTIFIER CalRegn01Cmn.CalibrationPorts.DutyCycThermProtnMplr4FetMtgtnStallTblY.Ary1D /end CHARACTERISTIC
/begin CHARACTERISTIC CalRegn01Cmn.DutyCycThermProtnMplr4NonStallTblY.Ary1D "MICROSAR RTE" VAL_BLK 0x0 RTE_RL_UWORD 0 NO_COMPU_METHOD 0 65535 MATRIX_DIM 5 1 1 SYMBOL_LINK "Rte_CalprmRom_CalRegn01Cmn_DEFAULT_RTE_CALPRM_GROUP.DutyCycThermProtnMplr4NonStallTblY_Ary1D" 0 DISPLAY_IDENTIFIER CalRegn01Cmn.CalibrationPorts.DutyCycThermProtnMplr4NonStallTblY.Ary1D /end CHARACTERISTIC
/begin CHARACTERISTIC CalRegn01Cmn.DutyCycThermProtnMplr4StallTblY.Ary1D "MICROSAR RTE" VAL_BLK 0x0 RTE_RL_UWORD 0 NO_COMPU_METHOD 0 65535 MATRIX_DIM 5 1 1 SYMBOL_LINK "Rte_CalprmRom_CalRegn01Cmn_DEFAULT_RTE_CALPRM_GROUP.DutyCycThermProtnMplr4StallTblY_Ary1D" 0 DISPLAY_IDENTIFIER CalRegn01Cmn.CalibrationPorts.DutyCycThermProtnMplr4StallTblY.Ary1D /end CHARACTERISTIC
/begin CHARACTERISTIC CalRegn01Cmn.DutyCycThermProtnMplr5FetMtgtnNonStallTblY.Ary1D "MICROSAR RTE" VAL_BLK 0x0 RTE_RL_UWORD 0 NO_COMPU_METHOD 0 65535 MATRIX_DIM 5 1 1 SYMBOL_LINK "Rte_CalprmRom_CalRegn01Cmn_DEFAULT_RTE_CALPRM_GROUP.DutyCycThermProtnMplr5FetMtgtnNonStallTblY_Ary1D" 0 DISPLAY_IDENTIFIER CalRegn01Cmn.CalibrationPorts.DutyCycThermProtnMplr5FetMtgtnNonStallTblY.Ary1D /end CHARACTERISTIC
/begin CHARACTERISTIC CalRegn01Cmn.DutyCycThermProtnMplr5FetMtgtnStallTblY.Ary1D "MICROSAR RTE" VAL_BLK 0x0 RTE_RL_UWORD 0 NO_COMPU_METHOD 0 65535 MATRIX_DIM 5 1 1 SYMBOL_LINK "Rte_CalprmRom_CalRegn01Cmn_DEFAULT_RTE_CALPRM_GROUP.DutyCycThermProtnMplr5FetMtgtnStallTblY_Ary1D" 0 DISPLAY_IDENTIFIER CalRegn01Cmn.CalibrationPorts.DutyCycThermProtnMplr5FetMtgtnStallTblY.Ary1D /end CHARACTERISTIC
/begin CHARACTERISTIC CalRegn01Cmn.DutyCycThermProtnMplr5NonStallTblY.Ary1D "MICROSAR RTE" VAL_BLK 0x0 RTE_RL_UWORD 0 NO_COMPU_METHOD 0 65535 MATRIX_DIM 5 1 1 SYMBOL_LINK "Rte_CalprmRom_CalRegn01Cmn_DEFAULT_RTE_CALPRM_GROUP.DutyCycThermProtnMplr5NonStallTblY_Ary1D" 0 DISPLAY_IDENTIFIER CalRegn01Cmn.CalibrationPorts.DutyCycThermProtnMplr5NonStallTblY.Ary1D /end CHARACTERISTIC
/begin CHARACTERISTIC CalRegn01Cmn.DutyCycThermProtnMplr5StallTblY.Ary1D "MICROSAR RTE" VAL_BLK 0x0 RTE_RL_UWORD 0 NO_COMPU_METHOD 0 65535 MATRIX_DIM 5 1 1 SYMBOL_LINK "Rte_CalprmRom_CalRegn01Cmn_DEFAULT_RTE_CALPRM_GROUP.DutyCycThermProtnMplr5StallTblY_Ary1D" 0 DISPLAY_IDENTIFIER CalRegn01Cmn.CalibrationPorts.DutyCycThermProtnMplr5StallTblY.Ary1D /end CHARACTERISTIC
/begin CHARACTERISTIC CalRegn01Cmn.DutyCycThermProtnMplr6FetMtgtnNonStallTblY.Ary1D "MICROSAR RTE" VAL_BLK 0x0 RTE_RL_UWORD 0 NO_COMPU_METHOD 0 65535 MATRIX_DIM 5 1 1 SYMBOL_LINK "Rte_CalprmRom_CalRegn01Cmn_DEFAULT_RTE_CALPRM_GROUP.DutyCycThermProtnMplr6FetMtgtnNonStallTblY_Ary1D" 0 DISPLAY_IDENTIFIER CalRegn01Cmn.CalibrationPorts.DutyCycThermProtnMplr6FetMtgtnNonStallTblY.Ary1D /end CHARACTERISTIC
/begin CHARACTERISTIC CalRegn01Cmn.DutyCycThermProtnMplr6FetMtgtnStallTblY.Ary1D "MICROSAR RTE" VAL_BLK 0x0 RTE_RL_UWORD 0 NO_COMPU_METHOD 0 65535 MATRIX_DIM 5 1 1 SYMBOL_LINK "Rte_CalprmRom_CalRegn01Cmn_DEFAULT_RTE_CALPRM_GROUP.DutyCycThermProtnMplr6FetMtgtnStallTblY_Ary1D" 0 DISPLAY_IDENTIFIER CalRegn01Cmn.CalibrationPorts.DutyCycThermProtnMplr6FetMtgtnStallTblY.Ary1D /end CHARACTERISTIC
/begin CHARACTERISTIC CalRegn01Cmn.DutyCycThermProtnMplr6NonStallTblY.Ary1D "MICROSAR RTE" VAL_BLK 0x0 RTE_RL_UWORD 0 NO_COMPU_METHOD 0 65535 MATRIX_DIM 5 1 1 SYMBOL_LINK "Rte_CalprmRom_CalRegn01Cmn_DEFAULT_RTE_CALPRM_GROUP.DutyCycThermProtnMplr6NonStallTblY_Ary1D" 0 DISPLAY_IDENTIFIER CalRegn01Cmn.CalibrationPorts.DutyCycThermProtnMplr6NonStallTblY.Ary1D /end CHARACTERISTIC
/begin CHARACTERISTIC CalRegn01Cmn.DutyCycThermProtnMplr6StallTblY.Ary1D "MICROSAR RTE" VAL_BLK 0x0 RTE_RL_UWORD 0 NO_COMPU_METHOD 0 65535 MATRIX_DIM 5 1 1 SYMBOL_LINK "Rte_CalprmRom_CalRegn01Cmn_DEFAULT_RTE_CALPRM_GROUP.DutyCycThermProtnMplr6StallTblY_Ary1D" 0 DISPLAY_IDENTIFIER CalRegn01Cmn.CalibrationPorts.DutyCycThermProtnMplr6StallTblY.Ary1D /end CHARACTERISTIC
/begin CHARACTERISTIC CalRegn01Cmn.DutyCycThermProtnMplrFetMtgtnTblX.Ary1D "MICROSAR RTE" VAL_BLK 0x0 RTE_RL_SWORD 0 NO_COMPU_METHOD -32768 32767 MATRIX_DIM 5 1 1 SYMBOL_LINK "Rte_CalprmRom_CalRegn01Cmn_DEFAULT_RTE_CALPRM_GROUP.DutyCycThermProtnMplrFetMtgtnTblX_Ary1D" 0 DISPLAY_IDENTIFIER CalRegn01Cmn.CalibrationPorts.DutyCycThermProtnMplrFetMtgtnTblX.Ary1D /end CHARACTERISTIC
/begin CHARACTERISTIC CalRegn01Cmn.DutyCycThermProtnMplrTSeln.Logl "MICROSAR RTE" VALUE 0x0 RTE_RL_BOOLEAN 0 RTE_CM_BOOLEAN 0 255 SYMBOL_LINK "Rte_CalprmRom_CalRegn01Cmn_DEFAULT_RTE_CALPRM_GROUP.DutyCycThermProtnMplrTSeln_Logl" 0 DISPLAY_IDENTIFIER CalRegn01Cmn.CalibrationPorts.DutyCycThermProtnMplrTSeln.Logl /end CHARACTERISTIC
/begin CHARACTERISTIC CalRegn01Cmn.DutyCycThermProtnMplrTblX.Ary1D "MICROSAR RTE" VAL_BLK 0x0 RTE_RL_SWORD 0 NO_COMPU_METHOD -32768 32767 MATRIX_DIM 5 1 1 SYMBOL_LINK "Rte_CalprmRom_CalRegn01Cmn_DEFAULT_RTE_CALPRM_GROUP.DutyCycThermProtnMplrTblX_Ary1D" 0 DISPLAY_IDENTIFIER CalRegn01Cmn.CalibrationPorts.DutyCycThermProtnMplrTblX.Ary1D /end CHARACTERISTIC
/begin CHARACTERISTIC CalRegn01Cmn.DutyCycThermProtnSlowFilTSeln.Logl "MICROSAR RTE" VALUE 0x0 RTE_RL_BOOLEAN 0 RTE_CM_BOOLEAN 0 255 SYMBOL_LINK "Rte_CalprmRom_CalRegn01Cmn_DEFAULT_RTE_CALPRM_GROUP.DutyCycThermProtnSlowFilTSeln_Logl" 0 DISPLAY_IDENTIFIER CalRegn01Cmn.CalibrationPorts.DutyCycThermProtnSlowFilTSeln.Logl /end CHARACTERISTIC
/begin CHARACTERISTIC CalRegn01Cmn.DutyCycThermProtnThermLimScaFac.Val "MICROSAR RTE" VALUE 0x0 RTE_RL_FLOAT32_IEEE 0 NO_COMPU_METHOD -3.402823466e+38 3.402823466e+38 SYMBOL_LINK "Rte_CalprmRom_CalRegn01Cmn_DEFAULT_RTE_CALPRM_GROUP.DutyCycThermProtnThermLimScaFac_Val" 0 DISPLAY_IDENTIFIER CalRegn01Cmn.CalibrationPorts.DutyCycThermProtnThermLimScaFac.Val /end CHARACTERISTIC
/begin CHARACTERISTIC CalRegn01Cmn.DutyCycThermProtnThermLoadLimTblX.Ary2D "MICROSAR RTE" VAL_BLK 0x0 RTE_RL_UWORD 0 NO_COMPU_METHOD 0 65535 MATRIX_DIM 8 2 1 SYMBOL_LINK "Rte_CalprmRom_CalRegn01Cmn_DEFAULT_RTE_CALPRM_GROUP.DutyCycThermProtnThermLoadLimTblX_Ary2D" 0 DISPLAY_IDENTIFIER CalRegn01Cmn.CalibrationPorts.DutyCycThermProtnThermLoadLimTblX.Ary2D /end CHARACTERISTIC
/begin CHARACTERISTIC CalRegn01Cmn.DutyCycThermProtnThermLoadLimTblY.Ary2D "MICROSAR RTE" VAL_BLK 0x0 RTE_RL_UWORD 0 NO_COMPU_METHOD 0 65535 MATRIX_DIM 8 2 1 SYMBOL_LINK "Rte_CalprmRom_CalRegn01Cmn_DEFAULT_RTE_CALPRM_GROUP.DutyCycThermProtnThermLoadLimTblY_Ary2D" 0 DISPLAY_IDENTIFIER CalRegn01Cmn.CalibrationPorts.DutyCycThermProtnThermLoadLimTblY.Ary2D /end CHARACTERISTIC
/begin CHARACTERISTIC CalRegn01Cmn.DutyCycThermProtnTqCmdSlewDwn.Val "MICROSAR RTE" VALUE 0x0 RTE_RL_FLOAT32_IEEE 0 NO_COMPU_METHOD -3.402823466e+38 3.402823466e+38 SYMBOL_LINK "Rte_CalprmRom_CalRegn01Cmn_DEFAULT_RTE_CALPRM_GROUP.DutyCycThermProtnTqCmdSlewDwn_Val" 0 DISPLAY_IDENTIFIER CalRegn01Cmn.CalibrationPorts.DutyCycThermProtnTqCmdSlewDwn.Val /end CHARACTERISTIC
/begin CHARACTERISTIC CalRegn01Cmn.DutyCycThermProtnTqCmdSlewUp.Val "MICROSAR RTE" VALUE 0x0 RTE_RL_FLOAT32_IEEE 0 NO_COMPU_METHOD -3.402823466e+38 3.402823466e+38 SYMBOL_LINK "Rte_CalprmRom_CalRegn01Cmn_DEFAULT_RTE_CALPRM_GROUP.DutyCycThermProtnTqCmdSlewUp_Val" 0 DISPLAY_IDENTIFIER CalRegn01Cmn.CalibrationPorts.DutyCycThermProtnTqCmdSlewUp.Val /end CHARACTERISTIC
/begin CHARACTERISTIC CalRegn01Cmn.ElecPwrCnsCtrlrInpR.Val "MICROSAR RTE" VALUE 0x0 RTE_RL_FLOAT32_IEEE 0 NO_COMPU_METHOD -3.402823466e+38 3.402823466e+38 SYMBOL_LINK "Rte_CalprmRom_CalRegn01Cmn_DEFAULT_RTE_CALPRM_GROUP.ElecPwrCnsCtrlrInpR_Val" 0 DISPLAY_IDENTIFIER CalRegn01Cmn.CalibrationPorts.ElecPwrCnsCtrlrInpR.Val /end CHARACTERISTIC
/begin CHARACTERISTIC CalRegn01Cmn.FordMsg077BusHiSpdCanDtcInhbThd.Val "MICROSAR RTE" VALUE 0x0 RTE_RL_UWORD 0 NO_COMPU_METHOD 0 65535 SYMBOL_LINK "Rte_CalprmRom_CalRegn01Cmn_DEFAULT_RTE_CALPRM_GROUP.FordMsg077BusHiSpdCanDtcInhbThd_Val" 0 DISPLAY_IDENTIFIER CalRegn01Cmn.CalibrationPorts.FordMsg077BusHiSpdCanDtcInhbThd.Val /end CHARACTERISTIC
/begin CHARACTERISTIC CalRegn01Cmn.FordMsg077BusHiSpdLatACmpdInvldSigFaildThd.Val "MICROSAR RTE" VALUE 0x0 RTE_RL_UWORD 0 NO_COMPU_METHOD 0 65535 SYMBOL_LINK "Rte_CalprmRom_CalRegn01Cmn_DEFAULT_RTE_CALPRM_GROUP.FordMsg077BusHiSpdLatACmpdInvldSigFaildThd_Val" 0 DISPLAY_IDENTIFIER CalRegn01Cmn.CalibrationPorts.FordMsg077BusHiSpdLatACmpdInvldSigFaildThd.Val /end CHARACTERISTIC
/begin CHARACTERISTIC CalRegn01Cmn.FordMsg077BusHiSpdLatACmpdInvldSigPassdThd.Val "MICROSAR RTE" VALUE 0x0 RTE_RL_UWORD 0 NO_COMPU_METHOD 0 65535 SYMBOL_LINK "Rte_CalprmRom_CalRegn01Cmn_DEFAULT_RTE_CALPRM_GROUP.FordMsg077BusHiSpdLatACmpdInvldSigPassdThd_Val" 0 DISPLAY_IDENTIFIER CalRegn01Cmn.CalibrationPorts.FordMsg077BusHiSpdLatACmpdInvldSigPassdThd.Val /end CHARACTERISTIC
/begin CHARACTERISTIC CalRegn01Cmn.FordMsg077BusHiSpdLatACmpdVldMissThd.Val "MICROSAR RTE" VALUE 0x0 RTE_RL_UWORD 0 NO_COMPU_METHOD 0 65535 SYMBOL_LINK "Rte_CalprmRom_CalRegn01Cmn_DEFAULT_RTE_CALPRM_GROUP.FordMsg077BusHiSpdLatACmpdVldMissThd_Val" 0 DISPLAY_IDENTIFIER CalRegn01Cmn.CalibrationPorts.FordMsg077BusHiSpdLatACmpdVldMissThd.Val /end CHARACTERISTIC
/begin CHARACTERISTIC CalRegn01Cmn.FordMsg077BusHiSpdLgtACmpdInvldSigFaildThd.Val "MICROSAR RTE" VALUE 0x0 RTE_RL_UWORD 0 NO_COMPU_METHOD 0 65535 SYMBOL_LINK "Rte_CalprmRom_CalRegn01Cmn_DEFAULT_RTE_CALPRM_GROUP.FordMsg077BusHiSpdLgtACmpdInvldSigFaildThd_Val" 0 DISPLAY_IDENTIFIER CalRegn01Cmn.CalibrationPorts.FordMsg077BusHiSpdLgtACmpdInvldSigFaildThd.Val /end CHARACTERISTIC
/begin CHARACTERISTIC CalRegn01Cmn.FordMsg077BusHiSpdLgtACmpdInvldSigPassdThd.Val "MICROSAR RTE" VALUE 0x0 RTE_RL_UWORD 0 NO_COMPU_METHOD 0 65535 SYMBOL_LINK "Rte_CalprmRom_CalRegn01Cmn_DEFAULT_RTE_CALPRM_GROUP.FordMsg077BusHiSpdLgtACmpdInvldSigPassdThd_Val" 0 DISPLAY_IDENTIFIER CalRegn01Cmn.CalibrationPorts.FordMsg077BusHiSpdLgtACmpdInvldSigPassdThd.Val /end CHARACTERISTIC
/begin CHARACTERISTIC CalRegn01Cmn.FordMsg077BusHiSpdLgtACmpdVldMissThd.Val "MICROSAR RTE" VALUE 0x0 RTE_RL_UWORD 0 NO_COMPU_METHOD 0 65535 SYMBOL_LINK "Rte_CalprmRom_CalRegn01Cmn_DEFAULT_RTE_CALPRM_GROUP.FordMsg077BusHiSpdLgtACmpdVldMissThd_Val" 0 DISPLAY_IDENTIFIER CalRegn01Cmn.CalibrationPorts.FordMsg077BusHiSpdLgtACmpdVldMissThd.Val /end CHARACTERISTIC
/begin CHARACTERISTIC CalRegn01Cmn.FordMsg077BusHiSpdMissMsgFaildThd.Val "MICROSAR RTE" VALUE 0x0 RTE_RL_UWORD 0 NO_COMPU_METHOD 0 65535 SYMBOL_LINK "Rte_CalprmRom_CalRegn01Cmn_DEFAULT_RTE_CALPRM_GROUP.FordMsg077BusHiSpdMissMsgFaildThd_Val" 0 DISPLAY_IDENTIFIER CalRegn01Cmn.CalibrationPorts.FordMsg077BusHiSpdMissMsgFaildThd.Val /end CHARACTERISTIC
/begin CHARACTERISTIC CalRegn01Cmn.FordMsg077BusHiSpdMissMsgPassdThd.Val "MICROSAR RTE" VALUE 0x0 RTE_RL_UWORD 0 NO_COMPU_METHOD 0 65535 SYMBOL_LINK "Rte_CalprmRom_CalRegn01Cmn_DEFAULT_RTE_CALPRM_GROUP.FordMsg077BusHiSpdMissMsgPassdThd_Val" 0 DISPLAY_IDENTIFIER CalRegn01Cmn.CalibrationPorts.FordMsg077BusHiSpdMissMsgPassdThd.Val /end CHARACTERISTIC
/begin CHARACTERISTIC CalRegn01Cmn.FordMsg077BusHiSpdOverGndInvldSigFaildThd.Val "MICROSAR RTE" VALUE 0x0 RTE_RL_UWORD 0 NO_COMPU_METHOD 0 65535 SYMBOL_LINK "Rte_CalprmRom_CalRegn01Cmn_DEFAULT_RTE_CALPRM_GROUP.FordMsg077BusHiSpdOverGndInvldSigFaildThd_Val" 0 DISPLAY_IDENTIFIER CalRegn01Cmn.CalibrationPorts.FordMsg077BusHiSpdOverGndInvldSigFaildThd.Val /end CHARACTERISTIC
/begin CHARACTERISTIC CalRegn01Cmn.FordMsg077BusHiSpdOverGndInvldSigPassdThd.Val "MICROSAR RTE" VALUE 0x0 RTE_RL_UWORD 0 NO_COMPU_METHOD 0 65535 SYMBOL_LINK "Rte_CalprmRom_CalRegn01Cmn_DEFAULT_RTE_CALPRM_GROUP.FordMsg077BusHiSpdOverGndInvldSigPassdThd_Val" 0 DISPLAY_IDENTIFIER CalRegn01Cmn.CalibrationPorts.FordMsg077BusHiSpdOverGndInvldSigPassdThd.Val /end CHARACTERISTIC
/begin CHARACTERISTIC CalRegn01Cmn.FordMsg077BusHiSpdVehLatACmpdVldFaildThd.Val "MICROSAR RTE" VALUE 0x0 RTE_RL_UWORD 0 NO_COMPU_METHOD 0 65535 SYMBOL_LINK "Rte_CalprmRom_CalRegn01Cmn_DEFAULT_RTE_CALPRM_GROUP.FordMsg077BusHiSpdVehLatACmpdVldFaildThd_Val" 0 DISPLAY_IDENTIFIER CalRegn01Cmn.CalibrationPorts.FordMsg077BusHiSpdVehLatACmpdVldFaildThd.Val /end CHARACTERISTIC
/begin CHARACTERISTIC CalRegn01Cmn.FordMsg077BusHiSpdVehLatACmpdVldPassdThd.Val "MICROSAR RTE" VALUE 0x0 RTE_RL_UWORD 0 NO_COMPU_METHOD 0 65535 SYMBOL_LINK "Rte_CalprmRom_CalRegn01Cmn_DEFAULT_RTE_CALPRM_GROUP.FordMsg077BusHiSpdVehLatACmpdVldPassdThd_Val" 0 DISPLAY_IDENTIFIER CalRegn01Cmn.CalibrationPorts.FordMsg077BusHiSpdVehLatACmpdVldPassdThd.Val /end CHARACTERISTIC
/begin CHARACTERISTIC CalRegn01Cmn.FordMsg077BusHiSpdVehLgtACmpdVldFaildThd.Val "MICROSAR RTE" VALUE 0x0 RTE_RL_UWORD 0 NO_COMPU_METHOD 0 65535 SYMBOL_LINK "Rte_CalprmRom_CalRegn01Cmn_DEFAULT_RTE_CALPRM_GROUP.FordMsg077BusHiSpdVehLgtACmpdVldFaildThd_Val" 0 DISPLAY_IDENTIFIER CalRegn01Cmn.CalibrationPorts.FordMsg077BusHiSpdVehLgtACmpdVldFaildThd.Val /end CHARACTERISTIC
/begin CHARACTERISTIC CalRegn01Cmn.FordMsg077BusHiSpdVehLgtACmpdVldPassdThd.Val "MICROSAR RTE" VALUE 0x0 RTE_RL_UWORD 0 NO_COMPU_METHOD 0 65535 SYMBOL_LINK "Rte_CalprmRom_CalRegn01Cmn_DEFAULT_RTE_CALPRM_GROUP.FordMsg077BusHiSpdVehLgtACmpdVldPassdThd_Val" 0 DISPLAY_IDENTIFIER CalRegn01Cmn.CalibrationPorts.FordMsg077BusHiSpdVehLgtACmpdVldPassdThd.Val /end CHARACTERISTIC
/begin CHARACTERISTIC CalRegn01Cmn.FordMsg077BusHiSpdVehSpdOverGndVldFaildThd.Val "MICROSAR RTE" VALUE 0x0 RTE_RL_UWORD 0 NO_COMPU_METHOD 0 65535 SYMBOL_LINK "Rte_CalprmRom_CalRegn01Cmn_DEFAULT_RTE_CALPRM_GROUP.FordMsg077BusHiSpdVehSpdOverGndVldFaildThd_Val" 0 DISPLAY_IDENTIFIER CalRegn01Cmn.CalibrationPorts.FordMsg077BusHiSpdVehSpdOverGndVldFaildThd.Val /end CHARACTERISTIC
/begin CHARACTERISTIC CalRegn01Cmn.FordMsg077BusHiSpdVehSpdOverGndVldMissThd.Val "MICROSAR RTE" VALUE 0x0 RTE_RL_UWORD 0 NO_COMPU_METHOD 0 65535 SYMBOL_LINK "Rte_CalprmRom_CalRegn01Cmn_DEFAULT_RTE_CALPRM_GROUP.FordMsg077BusHiSpdVehSpdOverGndVldMissThd_Val" 0 DISPLAY_IDENTIFIER CalRegn01Cmn.CalibrationPorts.FordMsg077BusHiSpdVehSpdOverGndVldMissThd.Val /end CHARACTERISTIC
/begin CHARACTERISTIC CalRegn01Cmn.FordMsg077BusHiSpdVehSpdOverGndVldPassdThd.Val "MICROSAR RTE" VALUE 0x0 RTE_RL_UWORD 0 NO_COMPU_METHOD 0 65535 SYMBOL_LINK "Rte_CalprmRom_CalRegn01Cmn_DEFAULT_RTE_CALPRM_GROUP.FordMsg077BusHiSpdVehSpdOverGndVldPassdThd_Val" 0 DISPLAY_IDENTIFIER CalRegn01Cmn.CalibrationPorts.FordMsg077BusHiSpdVehSpdOverGndVldPassdThd.Val /end CHARACTERISTIC
/begin CHARACTERISTIC CalRegn01Cmn.FordMsg077BusHiSpdVehYawRateCmpdVldFaildThd.Val "MICROSAR RTE" VALUE 0x0 RTE_RL_UWORD 0 NO_COMPU_METHOD 0 65535 SYMBOL_LINK "Rte_CalprmRom_CalRegn01Cmn_DEFAULT_RTE_CALPRM_GROUP.FordMsg077BusHiSpdVehYawRateCmpdVldFaildThd_Val" 0 DISPLAY_IDENTIFIER CalRegn01Cmn.CalibrationPorts.FordMsg077BusHiSpdVehYawRateCmpdVldFaildThd.Val /end CHARACTERISTIC
/begin CHARACTERISTIC CalRegn01Cmn.FordMsg077BusHiSpdVehYawRateCmpdVldPassdThd.Val "MICROSAR RTE" VALUE 0x0 RTE_RL_UWORD 0 NO_COMPU_METHOD 0 65535 SYMBOL_LINK "Rte_CalprmRom_CalRegn01Cmn_DEFAULT_RTE_CALPRM_GROUP.FordMsg077BusHiSpdVehYawRateCmpdVldPassdThd_Val" 0 DISPLAY_IDENTIFIER CalRegn01Cmn.CalibrationPorts.FordMsg077BusHiSpdVehYawRateCmpdVldPassdThd.Val /end CHARACTERISTIC
/begin CHARACTERISTIC CalRegn01Cmn.FordMsg077BusHiSpdYawRateCmpdInvldSigFaildThd.Val "MICROSAR RTE" VALUE 0x0 RTE_RL_UWORD 0 NO_COMPU_METHOD 0 65535 SYMBOL_LINK "Rte_CalprmRom_CalRegn01Cmn_DEFAULT_RTE_CALPRM_GROUP.FordMsg077BusHiSpdYawRateCmpdInvldSigFaildThd_Val" 0 DISPLAY_IDENTIFIER CalRegn01Cmn.CalibrationPorts.FordMsg077BusHiSpdYawRateCmpdInvldSigFaildThd.Val /end CHARACTERISTIC
/begin CHARACTERISTIC CalRegn01Cmn.FordMsg077BusHiSpdYawRateCmpdInvldSigPassdThd.Val "MICROSAR RTE" VALUE 0x0 RTE_RL_UWORD 0 NO_COMPU_METHOD 0 65535 SYMBOL_LINK "Rte_CalprmRom_CalRegn01Cmn_DEFAULT_RTE_CALPRM_GROUP.FordMsg077BusHiSpdYawRateCmpdInvldSigPassdThd_Val" 0 DISPLAY_IDENTIFIER CalRegn01Cmn.CalibrationPorts.FordMsg077BusHiSpdYawRateCmpdInvldSigPassdThd.Val /end CHARACTERISTIC
/begin CHARACTERISTIC CalRegn01Cmn.FordMsg077BusHiSpdYawRateCmpdVldMissThd.Val "MICROSAR RTE" VALUE 0x0 RTE_RL_UWORD 0 NO_COMPU_METHOD 0 65535 SYMBOL_LINK "Rte_CalprmRom_CalRegn01Cmn_DEFAULT_RTE_CALPRM_GROUP.FordMsg077BusHiSpdYawRateCmpdVldMissThd_Val" 0 DISPLAY_IDENTIFIER CalRegn01Cmn.CalibrationPorts.FordMsg077BusHiSpdYawRateCmpdVldMissThd.Val /end CHARACTERISTIC
/begin CHARACTERISTIC CalRegn01Cmn.FordMsg07DBusHiSpdActBrkTqSigInvldPassdThd.Val "MICROSAR RTE" VALUE 0x0 RTE_RL_UWORD 0 NO_COMPU_METHOD 0 65535 SYMBOL_LINK "Rte_CalprmRom_CalRegn01Cmn_DEFAULT_RTE_CALPRM_GROUP.FordMsg07DBusHiSpdActBrkTqSigInvldPassdThd_Val" 0 DISPLAY_IDENTIFIER CalRegn01Cmn.CalibrationPorts.FordMsg07DBusHiSpdActBrkTqSigInvldPassdThd.Val /end CHARACTERISTIC
/begin CHARACTERISTIC CalRegn01Cmn.FordMsg07DBusHiSpdFordVehActBrkTqInvldThd.Val "MICROSAR RTE" VALUE 0x0 RTE_RL_UWORD 0 NO_COMPU_METHOD 0 65535 SYMBOL_LINK "Rte_CalprmRom_CalRegn01Cmn_DEFAULT_RTE_CALPRM_GROUP.FordMsg07DBusHiSpdFordVehActBrkTqInvldThd_Val" 0 DISPLAY_IDENTIFIER CalRegn01Cmn.CalibrationPorts.FordMsg07DBusHiSpdFordVehActBrkTqInvldThd.Val /end CHARACTERISTIC
/begin CHARACTERISTIC CalRegn01Cmn.FordMsg07DBusHiSpdFordVehActBrkTqVldThd.Val "MICROSAR RTE" VALUE 0x0 RTE_RL_UWORD 0 NO_COMPU_METHOD 0 65535 SYMBOL_LINK "Rte_CalprmRom_CalRegn01Cmn_DEFAULT_RTE_CALPRM_GROUP.FordMsg07DBusHiSpdFordVehActBrkTqVldThd_Val" 0 DISPLAY_IDENTIFIER CalRegn01Cmn.CalibrationPorts.FordMsg07DBusHiSpdFordVehActBrkTqVldThd.Val /end CHARACTERISTIC
/begin CHARACTERISTIC CalRegn01Cmn.FordMsg07DBusHiSpdFordVehBrkTqVldMissMsgThd.Val "MICROSAR RTE" VALUE 0x0 RTE_RL_UWORD 0 NO_COMPU_METHOD 0 65535 SYMBOL_LINK "Rte_CalprmRom_CalRegn01Cmn_DEFAULT_RTE_CALPRM_GROUP.FordMsg07DBusHiSpdFordVehBrkTqVldMissMsgThd_Val" 0 DISPLAY_IDENTIFIER CalRegn01Cmn.CalibrationPorts.FordMsg07DBusHiSpdFordVehBrkTqVldMissMsgThd.Val /end CHARACTERISTIC
/begin CHARACTERISTIC CalRegn01Cmn.FordMsg07DBusHiSpdFordVehVertACmpdSigInvldThd.Val "MICROSAR RTE" VALUE 0x0 RTE_RL_UWORD 0 NO_COMPU_METHOD 0 65535 SYMBOL_LINK "Rte_CalprmRom_CalRegn01Cmn_DEFAULT_RTE_CALPRM_GROUP.FordMsg07DBusHiSpdFordVehVertACmpdSigInvldThd_Val" 0 DISPLAY_IDENTIFIER CalRegn01Cmn.CalibrationPorts.FordMsg07DBusHiSpdFordVehVertACmpdSigInvldThd.Val /end CHARACTERISTIC
/begin CHARACTERISTIC CalRegn01Cmn.FordMsg07DBusHiSpdFordVehVertACmpdSigVldThd.Val "MICROSAR RTE" VALUE 0x0 RTE_RL_UWORD 0 NO_COMPU_METHOD 0 65535 SYMBOL_LINK "Rte_CalprmRom_CalRegn01Cmn_DEFAULT_RTE_CALPRM_GROUP.FordMsg07DBusHiSpdFordVehVertACmpdSigVldThd_Val" 0 DISPLAY_IDENTIFIER CalRegn01Cmn.CalibrationPorts.FordMsg07DBusHiSpdFordVehVertACmpdSigVldThd.Val /end CHARACTERISTIC
/begin CHARACTERISTIC CalRegn01Cmn.FordMsg07DBusHiSpdFordVehVertAVldMissMsgThd.Val "MICROSAR RTE" VALUE 0x0 RTE_RL_UWORD 0 NO_COMPU_METHOD 0 65535 SYMBOL_LINK "Rte_CalprmRom_CalRegn01Cmn_DEFAULT_RTE_CALPRM_GROUP.FordMsg07DBusHiSpdFordVehVertAVldMissMsgThd_Val" 0 DISPLAY_IDENTIFIER CalRegn01Cmn.CalibrationPorts.FordMsg07DBusHiSpdFordVehVertAVldMissMsgThd.Val /end CHARACTERISTIC
/begin CHARACTERISTIC CalRegn01Cmn.FordMsg07DBusHiSpdMissMsgFaildThd.Val "MICROSAR RTE" VALUE 0x0 RTE_RL_UWORD 0 NO_COMPU_METHOD 0 65535 SYMBOL_LINK "Rte_CalprmRom_CalRegn01Cmn_DEFAULT_RTE_CALPRM_GROUP.FordMsg07DBusHiSpdMissMsgFaildThd_Val" 0 DISPLAY_IDENTIFIER CalRegn01Cmn.CalibrationPorts.FordMsg07DBusHiSpdMissMsgFaildThd.Val /end CHARACTERISTIC
/begin CHARACTERISTIC CalRegn01Cmn.FordMsg07DBusHiSpdMissMsgPassdThd.Val "MICROSAR RTE" VALUE 0x0 RTE_RL_UWORD 0 NO_COMPU_METHOD 0 65535 SYMBOL_LINK "Rte_CalprmRom_CalRegn01Cmn_DEFAULT_RTE_CALPRM_GROUP.FordMsg07DBusHiSpdMissMsgPassdThd_Val" 0 DISPLAY_IDENTIFIER CalRegn01Cmn.CalibrationPorts.FordMsg07DBusHiSpdMissMsgPassdThd.Val /end CHARACTERISTIC
/begin CHARACTERISTIC CalRegn01Cmn.FordMsg07DBusHiSpdVehActTqBrkInvldFaildThd.Val "MICROSAR RTE" VALUE 0x0 RTE_RL_UWORD 0 NO_COMPU_METHOD 0 65535 SYMBOL_LINK "Rte_CalprmRom_CalRegn01Cmn_DEFAULT_RTE_CALPRM_GROUP.FordMsg07DBusHiSpdVehActTqBrkInvldFaildThd_Val" 0 DISPLAY_IDENTIFIER CalRegn01Cmn.CalibrationPorts.FordMsg07DBusHiSpdVehActTqBrkInvldFaildThd.Val /end CHARACTERISTIC
/begin CHARACTERISTIC CalRegn01Cmn.FordMsg07DBusHiSpdVertACmpdSigInvldFaildThd.Val "MICROSAR RTE" VALUE 0x0 RTE_RL_UWORD 0 NO_COMPU_METHOD 0 65535 SYMBOL_LINK "Rte_CalprmRom_CalRegn01Cmn_DEFAULT_RTE_CALPRM_GROUP.FordMsg07DBusHiSpdVertACmpdSigInvldFaildThd_Val" 0 DISPLAY_IDENTIFIER CalRegn01Cmn.CalibrationPorts.FordMsg07DBusHiSpdVertACmpdSigInvldFaildThd.Val /end CHARACTERISTIC
/begin CHARACTERISTIC CalRegn01Cmn.FordMsg07DBusHiSpdVertACmpdSigInvldPassdThd.Val "MICROSAR RTE" VALUE 0x0 RTE_RL_UWORD 0 NO_COMPU_METHOD 0 65535 SYMBOL_LINK "Rte_CalprmRom_CalRegn01Cmn_DEFAULT_RTE_CALPRM_GROUP.FordMsg07DBusHiSpdVertACmpdSigInvldPassdThd_Val" 0 DISPLAY_IDENTIFIER CalRegn01Cmn.CalibrationPorts.FordMsg07DBusHiSpdVertACmpdSigInvldPassdThd.Val /end CHARACTERISTIC
/begin CHARACTERISTIC CalRegn01Cmn.FordMsg083BusHiSpdFordVehTurnSigVldThd.Val "MICROSAR RTE" VALUE 0x0 RTE_RL_UWORD 0 NO_COMPU_METHOD 0 65535 SYMBOL_LINK "Rte_CalprmRom_CalRegn01Cmn_DEFAULT_RTE_CALPRM_GROUP.FordMsg083BusHiSpdFordVehTurnSigVldThd_Val" 0 DISPLAY_IDENTIFIER CalRegn01Cmn.CalibrationPorts.FordMsg083BusHiSpdFordVehTurnSigVldThd.Val /end CHARACTERISTIC
/begin CHARACTERISTIC CalRegn01Cmn.FordMsg083BusHiSpdMissMsgFaildThd.Val "MICROSAR RTE" VALUE 0x0 RTE_RL_UWORD 0 NO_COMPU_METHOD 0 65535 SYMBOL_LINK "Rte_CalprmRom_CalRegn01Cmn_DEFAULT_RTE_CALPRM_GROUP.FordMsg083BusHiSpdMissMsgFaildThd_Val" 0 DISPLAY_IDENTIFIER CalRegn01Cmn.CalibrationPorts.FordMsg083BusHiSpdMissMsgFaildThd.Val /end CHARACTERISTIC
/begin CHARACTERISTIC CalRegn01Cmn.FordMsg083BusHiSpdMissMsgPassdThd.Val "MICROSAR RTE" VALUE 0x0 RTE_RL_UWORD 0 NO_COMPU_METHOD 0 65535 SYMBOL_LINK "Rte_CalprmRom_CalRegn01Cmn_DEFAULT_RTE_CALPRM_GROUP.FordMsg083BusHiSpdMissMsgPassdThd_Val" 0 DISPLAY_IDENTIFIER CalRegn01Cmn.CalibrationPorts.FordMsg083BusHiSpdMissMsgPassdThd.Val /end CHARACTERISTIC
/begin CHARACTERISTIC CalRegn01Cmn.FordMsg083BusHiSpdVehTurnSigVldMissMsgThd.Val "MICROSAR RTE" VALUE 0x0 RTE_RL_UWORD 0 NO_COMPU_METHOD 0 65535 SYMBOL_LINK "Rte_CalprmRom_CalRegn01Cmn_DEFAULT_RTE_CALPRM_GROUP.FordMsg083BusHiSpdVehTurnSigVldMissMsgThd_Val" 0 DISPLAY_IDENTIFIER CalRegn01Cmn.CalibrationPorts.FordMsg083BusHiSpdVehTurnSigVldMissMsgThd.Val /end CHARACTERISTIC
/begin CHARACTERISTIC CalRegn01Cmn.FordMsg091BusHiSpdInvldMsgFaildThd.Val "MICROSAR RTE" VALUE 0x0 RTE_RL_UWORD 0 NO_COMPU_METHOD 0 65535 SYMBOL_LINK "Rte_CalprmRom_CalRegn01Cmn_DEFAULT_RTE_CALPRM_GROUP.FordMsg091BusHiSpdInvldMsgFaildThd_Val" 0 DISPLAY_IDENTIFIER CalRegn01Cmn.CalibrationPorts.FordMsg091BusHiSpdInvldMsgFaildThd.Val /end CHARACTERISTIC
/begin CHARACTERISTIC CalRegn01Cmn.FordMsg091BusHiSpdInvldMsgPassdThd.Val "MICROSAR RTE" VALUE 0x0 RTE_RL_UWORD 0 NO_COMPU_METHOD 0 65535 SYMBOL_LINK "Rte_CalprmRom_CalRegn01Cmn_DEFAULT_RTE_CALPRM_GROUP.FordMsg091BusHiSpdInvldMsgPassdThd_Val" 0 DISPLAY_IDENTIFIER CalRegn01Cmn.CalibrationPorts.FordMsg091BusHiSpdInvldMsgPassdThd.Val /end CHARACTERISTIC
/begin CHARACTERISTIC CalRegn01Cmn.FordMsg091BusHiSpdMissMsgFaildThd.Val "MICROSAR RTE" VALUE 0x0 RTE_RL_UWORD 0 NO_COMPU_METHOD 0 65535 SYMBOL_LINK "Rte_CalprmRom_CalRegn01Cmn_DEFAULT_RTE_CALPRM_GROUP.FordMsg091BusHiSpdMissMsgFaildThd_Val" 0 DISPLAY_IDENTIFIER CalRegn01Cmn.CalibrationPorts.FordMsg091BusHiSpdMissMsgFaildThd.Val /end CHARACTERISTIC
/begin CHARACTERISTIC CalRegn01Cmn.FordMsg091BusHiSpdMissMsgPassdThd.Val "MICROSAR RTE" VALUE 0x0 RTE_RL_UWORD 0 NO_COMPU_METHOD 0 65535 SYMBOL_LINK "Rte_CalprmRom_CalRegn01Cmn_DEFAULT_RTE_CALPRM_GROUP.FordMsg091BusHiSpdMissMsgPassdThd_Val" 0 DISPLAY_IDENTIFIER CalRegn01Cmn.CalibrationPorts.FordMsg091BusHiSpdMissMsgPassdThd.Val /end CHARACTERISTIC
/begin CHARACTERISTIC CalRegn01Cmn.FordMsg091BusHiSpdYawRateRawVldMissFaildThd.Val "MICROSAR RTE" VALUE 0x0 RTE_RL_UWORD 0 NO_COMPU_METHOD 0 65535 SYMBOL_LINK "Rte_CalprmRom_CalRegn01Cmn_DEFAULT_RTE_CALPRM_GROUP.FordMsg091BusHiSpdYawRateRawVldMissFaildThd_Val" 0 DISPLAY_IDENTIFIER CalRegn01Cmn.CalibrationPorts.FordMsg091BusHiSpdYawRateRawVldMissFaildThd.Val /end CHARACTERISTIC
/begin CHARACTERISTIC CalRegn01Cmn.FordMsg091BusHiSpdYawRateRawVldSigFaildThd.Val "MICROSAR RTE" VALUE 0x0 RTE_RL_UWORD 0 NO_COMPU_METHOD 0 65535 SYMBOL_LINK "Rte_CalprmRom_CalRegn01Cmn_DEFAULT_RTE_CALPRM_GROUP.FordMsg091BusHiSpdYawRateRawVldSigFaildThd_Val" 0 DISPLAY_IDENTIFIER CalRegn01Cmn.CalibrationPorts.FordMsg091BusHiSpdYawRateRawVldSigFaildThd.Val /end CHARACTERISTIC
/begin CHARACTERISTIC CalRegn01Cmn.FordMsg091BusHiSpdYawRateRawVldSigPassdThd.Val "MICROSAR RTE" VALUE 0x0 RTE_RL_UWORD 0 NO_COMPU_METHOD 0 65535 SYMBOL_LINK "Rte_CalprmRom_CalRegn01Cmn_DEFAULT_RTE_CALPRM_GROUP.FordMsg091BusHiSpdYawRateRawVldSigPassdThd_Val" 0 DISPLAY_IDENTIFIER CalRegn01Cmn.CalibrationPorts.FordMsg091BusHiSpdYawRateRawVldSigPassdThd.Val /end CHARACTERISTIC
/begin CHARACTERISTIC CalRegn01Cmn.FordMsg167BusHiSpdMissMsgFaildTiThd.Val "MICROSAR RTE" VALUE 0x0 RTE_RL_UWORD 0 NO_COMPU_METHOD 0 65535 SYMBOL_LINK "Rte_CalprmRom_CalRegn01Cmn_DEFAULT_RTE_CALPRM_GROUP.FordMsg167BusHiSpdMissMsgFaildTiThd_Val" 0 DISPLAY_IDENTIFIER CalRegn01Cmn.CalibrationPorts.FordMsg167BusHiSpdMissMsgFaildTiThd.Val /end CHARACTERISTIC
/begin CHARACTERISTIC CalRegn01Cmn.FordMsg167BusHiSpdMissMsgPassdTiThd.Val "MICROSAR RTE" VALUE 0x0 RTE_RL_UWORD 0 NO_COMPU_METHOD 0 65535 SYMBOL_LINK "Rte_CalprmRom_CalRegn01Cmn_DEFAULT_RTE_CALPRM_GROUP.FordMsg167BusHiSpdMissMsgPassdTiThd_Val" 0 DISPLAY_IDENTIFIER CalRegn01Cmn.CalibrationPorts.FordMsg167BusHiSpdMissMsgPassdTiThd.Val /end CHARACTERISTIC
/begin CHARACTERISTIC CalRegn01Cmn.FordMsg167BusHiSpdPrpnWhlTqFaildTiThd.Val "MICROSAR RTE" VALUE 0x0 RTE_RL_UWORD 0 NO_COMPU_METHOD 0 65535 SYMBOL_LINK "Rte_CalprmRom_CalRegn01Cmn_DEFAULT_RTE_CALPRM_GROUP.FordMsg167BusHiSpdPrpnWhlTqFaildTiThd_Val" 0 DISPLAY_IDENTIFIER CalRegn01Cmn.CalibrationPorts.FordMsg167BusHiSpdPrpnWhlTqFaildTiThd.Val /end CHARACTERISTIC
/begin CHARACTERISTIC CalRegn01Cmn.FordMsg167BusHiSpdPrpnWhlTqMissTiThd.Val "MICROSAR RTE" VALUE 0x0 RTE_RL_UWORD 0 NO_COMPU_METHOD 0 65535 SYMBOL_LINK "Rte_CalprmRom_CalRegn01Cmn_DEFAULT_RTE_CALPRM_GROUP.FordMsg167BusHiSpdPrpnWhlTqMissTiThd_Val" 0 DISPLAY_IDENTIFIER CalRegn01Cmn.CalibrationPorts.FordMsg167BusHiSpdPrpnWhlTqMissTiThd.Val /end CHARACTERISTIC
/begin CHARACTERISTIC CalRegn01Cmn.FordMsg167BusHiSpdPrpnWhlTqPassdTiThd.Val "MICROSAR RTE" VALUE 0x0 RTE_RL_UWORD 0 NO_COMPU_METHOD 0 65535 SYMBOL_LINK "Rte_CalprmRom_CalRegn01Cmn_DEFAULT_RTE_CALPRM_GROUP.FordMsg167BusHiSpdPrpnWhlTqPassdTiThd_Val" 0 DISPLAY_IDENTIFIER CalRegn01Cmn.CalibrationPorts.FordMsg167BusHiSpdPrpnWhlTqPassdTiThd.Val /end CHARACTERISTIC
/begin CHARACTERISTIC CalRegn01Cmn.FordMsg167BusHiSpdPrpnWhlTqSigInvldFaildTiThd.Val "MICROSAR RTE" VALUE 0x0 RTE_RL_UWORD 0 NO_COMPU_METHOD 0 65535 SYMBOL_LINK "Rte_CalprmRom_CalRegn01Cmn_DEFAULT_RTE_CALPRM_GROUP.FordMsg167BusHiSpdPrpnWhlTqSigInvldFaildTiThd_Val" 0 DISPLAY_IDENTIFIER CalRegn01Cmn.CalibrationPorts.FordMsg167BusHiSpdPrpnWhlTqSigInvldFaildTiThd.Val /end CHARACTERISTIC
/begin CHARACTERISTIC CalRegn01Cmn.FordMsg167BusHiSpdPrpnWhlTqSigInvldPassdTiThd.Val "MICROSAR RTE" VALUE 0x0 RTE_RL_UWORD 0 NO_COMPU_METHOD 0 65535 SYMBOL_LINK "Rte_CalprmRom_CalRegn01Cmn_DEFAULT_RTE_CALPRM_GROUP.FordMsg167BusHiSpdPrpnWhlTqSigInvldPassdTiThd_Val" 0 DISPLAY_IDENTIFIER CalRegn01Cmn.CalibrationPorts.FordMsg167BusHiSpdPrpnWhlTqSigInvldPassdTiThd.Val /end CHARACTERISTIC
/begin CHARACTERISTIC CalRegn01Cmn.FordMsg202BusHiSpdEngModLoQlyVldFaildThd.Val "MICROSAR RTE" VALUE 0x0 RTE_RL_UWORD 0 NO_COMPU_METHOD 0 65535 SYMBOL_LINK "Rte_CalprmRom_CalRegn01Cmn_DEFAULT_RTE_CALPRM_GROUP.FordMsg202BusHiSpdEngModLoQlyVldFaildThd_Val" 0 DISPLAY_IDENTIFIER CalRegn01Cmn.CalibrationPorts.FordMsg202BusHiSpdEngModLoQlyVldFaildThd.Val /end CHARACTERISTIC
/begin CHARACTERISTIC CalRegn01Cmn.FordMsg202BusHiSpdEngModLoQlyVldMissThd.Val "MICROSAR RTE" VALUE 0x0 RTE_RL_UWORD 0 NO_COMPU_METHOD 0 65535 SYMBOL_LINK "Rte_CalprmRom_CalRegn01Cmn_DEFAULT_RTE_CALPRM_GROUP.FordMsg202BusHiSpdEngModLoQlyVldMissThd_Val" 0 DISPLAY_IDENTIFIER CalRegn01Cmn.CalibrationPorts.FordMsg202BusHiSpdEngModLoQlyVldMissThd.Val /end CHARACTERISTIC
/begin CHARACTERISTIC CalRegn01Cmn.FordMsg202BusHiSpdEngModLoQlyVldPassdThd.Val "MICROSAR RTE" VALUE 0x0 RTE_RL_UWORD 0 NO_COMPU_METHOD 0 65535 SYMBOL_LINK "Rte_CalprmRom_CalRegn01Cmn_DEFAULT_RTE_CALPRM_GROUP.FordMsg202BusHiSpdEngModLoQlyVldPassdThd_Val" 0 DISPLAY_IDENTIFIER CalRegn01Cmn.CalibrationPorts.FordMsg202BusHiSpdEngModLoQlyVldPassdThd.Val /end CHARACTERISTIC
/begin CHARACTERISTIC CalRegn01Cmn.FordMsg202BusHiSpdEngModlVldFaildThd.Val "MICROSAR RTE" VALUE 0x0 RTE_RL_UWORD 0 NO_COMPU_METHOD 0 65535 SYMBOL_LINK "Rte_CalprmRom_CalRegn01Cmn_DEFAULT_RTE_CALPRM_GROUP.FordMsg202BusHiSpdEngModlVldFaildThd_Val" 0 DISPLAY_IDENTIFIER CalRegn01Cmn.CalibrationPorts.FordMsg202BusHiSpdEngModlVldFaildThd.Val /end CHARACTERISTIC
/begin CHARACTERISTIC CalRegn01Cmn.FordMsg202BusHiSpdEngModlVldMissThd.Val "MICROSAR RTE" VALUE 0x0 RTE_RL_UWORD 0 NO_COMPU_METHOD 0 65535 SYMBOL_LINK "Rte_CalprmRom_CalRegn01Cmn_DEFAULT_RTE_CALPRM_GROUP.FordMsg202BusHiSpdEngModlVldMissThd_Val" 0 DISPLAY_IDENTIFIER CalRegn01Cmn.CalibrationPorts.FordMsg202BusHiSpdEngModlVldMissThd.Val /end CHARACTERISTIC
/begin CHARACTERISTIC CalRegn01Cmn.FordMsg202BusHiSpdGearRvsStsInvldFaildThd.Val "MICROSAR RTE" VALUE 0x0 RTE_RL_UWORD 0 NO_COMPU_METHOD 0 65535 SYMBOL_LINK "Rte_CalprmRom_CalRegn01Cmn_DEFAULT_RTE_CALPRM_GROUP.FordMsg202BusHiSpdGearRvsStsInvldFaildThd_Val" 0 DISPLAY_IDENTIFIER CalRegn01Cmn.CalibrationPorts.FordMsg202BusHiSpdGearRvsStsInvldFaildThd.Val /end CHARACTERISTIC
/begin CHARACTERISTIC CalRegn01Cmn.FordMsg202BusHiSpdGearRvsStsInvldPassdThd.Val "MICROSAR RTE" VALUE 0x0 RTE_RL_UWORD 0 NO_COMPU_METHOD 0 65535 SYMBOL_LINK "Rte_CalprmRom_CalRegn01Cmn_DEFAULT_RTE_CALPRM_GROUP.FordMsg202BusHiSpdGearRvsStsInvldPassdThd_Val" 0 DISPLAY_IDENTIFIER CalRegn01Cmn.CalibrationPorts.FordMsg202BusHiSpdGearRvsStsInvldPassdThd.Val /end CHARACTERISTIC
/begin CHARACTERISTIC CalRegn01Cmn.FordMsg202BusHiSpdGearRvsStsVldFaildThd.Val "MICROSAR RTE" VALUE 0x0 RTE_RL_UWORD 0 NO_COMPU_METHOD 0 65535 SYMBOL_LINK "Rte_CalprmRom_CalRegn01Cmn_DEFAULT_RTE_CALPRM_GROUP.FordMsg202BusHiSpdGearRvsStsVldFaildThd_Val" 0 DISPLAY_IDENTIFIER CalRegn01Cmn.CalibrationPorts.FordMsg202BusHiSpdGearRvsStsVldFaildThd.Val /end CHARACTERISTIC
/begin CHARACTERISTIC CalRegn01Cmn.FordMsg202BusHiSpdGearRvsStsVldMissThd.Val "MICROSAR RTE" VALUE 0x0 RTE_RL_UWORD 0 NO_COMPU_METHOD 0 65535 SYMBOL_LINK "Rte_CalprmRom_CalRegn01Cmn_DEFAULT_RTE_CALPRM_GROUP.FordMsg202BusHiSpdGearRvsStsVldMissThd_Val" 0 DISPLAY_IDENTIFIER CalRegn01Cmn.CalibrationPorts.FordMsg202BusHiSpdGearRvsStsVldMissThd.Val /end CHARACTERISTIC
/begin CHARACTERISTIC CalRegn01Cmn.FordMsg202BusHiSpdGearRvsStsVldPassdThd.Val "MICROSAR RTE" VALUE 0x0 RTE_RL_UWORD 0 NO_COMPU_METHOD 0 65535 SYMBOL_LINK "Rte_CalprmRom_CalRegn01Cmn_DEFAULT_RTE_CALPRM_GROUP.FordMsg202BusHiSpdGearRvsStsVldPassdThd_Val" 0 DISPLAY_IDENTIFIER CalRegn01Cmn.CalibrationPorts.FordMsg202BusHiSpdGearRvsStsVldPassdThd.Val /end CHARACTERISTIC
/begin CHARACTERISTIC CalRegn01Cmn.FordMsg202BusHiSpdMissMsgFaildAbsPrsntDisadThd.Val "MICROSAR RTE" VALUE 0x0 RTE_RL_UWORD 0 NO_COMPU_METHOD 0 65535 SYMBOL_LINK "Rte_CalprmRom_CalRegn01Cmn_DEFAULT_RTE_CALPRM_GROUP.FordMsg202BusHiSpdMissMsgFaildAbsPrsntDisadThd_Val" 0 DISPLAY_IDENTIFIER CalRegn01Cmn.CalibrationPorts.FordMsg202BusHiSpdMissMsgFaildAbsPrsntDisadThd.Val /end CHARACTERISTIC
/begin CHARACTERISTIC CalRegn01Cmn.FordMsg202BusHiSpdMissMsgFaildAbsPrsntEnadThd.Val "MICROSAR RTE" VALUE 0x0 RTE_RL_UWORD 0 NO_COMPU_METHOD 0 65535 SYMBOL_LINK "Rte_CalprmRom_CalRegn01Cmn_DEFAULT_RTE_CALPRM_GROUP.FordMsg202BusHiSpdMissMsgFaildAbsPrsntEnadThd_Val" 0 DISPLAY_IDENTIFIER CalRegn01Cmn.CalibrationPorts.FordMsg202BusHiSpdMissMsgFaildAbsPrsntEnadThd.Val /end CHARACTERISTIC
/begin CHARACTERISTIC CalRegn01Cmn.FordMsg202BusHiSpdMissMsgPassdThd.Val "MICROSAR RTE" VALUE 0x0 RTE_RL_UWORD 0 NO_COMPU_METHOD 0 65535 SYMBOL_LINK "Rte_CalprmRom_CalRegn01Cmn_DEFAULT_RTE_CALPRM_GROUP.FordMsg202BusHiSpdMissMsgPassdThd_Val" 0 DISPLAY_IDENTIFIER CalRegn01Cmn.CalibrationPorts.FordMsg202BusHiSpdMissMsgPassdThd.Val /end CHARACTERISTIC
/begin CHARACTERISTIC CalRegn01Cmn.FordMsg202BusHiSpdQlyFacEngModInvldFaildThd.Val "MICROSAR RTE" VALUE 0x0 RTE_RL_UWORD 0 NO_COMPU_METHOD 0 65535 SYMBOL_LINK "Rte_CalprmRom_CalRegn01Cmn_DEFAULT_RTE_CALPRM_GROUP.FordMsg202BusHiSpdQlyFacEngModInvldFaildThd_Val" 0 DISPLAY_IDENTIFIER CalRegn01Cmn.CalibrationPorts.FordMsg202BusHiSpdQlyFacEngModInvldFaildThd.Val /end CHARACTERISTIC
/begin CHARACTERISTIC CalRegn01Cmn.FordMsg202BusHiSpdQlyFacEngModInvldPassdThd.Val "MICROSAR RTE" VALUE 0x0 RTE_RL_UWORD 0 NO_COMPU_METHOD 0 65535 SYMBOL_LINK "Rte_CalprmRom_CalRegn01Cmn_DEFAULT_RTE_CALPRM_GROUP.FordMsg202BusHiSpdQlyFacEngModInvldPassdThd_Val" 0 DISPLAY_IDENTIFIER CalRegn01Cmn.CalibrationPorts.FordMsg202BusHiSpdQlyFacEngModInvldPassdThd.Val /end CHARACTERISTIC
/begin CHARACTERISTIC CalRegn01Cmn.FordMsg202BusHiSpdTrlrBackupAssiAvlVldMissThd.Val "MICROSAR RTE" VALUE 0x0 RTE_RL_UWORD 0 NO_COMPU_METHOD 0 65535 SYMBOL_LINK "Rte_CalprmRom_CalRegn01Cmn_DEFAULT_RTE_CALPRM_GROUP.FordMsg202BusHiSpdTrlrBackupAssiAvlVldMissThd_Val" 0 DISPLAY_IDENTIFIER CalRegn01Cmn.CalibrationPorts.FordMsg202BusHiSpdTrlrBackupAssiAvlVldMissThd.Val /end CHARACTERISTIC
/begin CHARACTERISTIC CalRegn01Cmn.FordMsg202BusHiSpdTrlrBackupAssiAvlVldPassdThd.Val "MICROSAR RTE" VALUE 0x0 RTE_RL_UWORD 0 NO_COMPU_METHOD 0 65535 SYMBOL_LINK "Rte_CalprmRom_CalRegn01Cmn_DEFAULT_RTE_CALPRM_GROUP.FordMsg202BusHiSpdTrlrBackupAssiAvlVldPassdThd_Val" 0 DISPLAY_IDENTIFIER CalRegn01Cmn.CalibrationPorts.FordMsg202BusHiSpdTrlrBackupAssiAvlVldPassdThd.Val /end CHARACTERISTIC
/begin CHARACTERISTIC CalRegn01Cmn.FordMsg213BusHiSpdAbsActvVldFaildThd.Val "MICROSAR RTE" VALUE 0x0 RTE_RL_UWORD 0 NO_COMPU_METHOD 0 65535 SYMBOL_LINK "Rte_CalprmRom_CalRegn01Cmn_DEFAULT_RTE_CALPRM_GROUP.FordMsg213BusHiSpdAbsActvVldFaildThd_Val" 0 DISPLAY_IDENTIFIER CalRegn01Cmn.CalibrationPorts.FordMsg213BusHiSpdAbsActvVldFaildThd.Val /end CHARACTERISTIC
/begin CHARACTERISTIC CalRegn01Cmn.FordMsg213BusHiSpdAbsActvVldPassdThd.Val "MICROSAR RTE" VALUE 0x0 RTE_RL_UWORD 0 NO_COMPU_METHOD 0 65535 SYMBOL_LINK "Rte_CalprmRom_CalRegn01Cmn_DEFAULT_RTE_CALPRM_GROUP.FordMsg213BusHiSpdAbsActvVldPassdThd_Val" 0 DISPLAY_IDENTIFIER CalRegn01Cmn.CalibrationPorts.FordMsg213BusHiSpdAbsActvVldPassdThd.Val /end CHARACTERISTIC
/begin CHARACTERISTIC CalRegn01Cmn.FordMsg213BusHiSpdEvasSteerAssiEnadThd.Val "MICROSAR RTE" VALUE 0x0 RTE_RL_UWORD 0 NO_COMPU_METHOD 0 65535 SYMBOL_LINK "Rte_CalprmRom_CalRegn01Cmn_DEFAULT_RTE_CALPRM_GROUP.FordMsg213BusHiSpdEvasSteerAssiEnadThd_Val" 0 DISPLAY_IDENTIFIER CalRegn01Cmn.CalibrationPorts.FordMsg213BusHiSpdEvasSteerAssiEnadThd.Val /end CHARACTERISTIC
/begin CHARACTERISTIC CalRegn01Cmn.FordMsg213BusHiSpdMissMsgFaildThd.Val "MICROSAR RTE" VALUE 0x0 RTE_RL_UWORD 0 NO_COMPU_METHOD 0 65535 SYMBOL_LINK "Rte_CalprmRom_CalRegn01Cmn_DEFAULT_RTE_CALPRM_GROUP.FordMsg213BusHiSpdMissMsgFaildThd_Val" 0 DISPLAY_IDENTIFIER CalRegn01Cmn.CalibrationPorts.FordMsg213BusHiSpdMissMsgFaildThd.Val /end CHARACTERISTIC
/begin CHARACTERISTIC CalRegn01Cmn.FordMsg213BusHiSpdMissMsgPassdThd.Val "MICROSAR RTE" VALUE 0x0 RTE_RL_UWORD 0 NO_COMPU_METHOD 0 65535 SYMBOL_LINK "Rte_CalprmRom_CalRegn01Cmn_DEFAULT_RTE_CALPRM_GROUP.FordMsg213BusHiSpdMissMsgPassdThd_Val" 0 DISPLAY_IDENTIFIER CalRegn01Cmn.CalibrationPorts.FordMsg213BusHiSpdMissMsgPassdThd.Val /end CHARACTERISTIC
/begin CHARACTERISTIC CalRegn01Cmn.FordMsg215BusHiSpdFordVehTrlrAidModReqVldNotRxdTiThd.Val "MICROSAR RTE" VALUE 0x0 RTE_RL_UWORD 0 NO_COMPU_METHOD 0 65535 SYMBOL_LINK "Rte_CalprmRom_CalRegn01Cmn_DEFAULT_RTE_CALPRM_GROUP.FordMsg215BusHiSpdFordVehTrlrAidModReqVldNotRxdTiThd_Val" 0 DISPLAY_IDENTIFIER CalRegn01Cmn.CalibrationPorts.FordMsg215BusHiSpdFordVehTrlrAidModReqVldNotRxdTiThd.Val /end CHARACTERISTIC
/begin CHARACTERISTIC CalRegn01Cmn.FordMsg215BusHiSpdFordVehTrlrAidModReqVldRxdTiThd.Val "MICROSAR RTE" VALUE 0x0 RTE_RL_UWORD 0 NO_COMPU_METHOD 0 65535 SYMBOL_LINK "Rte_CalprmRom_CalRegn01Cmn_DEFAULT_RTE_CALPRM_GROUP.FordMsg215BusHiSpdFordVehTrlrAidModReqVldRxdTiThd_Val" 0 DISPLAY_IDENTIFIER CalRegn01Cmn.CalibrationPorts.FordMsg215BusHiSpdFordVehTrlrAidModReqVldRxdTiThd.Val /end CHARACTERISTIC
/begin CHARACTERISTIC CalRegn01Cmn.FordMsg215BusHiSpdMissMsgFaildTiThd.Val "MICROSAR RTE" VALUE 0x0 RTE_RL_UWORD 0 NO_COMPU_METHOD 0 65535 SYMBOL_LINK "Rte_CalprmRom_CalRegn01Cmn_DEFAULT_RTE_CALPRM_GROUP.FordMsg215BusHiSpdMissMsgFaildTiThd_Val" 0 DISPLAY_IDENTIFIER CalRegn01Cmn.CalibrationPorts.FordMsg215BusHiSpdMissMsgFaildTiThd.Val /end CHARACTERISTIC
/begin CHARACTERISTIC CalRegn01Cmn.FordMsg215BusHiSpdMissMsgPassdTiThd.Val "MICROSAR RTE" VALUE 0x0 RTE_RL_UWORD 0 NO_COMPU_METHOD 0 65535 SYMBOL_LINK "Rte_CalprmRom_CalRegn01Cmn_DEFAULT_RTE_CALPRM_GROUP.FordMsg215BusHiSpdMissMsgPassdTiThd_Val" 0 DISPLAY_IDENTIFIER CalRegn01Cmn.CalibrationPorts.FordMsg215BusHiSpdMissMsgPassdTiThd.Val /end CHARACTERISTIC
/begin CHARACTERISTIC CalRegn01Cmn.FordMsg216BusHiSpdFrntLeWhlCntrDirFaildTiThd.Val "MICROSAR RTE" VALUE 0x0 RTE_RL_UWORD 0 NO_COMPU_METHOD 0 65535 SYMBOL_LINK "Rte_CalprmRom_CalRegn01Cmn_DEFAULT_RTE_CALPRM_GROUP.FordMsg216BusHiSpdFrntLeWhlCntrDirFaildTiThd_Val" 0 DISPLAY_IDENTIFIER CalRegn01Cmn.CalibrationPorts.FordMsg216BusHiSpdFrntLeWhlCntrDirFaildTiThd.Val /end CHARACTERISTIC
/begin CHARACTERISTIC CalRegn01Cmn.FordMsg216BusHiSpdFrntLeWhlCntrDirPassdTiThd.Val "MICROSAR RTE" VALUE 0x0 RTE_RL_UWORD 0 NO_COMPU_METHOD 0 65535 SYMBOL_LINK "Rte_CalprmRom_CalRegn01Cmn_DEFAULT_RTE_CALPRM_GROUP.FordMsg216BusHiSpdFrntLeWhlCntrDirPassdTiThd_Val" 0 DISPLAY_IDENTIFIER CalRegn01Cmn.CalibrationPorts.FordMsg216BusHiSpdFrntLeWhlCntrDirPassdTiThd.Val /end CHARACTERISTIC
/begin CHARACTERISTIC CalRegn01Cmn.FordMsg216BusHiSpdFrntLeWhlVldMissMsgThd.Val "MICROSAR RTE" VALUE 0x0 RTE_RL_UWORD 0 NO_COMPU_METHOD 0 65535 SYMBOL_LINK "Rte_CalprmRom_CalRegn01Cmn_DEFAULT_RTE_CALPRM_GROUP.FordMsg216BusHiSpdFrntLeWhlVldMissMsgThd_Val" 0 DISPLAY_IDENTIFIER CalRegn01Cmn.CalibrationPorts.FordMsg216BusHiSpdFrntLeWhlVldMissMsgThd.Val /end CHARACTERISTIC
/begin CHARACTERISTIC CalRegn01Cmn.FordMsg216BusHiSpdFrntRiWhlCntrDirFaildTiThd.Val "MICROSAR RTE" VALUE 0x0 RTE_RL_UWORD 0 NO_COMPU_METHOD 0 65535 SYMBOL_LINK "Rte_CalprmRom_CalRegn01Cmn_DEFAULT_RTE_CALPRM_GROUP.FordMsg216BusHiSpdFrntRiWhlCntrDirFaildTiThd_Val" 0 DISPLAY_IDENTIFIER CalRegn01Cmn.CalibrationPorts.FordMsg216BusHiSpdFrntRiWhlCntrDirFaildTiThd.Val /end CHARACTERISTIC
/begin CHARACTERISTIC CalRegn01Cmn.FordMsg216BusHiSpdFrntRiWhlCntrDirPassdTiThd.Val "MICROSAR RTE" VALUE 0x0 RTE_RL_UWORD 0 NO_COMPU_METHOD 0 65535 SYMBOL_LINK "Rte_CalprmRom_CalRegn01Cmn_DEFAULT_RTE_CALPRM_GROUP.FordMsg216BusHiSpdFrntRiWhlCntrDirPassdTiThd_Val" 0 DISPLAY_IDENTIFIER CalRegn01Cmn.CalibrationPorts.FordMsg216BusHiSpdFrntRiWhlCntrDirPassdTiThd.Val /end CHARACTERISTIC
/begin CHARACTERISTIC CalRegn01Cmn.FordMsg216BusHiSpdFrntRiWhlVldMissMsgThd.Val "MICROSAR RTE" VALUE 0x0 RTE_RL_UWORD 0 NO_COMPU_METHOD 0 65535 SYMBOL_LINK "Rte_CalprmRom_CalRegn01Cmn_DEFAULT_RTE_CALPRM_GROUP.FordMsg216BusHiSpdFrntRiWhlVldMissMsgThd_Val" 0 DISPLAY_IDENTIFIER CalRegn01Cmn.CalibrationPorts.FordMsg216BusHiSpdFrntRiWhlVldMissMsgThd.Val /end CHARACTERISTIC
/begin CHARACTERISTIC CalRegn01Cmn.FordMsg216BusHiSpdMissMsgFaildTiThd.Val "MICROSAR RTE" VALUE 0x0 RTE_RL_UWORD 0 NO_COMPU_METHOD 0 65535 SYMBOL_LINK "Rte_CalprmRom_CalRegn01Cmn_DEFAULT_RTE_CALPRM_GROUP.FordMsg216BusHiSpdMissMsgFaildTiThd_Val" 0 DISPLAY_IDENTIFIER CalRegn01Cmn.CalibrationPorts.FordMsg216BusHiSpdMissMsgFaildTiThd.Val /end CHARACTERISTIC
/begin CHARACTERISTIC CalRegn01Cmn.FordMsg216BusHiSpdMissMsgPassdTiThd.Val "MICROSAR RTE" VALUE 0x0 RTE_RL_UWORD 0 NO_COMPU_METHOD 0 65535 SYMBOL_LINK "Rte_CalprmRom_CalRegn01Cmn_DEFAULT_RTE_CALPRM_GROUP.FordMsg216BusHiSpdMissMsgPassdTiThd_Val" 0 DISPLAY_IDENTIFIER CalRegn01Cmn.CalibrationPorts.FordMsg216BusHiSpdMissMsgPassdTiThd.Val /end CHARACTERISTIC
/begin CHARACTERISTIC CalRegn01Cmn.FordMsg216BusHiSpdReLeWhlCntrDirFaildTiThd.Val "MICROSAR RTE" VALUE 0x0 RTE_RL_UWORD 0 NO_COMPU_METHOD 0 65535 SYMBOL_LINK "Rte_CalprmRom_CalRegn01Cmn_DEFAULT_RTE_CALPRM_GROUP.FordMsg216BusHiSpdReLeWhlCntrDirFaildTiThd_Val" 0 DISPLAY_IDENTIFIER CalRegn01Cmn.CalibrationPorts.FordMsg216BusHiSpdReLeWhlCntrDirFaildTiThd.Val /end CHARACTERISTIC
/begin CHARACTERISTIC CalRegn01Cmn.FordMsg216BusHiSpdReLeWhlCntrDirPassdTiThd.Val "MICROSAR RTE" VALUE 0x0 RTE_RL_UWORD 0 NO_COMPU_METHOD 0 65535 SYMBOL_LINK "Rte_CalprmRom_CalRegn01Cmn_DEFAULT_RTE_CALPRM_GROUP.FordMsg216BusHiSpdReLeWhlCntrDirPassdTiThd_Val" 0 DISPLAY_IDENTIFIER CalRegn01Cmn.CalibrationPorts.FordMsg216BusHiSpdReLeWhlCntrDirPassdTiThd.Val /end CHARACTERISTIC
/begin CHARACTERISTIC CalRegn01Cmn.FordMsg216BusHiSpdReLeWhlVldMissMsgThd.Val "MICROSAR RTE" VALUE 0x0 RTE_RL_UWORD 0 NO_COMPU_METHOD 0 65535 SYMBOL_LINK "Rte_CalprmRom_CalRegn01Cmn_DEFAULT_RTE_CALPRM_GROUP.FordMsg216BusHiSpdReLeWhlVldMissMsgThd_Val" 0 DISPLAY_IDENTIFIER CalRegn01Cmn.CalibrationPorts.FordMsg216BusHiSpdReLeWhlVldMissMsgThd.Val /end CHARACTERISTIC
/begin CHARACTERISTIC CalRegn01Cmn.FordMsg216BusHiSpdReRiWhlCntrDirFaildTiThd.Val "MICROSAR RTE" VALUE 0x0 RTE_RL_UWORD 0 NO_COMPU_METHOD 0 65535 SYMBOL_LINK "Rte_CalprmRom_CalRegn01Cmn_DEFAULT_RTE_CALPRM_GROUP.FordMsg216BusHiSpdReRiWhlCntrDirFaildTiThd_Val" 0 DISPLAY_IDENTIFIER CalRegn01Cmn.CalibrationPorts.FordMsg216BusHiSpdReRiWhlCntrDirFaildTiThd.Val /end CHARACTERISTIC
/begin CHARACTERISTIC CalRegn01Cmn.FordMsg216BusHiSpdReRiWhlCntrDirPassdTiThd.Val "MICROSAR RTE" VALUE 0x0 RTE_RL_UWORD 0 NO_COMPU_METHOD 0 65535 SYMBOL_LINK "Rte_CalprmRom_CalRegn01Cmn_DEFAULT_RTE_CALPRM_GROUP.FordMsg216BusHiSpdReRiWhlCntrDirPassdTiThd_Val" 0 DISPLAY_IDENTIFIER CalRegn01Cmn.CalibrationPorts.FordMsg216BusHiSpdReRiWhlCntrDirPassdTiThd.Val /end CHARACTERISTIC
/begin CHARACTERISTIC CalRegn01Cmn.FordMsg216BusHiSpdReRiWhlVldMissMsgThd.Val "MICROSAR RTE" VALUE 0x0 RTE_RL_UWORD 0 NO_COMPU_METHOD 0 65535 SYMBOL_LINK "Rte_CalprmRom_CalRegn01Cmn_DEFAULT_RTE_CALPRM_GROUP.FordMsg216BusHiSpdReRiWhlVldMissMsgThd_Val" 0 DISPLAY_IDENTIFIER CalRegn01Cmn.CalibrationPorts.FordMsg216BusHiSpdReRiWhlVldMissMsgThd.Val /end CHARACTERISTIC
/begin CHARACTERISTIC CalRegn01Cmn.FordMsg217BusHiSpdFrntLeWhlSpdInvldFaildThd.Val "MICROSAR RTE" VALUE 0x0 RTE_RL_UWORD 0 NO_COMPU_METHOD 0 65535 SYMBOL_LINK "Rte_CalprmRom_CalRegn01Cmn_DEFAULT_RTE_CALPRM_GROUP.FordMsg217BusHiSpdFrntLeWhlSpdInvldFaildThd_Val" 0 DISPLAY_IDENTIFIER CalRegn01Cmn.CalibrationPorts.FordMsg217BusHiSpdFrntLeWhlSpdInvldFaildThd.Val /end CHARACTERISTIC
/begin CHARACTERISTIC CalRegn01Cmn.FordMsg217BusHiSpdFrntLeWhlSpdInvldPassdThd.Val "MICROSAR RTE" VALUE 0x0 RTE_RL_UWORD 0 NO_COMPU_METHOD 0 65535 SYMBOL_LINK "Rte_CalprmRom_CalRegn01Cmn_DEFAULT_RTE_CALPRM_GROUP.FordMsg217BusHiSpdFrntLeWhlSpdInvldPassdThd_Val" 0 DISPLAY_IDENTIFIER CalRegn01Cmn.CalibrationPorts.FordMsg217BusHiSpdFrntLeWhlSpdInvldPassdThd.Val /end CHARACTERISTIC
/begin CHARACTERISTIC CalRegn01Cmn.FordMsg217BusHiSpdFrntLeWhlVldFaildThd.Val "MICROSAR RTE" VALUE 0x0 RTE_RL_UWORD 0 NO_COMPU_METHOD 0 65535 SYMBOL_LINK "Rte_CalprmRom_CalRegn01Cmn_DEFAULT_RTE_CALPRM_GROUP.FordMsg217BusHiSpdFrntLeWhlVldFaildThd_Val" 0 DISPLAY_IDENTIFIER CalRegn01Cmn.CalibrationPorts.FordMsg217BusHiSpdFrntLeWhlVldFaildThd.Val /end CHARACTERISTIC
/begin CHARACTERISTIC CalRegn01Cmn.FordMsg217BusHiSpdFrntLeWhlVldMissThd.Val "MICROSAR RTE" VALUE 0x0 RTE_RL_UWORD 0 NO_COMPU_METHOD 0 65535 SYMBOL_LINK "Rte_CalprmRom_CalRegn01Cmn_DEFAULT_RTE_CALPRM_GROUP.FordMsg217BusHiSpdFrntLeWhlVldMissThd_Val" 0 DISPLAY_IDENTIFIER CalRegn01Cmn.CalibrationPorts.FordMsg217BusHiSpdFrntLeWhlVldMissThd.Val /end CHARACTERISTIC
/begin CHARACTERISTIC CalRegn01Cmn.FordMsg217BusHiSpdFrntLeWhlVldPassdThd.Val "MICROSAR RTE" VALUE 0x0 RTE_RL_UWORD 0 NO_COMPU_METHOD 0 65535 SYMBOL_LINK "Rte_CalprmRom_CalRegn01Cmn_DEFAULT_RTE_CALPRM_GROUP.FordMsg217BusHiSpdFrntLeWhlVldPassdThd_Val" 0 DISPLAY_IDENTIFIER CalRegn01Cmn.CalibrationPorts.FordMsg217BusHiSpdFrntLeWhlVldPassdThd.Val /end CHARACTERISTIC
/begin CHARACTERISTIC CalRegn01Cmn.FordMsg217BusHiSpdFrntRiWhlSpdInvldFaildThd.Val "MICROSAR RTE" VALUE 0x0 RTE_RL_UWORD 0 NO_COMPU_METHOD 0 65535 SYMBOL_LINK "Rte_CalprmRom_CalRegn01Cmn_DEFAULT_RTE_CALPRM_GROUP.FordMsg217BusHiSpdFrntRiWhlSpdInvldFaildThd_Val" 0 DISPLAY_IDENTIFIER CalRegn01Cmn.CalibrationPorts.FordMsg217BusHiSpdFrntRiWhlSpdInvldFaildThd.Val /end CHARACTERISTIC
/begin CHARACTERISTIC CalRegn01Cmn.FordMsg217BusHiSpdFrntRiWhlSpdInvldPassdThd.Val "MICROSAR RTE" VALUE 0x0 RTE_RL_UWORD 0 NO_COMPU_METHOD 0 65535 SYMBOL_LINK "Rte_CalprmRom_CalRegn01Cmn_DEFAULT_RTE_CALPRM_GROUP.FordMsg217BusHiSpdFrntRiWhlSpdInvldPassdThd_Val" 0 DISPLAY_IDENTIFIER CalRegn01Cmn.CalibrationPorts.FordMsg217BusHiSpdFrntRiWhlSpdInvldPassdThd.Val /end CHARACTERISTIC
/begin CHARACTERISTIC CalRegn01Cmn.FordMsg217BusHiSpdFrntRiWhlVldFaildThd.Val "MICROSAR RTE" VALUE 0x0 RTE_RL_UWORD 0 NO_COMPU_METHOD 0 65535 SYMBOL_LINK "Rte_CalprmRom_CalRegn01Cmn_DEFAULT_RTE_CALPRM_GROUP.FordMsg217BusHiSpdFrntRiWhlVldFaildThd_Val" 0 DISPLAY_IDENTIFIER CalRegn01Cmn.CalibrationPorts.FordMsg217BusHiSpdFrntRiWhlVldFaildThd.Val /end CHARACTERISTIC
/begin CHARACTERISTIC CalRegn01Cmn.FordMsg217BusHiSpdFrntRiWhlVldMissThd.Val "MICROSAR RTE" VALUE 0x0 RTE_RL_UWORD 0 NO_COMPU_METHOD 0 65535 SYMBOL_LINK "Rte_CalprmRom_CalRegn01Cmn_DEFAULT_RTE_CALPRM_GROUP.FordMsg217BusHiSpdFrntRiWhlVldMissThd_Val" 0 DISPLAY_IDENTIFIER CalRegn01Cmn.CalibrationPorts.FordMsg217BusHiSpdFrntRiWhlVldMissThd.Val /end CHARACTERISTIC
/begin CHARACTERISTIC CalRegn01Cmn.FordMsg217BusHiSpdFrntRiWhlVldPassdThd.Val "MICROSAR RTE" VALUE 0x0 RTE_RL_UWORD 0 NO_COMPU_METHOD 0 65535 SYMBOL_LINK "Rte_CalprmRom_CalRegn01Cmn_DEFAULT_RTE_CALPRM_GROUP.FordMsg217BusHiSpdFrntRiWhlVldPassdThd_Val" 0 DISPLAY_IDENTIFIER CalRegn01Cmn.CalibrationPorts.FordMsg217BusHiSpdFrntRiWhlVldPassdThd.Val /end CHARACTERISTIC
/begin CHARACTERISTIC CalRegn01Cmn.FordMsg217BusHiSpdMissMsgFaildThd.Val "MICROSAR RTE" VALUE 0x0 RTE_RL_UWORD 0 NO_COMPU_METHOD 0 65535 SYMBOL_LINK "Rte_CalprmRom_CalRegn01Cmn_DEFAULT_RTE_CALPRM_GROUP.FordMsg217BusHiSpdMissMsgFaildThd_Val" 0 DISPLAY_IDENTIFIER CalRegn01Cmn.CalibrationPorts.FordMsg217BusHiSpdMissMsgFaildThd.Val /end CHARACTERISTIC
/begin CHARACTERISTIC CalRegn01Cmn.FordMsg217BusHiSpdMissMsgPassdThd.Val "MICROSAR RTE" VALUE 0x0 RTE_RL_UWORD 0 NO_COMPU_METHOD 0 65535 SYMBOL_LINK "Rte_CalprmRom_CalRegn01Cmn_DEFAULT_RTE_CALPRM_GROUP.FordMsg217BusHiSpdMissMsgPassdThd_Val" 0 DISPLAY_IDENTIFIER CalRegn01Cmn.CalibrationPorts.FordMsg217BusHiSpdMissMsgPassdThd.Val /end CHARACTERISTIC
/begin CHARACTERISTIC CalRegn01Cmn.FordMsg217BusHiSpdReLeWhlSpdInvldFaildThd.Val "MICROSAR RTE" VALUE 0x0 RTE_RL_UWORD 0 NO_COMPU_METHOD 0 65535 SYMBOL_LINK "Rte_CalprmRom_CalRegn01Cmn_DEFAULT_RTE_CALPRM_GROUP.FordMsg217BusHiSpdReLeWhlSpdInvldFaildThd_Val" 0 DISPLAY_IDENTIFIER CalRegn01Cmn.CalibrationPorts.FordMsg217BusHiSpdReLeWhlSpdInvldFaildThd.Val /end CHARACTERISTIC
/begin CHARACTERISTIC CalRegn01Cmn.FordMsg217BusHiSpdReLeWhlSpdInvldPassdThd.Val "MICROSAR RTE" VALUE 0x0 RTE_RL_UWORD 0 NO_COMPU_METHOD 0 65535 SYMBOL_LINK "Rte_CalprmRom_CalRegn01Cmn_DEFAULT_RTE_CALPRM_GROUP.FordMsg217BusHiSpdReLeWhlSpdInvldPassdThd_Val" 0 DISPLAY_IDENTIFIER CalRegn01Cmn.CalibrationPorts.FordMsg217BusHiSpdReLeWhlSpdInvldPassdThd.Val /end CHARACTERISTIC
/begin CHARACTERISTIC CalRegn01Cmn.FordMsg217BusHiSpdReLeWhlVldFaildThd.Val "MICROSAR RTE" VALUE 0x0 RTE_RL_UWORD 0 NO_COMPU_METHOD 0 65535 SYMBOL_LINK "Rte_CalprmRom_CalRegn01Cmn_DEFAULT_RTE_CALPRM_GROUP.FordMsg217BusHiSpdReLeWhlVldFaildThd_Val" 0 DISPLAY_IDENTIFIER CalRegn01Cmn.CalibrationPorts.FordMsg217BusHiSpdReLeWhlVldFaildThd.Val /end CHARACTERISTIC
/begin CHARACTERISTIC CalRegn01Cmn.FordMsg217BusHiSpdReLeWhlVldMissThd.Val "MICROSAR RTE" VALUE 0x0 RTE_RL_UWORD 0 NO_COMPU_METHOD 0 65535 SYMBOL_LINK "Rte_CalprmRom_CalRegn01Cmn_DEFAULT_RTE_CALPRM_GROUP.FordMsg217BusHiSpdReLeWhlVldMissThd_Val" 0 DISPLAY_IDENTIFIER CalRegn01Cmn.CalibrationPorts.FordMsg217BusHiSpdReLeWhlVldMissThd.Val /end CHARACTERISTIC
/begin CHARACTERISTIC CalRegn01Cmn.FordMsg217BusHiSpdReLeWhlVldPassdThd.Val "MICROSAR RTE" VALUE 0x0 RTE_RL_UWORD 0 NO_COMPU_METHOD 0 65535 SYMBOL_LINK "Rte_CalprmRom_CalRegn01Cmn_DEFAULT_RTE_CALPRM_GROUP.FordMsg217BusHiSpdReLeWhlVldPassdThd_Val" 0 DISPLAY_IDENTIFIER CalRegn01Cmn.CalibrationPorts.FordMsg217BusHiSpdReLeWhlVldPassdThd.Val /end CHARACTERISTIC
/begin CHARACTERISTIC CalRegn01Cmn.FordMsg217BusHiSpdReRiWhlSpdInvldFaildThd.Val "MICROSAR RTE" VALUE 0x0 RTE_RL_UWORD 0 NO_COMPU_METHOD 0 65535 SYMBOL_LINK "Rte_CalprmRom_CalRegn01Cmn_DEFAULT_RTE_CALPRM_GROUP.FordMsg217BusHiSpdReRiWhlSpdInvldFaildThd_Val" 0 DISPLAY_IDENTIFIER CalRegn01Cmn.CalibrationPorts.FordMsg217BusHiSpdReRiWhlSpdInvldFaildThd.Val /end CHARACTERISTIC
/begin CHARACTERISTIC CalRegn01Cmn.FordMsg217BusHiSpdReRiWhlSpdInvldPassdThd.Val "MICROSAR RTE" VALUE 0x0 RTE_RL_UWORD 0 NO_COMPU_METHOD 0 65535 SYMBOL_LINK "Rte_CalprmRom_CalRegn01Cmn_DEFAULT_RTE_CALPRM_GROUP.FordMsg217BusHiSpdReRiWhlSpdInvldPassdThd_Val" 0 DISPLAY_IDENTIFIER CalRegn01Cmn.CalibrationPorts.FordMsg217BusHiSpdReRiWhlSpdInvldPassdThd.Val /end CHARACTERISTIC
/begin CHARACTERISTIC CalRegn01Cmn.FordMsg217BusHiSpdReRiWhlVldFaildThd.Val "MICROSAR RTE" VALUE 0x0 RTE_RL_UWORD 0 NO_COMPU_METHOD 0 65535 SYMBOL_LINK "Rte_CalprmRom_CalRegn01Cmn_DEFAULT_RTE_CALPRM_GROUP.FordMsg217BusHiSpdReRiWhlVldFaildThd_Val" 0 DISPLAY_IDENTIFIER CalRegn01Cmn.CalibrationPorts.FordMsg217BusHiSpdReRiWhlVldFaildThd.Val /end CHARACTERISTIC
/begin CHARACTERISTIC CalRegn01Cmn.FordMsg217BusHiSpdReRiWhlVldMissThd.Val "MICROSAR RTE" VALUE 0x0 RTE_RL_UWORD 0 NO_COMPU_METHOD 0 65535 SYMBOL_LINK "Rte_CalprmRom_CalRegn01Cmn_DEFAULT_RTE_CALPRM_GROUP.FordMsg217BusHiSpdReRiWhlVldMissThd_Val" 0 DISPLAY_IDENTIFIER CalRegn01Cmn.CalibrationPorts.FordMsg217BusHiSpdReRiWhlVldMissThd.Val /end CHARACTERISTIC
/begin CHARACTERISTIC CalRegn01Cmn.FordMsg217BusHiSpdReRiWhlVldPassdThd.Val "MICROSAR RTE" VALUE 0x0 RTE_RL_UWORD 0 NO_COMPU_METHOD 0 65535 SYMBOL_LINK "Rte_CalprmRom_CalRegn01Cmn_DEFAULT_RTE_CALPRM_GROUP.FordMsg217BusHiSpdReRiWhlVldPassdThd_Val" 0 DISPLAY_IDENTIFIER CalRegn01Cmn.CalibrationPorts.FordMsg217BusHiSpdReRiWhlVldPassdThd.Val /end CHARACTERISTIC
/begin CHARACTERISTIC CalRegn01Cmn.FordMsg230BusHiSpdFordVehGearLvrPosnFaildTiThd.Val "MICROSAR RTE" VALUE 0x0 RTE_RL_UWORD 0 NO_COMPU_METHOD 0 65535 SYMBOL_LINK "Rte_CalprmRom_CalRegn01Cmn_DEFAULT_RTE_CALPRM_GROUP.FordMsg230BusHiSpdFordVehGearLvrPosnFaildTiThd_Val" 0 DISPLAY_IDENTIFIER CalRegn01Cmn.CalibrationPorts.FordMsg230BusHiSpdFordVehGearLvrPosnFaildTiThd.Val /end CHARACTERISTIC
/begin CHARACTERISTIC CalRegn01Cmn.FordMsg230BusHiSpdFordVehGearLvrPosnPassdTiThd.Val "MICROSAR RTE" VALUE 0x0 RTE_RL_UWORD 0 NO_COMPU_METHOD 0 65535 SYMBOL_LINK "Rte_CalprmRom_CalRegn01Cmn_DEFAULT_RTE_CALPRM_GROUP.FordMsg230BusHiSpdFordVehGearLvrPosnPassdTiThd_Val" 0 DISPLAY_IDENTIFIER CalRegn01Cmn.CalibrationPorts.FordMsg230BusHiSpdFordVehGearLvrPosnPassdTiThd.Val /end CHARACTERISTIC
/begin CHARACTERISTIC CalRegn01Cmn.FordMsg230BusHiSpdGearLvrPosnMissTiThd.Val "MICROSAR RTE" VALUE 0x0 RTE_RL_UWORD 0 NO_COMPU_METHOD 0 65535 SYMBOL_LINK "Rte_CalprmRom_CalRegn01Cmn_DEFAULT_RTE_CALPRM_GROUP.FordMsg230BusHiSpdGearLvrPosnMissTiThd_Val" 0 DISPLAY_IDENTIFIER CalRegn01Cmn.CalibrationPorts.FordMsg230BusHiSpdGearLvrPosnMissTiThd.Val /end CHARACTERISTIC
/begin CHARACTERISTIC CalRegn01Cmn.FordMsg230BusHiSpdInvldSigFaildThd.Val "MICROSAR RTE" VALUE 0x0 RTE_RL_UWORD 0 NO_COMPU_METHOD 0 65535 SYMBOL_LINK "Rte_CalprmRom_CalRegn01Cmn_DEFAULT_RTE_CALPRM_GROUP.FordMsg230BusHiSpdInvldSigFaildThd_Val" 0 DISPLAY_IDENTIFIER CalRegn01Cmn.CalibrationPorts.FordMsg230BusHiSpdInvldSigFaildThd.Val /end CHARACTERISTIC
/begin CHARACTERISTIC CalRegn01Cmn.FordMsg230BusHiSpdInvldSigPassdThd.Val "MICROSAR RTE" VALUE 0x0 RTE_RL_UWORD 0 NO_COMPU_METHOD 0 65535 SYMBOL_LINK "Rte_CalprmRom_CalRegn01Cmn_DEFAULT_RTE_CALPRM_GROUP.FordMsg230BusHiSpdInvldSigPassdThd_Val" 0 DISPLAY_IDENTIFIER CalRegn01Cmn.CalibrationPorts.FordMsg230BusHiSpdInvldSigPassdThd.Val /end CHARACTERISTIC
/begin CHARACTERISTIC CalRegn01Cmn.FordMsg230BusHiSpdMissMsgFaildThd.Val "MICROSAR RTE" VALUE 0x0 RTE_RL_UWORD 0 NO_COMPU_METHOD 0 65535 SYMBOL_LINK "Rte_CalprmRom_CalRegn01Cmn_DEFAULT_RTE_CALPRM_GROUP.FordMsg230BusHiSpdMissMsgFaildThd_Val" 0 DISPLAY_IDENTIFIER CalRegn01Cmn.CalibrationPorts.FordMsg230BusHiSpdMissMsgFaildThd.Val /end CHARACTERISTIC
/begin CHARACTERISTIC CalRegn01Cmn.FordMsg230BusHiSpdMissMsgPassdThd.Val "MICROSAR RTE" VALUE 0x0 RTE_RL_UWORD 0 NO_COMPU_METHOD 0 65535 SYMBOL_LINK "Rte_CalprmRom_CalRegn01Cmn_DEFAULT_RTE_CALPRM_GROUP.FordMsg230BusHiSpdMissMsgPassdThd_Val" 0 DISPLAY_IDENTIFIER CalRegn01Cmn.CalibrationPorts.FordMsg230BusHiSpdMissMsgPassdThd.Val /end CHARACTERISTIC
/begin CHARACTERISTIC CalRegn01Cmn.FordMsg2FDBusHiSpdFordVehEvasSteerAssiReqVldNotRxdTiThd.Val "MICROSAR RTE" VALUE 0x0 RTE_RL_UWORD 0 NO_COMPU_METHOD 0 65535 SYMBOL_LINK "Rte_CalprmRom_CalRegn01Cmn_DEFAULT_RTE_CALPRM_GROUP.FordMsg2FDBusHiSpdFordVehEvasSteerAssiReqVldNotRxdTiThd_Val" 0 DISPLAY_IDENTIFIER CalRegn01Cmn.CalibrationPorts.FordMsg2FDBusHiSpdFordVehEvasSteerAssiReqVldNotRxdTiThd.Val /end CHARACTERISTIC
/begin CHARACTERISTIC CalRegn01Cmn.FordMsg2FDBusHiSpdFordVehEvasSteerAssiReqVldRxdTiThd.Val "MICROSAR RTE" VALUE 0x0 RTE_RL_UWORD 0 NO_COMPU_METHOD 0 65535 SYMBOL_LINK "Rte_CalprmRom_CalRegn01Cmn_DEFAULT_RTE_CALPRM_GROUP.FordMsg2FDBusHiSpdFordVehEvasSteerAssiReqVldRxdTiThd_Val" 0 DISPLAY_IDENTIFIER CalRegn01Cmn.CalibrationPorts.FordMsg2FDBusHiSpdFordVehEvasSteerAssiReqVldRxdTiThd.Val /end CHARACTERISTIC
/begin CHARACTERISTIC CalRegn01Cmn.FordMsg2FDBusHiSpdMissMsgFaildTiThd.Val "MICROSAR RTE" VALUE 0x0 RTE_RL_UWORD 0 NO_COMPU_METHOD 0 65535 SYMBOL_LINK "Rte_CalprmRom_CalRegn01Cmn_DEFAULT_RTE_CALPRM_GROUP.FordMsg2FDBusHiSpdMissMsgFaildTiThd_Val" 0 DISPLAY_IDENTIFIER CalRegn01Cmn.CalibrationPorts.FordMsg2FDBusHiSpdMissMsgFaildTiThd.Val /end CHARACTERISTIC
/begin CHARACTERISTIC CalRegn01Cmn.FordMsg2FDBusHiSpdMissMsgPassdTiThd.Val "MICROSAR RTE" VALUE 0x0 RTE_RL_UWORD 0 NO_COMPU_METHOD 0 65535 SYMBOL_LINK "Rte_CalprmRom_CalRegn01Cmn_DEFAULT_RTE_CALPRM_GROUP.FordMsg2FDBusHiSpdMissMsgPassdTiThd_Val" 0 DISPLAY_IDENTIFIER CalRegn01Cmn.CalibrationPorts.FordMsg2FDBusHiSpdMissMsgPassdTiThd.Val /end CHARACTERISTIC
/begin CHARACTERISTIC CalRegn01Cmn.FordMsg3B3BusHiSpdIgnStsVldFaildThd.Val "MICROSAR RTE" VALUE 0x0 RTE_RL_UWORD 0 NO_COMPU_METHOD 0 65535 SYMBOL_LINK "Rte_CalprmRom_CalRegn01Cmn_DEFAULT_RTE_CALPRM_GROUP.FordMsg3B3BusHiSpdIgnStsVldFaildThd_Val" 0 DISPLAY_IDENTIFIER CalRegn01Cmn.CalibrationPorts.FordMsg3B3BusHiSpdIgnStsVldFaildThd.Val /end CHARACTERISTIC
/begin CHARACTERISTIC CalRegn01Cmn.FordMsg3B3BusHiSpdIgnStsVldMissThd.Val "MICROSAR RTE" VALUE 0x0 RTE_RL_UWORD 0 NO_COMPU_METHOD 0 65535 SYMBOL_LINK "Rte_CalprmRom_CalRegn01Cmn_DEFAULT_RTE_CALPRM_GROUP.FordMsg3B3BusHiSpdIgnStsVldMissThd_Val" 0 DISPLAY_IDENTIFIER CalRegn01Cmn.CalibrationPorts.FordMsg3B3BusHiSpdIgnStsVldMissThd.Val /end CHARACTERISTIC
/begin CHARACTERISTIC CalRegn01Cmn.FordMsg3B3BusHiSpdIgnStsVldPassdThd.Val "MICROSAR RTE" VALUE 0x0 RTE_RL_UWORD 0 NO_COMPU_METHOD 0 65535 SYMBOL_LINK "Rte_CalprmRom_CalRegn01Cmn_DEFAULT_RTE_CALPRM_GROUP.FordMsg3B3BusHiSpdIgnStsVldPassdThd_Val" 0 DISPLAY_IDENTIFIER CalRegn01Cmn.CalibrationPorts.FordMsg3B3BusHiSpdIgnStsVldPassdThd.Val /end CHARACTERISTIC
/begin CHARACTERISTIC CalRegn01Cmn.FordMsg3B3BusHiSpdInvldSigFaildThd.Val "MICROSAR RTE" VALUE 0x0 RTE_RL_UWORD 0 NO_COMPU_METHOD 0 65535 SYMBOL_LINK "Rte_CalprmRom_CalRegn01Cmn_DEFAULT_RTE_CALPRM_GROUP.FordMsg3B3BusHiSpdInvldSigFaildThd_Val" 0 DISPLAY_IDENTIFIER CalRegn01Cmn.CalibrationPorts.FordMsg3B3BusHiSpdInvldSigFaildThd.Val /end CHARACTERISTIC
/begin CHARACTERISTIC CalRegn01Cmn.FordMsg3B3BusHiSpdInvldSigPassdThd.Val "MICROSAR RTE" VALUE 0x0 RTE_RL_UWORD 0 NO_COMPU_METHOD 0 65535 SYMBOL_LINK "Rte_CalprmRom_CalRegn01Cmn_DEFAULT_RTE_CALPRM_GROUP.FordMsg3B3BusHiSpdInvldSigPassdThd_Val" 0 DISPLAY_IDENTIFIER CalRegn01Cmn.CalibrationPorts.FordMsg3B3BusHiSpdInvldSigPassdThd.Val /end CHARACTERISTIC
/begin CHARACTERISTIC CalRegn01Cmn.FordMsg3B3BusHiSpdMissMsgFaildThd.Val "MICROSAR RTE" VALUE 0x0 RTE_RL_UWORD 0 NO_COMPU_METHOD 0 65535 SYMBOL_LINK "Rte_CalprmRom_CalRegn01Cmn_DEFAULT_RTE_CALPRM_GROUP.FordMsg3B3BusHiSpdMissMsgFaildThd_Val" 0 DISPLAY_IDENTIFIER CalRegn01Cmn.CalibrationPorts.FordMsg3B3BusHiSpdMissMsgFaildThd.Val /end CHARACTERISTIC
/begin CHARACTERISTIC CalRegn01Cmn.FordMsg3B3BusHiSpdMissMsgPassdThd.Val "MICROSAR RTE" VALUE 0x0 RTE_RL_UWORD 0 NO_COMPU_METHOD 0 65535 SYMBOL_LINK "Rte_CalprmRom_CalRegn01Cmn_DEFAULT_RTE_CALPRM_GROUP.FordMsg3B3BusHiSpdMissMsgPassdThd_Val" 0 DISPLAY_IDENTIFIER CalRegn01Cmn.CalibrationPorts.FordMsg3B3BusHiSpdMissMsgPassdThd.Val /end CHARACTERISTIC
/begin CHARACTERISTIC CalRegn01Cmn.FordMsg3CABusHiSpdLaneAssiImgProcgModlAFaildCrvtTiThd.Val "MICROSAR RTE" VALUE 0x0 RTE_RL_UWORD 0 NO_COMPU_METHOD 0 65535 SYMBOL_LINK "Rte_CalprmRom_CalRegn01Cmn_DEFAULT_RTE_CALPRM_GROUP.FordMsg3CABusHiSpdLaneAssiImgProcgModlAFaildCrvtTiThd_Val" 0 DISPLAY_IDENTIFIER CalRegn01Cmn.CalibrationPorts.FordMsg3CABusHiSpdLaneAssiImgProcgModlAFaildCrvtTiThd.Val /end CHARACTERISTIC
/begin CHARACTERISTIC CalRegn01Cmn.FordMsg3CABusHiSpdLaneAssiImgProcgModlAFaildReqdAgTiThd.Val "MICROSAR RTE" VALUE 0x0 RTE_RL_UWORD 0 NO_COMPU_METHOD 0 65535 SYMBOL_LINK "Rte_CalprmRom_CalRegn01Cmn_DEFAULT_RTE_CALPRM_GROUP.FordMsg3CABusHiSpdLaneAssiImgProcgModlAFaildReqdAgTiThd_Val" 0 DISPLAY_IDENTIFIER CalRegn01Cmn.CalibrationPorts.FordMsg3CABusHiSpdLaneAssiImgProcgModlAFaildReqdAgTiThd.Val /end CHARACTERISTIC
/begin CHARACTERISTIC CalRegn01Cmn.FordMsg3CABusHiSpdLaneAssiImgProcgModlAPassdTiThd.Val "MICROSAR RTE" VALUE 0x0 RTE_RL_UWORD 0 NO_COMPU_METHOD 0 65535 SYMBOL_LINK "Rte_CalprmRom_CalRegn01Cmn_DEFAULT_RTE_CALPRM_GROUP.FordMsg3CABusHiSpdLaneAssiImgProcgModlAPassdTiThd_Val" 0 DISPLAY_IDENTIFIER CalRegn01Cmn.CalibrationPorts.FordMsg3CABusHiSpdLaneAssiImgProcgModlAPassdTiThd.Val /end CHARACTERISTIC
/begin CHARACTERISTIC CalRegn01Cmn.FordMsg3CABusHiSpdLaneAssiImgProcgModlAVldMissTiThd.Val "MICROSAR RTE" VALUE 0x0 RTE_RL_UWORD 0 NO_COMPU_METHOD 0 65535 SYMBOL_LINK "Rte_CalprmRom_CalRegn01Cmn_DEFAULT_RTE_CALPRM_GROUP.FordMsg3CABusHiSpdLaneAssiImgProcgModlAVldMissTiThd_Val" 0 DISPLAY_IDENTIFIER CalRegn01Cmn.CalibrationPorts.FordMsg3CABusHiSpdLaneAssiImgProcgModlAVldMissTiThd.Val /end CHARACTERISTIC
/begin CHARACTERISTIC CalRegn01Cmn.FordMsg3CABusHiSpdLaneKeepSysCrvtInvldFaildTiThd.Val "MICROSAR RTE" VALUE 0x0 RTE_RL_UWORD 0 NO_COMPU_METHOD 0 65535 SYMBOL_LINK "Rte_CalprmRom_CalRegn01Cmn_DEFAULT_RTE_CALPRM_GROUP.FordMsg3CABusHiSpdLaneKeepSysCrvtInvldFaildTiThd_Val" 0 DISPLAY_IDENTIFIER CalRegn01Cmn.CalibrationPorts.FordMsg3CABusHiSpdLaneKeepSysCrvtInvldFaildTiThd.Val /end CHARACTERISTIC
/begin CHARACTERISTIC CalRegn01Cmn.FordMsg3CABusHiSpdLaneKeepSysCrvtInvldPassdTiThd.Val "MICROSAR RTE" VALUE 0x0 RTE_RL_UWORD 0 NO_COMPU_METHOD 0 65535 SYMBOL_LINK "Rte_CalprmRom_CalRegn01Cmn_DEFAULT_RTE_CALPRM_GROUP.FordMsg3CABusHiSpdLaneKeepSysCrvtInvldPassdTiThd_Val" 0 DISPLAY_IDENTIFIER CalRegn01Cmn.CalibrationPorts.FordMsg3CABusHiSpdLaneKeepSysCrvtInvldPassdTiThd.Val /end CHARACTERISTIC
/begin CHARACTERISTIC CalRegn01Cmn.FordMsg3CABusHiSpdLaneKeepSysReqdAgInvldFaildTiThd.Val "MICROSAR RTE" VALUE 0x0 RTE_RL_UWORD 0 NO_COMPU_METHOD 0 65535 SYMBOL_LINK "Rte_CalprmRom_CalRegn01Cmn_DEFAULT_RTE_CALPRM_GROUP.FordMsg3CABusHiSpdLaneKeepSysReqdAgInvldFaildTiThd_Val" 0 DISPLAY_IDENTIFIER CalRegn01Cmn.CalibrationPorts.FordMsg3CABusHiSpdLaneKeepSysReqdAgInvldFaildTiThd.Val /end CHARACTERISTIC
/begin CHARACTERISTIC CalRegn01Cmn.FordMsg3CABusHiSpdLaneKeepSysReqdAgInvldPassdTiThd.Val "MICROSAR RTE" VALUE 0x0 RTE_RL_UWORD 0 NO_COMPU_METHOD 0 65535 SYMBOL_LINK "Rte_CalprmRom_CalRegn01Cmn_DEFAULT_RTE_CALPRM_GROUP.FordMsg3CABusHiSpdLaneKeepSysReqdAgInvldPassdTiThd_Val" 0 DISPLAY_IDENTIFIER CalRegn01Cmn.CalibrationPorts.FordMsg3CABusHiSpdLaneKeepSysReqdAgInvldPassdTiThd.Val /end CHARACTERISTIC
/begin CHARACTERISTIC CalRegn01Cmn.FordMsg3CABusHiSpdMissMsgFaildTiThd.Val "MICROSAR RTE" VALUE 0x0 RTE_RL_UWORD 0 NO_COMPU_METHOD 0 65535 SYMBOL_LINK "Rte_CalprmRom_CalRegn01Cmn_DEFAULT_RTE_CALPRM_GROUP.FordMsg3CABusHiSpdMissMsgFaildTiThd_Val" 0 DISPLAY_IDENTIFIER CalRegn01Cmn.CalibrationPorts.FordMsg3CABusHiSpdMissMsgFaildTiThd.Val /end CHARACTERISTIC
/begin CHARACTERISTIC CalRegn01Cmn.FordMsg3CABusHiSpdMissMsgPassdTiThd.Val "MICROSAR RTE" VALUE 0x0 RTE_RL_UWORD 0 NO_COMPU_METHOD 0 65535 SYMBOL_LINK "Rte_CalprmRom_CalRegn01Cmn_DEFAULT_RTE_CALPRM_GROUP.FordMsg3CABusHiSpdMissMsgPassdTiThd_Val" 0 DISPLAY_IDENTIFIER CalRegn01Cmn.CalibrationPorts.FordMsg3CABusHiSpdMissMsgPassdTiThd.Val /end CHARACTERISTIC
/begin CHARACTERISTIC CalRegn01Cmn.FordMsg3D3BusHiSpdImgProcrModlAVldFaildThd.Val "MICROSAR RTE" VALUE 0x0 RTE_RL_UWORD 0 NO_COMPU_METHOD 0 65535 SYMBOL_LINK "Rte_CalprmRom_CalRegn01Cmn_DEFAULT_RTE_CALPRM_GROUP.FordMsg3D3BusHiSpdImgProcrModlAVldFaildThd_Val" 0 DISPLAY_IDENTIFIER CalRegn01Cmn.CalibrationPorts.FordMsg3D3BusHiSpdImgProcrModlAVldFaildThd.Val /end CHARACTERISTIC
/begin CHARACTERISTIC CalRegn01Cmn.FordMsg3D3BusHiSpdImgProcrModlAVldPassdThd.Val "MICROSAR RTE" VALUE 0x0 RTE_RL_UWORD 0 NO_COMPU_METHOD 0 65535 SYMBOL_LINK "Rte_CalprmRom_CalRegn01Cmn_DEFAULT_RTE_CALPRM_GROUP.FordMsg3D3BusHiSpdImgProcrModlAVldPassdThd_Val" 0 DISPLAY_IDENTIFIER CalRegn01Cmn.CalibrationPorts.FordMsg3D3BusHiSpdImgProcrModlAVldPassdThd.Val /end CHARACTERISTIC
/begin CHARACTERISTIC CalRegn01Cmn.FordMsg3D3BusHiSpdMissMsgFaildThd.Val "MICROSAR RTE" VALUE 0x0 RTE_RL_UWORD 0 NO_COMPU_METHOD 0 65535 SYMBOL_LINK "Rte_CalprmRom_CalRegn01Cmn_DEFAULT_RTE_CALPRM_GROUP.FordMsg3D3BusHiSpdMissMsgFaildThd_Val" 0 DISPLAY_IDENTIFIER CalRegn01Cmn.CalibrationPorts.FordMsg3D3BusHiSpdMissMsgFaildThd.Val /end CHARACTERISTIC
/begin CHARACTERISTIC CalRegn01Cmn.FordMsg3D3BusHiSpdMissMsgPassdThd.Val "MICROSAR RTE" VALUE 0x0 RTE_RL_UWORD 0 NO_COMPU_METHOD 0 65535 SYMBOL_LINK "Rte_CalprmRom_CalRegn01Cmn_DEFAULT_RTE_CALPRM_GROUP.FordMsg3D3BusHiSpdMissMsgPassdThd_Val" 0 DISPLAY_IDENTIFIER CalRegn01Cmn.CalibrationPorts.FordMsg3D3BusHiSpdMissMsgPassdThd.Val /end CHARACTERISTIC
/begin CHARACTERISTIC CalRegn01Cmn.FordMsg3D7BusHiSpdImgProcrModlAVldMissThd.Val "MICROSAR RTE" VALUE 0x0 RTE_RL_UWORD 0 NO_COMPU_METHOD 0 65535 SYMBOL_LINK "Rte_CalprmRom_CalRegn01Cmn_DEFAULT_RTE_CALPRM_GROUP.FordMsg3D7BusHiSpdImgProcrModlAVldMissThd_Val" 0 DISPLAY_IDENTIFIER CalRegn01Cmn.CalibrationPorts.FordMsg3D7BusHiSpdImgProcrModlAVldMissThd.Val /end CHARACTERISTIC
/begin CHARACTERISTIC CalRegn01Cmn.FordMsg3D7BusHiSpdImgProcrModlAVldPassdThd.Val "MICROSAR RTE" VALUE 0x0 RTE_RL_UWORD 0 NO_COMPU_METHOD 0 65535 SYMBOL_LINK "Rte_CalprmRom_CalRegn01Cmn_DEFAULT_RTE_CALPRM_GROUP.FordMsg3D7BusHiSpdImgProcrModlAVldPassdThd_Val" 0 DISPLAY_IDENTIFIER CalRegn01Cmn.CalibrationPorts.FordMsg3D7BusHiSpdImgProcrModlAVldPassdThd.Val /end CHARACTERISTIC
/begin CHARACTERISTIC CalRegn01Cmn.FordMsg3D7BusHiSpdLatDstInvldFaildThd.Val "MICROSAR RTE" VALUE 0x0 RTE_RL_UWORD 0 NO_COMPU_METHOD 0 65535 SYMBOL_LINK "Rte_CalprmRom_CalRegn01Cmn_DEFAULT_RTE_CALPRM_GROUP.FordMsg3D7BusHiSpdLatDstInvldFaildThd_Val" 0 DISPLAY_IDENTIFIER CalRegn01Cmn.CalibrationPorts.FordMsg3D7BusHiSpdLatDstInvldFaildThd.Val /end CHARACTERISTIC
/begin CHARACTERISTIC CalRegn01Cmn.FordMsg3D7BusHiSpdLatDstInvldPassdThd.Val "MICROSAR RTE" VALUE 0x0 RTE_RL_UWORD 0 NO_COMPU_METHOD 0 65535 SYMBOL_LINK "Rte_CalprmRom_CalRegn01Cmn_DEFAULT_RTE_CALPRM_GROUP.FordMsg3D7BusHiSpdLatDstInvldPassdThd_Val" 0 DISPLAY_IDENTIFIER CalRegn01Cmn.CalibrationPorts.FordMsg3D7BusHiSpdLatDstInvldPassdThd.Val /end CHARACTERISTIC
/begin CHARACTERISTIC CalRegn01Cmn.FordMsg3D7BusHiSpdLatDstRawVldFaildThd.Val "MICROSAR RTE" VALUE 0x0 RTE_RL_UWORD 0 NO_COMPU_METHOD 0 65535 SYMBOL_LINK "Rte_CalprmRom_CalRegn01Cmn_DEFAULT_RTE_CALPRM_GROUP.FordMsg3D7BusHiSpdLatDstRawVldFaildThd_Val" 0 DISPLAY_IDENTIFIER CalRegn01Cmn.CalibrationPorts.FordMsg3D7BusHiSpdLatDstRawVldFaildThd.Val /end CHARACTERISTIC
/begin CHARACTERISTIC CalRegn01Cmn.FordMsg3D7BusHiSpdLgtDstInvldFaildThd.Val "MICROSAR RTE" VALUE 0x0 RTE_RL_UWORD 0 NO_COMPU_METHOD 0 65535 SYMBOL_LINK "Rte_CalprmRom_CalRegn01Cmn_DEFAULT_RTE_CALPRM_GROUP.FordMsg3D7BusHiSpdLgtDstInvldFaildThd_Val" 0 DISPLAY_IDENTIFIER CalRegn01Cmn.CalibrationPorts.FordMsg3D7BusHiSpdLgtDstInvldFaildThd.Val /end CHARACTERISTIC
/begin CHARACTERISTIC CalRegn01Cmn.FordMsg3D7BusHiSpdLgtDstInvldPassdThd.Val "MICROSAR RTE" VALUE 0x0 RTE_RL_UWORD 0 NO_COMPU_METHOD 0 65535 SYMBOL_LINK "Rte_CalprmRom_CalRegn01Cmn_DEFAULT_RTE_CALPRM_GROUP.FordMsg3D7BusHiSpdLgtDstInvldPassdThd_Val" 0 DISPLAY_IDENTIFIER CalRegn01Cmn.CalibrationPorts.FordMsg3D7BusHiSpdLgtDstInvldPassdThd.Val /end CHARACTERISTIC
/begin CHARACTERISTIC CalRegn01Cmn.FordMsg3D7BusHiSpdLgtDstRawVldFaildThd.Val "MICROSAR RTE" VALUE 0x0 RTE_RL_UWORD 0 NO_COMPU_METHOD 0 65535 SYMBOL_LINK "Rte_CalprmRom_CalRegn01Cmn_DEFAULT_RTE_CALPRM_GROUP.FordMsg3D7BusHiSpdLgtDstRawVldFaildThd_Val" 0 DISPLAY_IDENTIFIER CalRegn01Cmn.CalibrationPorts.FordMsg3D7BusHiSpdLgtDstRawVldFaildThd.Val /end CHARACTERISTIC
/begin CHARACTERISTIC CalRegn01Cmn.FordMsg3D7BusHiSpdMissMsgFaildThd.Val "MICROSAR RTE" VALUE 0x0 RTE_RL_UWORD 0 NO_COMPU_METHOD 0 65535 SYMBOL_LINK "Rte_CalprmRom_CalRegn01Cmn_DEFAULT_RTE_CALPRM_GROUP.FordMsg3D7BusHiSpdMissMsgFaildThd_Val" 0 DISPLAY_IDENTIFIER CalRegn01Cmn.CalibrationPorts.FordMsg3D7BusHiSpdMissMsgFaildThd.Val /end CHARACTERISTIC
/begin CHARACTERISTIC CalRegn01Cmn.FordMsg3D7BusHiSpdMissMsgPassdThd.Val "MICROSAR RTE" VALUE 0x0 RTE_RL_UWORD 0 NO_COMPU_METHOD 0 65535 SYMBOL_LINK "Rte_CalprmRom_CalRegn01Cmn_DEFAULT_RTE_CALPRM_GROUP.FordMsg3D7BusHiSpdMissMsgPassdThd_Val" 0 DISPLAY_IDENTIFIER CalRegn01Cmn.CalibrationPorts.FordMsg3D7BusHiSpdMissMsgPassdThd.Val /end CHARACTERISTIC
/begin CHARACTERISTIC CalRegn01Cmn.FordMsg3D7BusHiSpdRelLatVelInvldFaildThd.Val "MICROSAR RTE" VALUE 0x0 RTE_RL_UWORD 0 NO_COMPU_METHOD 0 65535 SYMBOL_LINK "Rte_CalprmRom_CalRegn01Cmn_DEFAULT_RTE_CALPRM_GROUP.FordMsg3D7BusHiSpdRelLatVelInvldFaildThd_Val" 0 DISPLAY_IDENTIFIER CalRegn01Cmn.CalibrationPorts.FordMsg3D7BusHiSpdRelLatVelInvldFaildThd.Val /end CHARACTERISTIC
/begin CHARACTERISTIC CalRegn01Cmn.FordMsg3D7BusHiSpdRelLatVelInvldPassdThd.Val "MICROSAR RTE" VALUE 0x0 RTE_RL_UWORD 0 NO_COMPU_METHOD 0 65535 SYMBOL_LINK "Rte_CalprmRom_CalRegn01Cmn_DEFAULT_RTE_CALPRM_GROUP.FordMsg3D7BusHiSpdRelLatVelInvldPassdThd_Val" 0 DISPLAY_IDENTIFIER CalRegn01Cmn.CalibrationPorts.FordMsg3D7BusHiSpdRelLatVelInvldPassdThd.Val /end CHARACTERISTIC
/begin CHARACTERISTIC CalRegn01Cmn.FordMsg3D7BusHiSpdRelLatVelRawVldFaildThd.Val "MICROSAR RTE" VALUE 0x0 RTE_RL_UWORD 0 NO_COMPU_METHOD 0 65535 SYMBOL_LINK "Rte_CalprmRom_CalRegn01Cmn_DEFAULT_RTE_CALPRM_GROUP.FordMsg3D7BusHiSpdRelLatVelRawVldFaildThd_Val" 0 DISPLAY_IDENTIFIER CalRegn01Cmn.CalibrationPorts.FordMsg3D7BusHiSpdRelLatVelRawVldFaildThd.Val /end CHARACTERISTIC
/begin CHARACTERISTIC CalRegn01Cmn.FordMsg3D7BusHiSpdRelLgtVelInvldFaildThd.Val "MICROSAR RTE" VALUE 0x0 RTE_RL_UWORD 0 NO_COMPU_METHOD 0 65535 SYMBOL_LINK "Rte_CalprmRom_CalRegn01Cmn_DEFAULT_RTE_CALPRM_GROUP.FordMsg3D7BusHiSpdRelLgtVelInvldFaildThd_Val" 0 DISPLAY_IDENTIFIER CalRegn01Cmn.CalibrationPorts.FordMsg3D7BusHiSpdRelLgtVelInvldFaildThd.Val /end CHARACTERISTIC
/begin CHARACTERISTIC CalRegn01Cmn.FordMsg3D7BusHiSpdRelLgtVelInvldPassdThd.Val "MICROSAR RTE" VALUE 0x0 RTE_RL_UWORD 0 NO_COMPU_METHOD 0 65535 SYMBOL_LINK "Rte_CalprmRom_CalRegn01Cmn_DEFAULT_RTE_CALPRM_GROUP.FordMsg3D7BusHiSpdRelLgtVelInvldPassdThd_Val" 0 DISPLAY_IDENTIFIER CalRegn01Cmn.CalibrationPorts.FordMsg3D7BusHiSpdRelLgtVelInvldPassdThd.Val /end CHARACTERISTIC
/begin CHARACTERISTIC CalRegn01Cmn.FordMsg3D7BusHiSpdRelLgtVelRawVldFaildThd.Val "MICROSAR RTE" VALUE 0x0 RTE_RL_UWORD 0 NO_COMPU_METHOD 0 65535 SYMBOL_LINK "Rte_CalprmRom_CalRegn01Cmn_DEFAULT_RTE_CALPRM_GROUP.FordMsg3D7BusHiSpdRelLgtVelRawVldFaildThd_Val" 0 DISPLAY_IDENTIFIER CalRegn01Cmn.CalibrationPorts.FordMsg3D7BusHiSpdRelLgtVelRawVldFaildThd.Val /end CHARACTERISTIC
/begin CHARACTERISTIC CalRegn01Cmn.FordMsg3D7BusHiSpdTiToCllsnInvldFaildThd.Val "MICROSAR RTE" VALUE 0x0 RTE_RL_UWORD 0 NO_COMPU_METHOD 0 65535 SYMBOL_LINK "Rte_CalprmRom_CalRegn01Cmn_DEFAULT_RTE_CALPRM_GROUP.FordMsg3D7BusHiSpdTiToCllsnInvldFaildThd_Val" 0 DISPLAY_IDENTIFIER CalRegn01Cmn.CalibrationPorts.FordMsg3D7BusHiSpdTiToCllsnInvldFaildThd.Val /end CHARACTERISTIC
/begin CHARACTERISTIC CalRegn01Cmn.FordMsg3D7BusHiSpdTiToCllsnInvldPassdThd.Val "MICROSAR RTE" VALUE 0x0 RTE_RL_UWORD 0 NO_COMPU_METHOD 0 65535 SYMBOL_LINK "Rte_CalprmRom_CalRegn01Cmn_DEFAULT_RTE_CALPRM_GROUP.FordMsg3D7BusHiSpdTiToCllsnInvldPassdThd_Val" 0 DISPLAY_IDENTIFIER CalRegn01Cmn.CalibrationPorts.FordMsg3D7BusHiSpdTiToCllsnInvldPassdThd.Val /end CHARACTERISTIC
/begin CHARACTERISTIC CalRegn01Cmn.FordMsg3D7BusHiSpdTiToCllsnRawVldFaildThd.Val "MICROSAR RTE" VALUE 0x0 RTE_RL_UWORD 0 NO_COMPU_METHOD 0 65535 SYMBOL_LINK "Rte_CalprmRom_CalRegn01Cmn_DEFAULT_RTE_CALPRM_GROUP.FordMsg3D7BusHiSpdTiToCllsnRawVldFaildThd_Val" 0 DISPLAY_IDENTIFIER CalRegn01Cmn.CalibrationPorts.FordMsg3D7BusHiSpdTiToCllsnRawVldFaildThd.Val /end CHARACTERISTIC
/begin CHARACTERISTIC CalRegn01Cmn.FordMsg40ABusHiSpdMissMsgFaildThd.Val "MICROSAR RTE" VALUE 0x0 RTE_RL_UWORD 0 NO_COMPU_METHOD 0 65535 SYMBOL_LINK "Rte_CalprmRom_CalRegn01Cmn_DEFAULT_RTE_CALPRM_GROUP.FordMsg40ABusHiSpdMissMsgFaildThd_Val" 0 DISPLAY_IDENTIFIER CalRegn01Cmn.CalibrationPorts.FordMsg40ABusHiSpdMissMsgFaildThd.Val /end CHARACTERISTIC
/begin CHARACTERISTIC CalRegn01Cmn.FordMsg40ABusHiSpdMissMsgPassdThd.Val "MICROSAR RTE" VALUE 0x0 RTE_RL_UWORD 0 NO_COMPU_METHOD 0 65535 SYMBOL_LINK "Rte_CalprmRom_CalRegn01Cmn_DEFAULT_RTE_CALPRM_GROUP.FordMsg40ABusHiSpdMissMsgPassdThd_Val" 0 DISPLAY_IDENTIFIER CalRegn01Cmn.CalibrationPorts.FordMsg40ABusHiSpdMissMsgPassdThd.Val /end CHARACTERISTIC
/begin CHARACTERISTIC CalRegn01Cmn.FordMsg414BusHiSpdAgOffsVldFaildThd.Val "MICROSAR RTE" VALUE 0x0 RTE_RL_UWORD 0 NO_COMPU_METHOD 0 65535 SYMBOL_LINK "Rte_CalprmRom_CalRegn01Cmn_DEFAULT_RTE_CALPRM_GROUP.FordMsg414BusHiSpdAgOffsVldFaildThd_Val" 0 DISPLAY_IDENTIFIER CalRegn01Cmn.CalibrationPorts.FordMsg414BusHiSpdAgOffsVldFaildThd.Val /end CHARACTERISTIC
/begin CHARACTERISTIC CalRegn01Cmn.FordMsg414BusHiSpdAgOffsVldMissThd.Val "MICROSAR RTE" VALUE 0x0 RTE_RL_UWORD 0 NO_COMPU_METHOD 0 65535 SYMBOL_LINK "Rte_CalprmRom_CalRegn01Cmn_DEFAULT_RTE_CALPRM_GROUP.FordMsg414BusHiSpdAgOffsVldMissThd_Val" 0 DISPLAY_IDENTIFIER CalRegn01Cmn.CalibrationPorts.FordMsg414BusHiSpdAgOffsVldMissThd.Val /end CHARACTERISTIC
/begin CHARACTERISTIC CalRegn01Cmn.FordMsg414BusHiSpdAgOffsVldPassdThd.Val "MICROSAR RTE" VALUE 0x0 RTE_RL_UWORD 0 NO_COMPU_METHOD 0 65535 SYMBOL_LINK "Rte_CalprmRom_CalRegn01Cmn_DEFAULT_RTE_CALPRM_GROUP.FordMsg414BusHiSpdAgOffsVldPassdThd_Val" 0 DISPLAY_IDENTIFIER CalRegn01Cmn.CalibrationPorts.FordMsg414BusHiSpdAgOffsVldPassdThd.Val /end CHARACTERISTIC
/begin CHARACTERISTIC CalRegn01Cmn.FordMsg414BusHiSpdChksVldFaildThd.Val "MICROSAR RTE" VALUE 0x0 RTE_RL_UWORD 0 NO_COMPU_METHOD 0 65535 SYMBOL_LINK "Rte_CalprmRom_CalRegn01Cmn_DEFAULT_RTE_CALPRM_GROUP.FordMsg414BusHiSpdChksVldFaildThd_Val" 0 DISPLAY_IDENTIFIER CalRegn01Cmn.CalibrationPorts.FordMsg414BusHiSpdChksVldFaildThd.Val /end CHARACTERISTIC
/begin CHARACTERISTIC CalRegn01Cmn.FordMsg414BusHiSpdChksVldMissThd.Val "MICROSAR RTE" VALUE 0x0 RTE_RL_UWORD 0 NO_COMPU_METHOD 0 65535 SYMBOL_LINK "Rte_CalprmRom_CalRegn01Cmn_DEFAULT_RTE_CALPRM_GROUP.FordMsg414BusHiSpdChksVldMissThd_Val" 0 DISPLAY_IDENTIFIER CalRegn01Cmn.CalibrationPorts.FordMsg414BusHiSpdChksVldMissThd.Val /end CHARACTERISTIC
/begin CHARACTERISTIC CalRegn01Cmn.FordMsg414BusHiSpdCntrVldMissThd.Val "MICROSAR RTE" VALUE 0x0 RTE_RL_UWORD 0 NO_COMPU_METHOD 0 65535 SYMBOL_LINK "Rte_CalprmRom_CalRegn01Cmn_DEFAULT_RTE_CALPRM_GROUP.FordMsg414BusHiSpdCntrVldMissThd_Val" 0 DISPLAY_IDENTIFIER CalRegn01Cmn.CalibrationPorts.FordMsg414BusHiSpdCntrVldMissThd.Val /end CHARACTERISTIC
/begin CHARACTERISTIC CalRegn01Cmn.FordMsg415BusHiSpdBrkModlLoQlyVldFaildThd.Val "MICROSAR RTE" VALUE 0x0 RTE_RL_UWORD 0 NO_COMPU_METHOD 0 65535 SYMBOL_LINK "Rte_CalprmRom_CalRegn01Cmn_DEFAULT_RTE_CALPRM_GROUP.FordMsg415BusHiSpdBrkModlLoQlyVldFaildThd_Val" 0 DISPLAY_IDENTIFIER CalRegn01Cmn.CalibrationPorts.FordMsg415BusHiSpdBrkModlLoQlyVldFaildThd.Val /end CHARACTERISTIC
/begin CHARACTERISTIC CalRegn01Cmn.FordMsg415BusHiSpdBrkModlLoQlyVldMissThd.Val "MICROSAR RTE" VALUE 0x0 RTE_RL_UWORD 0 NO_COMPU_METHOD 0 65535 SYMBOL_LINK "Rte_CalprmRom_CalRegn01Cmn_DEFAULT_RTE_CALPRM_GROUP.FordMsg415BusHiSpdBrkModlLoQlyVldMissThd_Val" 0 DISPLAY_IDENTIFIER CalRegn01Cmn.CalibrationPorts.FordMsg415BusHiSpdBrkModlLoQlyVldMissThd.Val /end CHARACTERISTIC
/begin CHARACTERISTIC CalRegn01Cmn.FordMsg415BusHiSpdBrkModlLoQlyVldPassdThd.Val "MICROSAR RTE" VALUE 0x0 RTE_RL_UWORD 0 NO_COMPU_METHOD 0 65535 SYMBOL_LINK "Rte_CalprmRom_CalRegn01Cmn_DEFAULT_RTE_CALPRM_GROUP.FordMsg415BusHiSpdBrkModlLoQlyVldPassdThd_Val" 0 DISPLAY_IDENTIFIER CalRegn01Cmn.CalibrationPorts.FordMsg415BusHiSpdBrkModlLoQlyVldPassdThd.Val /end CHARACTERISTIC
/begin CHARACTERISTIC CalRegn01Cmn.FordMsg415BusHiSpdBrkModlVldFaildThd.Val "MICROSAR RTE" VALUE 0x0 RTE_RL_UWORD 0 NO_COMPU_METHOD 0 65535 SYMBOL_LINK "Rte_CalprmRom_CalRegn01Cmn_DEFAULT_RTE_CALPRM_GROUP.FordMsg415BusHiSpdBrkModlVldFaildThd_Val" 0 DISPLAY_IDENTIFIER CalRegn01Cmn.CalibrationPorts.FordMsg415BusHiSpdBrkModlVldFaildThd.Val /end CHARACTERISTIC
/begin CHARACTERISTIC CalRegn01Cmn.FordMsg415BusHiSpdBrkModlVldMissThd.Val "MICROSAR RTE" VALUE 0x0 RTE_RL_UWORD 0 NO_COMPU_METHOD 0 65535 SYMBOL_LINK "Rte_CalprmRom_CalRegn01Cmn_DEFAULT_RTE_CALPRM_GROUP.FordMsg415BusHiSpdBrkModlVldMissThd_Val" 0 DISPLAY_IDENTIFIER CalRegn01Cmn.CalibrationPorts.FordMsg415BusHiSpdBrkModlVldMissThd.Val /end CHARACTERISTIC
/begin CHARACTERISTIC CalRegn01Cmn.FordMsg415BusHiSpdBrkModlVldPassdThd.Val "MICROSAR RTE" VALUE 0x0 RTE_RL_UWORD 0 NO_COMPU_METHOD 0 65535 SYMBOL_LINK "Rte_CalprmRom_CalRegn01Cmn_DEFAULT_RTE_CALPRM_GROUP.FordMsg415BusHiSpdBrkModlVldPassdThd_Val" 0 DISPLAY_IDENTIFIER CalRegn01Cmn.CalibrationPorts.FordMsg415BusHiSpdBrkModlVldPassdThd.Val /end CHARACTERISTIC
/begin CHARACTERISTIC CalRegn01Cmn.FordMsg415BusHiSpdBrkSprtVldMissThd.Val "MICROSAR RTE" VALUE 0x0 RTE_RL_UWORD 0 NO_COMPU_METHOD 0 65535 SYMBOL_LINK "Rte_CalprmRom_CalRegn01Cmn_DEFAULT_RTE_CALPRM_GROUP.FordMsg415BusHiSpdBrkSprtVldMissThd_Val" 0 DISPLAY_IDENTIFIER CalRegn01Cmn.CalibrationPorts.FordMsg415BusHiSpdBrkSprtVldMissThd.Val /end CHARACTERISTIC
/begin CHARACTERISTIC CalRegn01Cmn.FordMsg415BusHiSpdBrkSprtVldPassdThd.Val "MICROSAR RTE" VALUE 0x0 RTE_RL_UWORD 0 NO_COMPU_METHOD 0 65535 SYMBOL_LINK "Rte_CalprmRom_CalRegn01Cmn_DEFAULT_RTE_CALPRM_GROUP.FordMsg415BusHiSpdBrkSprtVldPassdThd_Val" 0 DISPLAY_IDENTIFIER CalRegn01Cmn.CalibrationPorts.FordMsg415BusHiSpdBrkSprtVldPassdThd.Val /end CHARACTERISTIC
/begin CHARACTERISTIC CalRegn01Cmn.FordMsg415BusHiSpdChksBrkModlInvldFaildThd.Val "MICROSAR RTE" VALUE 0x0 RTE_RL_UWORD 0 NO_COMPU_METHOD 0 65535 SYMBOL_LINK "Rte_CalprmRom_CalRegn01Cmn_DEFAULT_RTE_CALPRM_GROUP.FordMsg415BusHiSpdChksBrkModlInvldFaildThd_Val" 0 DISPLAY_IDENTIFIER CalRegn01Cmn.CalibrationPorts.FordMsg415BusHiSpdChksBrkModlInvldFaildThd.Val /end CHARACTERISTIC
/begin CHARACTERISTIC CalRegn01Cmn.FordMsg415BusHiSpdChksBrkModlInvldPassdThd.Val "MICROSAR RTE" VALUE 0x0 RTE_RL_UWORD 0 NO_COMPU_METHOD 0 65535 SYMBOL_LINK "Rte_CalprmRom_CalRegn01Cmn_DEFAULT_RTE_CALPRM_GROUP.FordMsg415BusHiSpdChksBrkModlInvldPassdThd_Val" 0 DISPLAY_IDENTIFIER CalRegn01Cmn.CalibrationPorts.FordMsg415BusHiSpdChksBrkModlInvldPassdThd.Val /end CHARACTERISTIC
/begin CHARACTERISTIC CalRegn01Cmn.FordMsg415BusHiSpdCntrBrkModlInvldFaildThd.Val "MICROSAR RTE" VALUE 0x0 RTE_RL_UWORD 0 NO_COMPU_METHOD 0 65535 SYMBOL_LINK "Rte_CalprmRom_CalRegn01Cmn_DEFAULT_RTE_CALPRM_GROUP.FordMsg415BusHiSpdCntrBrkModlInvldFaildThd_Val" 0 DISPLAY_IDENTIFIER CalRegn01Cmn.CalibrationPorts.FordMsg415BusHiSpdCntrBrkModlInvldFaildThd.Val /end CHARACTERISTIC
/begin CHARACTERISTIC CalRegn01Cmn.FordMsg415BusHiSpdCntrBrkModlInvldPassdThd.Val "MICROSAR RTE" VALUE 0x0 RTE_RL_UWORD 0 NO_COMPU_METHOD 0 65535 SYMBOL_LINK "Rte_CalprmRom_CalRegn01Cmn_DEFAULT_RTE_CALPRM_GROUP.FordMsg415BusHiSpdCntrBrkModlInvldPassdThd_Val" 0 DISPLAY_IDENTIFIER CalRegn01Cmn.CalibrationPorts.FordMsg415BusHiSpdCntrBrkModlInvldPassdThd.Val /end CHARACTERISTIC
/begin CHARACTERISTIC CalRegn01Cmn.FordMsg415BusHiSpdMissMsgFaildThd.Val "MICROSAR RTE" VALUE 0x0 RTE_RL_UWORD 0 NO_COMPU_METHOD 0 65535 SYMBOL_LINK "Rte_CalprmRom_CalRegn01Cmn_DEFAULT_RTE_CALPRM_GROUP.FordMsg415BusHiSpdMissMsgFaildThd_Val" 0 DISPLAY_IDENTIFIER CalRegn01Cmn.CalibrationPorts.FordMsg415BusHiSpdMissMsgFaildThd.Val /end CHARACTERISTIC
/begin CHARACTERISTIC CalRegn01Cmn.FordMsg415BusHiSpdMissMsgPassdThd.Val "MICROSAR RTE" VALUE 0x0 RTE_RL_UWORD 0 NO_COMPU_METHOD 0 65535 SYMBOL_LINK "Rte_CalprmRom_CalRegn01Cmn_DEFAULT_RTE_CALPRM_GROUP.FordMsg415BusHiSpdMissMsgPassdThd_Val" 0 DISPLAY_IDENTIFIER CalRegn01Cmn.CalibrationPorts.FordMsg415BusHiSpdMissMsgPassdThd.Val /end CHARACTERISTIC
/begin CHARACTERISTIC CalRegn01Cmn.FordMsg415BusHiSpdQlyFacBrkModlInvldFaildThd.Val "MICROSAR RTE" VALUE 0x0 RTE_RL_UWORD 0 NO_COMPU_METHOD 0 65535 SYMBOL_LINK "Rte_CalprmRom_CalRegn01Cmn_DEFAULT_RTE_CALPRM_GROUP.FordMsg415BusHiSpdQlyFacBrkModlInvldFaildThd_Val" 0 DISPLAY_IDENTIFIER CalRegn01Cmn.CalibrationPorts.FordMsg415BusHiSpdQlyFacBrkModlInvldFaildThd.Val /end CHARACTERISTIC
/begin CHARACTERISTIC CalRegn01Cmn.FordMsg415BusHiSpdQlyFacBrkModlInvldSigPassdThd.Val "MICROSAR RTE" VALUE 0x0 RTE_RL_UWORD 0 NO_COMPU_METHOD 0 65535 SYMBOL_LINK "Rte_CalprmRom_CalRegn01Cmn_DEFAULT_RTE_CALPRM_GROUP.FordMsg415BusHiSpdQlyFacBrkModlInvldSigPassdThd_Val" 0 DISPLAY_IDENTIFIER CalRegn01Cmn.CalibrationPorts.FordMsg415BusHiSpdQlyFacBrkModlInvldSigPassdThd.Val /end CHARACTERISTIC
/begin CHARACTERISTIC CalRegn01Cmn.FordMsg41ABusHiSpdMissMsgFaildThd.Val "MICROSAR RTE" VALUE 0x0 RTE_RL_UWORD 0 NO_COMPU_METHOD 0 65535 SYMBOL_LINK "Rte_CalprmRom_CalRegn01Cmn_DEFAULT_RTE_CALPRM_GROUP.FordMsg41ABusHiSpdMissMsgFaildThd_Val" 0 DISPLAY_IDENTIFIER CalRegn01Cmn.CalibrationPorts.FordMsg41ABusHiSpdMissMsgFaildThd.Val /end CHARACTERISTIC
/begin CHARACTERISTIC CalRegn01Cmn.FordMsg41ABusHiSpdMissMsgPassdThd.Val "MICROSAR RTE" VALUE 0x0 RTE_RL_UWORD 0 NO_COMPU_METHOD 0 65535 SYMBOL_LINK "Rte_CalprmRom_CalRegn01Cmn_DEFAULT_RTE_CALPRM_GROUP.FordMsg41ABusHiSpdMissMsgPassdThd_Val" 0 DISPLAY_IDENTIFIER CalRegn01Cmn.CalibrationPorts.FordMsg41ABusHiSpdMissMsgPassdThd.Val /end CHARACTERISTIC
/begin CHARACTERISTIC CalRegn01Cmn.FordMsg41EBusHiSpdChassisVldMissFaildThd.Val "MICROSAR RTE" VALUE 0x0 RTE_RL_UWORD 0 NO_COMPU_METHOD 0 65535 SYMBOL_LINK "Rte_CalprmRom_CalRegn01Cmn_DEFAULT_RTE_CALPRM_GROUP.FordMsg41EBusHiSpdChassisVldMissFaildThd_Val" 0 DISPLAY_IDENTIFIER CalRegn01Cmn.CalibrationPorts.FordMsg41EBusHiSpdChassisVldMissFaildThd.Val /end CHARACTERISTIC
/begin CHARACTERISTIC CalRegn01Cmn.FordMsg41EBusHiSpdChassisVldSigFaildThd.Val "MICROSAR RTE" VALUE 0x0 RTE_RL_UWORD 0 NO_COMPU_METHOD 0 65535 SYMBOL_LINK "Rte_CalprmRom_CalRegn01Cmn_DEFAULT_RTE_CALPRM_GROUP.FordMsg41EBusHiSpdChassisVldSigFaildThd_Val" 0 DISPLAY_IDENTIFIER CalRegn01Cmn.CalibrationPorts.FordMsg41EBusHiSpdChassisVldSigFaildThd.Val /end CHARACTERISTIC
/begin CHARACTERISTIC CalRegn01Cmn.FordMsg41EBusHiSpdChassisVldSigPassdThd.Val "MICROSAR RTE" VALUE 0x0 RTE_RL_UWORD 0 NO_COMPU_METHOD 0 65535 SYMBOL_LINK "Rte_CalprmRom_CalRegn01Cmn_DEFAULT_RTE_CALPRM_GROUP.FordMsg41EBusHiSpdChassisVldSigPassdThd_Val" 0 DISPLAY_IDENTIFIER CalRegn01Cmn.CalibrationPorts.FordMsg41EBusHiSpdChassisVldSigPassdThd.Val /end CHARACTERISTIC
/begin CHARACTERISTIC CalRegn01Cmn.FordMsg41EBusHiSpdInvldMsgFaildThd.Val "MICROSAR RTE" VALUE 0x0 RTE_RL_UWORD 0 NO_COMPU_METHOD 0 65535 SYMBOL_LINK "Rte_CalprmRom_CalRegn01Cmn_DEFAULT_RTE_CALPRM_GROUP.FordMsg41EBusHiSpdInvldMsgFaildThd_Val" 0 DISPLAY_IDENTIFIER CalRegn01Cmn.CalibrationPorts.FordMsg41EBusHiSpdInvldMsgFaildThd.Val /end CHARACTERISTIC
/begin CHARACTERISTIC CalRegn01Cmn.FordMsg41EBusHiSpdInvldMsgPassdThd.Val "MICROSAR RTE" VALUE 0x0 RTE_RL_UWORD 0 NO_COMPU_METHOD 0 65535 SYMBOL_LINK "Rte_CalprmRom_CalRegn01Cmn_DEFAULT_RTE_CALPRM_GROUP.FordMsg41EBusHiSpdInvldMsgPassdThd_Val" 0 DISPLAY_IDENTIFIER CalRegn01Cmn.CalibrationPorts.FordMsg41EBusHiSpdInvldMsgPassdThd.Val /end CHARACTERISTIC
/begin CHARACTERISTIC CalRegn01Cmn.FordMsg41EBusHiSpdMissMsgFaildThd.Val "MICROSAR RTE" VALUE 0x0 RTE_RL_UWORD 0 NO_COMPU_METHOD 0 65535 SYMBOL_LINK "Rte_CalprmRom_CalRegn01Cmn_DEFAULT_RTE_CALPRM_GROUP.FordMsg41EBusHiSpdMissMsgFaildThd_Val" 0 DISPLAY_IDENTIFIER CalRegn01Cmn.CalibrationPorts.FordMsg41EBusHiSpdMissMsgFaildThd.Val /end CHARACTERISTIC
/begin CHARACTERISTIC CalRegn01Cmn.FordMsg41EBusHiSpdMissMsgPassdThd.Val "MICROSAR RTE" VALUE 0x0 RTE_RL_UWORD 0 NO_COMPU_METHOD 0 65535 SYMBOL_LINK "Rte_CalprmRom_CalRegn01Cmn_DEFAULT_RTE_CALPRM_GROUP.FordMsg41EBusHiSpdMissMsgPassdThd_Val" 0 DISPLAY_IDENTIFIER CalRegn01Cmn.CalibrationPorts.FordMsg41EBusHiSpdMissMsgPassdThd.Val /end CHARACTERISTIC
/begin CHARACTERISTIC CalRegn01Cmn.FordMsg430BusHiSpdMissMsgFaildThd.Val "MICROSAR RTE" VALUE 0x0 RTE_RL_UWORD 0 NO_COMPU_METHOD 0 65535 SYMBOL_LINK "Rte_CalprmRom_CalRegn01Cmn_DEFAULT_RTE_CALPRM_GROUP.FordMsg430BusHiSpdMissMsgFaildThd_Val" 0 DISPLAY_IDENTIFIER CalRegn01Cmn.CalibrationPorts.FordMsg430BusHiSpdMissMsgFaildThd.Val /end CHARACTERISTIC
/begin CHARACTERISTIC CalRegn01Cmn.FordMsg430BusHiSpdMissMsgPassdThd.Val "MICROSAR RTE" VALUE 0x0 RTE_RL_UWORD 0 NO_COMPU_METHOD 0 65535 SYMBOL_LINK "Rte_CalprmRom_CalRegn01Cmn_DEFAULT_RTE_CALPRM_GROUP.FordMsg430BusHiSpdMissMsgPassdThd_Val" 0 DISPLAY_IDENTIFIER CalRegn01Cmn.CalibrationPorts.FordMsg430BusHiSpdMissMsgPassdThd.Val /end CHARACTERISTIC
/begin CHARACTERISTIC CalRegn01Cmn.FordMsg443BusHiSpdMissMsgFaildThd.Val "MICROSAR RTE" VALUE 0x0 RTE_RL_UWORD 0 NO_COMPU_METHOD 0 65535 SYMBOL_LINK "Rte_CalprmRom_CalRegn01Cmn_DEFAULT_RTE_CALPRM_GROUP.FordMsg443BusHiSpdMissMsgFaildThd_Val" 0 DISPLAY_IDENTIFIER CalRegn01Cmn.CalibrationPorts.FordMsg443BusHiSpdMissMsgFaildThd.Val /end CHARACTERISTIC
/begin CHARACTERISTIC CalRegn01Cmn.FordMsg443BusHiSpdMissMsgPassdThd.Val "MICROSAR RTE" VALUE 0x0 RTE_RL_UWORD 0 NO_COMPU_METHOD 0 65535 SYMBOL_LINK "Rte_CalprmRom_CalRegn01Cmn_DEFAULT_RTE_CALPRM_GROUP.FordMsg443BusHiSpdMissMsgPassdThd_Val" 0 DISPLAY_IDENTIFIER CalRegn01Cmn.CalibrationPorts.FordMsg443BusHiSpdMissMsgPassdThd.Val /end CHARACTERISTIC
/begin CHARACTERISTIC CalRegn01Cmn.FordMsg459BusHiSpdDiagMsgMissTmrThd.Val "MICROSAR RTE" VALUE 0x0 RTE_RL_UWORD 0 NO_COMPU_METHOD 0 65535 SYMBOL_LINK "Rte_CalprmRom_CalRegn01Cmn_DEFAULT_RTE_CALPRM_GROUP.FordMsg459BusHiSpdDiagMsgMissTmrThd_Val" 0 DISPLAY_IDENTIFIER CalRegn01Cmn.CalibrationPorts.FordMsg459BusHiSpdDiagMsgMissTmrThd.Val /end CHARACTERISTIC
/begin CHARACTERISTIC CalRegn01Cmn.FordMsg459BusHiSpdHitchAgInvldFaildThd.Val "MICROSAR RTE" VALUE 0x0 RTE_RL_UWORD 0 NO_COMPU_METHOD 0 65535 SYMBOL_LINK "Rte_CalprmRom_CalRegn01Cmn_DEFAULT_RTE_CALPRM_GROUP.FordMsg459BusHiSpdHitchAgInvldFaildThd_Val" 0 DISPLAY_IDENTIFIER CalRegn01Cmn.CalibrationPorts.FordMsg459BusHiSpdHitchAgInvldFaildThd.Val /end CHARACTERISTIC
/begin CHARACTERISTIC CalRegn01Cmn.FordMsg459BusHiSpdHitchAgInvldPassdThd.Val "MICROSAR RTE" VALUE 0x0 RTE_RL_UWORD 0 NO_COMPU_METHOD 0 65535 SYMBOL_LINK "Rte_CalprmRom_CalRegn01Cmn_DEFAULT_RTE_CALPRM_GROUP.FordMsg459BusHiSpdHitchAgInvldPassdThd_Val" 0 DISPLAY_IDENTIFIER CalRegn01Cmn.CalibrationPorts.FordMsg459BusHiSpdHitchAgInvldPassdThd.Val /end CHARACTERISTIC
/begin CHARACTERISTIC CalRegn01Cmn.FordMsg459BusHiSpdHitchAgRateInvldFaildThd.Val "MICROSAR RTE" VALUE 0x0 RTE_RL_UWORD 0 NO_COMPU_METHOD 0 65535 SYMBOL_LINK "Rte_CalprmRom_CalRegn01Cmn_DEFAULT_RTE_CALPRM_GROUP.FordMsg459BusHiSpdHitchAgRateInvldFaildThd_Val" 0 DISPLAY_IDENTIFIER CalRegn01Cmn.CalibrationPorts.FordMsg459BusHiSpdHitchAgRateInvldFaildThd.Val /end CHARACTERISTIC
/begin CHARACTERISTIC CalRegn01Cmn.FordMsg459BusHiSpdHitchAgRateInvldPassdThd.Val "MICROSAR RTE" VALUE 0x0 RTE_RL_UWORD 0 NO_COMPU_METHOD 0 65535 SYMBOL_LINK "Rte_CalprmRom_CalRegn01Cmn_DEFAULT_RTE_CALPRM_GROUP.FordMsg459BusHiSpdHitchAgRateInvldPassdThd_Val" 0 DISPLAY_IDENTIFIER CalRegn01Cmn.CalibrationPorts.FordMsg459BusHiSpdHitchAgRateInvldPassdThd.Val /end CHARACTERISTIC
/begin CHARACTERISTIC CalRegn01Cmn.FordMsg459BusHiSpdPrsntFlgMsgMissTmrThd.Val "MICROSAR RTE" VALUE 0x0 RTE_RL_UWORD 0 NO_COMPU_METHOD 0 65535 SYMBOL_LINK "Rte_CalprmRom_CalRegn01Cmn_DEFAULT_RTE_CALPRM_GROUP.FordMsg459BusHiSpdPrsntFlgMsgMissTmrThd_Val" 0 DISPLAY_IDENTIFIER CalRegn01Cmn.CalibrationPorts.FordMsg459BusHiSpdPrsntFlgMsgMissTmrThd.Val /end CHARACTERISTIC
/begin CHARACTERISTIC CalRegn01Cmn.FordMsg459BusHiSpdRcvrDiagMsgMissTmrThd.Val "MICROSAR RTE" VALUE 0x0 RTE_RL_UWORD 0 NO_COMPU_METHOD 0 65535 SYMBOL_LINK "Rte_CalprmRom_CalRegn01Cmn_DEFAULT_RTE_CALPRM_GROUP.FordMsg459BusHiSpdRcvrDiagMsgMissTmrThd_Val" 0 DISPLAY_IDENTIFIER CalRegn01Cmn.CalibrationPorts.FordMsg459BusHiSpdRcvrDiagMsgMissTmrThd.Val /end CHARACTERISTIC
/begin CHARACTERISTIC CalRegn01Cmn.FordMsg459BusHiSpdRcvrPrsntFlgTmrThd.Val "MICROSAR RTE" VALUE 0x0 RTE_RL_UWORD 0 NO_COMPU_METHOD 0 65535 SYMBOL_LINK "Rte_CalprmRom_CalRegn01Cmn_DEFAULT_RTE_CALPRM_GROUP.FordMsg459BusHiSpdRcvrPrsntFlgTmrThd_Val" 0 DISPLAY_IDENTIFIER CalRegn01Cmn.CalibrationPorts.FordMsg459BusHiSpdRcvrPrsntFlgTmrThd.Val /end CHARACTERISTIC
/begin CHARACTERISTIC CalRegn01Cmn.FordMsg459BusHiSpdTrackStInvldFaildThd.Val "MICROSAR RTE" VALUE 0x0 RTE_RL_UWORD 0 NO_COMPU_METHOD 0 65535 SYMBOL_LINK "Rte_CalprmRom_CalRegn01Cmn_DEFAULT_RTE_CALPRM_GROUP.FordMsg459BusHiSpdTrackStInvldFaildThd_Val" 0 DISPLAY_IDENTIFIER CalRegn01Cmn.CalibrationPorts.FordMsg459BusHiSpdTrackStInvldFaildThd.Val /end CHARACTERISTIC
/begin CHARACTERISTIC CalRegn01Cmn.FordMsg459BusHiSpdTrackStInvldPassdThd.Val "MICROSAR RTE" VALUE 0x0 RTE_RL_UWORD 0 NO_COMPU_METHOD 0 65535 SYMBOL_LINK "Rte_CalprmRom_CalRegn01Cmn_DEFAULT_RTE_CALPRM_GROUP.FordMsg459BusHiSpdTrackStInvldPassdThd_Val" 0 DISPLAY_IDENTIFIER CalRegn01Cmn.CalibrationPorts.FordMsg459BusHiSpdTrackStInvldPassdThd.Val /end CHARACTERISTIC
/begin CHARACTERISTIC CalRegn01Cmn.FordMsg459BusHiSpdTrlrHitchAgVldInvldMsgThd.Val "MICROSAR RTE" VALUE 0x0 RTE_RL_UWORD 0 NO_COMPU_METHOD 0 65535 SYMBOL_LINK "Rte_CalprmRom_CalRegn01Cmn_DEFAULT_RTE_CALPRM_GROUP.FordMsg459BusHiSpdTrlrHitchAgVldInvldMsgThd_Val" 0 DISPLAY_IDENTIFIER CalRegn01Cmn.CalibrationPorts.FordMsg459BusHiSpdTrlrHitchAgVldInvldMsgThd.Val /end CHARACTERISTIC
/begin CHARACTERISTIC CalRegn01Cmn.FordMsg459BusHiSpdTrlrHitchAgVldMissMsgThd.Val "MICROSAR RTE" VALUE 0x0 RTE_RL_UWORD 0 NO_COMPU_METHOD 0 65535 SYMBOL_LINK "Rte_CalprmRom_CalRegn01Cmn_DEFAULT_RTE_CALPRM_GROUP.FordMsg459BusHiSpdTrlrHitchAgVldMissMsgThd_Val" 0 DISPLAY_IDENTIFIER CalRegn01Cmn.CalibrationPorts.FordMsg459BusHiSpdTrlrHitchAgVldMissMsgThd.Val /end CHARACTERISTIC
/begin CHARACTERISTIC CalRegn01Cmn.FordMsg459BusHiSpdTrlrHitchRateVldInvldMsgThd.Val "MICROSAR RTE" VALUE 0x0 RTE_RL_UWORD 0 NO_COMPU_METHOD 0 65535 SYMBOL_LINK "Rte_CalprmRom_CalRegn01Cmn_DEFAULT_RTE_CALPRM_GROUP.FordMsg459BusHiSpdTrlrHitchRateVldInvldMsgThd_Val" 0 DISPLAY_IDENTIFIER CalRegn01Cmn.CalibrationPorts.FordMsg459BusHiSpdTrlrHitchRateVldInvldMsgThd.Val /end CHARACTERISTIC
/begin CHARACTERISTIC CalRegn01Cmn.FordMsg459BusHiSpdTrlrHitchRateVldMissMsgThd.Val "MICROSAR RTE" VALUE 0x0 RTE_RL_UWORD 0 NO_COMPU_METHOD 0 65535 SYMBOL_LINK "Rte_CalprmRom_CalRegn01Cmn_DEFAULT_RTE_CALPRM_GROUP.FordMsg459BusHiSpdTrlrHitchRateVldMissMsgThd_Val" 0 DISPLAY_IDENTIFIER CalRegn01Cmn.CalibrationPorts.FordMsg459BusHiSpdTrlrHitchRateVldMissMsgThd.Val /end CHARACTERISTIC
/begin CHARACTERISTIC CalRegn01Cmn.FordMsg459BusHiSpdTrlrRcvrHitchAgVldThd.Val "MICROSAR RTE" VALUE 0x0 RTE_RL_UWORD 0 NO_COMPU_METHOD 0 65535 SYMBOL_LINK "Rte_CalprmRom_CalRegn01Cmn_DEFAULT_RTE_CALPRM_GROUP.FordMsg459BusHiSpdTrlrRcvrHitchAgVldThd_Val" 0 DISPLAY_IDENTIFIER CalRegn01Cmn.CalibrationPorts.FordMsg459BusHiSpdTrlrRcvrHitchAgVldThd.Val /end CHARACTERISTIC
/begin CHARACTERISTIC CalRegn01Cmn.FordMsg459BusHiSpdTrlrRcvrHitchRateVldThd.Val "MICROSAR RTE" VALUE 0x0 RTE_RL_UWORD 0 NO_COMPU_METHOD 0 65535 SYMBOL_LINK "Rte_CalprmRom_CalRegn01Cmn_DEFAULT_RTE_CALPRM_GROUP.FordMsg459BusHiSpdTrlrRcvrHitchRateVldThd_Val" 0 DISPLAY_IDENTIFIER CalRegn01Cmn.CalibrationPorts.FordMsg459BusHiSpdTrlrRcvrHitchRateVldThd.Val /end CHARACTERISTIC
/begin CHARACTERISTIC CalRegn01Cmn.FordMsg459BusHiSpdTrlrRcvrTarVldThd.Val "MICROSAR RTE" VALUE 0x0 RTE_RL_UWORD 0 NO_COMPU_METHOD 0 65535 SYMBOL_LINK "Rte_CalprmRom_CalRegn01Cmn_DEFAULT_RTE_CALPRM_GROUP.FordMsg459BusHiSpdTrlrRcvrTarVldThd_Val" 0 DISPLAY_IDENTIFIER CalRegn01Cmn.CalibrationPorts.FordMsg459BusHiSpdTrlrRcvrTarVldThd.Val /end CHARACTERISTIC
/begin CHARACTERISTIC CalRegn01Cmn.FordMsg459BusHiSpdTrlrRcvrTrackStVldThd.Val "MICROSAR RTE" VALUE 0x0 RTE_RL_UWORD 0 NO_COMPU_METHOD 0 65535 SYMBOL_LINK "Rte_CalprmRom_CalRegn01Cmn_DEFAULT_RTE_CALPRM_GROUP.FordMsg459BusHiSpdTrlrRcvrTrackStVldThd_Val" 0 DISPLAY_IDENTIFIER CalRegn01Cmn.CalibrationPorts.FordMsg459BusHiSpdTrlrRcvrTrackStVldThd.Val /end CHARACTERISTIC
/begin CHARACTERISTIC CalRegn01Cmn.FordMsg459BusHiSpdTrlrTarVldMissMsgThd.Val "MICROSAR RTE" VALUE 0x0 RTE_RL_UWORD 0 NO_COMPU_METHOD 0 65535 SYMBOL_LINK "Rte_CalprmRom_CalRegn01Cmn_DEFAULT_RTE_CALPRM_GROUP.FordMsg459BusHiSpdTrlrTarVldMissMsgThd_Val" 0 DISPLAY_IDENTIFIER CalRegn01Cmn.CalibrationPorts.FordMsg459BusHiSpdTrlrTarVldMissMsgThd.Val /end CHARACTERISTIC
/begin CHARACTERISTIC CalRegn01Cmn.FordMsg459BusHiSpdTrlrTrackStVldInvldMsgThd.Val "MICROSAR RTE" VALUE 0x0 RTE_RL_UWORD 0 NO_COMPU_METHOD 0 65535 SYMBOL_LINK "Rte_CalprmRom_CalRegn01Cmn_DEFAULT_RTE_CALPRM_GROUP.FordMsg459BusHiSpdTrlrTrackStVldInvldMsgThd_Val" 0 DISPLAY_IDENTIFIER CalRegn01Cmn.CalibrationPorts.FordMsg459BusHiSpdTrlrTrackStVldInvldMsgThd.Val /end CHARACTERISTIC
/begin CHARACTERISTIC CalRegn01Cmn.FordMsg459BusHiSpdTrlrTrackStVldMissMsgThd.Val "MICROSAR RTE" VALUE 0x0 RTE_RL_UWORD 0 NO_COMPU_METHOD 0 65535 SYMBOL_LINK "Rte_CalprmRom_CalRegn01Cmn_DEFAULT_RTE_CALPRM_GROUP.FordMsg459BusHiSpdTrlrTrackStVldMissMsgThd_Val" 0 DISPLAY_IDENTIFIER CalRegn01Cmn.CalibrationPorts.FordMsg459BusHiSpdTrlrTrackStVldMissMsgThd.Val /end CHARACTERISTIC
/begin CHARACTERISTIC CalRegn01Cmn.FordMsg47ABusHiSpdMissMsgFaildTiThd.Val "MICROSAR RTE" VALUE 0x0 RTE_RL_UWORD 0 NO_COMPU_METHOD 0 65535 SYMBOL_LINK "Rte_CalprmRom_CalRegn01Cmn_DEFAULT_RTE_CALPRM_GROUP.FordMsg47ABusHiSpdMissMsgFaildTiThd_Val" 0 DISPLAY_IDENTIFIER CalRegn01Cmn.CalibrationPorts.FordMsg47ABusHiSpdMissMsgFaildTiThd.Val /end CHARACTERISTIC
/begin CHARACTERISTIC CalRegn01Cmn.FordMsg47ABusHiSpdMissMsgPassdTiThd.Val "MICROSAR RTE" VALUE 0x0 RTE_RL_UWORD 0 NO_COMPU_METHOD 0 65535 SYMBOL_LINK "Rte_CalprmRom_CalRegn01Cmn_DEFAULT_RTE_CALPRM_GROUP.FordMsg47ABusHiSpdMissMsgPassdTiThd_Val" 0 DISPLAY_IDENTIFIER CalRegn01Cmn.CalibrationPorts.FordMsg47ABusHiSpdMissMsgPassdTiThd.Val /end CHARACTERISTIC
/begin CHARACTERISTIC CalRegn01Cmn.FordMsg47ABusHiSpdTrlrAidKnobBtnFaildTiThd.Val "MICROSAR RTE" VALUE 0x0 RTE_RL_UWORD 0 NO_COMPU_METHOD 0 65535 SYMBOL_LINK "Rte_CalprmRom_CalRegn01Cmn_DEFAULT_RTE_CALPRM_GROUP.FordMsg47ABusHiSpdTrlrAidKnobBtnFaildTiThd_Val" 0 DISPLAY_IDENTIFIER CalRegn01Cmn.CalibrationPorts.FordMsg47ABusHiSpdTrlrAidKnobBtnFaildTiThd.Val /end CHARACTERISTIC
/begin CHARACTERISTIC CalRegn01Cmn.FordMsg47ABusHiSpdTrlrAidKnobBtnInvldPassdTiThd.Val "MICROSAR RTE" VALUE 0x0 RTE_RL_UWORD 0 NO_COMPU_METHOD 0 65535 SYMBOL_LINK "Rte_CalprmRom_CalRegn01Cmn_DEFAULT_RTE_CALPRM_GROUP.FordMsg47ABusHiSpdTrlrAidKnobBtnInvldPassdTiThd_Val" 0 DISPLAY_IDENTIFIER CalRegn01Cmn.CalibrationPorts.FordMsg47ABusHiSpdTrlrAidKnobBtnInvldPassdTiThd.Val /end CHARACTERISTIC
/begin CHARACTERISTIC CalRegn01Cmn.FordMsg47ABusHiSpdTrlrAidKnobBtnMissTiThd.Val "MICROSAR RTE" VALUE 0x0 RTE_RL_UWORD 0 NO_COMPU_METHOD 0 65535 SYMBOL_LINK "Rte_CalprmRom_CalRegn01Cmn_DEFAULT_RTE_CALPRM_GROUP.FordMsg47ABusHiSpdTrlrAidKnobBtnMissTiThd_Val" 0 DISPLAY_IDENTIFIER CalRegn01Cmn.CalibrationPorts.FordMsg47ABusHiSpdTrlrAidKnobBtnMissTiThd.Val /end CHARACTERISTIC
/begin GROUP CalRegn01Cmn.DutyCycThermProtnLstTblValNonStall.Ary2D "MICROSAR RTE" /begin SUB_GROUP /end SUB_GROUP /begin FUNCTION_LIST /end FUNCTION_LIST /begin REF_CHARACTERISTIC CalRegn01Cmn.DutyCycThermProtnLstTblValNonStall.Ary2D /end REF_CHARACTERISTIC /begin REF_MEASUREMENT /end REF_MEASUREMENT /end GROUP
/begin GROUP CalRegn01Cmn.DutyCycThermProtnLstTblValStall.Ary2D "MICROSAR RTE" /begin SUB_GROUP /end SUB_GROUP /begin FUNCTION_LIST /end FUNCTION_LIST /begin REF_CHARACTERISTIC CalRegn01Cmn.DutyCycThermProtnLstTblValStall.Ary2D /end REF_CHARACTERISTIC /begin REF_MEASUREMENT /end REF_MEASUREMENT /end GROUP
/begin GROUP CalRegn01Cmn.DutyCycThermProtnMotPrTSeln.Logl "MICROSAR RTE" /begin SUB_GROUP /end SUB_GROUP /begin FUNCTION_LIST /end FUNCTION_LIST /begin REF_CHARACTERISTIC CalRegn01Cmn.DutyCycThermProtnMotPrTSeln.Logl /end REF_CHARACTERISTIC /begin REF_MEASUREMENT /end REF_MEASUREMENT /end GROUP
/begin GROUP CalRegn01Cmn.DutyCycThermProtnMplr1FetMtgtnNonStallTblY.Ary1D "MICROSAR RTE" /begin SUB_GROUP /end SUB_GROUP /begin FUNCTION_LIST /end FUNCTION_LIST
 /begin REF_CHARACTERISTIC CalRegn01Cmn.DutyCycThermProtnMplr1FetMtgtnNonStallTblY.Ary1D /end REF_CHARACTERISTIC
 /begin REF_MEASUREMENT /end REF_MEASUREMENT
/end GROUP
/begin GROUP CalRegn01Cmn.DutyCycThermProtnMplr1FetMtgtnStallTblY.Ary1D "MICROSAR RTE" /begin SUB_GROUP /end SUB_GROUP /begin FUNCTION_LIST /end FUNCTION_LIST /begin REF_CHARACTERISTIC CalRegn01Cmn.DutyCycThermProtnMplr1FetMtgtnStallTblY.Ary1D /end REF_CHARACTERISTIC /begin REF_MEASUREMENT /end REF_MEASUREMENT /end GROUP
/begin GROUP CalRegn01Cmn.DutyCycThermProtnMplr1NonStallTblY.Ary1D "MICROSAR RTE" /begin SUB_GROUP /end SUB_GROUP /begin FUNCTION_LIST /end FUNCTION_LIST /begin REF_CHARACTERISTIC CalRegn01Cmn.DutyCycThermProtnMplr1NonStallTblY.Ary1D /end REF_CHARACTERISTIC /begin REF_MEASUREMENT /end REF_MEASUREMENT /end GROUP
/begin GROUP CalRegn01Cmn.DutyCycThermProtnMplr1StallTblY.Ary1D "MICROSAR RTE" /begin SUB_GROUP /end SUB_GROUP /begin FUNCTION_LIST /end FUNCTION_LIST /begin REF_CHARACTERISTIC CalRegn01Cmn.DutyCycThermProtnMplr1StallTblY.Ary1D /end REF_CHARACTERISTIC /begin REF_MEASUREMENT /end REF_MEASUREMENT /end GROUP
/begin GROUP CalRegn01Cmn.DutyCycThermProtnMplr2FetMtgtnNonStallTblY.Ary1D "MICROSAR RTE" /begin SUB_GROUP /end SUB_GROUP /begin FUNCTION_LIST /end FUNCTION_LIST
 /begin REF_CHARACTERISTIC CalRegn01Cmn.DutyCycThermProtnMplr2FetMtgtnNonStallTblY.Ary1D /end REF_CHARACTERISTIC
 /begin REF_MEASUREMENT /end REF_MEASUREMENT
/end GROUP
/begin GROUP CalRegn01Cmn.DutyCycThermProtnMplr2FetMtgtnStallTblY.Ary1D "MICROSAR RTE" /begin SUB_GROUP /end SUB_GROUP /begin FUNCTION_LIST /end FUNCTION_LIST /begin REF_CHARACTERISTIC CalRegn01Cmn.DutyCycThermProtnMplr2FetMtgtnStallTblY.Ary1D /end REF_CHARACTERISTIC /begin REF_MEASUREMENT /end REF_MEASUREMENT /end GROUP
/begin GROUP CalRegn01Cmn.DutyCycThermProtnMplr2NonStallTblY.Ary1D "MICROSAR RTE" /begin SUB_GROUP /end SUB_GROUP /begin FUNCTION_LIST /end FUNCTION_LIST /begin REF_CHARACTERISTIC CalRegn01Cmn.DutyCycThermProtnMplr2NonStallTblY.Ary1D /end REF_CHARACTERISTIC /begin REF_MEASUREMENT /end REF_MEASUREMENT /end GROUP
/begin GROUP CalRegn01Cmn.DutyCycThermProtnMplr2StallTblY.Ary1D "MICROSAR RTE" /begin SUB_GROUP /end SUB_GROUP /begin FUNCTION_LIST /end FUNCTION_LIST /begin REF_CHARACTERISTIC CalRegn01Cmn.DutyCycThermProtnMplr2StallTblY.Ary1D /end REF_CHARACTERISTIC /begin REF_MEASUREMENT /end REF_MEASUREMENT /end GROUP
/begin GROUP CalRegn01Cmn.DutyCycThermProtnMplr3FetMtgtnNonStallTblY.Ary1D "MICROSAR RTE" /begin SUB_GROUP /end SUB_GROUP /begin FUNCTION_LIST /end FUNCTION_LIST
 /begin REF_CHARACTERISTIC CalRegn01Cmn.DutyCycThermProtnMplr3FetMtgtnNonStallTblY.Ary1D /end REF_CHARACTERISTIC
 /begin REF_MEASUREMENT /end REF_MEASUREMENT
/end GROUP
/begin GROUP CalRegn01Cmn.DutyCycThermProtnMplr3FetMtgtnStallTblY.Ary1D "MICROSAR RTE" /begin SUB_GROUP /end SUB_GROUP /begin FUNCTION_LIST /end FUNCTION_LIST /begin REF_CHARACTERISTIC CalRegn01Cmn.DutyCycThermProtnMplr3FetMtgtnStallTblY.Ary1D /end REF_CHARACTERISTIC /begin REF_MEASUREMENT /end REF_MEASUREMENT /end GROUP
/begin GROUP CalRegn01Cmn.DutyCycThermProtnMplr3NonStallTblY.Ary1D "MICROSAR RTE" /begin SUB_GROUP /end SUB_GROUP /begin FUNCTION_LIST /end FUNCTION_LIST /begin REF_CHARACTERISTIC CalRegn01Cmn.DutyCycThermProtnMplr3NonStallTblY.Ary1D /end REF_CHARACTERISTIC /begin REF_MEASUREMENT /end REF_MEASUREMENT /end GROUP
/begin GROUP CalRegn01Cmn.DutyCycThermProtnMplr3StallTblY.Ary1D "MICROSAR RTE" /begin SUB_GROUP /end SUB_GROUP /begin FUNCTION_LIST /end FUNCTION_LIST /begin REF_CHARACTERISTIC CalRegn01Cmn.DutyCycThermProtnMplr3StallTblY.Ary1D /end REF_CHARACTERISTIC /begin REF_MEASUREMENT /end REF_MEASUREMENT /end GROUP
/begin GROUP CalRegn01Cmn.DutyCycThermProtnMplr4FetMtgtnNonStallTblY.Ary1D "MICROSAR RTE" /begin SUB_GROUP /end SUB_GROUP /begin FUNCTION_LIST /end FUNCTION_LIST
 /begin REF_CHARACTERISTIC CalRegn01Cmn.DutyCycThermProtnMplr4FetMtgtnNonStallTblY.Ary1D /end REF_CHARACTERISTIC
 /begin REF_MEASUREMENT /end REF_MEASUREMENT
/end GROUP
/begin GROUP CalRegn01Cmn.DutyCycThermProtnMplr4FetMtgtnStallTblY.Ary1D "MICROSAR RTE" /begin SUB_GROUP /end SUB_GROUP /begin FUNCTION_LIST /end FUNCTION_LIST /begin REF_CHARACTERISTIC CalRegn01Cmn.DutyCycThermProtnMplr4FetMtgtnStallTblY.Ary1D /end REF_CHARACTERISTIC /begin REF_MEASUREMENT /end REF_MEASUREMENT /end GROUP
/begin GROUP CalRegn01Cmn.DutyCycThermProtnMplr4NonStallTblY.Ary1D "MICROSAR RTE" /begin SUB_GROUP /end SUB_GROUP /begin FUNCTION_LIST /end FUNCTION_LIST /begin REF_CHARACTERISTIC CalRegn01Cmn.DutyCycThermProtnMplr4NonStallTblY.Ary1D /end REF_CHARACTERISTIC /begin REF_MEASUREMENT /end REF_MEASUREMENT /end GROUP
/begin GROUP CalRegn01Cmn.DutyCycThermProtnMplr4StallTblY.Ary1D "MICROSAR RTE" /begin SUB_GROUP /end SUB_GROUP /begin FUNCTION_LIST /end FUNCTION_LIST /begin REF_CHARACTERISTIC CalRegn01Cmn.DutyCycThermProtnMplr4StallTblY.Ary1D /end REF_CHARACTERISTIC /begin REF_MEASUREMENT /end REF_MEASUREMENT /end GROUP
/begin GROUP CalRegn01Cmn.DutyCycThermProtnMplr5FetMtgtnNonStallTblY.Ary1D "MICROSAR RTE" /begin SUB_GROUP /end SUB_GROUP /begin FUNCTION_LIST /end FUNCTION_LIST
 /begin REF_CHARACTERISTIC CalRegn01Cmn.DutyCycThermProtnMplr5FetMtgtnNonStallTblY.Ary1D /end REF_CHARACTERISTIC
 /begin REF_MEASUREMENT /end REF_MEASUREMENT
/end GROUP
/begin GROUP CalRegn01Cmn.DutyCycThermProtnMplr5FetMtgtnStallTblY.Ary1D "MICROSAR RTE" /begin SUB_GROUP /end SUB_GROUP /begin FUNCTION_LIST /end FUNCTION_LIST /begin REF_CHARACTERISTIC CalRegn01Cmn.DutyCycThermProtnMplr5FetMtgtnStallTblY.Ary1D /end REF_CHARACTERISTIC /begin REF_MEASUREMENT /end REF_MEASUREMENT /end GROUP
/begin GROUP CalRegn01Cmn.DutyCycThermProtnMplr5NonStallTblY.Ary1D "MICROSAR RTE" /begin SUB_GROUP /end SUB_GROUP /begin FUNCTION_LIST /end FUNCTION_LIST /begin REF_CHARACTERISTIC CalRegn01Cmn.DutyCycThermProtnMplr5NonStallTblY.Ary1D /end REF_CHARACTERISTIC /begin REF_MEASUREMENT /end REF_MEASUREMENT /end GROUP
/begin GROUP CalRegn01Cmn.DutyCycThermProtnMplr5StallTblY.Ary1D "MICROSAR RTE" /begin SUB_GROUP /end SUB_GROUP /begin FUNCTION_LIST /end FUNCTION_LIST /begin REF_CHARACTERISTIC CalRegn01Cmn.DutyCycThermProtnMplr5StallTblY.Ary1D /end REF_CHARACTERISTIC /begin REF_MEASUREMENT /end REF_MEASUREMENT /end GROUP
/begin GROUP CalRegn01Cmn.DutyCycThermProtnMplr6FetMtgtnNonStallTblY.Ary1D "MICROSAR RTE" /begin SUB_GROUP /end SUB_GROUP /begin FUNCTION_LIST /end FUNCTION_LIST
 /begin REF_CHARACTERISTIC CalRegn01Cmn.DutyCycThermProtnMplr6FetMtgtnNonStallTblY.Ary1D /end REF_CHARACTERISTIC
 /begin REF_MEASUREMENT /end REF_MEASUREMENT
/end GROUP
/begin GROUP CalRegn01Cmn.DutyCycThermProtnMplr6FetMtgtnStallTblY.Ary1D "MICROSAR RTE" /begin SUB_GROUP /end SUB_GROUP /begin FUNCTION_LIST /end FUNCTION_LIST /begin REF_CHARACTERISTIC CalRegn01Cmn.DutyCycThermProtnMplr6FetMtgtnStallTblY.Ary1D /end REF_CHARACTERISTIC /begin REF_MEASUREMENT /end REF_MEASUREMENT /end GROUP
/begin GROUP CalRegn01Cmn.DutyCycThermProtnMplr6NonStallTblY.Ary1D "MICROSAR RTE" /begin SUB_GROUP /end SUB_GROUP /begin FUNCTION_LIST /end FUNCTION_LIST /begin REF_CHARACTERISTIC CalRegn01Cmn.DutyCycThermProtnMplr6NonStallTblY.Ary1D /end REF_CHARACTERISTIC /begin REF_MEASUREMENT /end REF_MEASUREMENT /end GROUP
/begin GROUP CalRegn01Cmn.DutyCycThermProtnMplr6StallTblY.Ary1D "MICROSAR RTE" /begin SUB_GROUP /end SUB_GROUP /begin FUNCTION_LIST /end FUNCTION_LIST /begin REF_CHARACTERISTIC CalRegn01Cmn.DutyCycThermProtnMplr6StallTblY.Ary1D /end REF_CHARACTERISTIC /begin REF_MEASUREMENT /end REF_MEASUREMENT /end GROUP
/begin GROUP CalRegn01Cmn.DutyCycThermProtnMplrFetMtgtnTblX.Ary1D "MICROSAR RTE" /begin SUB_GROUP /end SUB_GROUP /begin FUNCTION_LIST /end FUNCTION_LIST /begin REF_CHARACTERISTIC CalRegn01Cmn.DutyCycThermProtnMplrFetMtgtnTblX.Ary1D /end REF_CHARACTERISTIC /begin REF_MEASUREMENT /end REF_MEASUREMENT /end GROUP
/begin GROUP CalRegn01Cmn.DutyCycThermProtnMplrTSeln.Logl "MICROSAR RTE" /begin SUB_GROUP /end SUB_GROUP /begin FUNCTION_LIST /end FUNCTION_LIST /begin REF_CHARACTERISTIC CalRegn01Cmn.DutyCycThermProtnMplrTSeln.Logl /end REF_CHARACTERISTIC /begin REF_MEASUREMENT /end REF_MEASUREMENT /end GROUP
/begin GROUP CalRegn01Cmn.DutyCycThermProtnMplrTblX.Ary1D "MICROSAR RTE" /begin SUB_GROUP /end SUB_GROUP /begin FUNCTION_LIST /end FUNCTION_LIST /begin REF_CHARACTERISTIC CalRegn01Cmn.DutyCycThermProtnMplrTblX.Ary1D /end REF_CHARACTERISTIC /begin REF_MEASUREMENT /end REF_MEASUREMENT /end GROUP
/begin GROUP CalRegn01Cmn.DutyCycThermProtnSlowFilTSeln.Logl "MICROSAR RTE" /begin SUB_GROUP /end SUB_GROUP /begin FUNCTION_LIST /end FUNCTION_LIST /begin REF_CHARACTERISTIC CalRegn01Cmn.DutyCycThermProtnSlowFilTSeln.Logl /end REF_CHARACTERISTIC /begin REF_MEASUREMENT /end REF_MEASUREMENT /end GROUP
/begin GROUP CalRegn01Cmn.DutyCycThermProtnThermLimScaFac.Val "MICROSAR RTE" /begin SUB_GROUP /end SUB_GROUP /begin FUNCTION_LIST /end FUNCTION_LIST /begin REF_CHARACTERISTIC CalRegn01Cmn.DutyCycThermProtnThermLimScaFac.Val /end REF_CHARACTERISTIC /begin REF_MEASUREMENT /end REF_MEASUREMENT /end GROUP
/begin GROUP CalRegn01Cmn.DutyCycThermProtnThermLoadLimTblX.Ary2D "MICROSAR RTE" /begin SUB_GROUP /end SUB_GROUP /begin FUNCTION_LIST /end FUNCTION_LIST /begin REF_CHARACTERISTIC CalRegn01Cmn.DutyCycThermProtnThermLoadLimTblX.Ary2D /end REF_CHARACTERISTIC /begin REF_MEASUREMENT /end REF_MEASUREMENT /end GROUP
/begin GROUP CalRegn01Cmn.DutyCycThermProtnThermLoadLimTblY.Ary2D "MICROSAR RTE" /begin SUB_GROUP /end SUB_GROUP /begin FUNCTION_LIST /end FUNCTION_LIST /begin REF_CHARACTERISTIC CalRegn01Cmn.DutyCycThermProtnThermLoadLimTblY.Ary2D /end REF_CHARACTERISTIC /begin REF_MEASUREMENT /end REF_MEASUREMENT /end GROUP
/begin GROUP CalRegn01Cmn.DutyCycThermProtnTqCmdSlewDwn.Val "MICROSAR RTE" /begin SUB_GROUP /end SUB_GROUP /begin FUNCTION_LIST /end FUNCTION_LIST /begin REF_CHARACTERISTIC CalRegn01Cmn.DutyCycThermProtnTqCmdSlewDwn.Val /end REF_CHARACTERISTIC /begin REF_MEASUREMENT /end REF_MEASUREMENT /end GROUP
/begin GROUP CalRegn01Cmn.DutyCycThermProtnTqCmdSlewUp.Val "MICROSAR RTE" /begin SUB_GROUP /end SUB_GROUP /begin FUNCTION_LIST /end FUNCTION_LIST /begin REF_CHARACTERISTIC CalRegn01Cmn.DutyCycThermProtnTqCmdSlewUp.Val /end REF_CHARACTERISTIC /begin REF_MEASUREMENT /end REF_MEASUREMENT /end GROUP
/begin GROUP CalRegn01Cmn.ElecPwrCnsCtrlrInpR.Val "MICROSAR RTE" /begin SUB_GROUP /end SUB_GROUP /begin FUNCTION_LIST /end FUNCTION_LIST /begin REF_CHARACTERISTIC CalRegn01Cmn.ElecPwrCnsCtrlrInpR.Val /end REF_CHARACTERISTIC /begin REF_MEASUREMENT /end REF_MEASUREMENT /end GROUP
/begin GROUP CalRegn01Cmn.FordMsg077BusHiSpdCanDtcInhbThd.Val "MICROSAR RTE" /begin SUB_GROUP /end SUB_GROUP /begin FUNCTION_LIST /end FUNCTION_LIST /begin REF_CHARACTERISTIC CalRegn01Cmn.FordMsg077BusHiSpdCanDtcInhbThd.Val /end REF_CHARACTERISTIC /begin REF_MEASUREMENT /end REF_MEASUREMENT /end GROUP
/begin GROUP CalRegn01Cmn.FordMsg077BusHiSpdLatACmpdInvldSigFaildThd.Val "MICROSAR RTE" /begin SUB_GROUP /end SUB_GROUP /begin FUNCTION_LIST /end FUNCTION_LIST
 /begin REF_CHARACTERISTIC CalRegn01Cmn.FordMsg077BusHiSpdLatACmpdInvldSigFaildThd.Val /end REF_CHARACTERISTIC
 /begin REF_MEASUREMENT /end REF_MEASUREMENT
/end GROUP
/begin GROUP CalRegn01Cmn.FordMsg077BusHiSpdLatACmpdInvldSigPassdThd.Val "MICROSAR RTE" /begin SUB_GROUP /end SUB_GROUP /begin FUNCTION_LIST /end FUNCTION_LIST
 /begin REF_CHARACTERISTIC CalRegn01Cmn.FordMsg077BusHiSpdLatACmpdInvldSigPassdThd.Val /end REF_CHARACTERISTIC
 /begin REF_MEASUREMENT /end REF_MEASUREMENT
/end GROUP
/begin GROUP CalRegn01Cmn.FordMsg077BusHiSpdLatACmpdVldMissThd.Val "MICROSAR RTE" /begin SUB_GROUP /end SUB_GROUP /begin FUNCTION_LIST /end FUNCTION_LIST /begin REF_CHARACTERISTIC CalRegn01Cmn.FordMsg077BusHiSpdLatACmpdVldMissThd.Val /end REF_CHARACTERISTIC /begin REF_MEASUREMENT /end REF_MEASUREMENT /end GROUP
/begin GROUP CalRegn01Cmn.FordMsg077BusHiSpdLgtACmpdInvldSigFaildThd.Val "MICROSAR RTE" /begin SUB_GROUP /end SUB_GROUP /begin FUNCTION_LIST /end FUNCTION_LIST
 /begin REF_CHARACTERISTIC CalRegn01Cmn.FordMsg077BusHiSpdLgtACmpdInvldSigFaildThd.Val /end REF_CHARACTERISTIC
 /begin REF_MEASUREMENT /end REF_MEASUREMENT
/end GROUP
/begin GROUP CalRegn01Cmn.FordMsg077BusHiSpdLgtACmpdInvldSigPassdThd.Val "MICROSAR RTE" /begin SUB_GROUP /end SUB_GROUP /begin FUNCTION_LIST /end FUNCTION_LIST
 /begin REF_CHARACTERISTIC CalRegn01Cmn.FordMsg077BusHiSpdLgtACmpdInvldSigPassdThd.Val /end REF_CHARACTERISTIC
 /begin REF_MEASUREMENT /end REF_MEASUREMENT
/end GROUP
/begin GROUP CalRegn01Cmn.FordMsg077BusHiSpdLgtACmpdVldMissThd.Val "MICROSAR RTE" /begin SUB_GROUP /end SUB_GROUP /begin FUNCTION_LIST /end FUNCTION_LIST /begin REF_CHARACTERISTIC CalRegn01Cmn.FordMsg077BusHiSpdLgtACmpdVldMissThd.Val /end REF_CHARACTERISTIC /begin REF_MEASUREMENT /end REF_MEASUREMENT /end GROUP
/begin GROUP CalRegn01Cmn.FordMsg077BusHiSpdMissMsgFaildThd.Val "MICROSAR RTE" /begin SUB_GROUP /end SUB_GROUP /begin FUNCTION_LIST /end FUNCTION_LIST /begin REF_CHARACTERISTIC CalRegn01Cmn.FordMsg077BusHiSpdMissMsgFaildThd.Val /end REF_CHARACTERISTIC /begin REF_MEASUREMENT /end REF_MEASUREMENT /end GROUP
/begin GROUP CalRegn01Cmn.FordMsg077BusHiSpdMissMsgPassdThd.Val "MICROSAR RTE" /begin SUB_GROUP /end SUB_GROUP /begin FUNCTION_LIST /end FUNCTION_LIST /begin REF_CHARACTERISTIC CalRegn01Cmn.FordMsg077BusHiSpdMissMsgPassdThd.Val /end REF_CHARACTERISTIC /begin REF_MEASUREMENT /end REF_MEASUREMENT /end GROUP
/begin GROUP CalRegn01Cmn.FordMsg077BusHiSpdOverGndInvldSigFaildThd.Val "MICROSAR RTE" /begin SUB_GROUP /end SUB_GROUP /begin FUNCTION_LIST /end FUNCTION_LIST /begin REF_CHARACTERISTIC CalRegn01Cmn.FordMsg077BusHiSpdOverGndInvldSigFaildThd.Val /end REF_CHARACTERISTIC /begin REF_MEASUREMENT /end REF_MEASUREMENT /end GROUP
/begin GROUP CalRegn01Cmn.FordMsg077BusHiSpdOverGndInvldSigPassdThd.Val "MICROSAR RTE" /begin SUB_GROUP /end SUB_GROUP /begin FUNCTION_LIST /end FUNCTION_LIST /begin REF_CHARACTERISTIC CalRegn01Cmn.FordMsg077BusHiSpdOverGndInvldSigPassdThd.Val /end REF_CHARACTERISTIC /begin REF_MEASUREMENT /end REF_MEASUREMENT /end GROUP
/begin GROUP CalRegn01Cmn.FordMsg077BusHiSpdVehLatACmpdVldFaildThd.Val "MICROSAR RTE" /begin SUB_GROUP /end SUB_GROUP /begin FUNCTION_LIST /end FUNCTION_LIST /begin REF_CHARACTERISTIC CalRegn01Cmn.FordMsg077BusHiSpdVehLatACmpdVldFaildThd.Val /end REF_CHARACTERISTIC /begin REF_MEASUREMENT /end REF_MEASUREMENT /end GROUP
/begin GROUP CalRegn01Cmn.FordMsg077BusHiSpdVehLatACmpdVldPassdThd.Val "MICROSAR RTE" /begin SUB_GROUP /end SUB_GROUP /begin FUNCTION_LIST /end FUNCTION_LIST /begin REF_CHARACTERISTIC CalRegn01Cmn.FordMsg077BusHiSpdVehLatACmpdVldPassdThd.Val /end REF_CHARACTERISTIC /begin REF_MEASUREMENT /end REF_MEASUREMENT /end GROUP
/begin GROUP CalRegn01Cmn.FordMsg077BusHiSpdVehLgtACmpdVldFaildThd.Val "MICROSAR RTE" /begin SUB_GROUP /end SUB_GROUP /begin FUNCTION_LIST /end FUNCTION_LIST /begin REF_CHARACTERISTIC CalRegn01Cmn.FordMsg077BusHiSpdVehLgtACmpdVldFaildThd.Val /end REF_CHARACTERISTIC /begin REF_MEASUREMENT /end REF_MEASUREMENT /end GROUP
/begin GROUP CalRegn01Cmn.FordMsg077BusHiSpdVehLgtACmpdVldPassdThd.Val "MICROSAR RTE" /begin SUB_GROUP /end SUB_GROUP /begin FUNCTION_LIST /end FUNCTION_LIST /begin REF_CHARACTERISTIC CalRegn01Cmn.FordMsg077BusHiSpdVehLgtACmpdVldPassdThd.Val /end REF_CHARACTERISTIC /begin REF_MEASUREMENT /end REF_MEASUREMENT /end GROUP
/begin GROUP CalRegn01Cmn.FordMsg077BusHiSpdVehSpdOverGndVldFaildThd.Val "MICROSAR RTE" /begin SUB_GROUP /end SUB_GROUP /begin FUNCTION_LIST /end FUNCTION_LIST
 /begin REF_CHARACTERISTIC CalRegn01Cmn.FordMsg077BusHiSpdVehSpdOverGndVldFaildThd.Val /end REF_CHARACTERISTIC
 /begin REF_MEASUREMENT /end REF_MEASUREMENT
/end GROUP
/begin GROUP CalRegn01Cmn.FordMsg077BusHiSpdVehSpdOverGndVldMissThd.Val "MICROSAR RTE" /begin SUB_GROUP /end SUB_GROUP /begin FUNCTION_LIST /end FUNCTION_LIST /begin REF_CHARACTERISTIC CalRegn01Cmn.FordMsg077BusHiSpdVehSpdOverGndVldMissThd.Val /end REF_CHARACTERISTIC /begin REF_MEASUREMENT /end REF_MEASUREMENT /end GROUP
/begin GROUP CalRegn01Cmn.FordMsg077BusHiSpdVehSpdOverGndVldPassdThd.Val "MICROSAR RTE" /begin SUB_GROUP /end SUB_GROUP /begin FUNCTION_LIST /end FUNCTION_LIST
 /begin REF_CHARACTERISTIC CalRegn01Cmn.FordMsg077BusHiSpdVehSpdOverGndVldPassdThd.Val /end REF_CHARACTERISTIC
 /begin REF_MEASUREMENT /end REF_MEASUREMENT
/end GROUP
/begin GROUP CalRegn01Cmn.FordMsg077BusHiSpdVehYawRateCmpdVldFaildThd.Val "MICROSAR RTE" /begin SUB_GROUP /end SUB_GROUP /begin FUNCTION_LIST /end FUNCTION_LIST
 /begin REF_CHARACTERISTIC CalRegn01Cmn.FordMsg077BusHiSpdVehYawRateCmpdVldFaildThd.Val /end REF_CHARACTERISTIC
 /begin REF_MEASUREMENT /end REF_MEASUREMENT
/end GROUP
/begin GROUP CalRegn01Cmn.FordMsg077BusHiSpdVehYawRateCmpdVldPassdThd.Val "MICROSAR RTE" /begin SUB_GROUP /end SUB_GROUP /begin FUNCTION_LIST /end FUNCTION_LIST
 /begin REF_CHARACTERISTIC CalRegn01Cmn.FordMsg077BusHiSpdVehYawRateCmpdVldPassdThd.Val /end REF_CHARACTERISTIC
 /begin REF_MEASUREMENT /end REF_MEASUREMENT
/end GROUP
/begin GROUP CalRegn01Cmn.FordMsg077BusHiSpdYawRateCmpdInvldSigFaildThd.Val "MICROSAR RTE" /begin SUB_GROUP /end SUB_GROUP /begin FUNCTION_LIST /end FUNCTION_LIST
 /begin REF_CHARACTERISTIC CalRegn01Cmn.FordMsg077BusHiSpdYawRateCmpdInvldSigFaildThd.Val /end REF_CHARACTERISTIC
 /begin REF_MEASUREMENT /end REF_MEASUREMENT
/end GROUP
/begin GROUP CalRegn01Cmn.FordMsg077BusHiSpdYawRateCmpdInvldSigPassdThd.Val "MICROSAR RTE" /begin SUB_GROUP /end SUB_GROUP /begin FUNCTION_LIST /end FUNCTION_LIST
 /begin REF_CHARACTERISTIC CalRegn01Cmn.FordMsg077BusHiSpdYawRateCmpdInvldSigPassdThd.Val /end REF_CHARACTERISTIC
 /begin REF_MEASUREMENT /end REF_MEASUREMENT
/end GROUP
/begin GROUP CalRegn01Cmn.FordMsg077BusHiSpdYawRateCmpdVldMissThd.Val "MICROSAR RTE" /begin SUB_GROUP /end SUB_GROUP /begin FUNCTION_LIST /end FUNCTION_LIST /begin REF_CHARACTERISTIC CalRegn01Cmn.FordMsg077BusHiSpdYawRateCmpdVldMissThd.Val /end REF_CHARACTERISTIC /begin REF_MEASUREMENT /end REF_MEASUREMENT /end GROUP
/begin GROUP CalRegn01Cmn.FordMsg07DBusHiSpdActBrkTqSigInvldPassdThd.Val "MICROSAR RTE" /begin SUB_GROUP /end SUB_GROUP /begin FUNCTION_LIST /end FUNCTION_LIST
 /begin REF_CHARACTERISTIC CalRegn01Cmn.FordMsg07DBusHiSpdActBrkTqSigInvldPassdThd.Val /end REF_CHARACTERISTIC
 /begin REF_MEASUREMENT /end REF_MEASUREMENT
/end GROUP
/begin GROUP CalRegn01Cmn.FordMsg07DBusHiSpdFordVehActBrkTqInvldThd.Val "MICROSAR RTE" /begin SUB_GROUP /end SUB_GROUP /begin FUNCTION_LIST /end FUNCTION_LIST /begin REF_CHARACTERISTIC CalRegn01Cmn.FordMsg07DBusHiSpdFordVehActBrkTqInvldThd.Val /end REF_CHARACTERISTIC /begin REF_MEASUREMENT /end REF_MEASUREMENT /end GROUP
/begin GROUP CalRegn01Cmn.FordMsg07DBusHiSpdFordVehActBrkTqVldThd.Val "MICROSAR RTE" /begin SUB_GROUP /end SUB_GROUP /begin FUNCTION_LIST /end FUNCTION_LIST /begin REF_CHARACTERISTIC CalRegn01Cmn.FordMsg07DBusHiSpdFordVehActBrkTqVldThd.Val /end REF_CHARACTERISTIC /begin REF_MEASUREMENT /end REF_MEASUREMENT /end GROUP
/begin GROUP CalRegn01Cmn.FordMsg07DBusHiSpdFordVehBrkTqVldMissMsgThd.Val "MICROSAR RTE" /begin SUB_GROUP /end SUB_GROUP /begin FUNCTION_LIST /end FUNCTION_LIST
 /begin REF_CHARACTERISTIC CalRegn01Cmn.FordMsg07DBusHiSpdFordVehBrkTqVldMissMsgThd.Val /end REF_CHARACTERISTIC
 /begin REF_MEASUREMENT /end REF_MEASUREMENT
/end GROUP
/begin GROUP CalRegn01Cmn.FordMsg07DBusHiSpdFordVehVertACmpdSigInvldThd.Val "MICROSAR RTE" /begin SUB_GROUP /end SUB_GROUP /begin FUNCTION_LIST /end FUNCTION_LIST
 /begin REF_CHARACTERISTIC CalRegn01Cmn.FordMsg07DBusHiSpdFordVehVertACmpdSigInvldThd.Val /end REF_CHARACTERISTIC
 /begin REF_MEASUREMENT /end REF_MEASUREMENT
/end GROUP
/begin GROUP CalRegn01Cmn.FordMsg07DBusHiSpdFordVehVertACmpdSigVldThd.Val "MICROSAR RTE" /begin SUB_GROUP /end SUB_GROUP /begin FUNCTION_LIST /end FUNCTION_LIST
 /begin REF_CHARACTERISTIC CalRegn01Cmn.FordMsg07DBusHiSpdFordVehVertACmpdSigVldThd.Val /end REF_CHARACTERISTIC
 /begin REF_MEASUREMENT /end REF_MEASUREMENT
/end GROUP
/begin GROUP CalRegn01Cmn.FordMsg07DBusHiSpdFordVehVertAVldMissMsgThd.Val "MICROSAR RTE" /begin SUB_GROUP /end SUB_GROUP /begin FUNCTION_LIST /end FUNCTION_LIST
 /begin REF_CHARACTERISTIC CalRegn01Cmn.FordMsg07DBusHiSpdFordVehVertAVldMissMsgThd.Val /end REF_CHARACTERISTIC
 /begin REF_MEASUREMENT /end REF_MEASUREMENT
/end GROUP
/begin GROUP CalRegn01Cmn.FordMsg07DBusHiSpdMissMsgFaildThd.Val "MICROSAR RTE" /begin SUB_GROUP /end SUB_GROUP /begin FUNCTION_LIST /end FUNCTION_LIST /begin REF_CHARACTERISTIC CalRegn01Cmn.FordMsg07DBusHiSpdMissMsgFaildThd.Val /end REF_CHARACTERISTIC /begin REF_MEASUREMENT /end REF_MEASUREMENT /end GROUP
/begin GROUP CalRegn01Cmn.FordMsg07DBusHiSpdMissMsgPassdThd.Val "MICROSAR RTE" /begin SUB_GROUP /end SUB_GROUP /begin FUNCTION_LIST /end FUNCTION_LIST /begin REF_CHARACTERISTIC CalRegn01Cmn.FordMsg07DBusHiSpdMissMsgPassdThd.Val /end REF_CHARACTERISTIC /begin REF_MEASUREMENT /end REF_MEASUREMENT /end GROUP
/begin GROUP CalRegn01Cmn.FordMsg07DBusHiSpdVehActTqBrkInvldFaildThd.Val "MICROSAR RTE" /begin SUB_GROUP /end SUB_GROUP /begin FUNCTION_LIST /end FUNCTION_LIST
 /begin REF_CHARACTERISTIC CalRegn01Cmn.FordMsg07DBusHiSpdVehActTqBrkInvldFaildThd.Val /end REF_CHARACTERISTIC
 /begin REF_MEASUREMENT /end REF_MEASUREMENT
/end GROUP
/begin GROUP CalRegn01Cmn.FordMsg07DBusHiSpdVertACmpdSigInvldFaildThd.Val "MICROSAR RTE" /begin SUB_GROUP /end SUB_GROUP /begin FUNCTION_LIST /end FUNCTION_LIST
 /begin REF_CHARACTERISTIC CalRegn01Cmn.FordMsg07DBusHiSpdVertACmpdSigInvldFaildThd.Val /end REF_CHARACTERISTIC
 /begin REF_MEASUREMENT /end REF_MEASUREMENT
/end GROUP
/begin GROUP CalRegn01Cmn.FordMsg07DBusHiSpdVertACmpdSigInvldPassdThd.Val "MICROSAR RTE" /begin SUB_GROUP /end SUB_GROUP /begin FUNCTION_LIST /end FUNCTION_LIST
 /begin REF_CHARACTERISTIC CalRegn01Cmn.FordMsg07DBusHiSpdVertACmpdSigInvldPassdThd.Val /end REF_CHARACTERISTIC
 /begin REF_MEASUREMENT /end REF_MEASUREMENT
/end GROUP
/begin GROUP CalRegn01Cmn.FordMsg083BusHiSpdFordVehTurnSigVldThd.Val "MICROSAR RTE" /begin SUB_GROUP /end SUB_GROUP /begin FUNCTION_LIST /end FUNCTION_LIST /begin REF_CHARACTERISTIC CalRegn01Cmn.FordMsg083BusHiSpdFordVehTurnSigVldThd.Val /end REF_CHARACTERISTIC /begin REF_MEASUREMENT /end REF_MEASUREMENT /end GROUP
/begin GROUP CalRegn01Cmn.FordMsg083BusHiSpdMissMsgFaildThd.Val "MICROSAR RTE" /begin SUB_GROUP /end SUB_GROUP /begin FUNCTION_LIST /end FUNCTION_LIST /begin REF_CHARACTERISTIC CalRegn01Cmn.FordMsg083BusHiSpdMissMsgFaildThd.Val /end REF_CHARACTERISTIC /begin REF_MEASUREMENT /end REF_MEASUREMENT /end GROUP
/begin GROUP CalRegn01Cmn.FordMsg083BusHiSpdMissMsgPassdThd.Val "MICROSAR RTE" /begin SUB_GROUP /end SUB_GROUP /begin FUNCTION_LIST /end FUNCTION_LIST /begin REF_CHARACTERISTIC CalRegn01Cmn.FordMsg083BusHiSpdMissMsgPassdThd.Val /end REF_CHARACTERISTIC /begin REF_MEASUREMENT /end REF_MEASUREMENT /end GROUP
/begin GROUP CalRegn01Cmn.FordMsg083BusHiSpdVehTurnSigVldMissMsgThd.Val "MICROSAR RTE" /begin SUB_GROUP /end SUB_GROUP /begin FUNCTION_LIST /end FUNCTION_LIST /begin REF_CHARACTERISTIC CalRegn01Cmn.FordMsg083BusHiSpdVehTurnSigVldMissMsgThd.Val /end REF_CHARACTERISTIC /begin REF_MEASUREMENT /end REF_MEASUREMENT /end GROUP
/begin GROUP CalRegn01Cmn.FordMsg091BusHiSpdInvldMsgFaildThd.Val "MICROSAR RTE" /begin SUB_GROUP /end SUB_GROUP /begin FUNCTION_LIST /end FUNCTION_LIST /begin REF_CHARACTERISTIC CalRegn01Cmn.FordMsg091BusHiSpdInvldMsgFaildThd.Val /end REF_CHARACTERISTIC /begin REF_MEASUREMENT /end REF_MEASUREMENT /end GROUP
/begin GROUP CalRegn01Cmn.FordMsg091BusHiSpdInvldMsgPassdThd.Val "MICROSAR RTE" /begin SUB_GROUP /end SUB_GROUP /begin FUNCTION_LIST /end FUNCTION_LIST /begin REF_CHARACTERISTIC CalRegn01Cmn.FordMsg091BusHiSpdInvldMsgPassdThd.Val /end REF_CHARACTERISTIC /begin REF_MEASUREMENT /end REF_MEASUREMENT /end GROUP
/begin GROUP CalRegn01Cmn.FordMsg091BusHiSpdMissMsgFaildThd.Val "MICROSAR RTE" /begin SUB_GROUP /end SUB_GROUP /begin FUNCTION_LIST /end FUNCTION_LIST /begin REF_CHARACTERISTIC CalRegn01Cmn.FordMsg091BusHiSpdMissMsgFaildThd.Val /end REF_CHARACTERISTIC /begin REF_MEASUREMENT /end REF_MEASUREMENT /end GROUP
/begin GROUP CalRegn01Cmn.FordMsg091BusHiSpdMissMsgPassdThd.Val "MICROSAR RTE" /begin SUB_GROUP /end SUB_GROUP /begin FUNCTION_LIST /end FUNCTION_LIST /begin REF_CHARACTERISTIC CalRegn01Cmn.FordMsg091BusHiSpdMissMsgPassdThd.Val /end REF_CHARACTERISTIC /begin REF_MEASUREMENT /end REF_MEASUREMENT /end GROUP
/begin GROUP CalRegn01Cmn.FordMsg091BusHiSpdYawRateRawVldMissFaildThd.Val "MICROSAR RTE" /begin SUB_GROUP /end SUB_GROUP /begin FUNCTION_LIST /end FUNCTION_LIST
 /begin REF_CHARACTERISTIC CalRegn01Cmn.FordMsg091BusHiSpdYawRateRawVldMissFaildThd.Val /end REF_CHARACTERISTIC
 /begin REF_MEASUREMENT /end REF_MEASUREMENT
/end GROUP
/begin GROUP CalRegn01Cmn.FordMsg091BusHiSpdYawRateRawVldSigFaildThd.Val "MICROSAR RTE" /begin SUB_GROUP /end SUB_GROUP /begin FUNCTION_LIST /end FUNCTION_LIST
 /begin REF_CHARACTERISTIC CalRegn01Cmn.FordMsg091BusHiSpdYawRateRawVldSigFaildThd.Val /end REF_CHARACTERISTIC
 /begin REF_MEASUREMENT /end REF_MEASUREMENT
/end GROUP
/begin GROUP CalRegn01Cmn.FordMsg091BusHiSpdYawRateRawVldSigPassdThd.Val "MICROSAR RTE" /begin SUB_GROUP /end SUB_GROUP /begin FUNCTION_LIST /end FUNCTION_LIST
 /begin REF_CHARACTERISTIC CalRegn01Cmn.FordMsg091BusHiSpdYawRateRawVldSigPassdThd.Val /end REF_CHARACTERISTIC
 /begin REF_MEASUREMENT /end REF_MEASUREMENT
/end GROUP
/begin GROUP CalRegn01Cmn.FordMsg167BusHiSpdMissMsgFaildTiThd.Val "MICROSAR RTE" /begin SUB_GROUP /end SUB_GROUP /begin FUNCTION_LIST /end FUNCTION_LIST /begin REF_CHARACTERISTIC CalRegn01Cmn.FordMsg167BusHiSpdMissMsgFaildTiThd.Val /end REF_CHARACTERISTIC /begin REF_MEASUREMENT /end REF_MEASUREMENT /end GROUP
/begin GROUP CalRegn01Cmn.FordMsg167BusHiSpdMissMsgPassdTiThd.Val "MICROSAR RTE" /begin SUB_GROUP /end SUB_GROUP /begin FUNCTION_LIST /end FUNCTION_LIST /begin REF_CHARACTERISTIC CalRegn01Cmn.FordMsg167BusHiSpdMissMsgPassdTiThd.Val /end REF_CHARACTERISTIC /begin REF_MEASUREMENT /end REF_MEASUREMENT /end GROUP
/begin GROUP CalRegn01Cmn.FordMsg167BusHiSpdPrpnWhlTqFaildTiThd.Val "MICROSAR RTE" /begin SUB_GROUP /end SUB_GROUP /begin FUNCTION_LIST /end FUNCTION_LIST /begin REF_CHARACTERISTIC CalRegn01Cmn.FordMsg167BusHiSpdPrpnWhlTqFaildTiThd.Val /end REF_CHARACTERISTIC /begin REF_MEASUREMENT /end REF_MEASUREMENT /end GROUP
/begin GROUP CalRegn01Cmn.FordMsg167BusHiSpdPrpnWhlTqMissTiThd.Val "MICROSAR RTE" /begin SUB_GROUP /end SUB_GROUP /begin FUNCTION_LIST /end FUNCTION_LIST /begin REF_CHARACTERISTIC CalRegn01Cmn.FordMsg167BusHiSpdPrpnWhlTqMissTiThd.Val /end REF_CHARACTERISTIC /begin REF_MEASUREMENT /end REF_MEASUREMENT /end GROUP
/begin GROUP CalRegn01Cmn.FordMsg167BusHiSpdPrpnWhlTqPassdTiThd.Val "MICROSAR RTE" /begin SUB_GROUP /end SUB_GROUP /begin FUNCTION_LIST /end FUNCTION_LIST /begin REF_CHARACTERISTIC CalRegn01Cmn.FordMsg167BusHiSpdPrpnWhlTqPassdTiThd.Val /end REF_CHARACTERISTIC /begin REF_MEASUREMENT /end REF_MEASUREMENT /end GROUP
/begin GROUP CalRegn01Cmn.FordMsg167BusHiSpdPrpnWhlTqSigInvldFaildTiThd.Val "MICROSAR RTE" /begin SUB_GROUP /end SUB_GROUP /begin FUNCTION_LIST /end FUNCTION_LIST
 /begin REF_CHARACTERISTIC CalRegn01Cmn.FordMsg167BusHiSpdPrpnWhlTqSigInvldFaildTiThd.Val /end REF_CHARACTERISTIC
 /begin REF_MEASUREMENT /end REF_MEASUREMENT
/end GROUP
/begin GROUP CalRegn01Cmn.FordMsg167BusHiSpdPrpnWhlTqSigInvldPassdTiThd.Val "MICROSAR RTE" /begin SUB_GROUP /end SUB_GROUP /begin FUNCTION_LIST /end FUNCTION_LIST
 /begin REF_CHARACTERISTIC CalRegn01Cmn.FordMsg167BusHiSpdPrpnWhlTqSigInvldPassdTiThd.Val /end REF_CHARACTERISTIC
 /begin REF_MEASUREMENT /end REF_MEASUREMENT
/end GROUP
/begin GROUP CalRegn01Cmn.FordMsg202BusHiSpdEngModLoQlyVldFaildThd.Val "MICROSAR RTE" /begin SUB_GROUP /end SUB_GROUP /begin FUNCTION_LIST /end FUNCTION_LIST /begin REF_CHARACTERISTIC CalRegn01Cmn.FordMsg202BusHiSpdEngModLoQlyVldFaildThd.Val /end REF_CHARACTERISTIC /begin REF_MEASUREMENT /end REF_MEASUREMENT /end GROUP
/begin GROUP CalRegn01Cmn.FordMsg202BusHiSpdEngModLoQlyVldMissThd.Val "MICROSAR RTE" /begin SUB_GROUP /end SUB_GROUP /begin FUNCTION_LIST /end FUNCTION_LIST /begin REF_CHARACTERISTIC CalRegn01Cmn.FordMsg202BusHiSpdEngModLoQlyVldMissThd.Val /end REF_CHARACTERISTIC /begin REF_MEASUREMENT /end REF_MEASUREMENT /end GROUP
/begin GROUP CalRegn01Cmn.FordMsg202BusHiSpdEngModLoQlyVldPassdThd.Val "MICROSAR RTE" /begin SUB_GROUP /end SUB_GROUP /begin FUNCTION_LIST /end FUNCTION_LIST /begin REF_CHARACTERISTIC CalRegn01Cmn.FordMsg202BusHiSpdEngModLoQlyVldPassdThd.Val /end REF_CHARACTERISTIC /begin REF_MEASUREMENT /end REF_MEASUREMENT /end GROUP
/begin GROUP CalRegn01Cmn.FordMsg202BusHiSpdEngModlVldFaildThd.Val "MICROSAR RTE" /begin SUB_GROUP /end SUB_GROUP /begin FUNCTION_LIST /end FUNCTION_LIST /begin REF_CHARACTERISTIC CalRegn01Cmn.FordMsg202BusHiSpdEngModlVldFaildThd.Val /end REF_CHARACTERISTIC /begin REF_MEASUREMENT /end REF_MEASUREMENT /end GROUP
/begin GROUP CalRegn01Cmn.FordMsg202BusHiSpdEngModlVldMissThd.Val "MICROSAR RTE" /begin SUB_GROUP /end SUB_GROUP /begin FUNCTION_LIST /end FUNCTION_LIST /begin REF_CHARACTERISTIC CalRegn01Cmn.FordMsg202BusHiSpdEngModlVldMissThd.Val /end REF_CHARACTERISTIC /begin REF_MEASUREMENT /end REF_MEASUREMENT /end GROUP
/begin GROUP CalRegn01Cmn.FordMsg202BusHiSpdGearRvsStsInvldFaildThd.Val "MICROSAR RTE" /begin SUB_GROUP /end SUB_GROUP /begin FUNCTION_LIST /end FUNCTION_LIST /begin REF_CHARACTERISTIC CalRegn01Cmn.FordMsg202BusHiSpdGearRvsStsInvldFaildThd.Val /end REF_CHARACTERISTIC /begin REF_MEASUREMENT /end REF_MEASUREMENT /end GROUP
/begin GROUP CalRegn01Cmn.FordMsg202BusHiSpdGearRvsStsInvldPassdThd.Val "MICROSAR RTE" /begin SUB_GROUP /end SUB_GROUP /begin FUNCTION_LIST /end FUNCTION_LIST /begin REF_CHARACTERISTIC CalRegn01Cmn.FordMsg202BusHiSpdGearRvsStsInvldPassdThd.Val /end REF_CHARACTERISTIC /begin REF_MEASUREMENT /end REF_MEASUREMENT /end GROUP
/begin GROUP CalRegn01Cmn.FordMsg202BusHiSpdGearRvsStsVldFaildThd.Val "MICROSAR RTE" /begin SUB_GROUP /end SUB_GROUP /begin FUNCTION_LIST /end FUNCTION_LIST /begin REF_CHARACTERISTIC CalRegn01Cmn.FordMsg202BusHiSpdGearRvsStsVldFaildThd.Val /end REF_CHARACTERISTIC /begin REF_MEASUREMENT /end REF_MEASUREMENT /end GROUP
/begin GROUP CalRegn01Cmn.FordMsg202BusHiSpdGearRvsStsVldMissThd.Val "MICROSAR RTE" /begin SUB_GROUP /end SUB_GROUP /begin FUNCTION_LIST /end FUNCTION_LIST /begin REF_CHARACTERISTIC CalRegn01Cmn.FordMsg202BusHiSpdGearRvsStsVldMissThd.Val /end REF_CHARACTERISTIC /begin REF_MEASUREMENT /end REF_MEASUREMENT /end GROUP
/begin GROUP CalRegn01Cmn.FordMsg202BusHiSpdGearRvsStsVldPassdThd.Val "MICROSAR RTE" /begin SUB_GROUP /end SUB_GROUP /begin FUNCTION_LIST /end FUNCTION_LIST /begin REF_CHARACTERISTIC CalRegn01Cmn.FordMsg202BusHiSpdGearRvsStsVldPassdThd.Val /end REF_CHARACTERISTIC /begin REF_MEASUREMENT /end REF_MEASUREMENT /end GROUP
/begin GROUP CalRegn01Cmn.FordMsg202BusHiSpdMissMsgFaildAbsPrsntDisadThd.Val "MICROSAR RTE" /begin SUB_GROUP /end SUB_GROUP /begin FUNCTION_LIST /end FUNCTION_LIST
 /begin REF_CHARACTERISTIC CalRegn01Cmn.FordMsg202BusHiSpdMissMsgFaildAbsPrsntDisadThd.Val /end REF_CHARACTERISTIC
 /begin REF_MEASUREMENT /end REF_MEASUREMENT
/end GROUP
/begin GROUP CalRegn01Cmn.FordMsg202BusHiSpdMissMsgFaildAbsPrsntEnadThd.Val "MICROSAR RTE" /begin SUB_GROUP /end SUB_GROUP /begin FUNCTION_LIST /end FUNCTION_LIST
 /begin REF_CHARACTERISTIC CalRegn01Cmn.FordMsg202BusHiSpdMissMsgFaildAbsPrsntEnadThd.Val /end REF_CHARACTERISTIC
 /begin REF_MEASUREMENT /end REF_MEASUREMENT
/end GROUP
/begin GROUP CalRegn01Cmn.FordMsg202BusHiSpdMissMsgPassdThd.Val "MICROSAR RTE" /begin SUB_GROUP /end SUB_GROUP /begin FUNCTION_LIST /end FUNCTION_LIST /begin REF_CHARACTERISTIC CalRegn01Cmn.FordMsg202BusHiSpdMissMsgPassdThd.Val /end REF_CHARACTERISTIC /begin REF_MEASUREMENT /end REF_MEASUREMENT /end GROUP
/begin GROUP CalRegn01Cmn.FordMsg202BusHiSpdQlyFacEngModInvldFaildThd.Val "MICROSAR RTE" /begin SUB_GROUP /end SUB_GROUP /begin FUNCTION_LIST /end FUNCTION_LIST
 /begin REF_CHARACTERISTIC CalRegn01Cmn.FordMsg202BusHiSpdQlyFacEngModInvldFaildThd.Val /end REF_CHARACTERISTIC
 /begin REF_MEASUREMENT /end REF_MEASUREMENT
/end GROUP
/begin GROUP CalRegn01Cmn.FordMsg202BusHiSpdQlyFacEngModInvldPassdThd.Val "MICROSAR RTE" /begin SUB_GROUP /end SUB_GROUP /begin FUNCTION_LIST /end FUNCTION_LIST
 /begin REF_CHARACTERISTIC CalRegn01Cmn.FordMsg202BusHiSpdQlyFacEngModInvldPassdThd.Val /end REF_CHARACTERISTIC
 /begin REF_MEASUREMENT /end REF_MEASUREMENT
/end GROUP
/begin GROUP CalRegn01Cmn.FordMsg202BusHiSpdTrlrBackupAssiAvlVldMissThd.Val "MICROSAR RTE" /begin SUB_GROUP /end SUB_GROUP /begin FUNCTION_LIST /end FUNCTION_LIST
 /begin REF_CHARACTERISTIC CalRegn01Cmn.FordMsg202BusHiSpdTrlrBackupAssiAvlVldMissThd.Val /end REF_CHARACTERISTIC
 /begin REF_MEASUREMENT /end REF_MEASUREMENT
/end GROUP
/begin GROUP CalRegn01Cmn.FordMsg202BusHiSpdTrlrBackupAssiAvlVldPassdThd.Val "MICROSAR RTE" /begin SUB_GROUP /end SUB_GROUP /begin FUNCTION_LIST /end FUNCTION_LIST
 /begin REF_CHARACTERISTIC CalRegn01Cmn.FordMsg202BusHiSpdTrlrBackupAssiAvlVldPassdThd.Val /end REF_CHARACTERISTIC
 /begin REF_MEASUREMENT /end REF_MEASUREMENT
/end GROUP
/begin GROUP CalRegn01Cmn.FordMsg213BusHiSpdAbsActvVldFaildThd.Val "MICROSAR RTE" /begin SUB_GROUP /end SUB_GROUP /begin FUNCTION_LIST /end FUNCTION_LIST /begin REF_CHARACTERISTIC CalRegn01Cmn.FordMsg213BusHiSpdAbsActvVldFaildThd.Val /end REF_CHARACTERISTIC /begin REF_MEASUREMENT /end REF_MEASUREMENT /end GROUP
/begin GROUP CalRegn01Cmn.FordMsg213BusHiSpdAbsActvVldPassdThd.Val "MICROSAR RTE" /begin SUB_GROUP /end SUB_GROUP /begin FUNCTION_LIST /end FUNCTION_LIST /begin REF_CHARACTERISTIC CalRegn01Cmn.FordMsg213BusHiSpdAbsActvVldPassdThd.Val /end REF_CHARACTERISTIC /begin REF_MEASUREMENT /end REF_MEASUREMENT /end GROUP
/begin GROUP CalRegn01Cmn.FordMsg213BusHiSpdEvasSteerAssiEnadThd.Val "MICROSAR RTE" /begin SUB_GROUP /end SUB_GROUP /begin FUNCTION_LIST /end FUNCTION_LIST /begin REF_CHARACTERISTIC CalRegn01Cmn.FordMsg213BusHiSpdEvasSteerAssiEnadThd.Val /end REF_CHARACTERISTIC /begin REF_MEASUREMENT /end REF_MEASUREMENT /end GROUP
/begin GROUP CalRegn01Cmn.FordMsg213BusHiSpdMissMsgFaildThd.Val "MICROSAR RTE" /begin SUB_GROUP /end SUB_GROUP /begin FUNCTION_LIST /end FUNCTION_LIST /begin REF_CHARACTERISTIC CalRegn01Cmn.FordMsg213BusHiSpdMissMsgFaildThd.Val /end REF_CHARACTERISTIC /begin REF_MEASUREMENT /end REF_MEASUREMENT /end GROUP
/begin GROUP CalRegn01Cmn.FordMsg213BusHiSpdMissMsgPassdThd.Val "MICROSAR RTE" /begin SUB_GROUP /end SUB_GROUP /begin FUNCTION_LIST /end FUNCTION_LIST /begin REF_CHARACTERISTIC CalRegn01Cmn.FordMsg213BusHiSpdMissMsgPassdThd.Val /end REF_CHARACTERISTIC /begin REF_MEASUREMENT /end REF_MEASUREMENT /end GROUP
/begin GROUP CalRegn01Cmn.FordMsg215BusHiSpdFordVehTrlrAidModReqVldNotRxdTiThd.Val "MICROSAR RTE" /begin SUB_GROUP /end SUB_GROUP /begin FUNCTION_LIST /end FUNCTION_LIST
 /begin REF_CHARACTERISTIC CalRegn01Cmn.FordMsg215BusHiSpdFordVehTrlrAidModReqVldNotRxdTiThd.Val /end REF_CHARACTERISTIC
 /begin REF_MEASUREMENT /end REF_MEASUREMENT
/end GROUP
/begin GROUP CalRegn01Cmn.FordMsg215BusHiSpdFordVehTrlrAidModReqVldRxdTiThd.Val "MICROSAR RTE" /begin SUB_GROUP /end SUB_GROUP /begin FUNCTION_LIST /end FUNCTION_LIST
 /begin REF_CHARACTERISTIC CalRegn01Cmn.FordMsg215BusHiSpdFordVehTrlrAidModReqVldRxdTiThd.Val /end REF_CHARACTERISTIC
 /begin REF_MEASUREMENT /end REF_MEASUREMENT
/end GROUP
/begin GROUP CalRegn01Cmn.FordMsg215BusHiSpdMissMsgFaildTiThd.Val "MICROSAR RTE" /begin SUB_GROUP /end SUB_GROUP /begin FUNCTION_LIST /end FUNCTION_LIST /begin REF_CHARACTERISTIC CalRegn01Cmn.FordMsg215BusHiSpdMissMsgFaildTiThd.Val /end REF_CHARACTERISTIC /begin REF_MEASUREMENT /end REF_MEASUREMENT /end GROUP
/begin GROUP CalRegn01Cmn.FordMsg215BusHiSpdMissMsgPassdTiThd.Val "MICROSAR RTE" /begin SUB_GROUP /end SUB_GROUP /begin FUNCTION_LIST /end FUNCTION_LIST /begin REF_CHARACTERISTIC CalRegn01Cmn.FordMsg215BusHiSpdMissMsgPassdTiThd.Val /end REF_CHARACTERISTIC /begin REF_MEASUREMENT /end REF_MEASUREMENT /end GROUP
/begin GROUP CalRegn01Cmn.FordMsg216BusHiSpdFrntLeWhlCntrDirFaildTiThd.Val "MICROSAR RTE" /begin SUB_GROUP /end SUB_GROUP /begin FUNCTION_LIST /end FUNCTION_LIST
 /begin REF_CHARACTERISTIC CalRegn01Cmn.FordMsg216BusHiSpdFrntLeWhlCntrDirFaildTiThd.Val /end REF_CHARACTERISTIC
 /begin REF_MEASUREMENT /end REF_MEASUREMENT
/end GROUP
/begin GROUP CalRegn01Cmn.FordMsg216BusHiSpdFrntLeWhlCntrDirPassdTiThd.Val "MICROSAR RTE" /begin SUB_GROUP /end SUB_GROUP /begin FUNCTION_LIST /end FUNCTION_LIST
 /begin REF_CHARACTERISTIC CalRegn01Cmn.FordMsg216BusHiSpdFrntLeWhlCntrDirPassdTiThd.Val /end REF_CHARACTERISTIC
 /begin REF_MEASUREMENT /end REF_MEASUREMENT
/end GROUP
/begin GROUP CalRegn01Cmn.FordMsg216BusHiSpdFrntLeWhlVldMissMsgThd.Val "MICROSAR RTE" /begin SUB_GROUP /end SUB_GROUP /begin FUNCTION_LIST /end FUNCTION_LIST /begin REF_CHARACTERISTIC CalRegn01Cmn.FordMsg216BusHiSpdFrntLeWhlVldMissMsgThd.Val /end REF_CHARACTERISTIC /begin REF_MEASUREMENT /end REF_MEASUREMENT /end GROUP
/begin GROUP CalRegn01Cmn.FordMsg216BusHiSpdFrntRiWhlCntrDirFaildTiThd.Val "MICROSAR RTE" /begin SUB_GROUP /end SUB_GROUP /begin FUNCTION_LIST /end FUNCTION_LIST
 /begin REF_CHARACTERISTIC CalRegn01Cmn.FordMsg216BusHiSpdFrntRiWhlCntrDirFaildTiThd.Val /end REF_CHARACTERISTIC
 /begin REF_MEASUREMENT /end REF_MEASUREMENT
/end GROUP
/begin GROUP CalRegn01Cmn.FordMsg216BusHiSpdFrntRiWhlCntrDirPassdTiThd.Val "MICROSAR RTE" /begin SUB_GROUP /end SUB_GROUP /begin FUNCTION_LIST /end FUNCTION_LIST
 /begin REF_CHARACTERISTIC CalRegn01Cmn.FordMsg216BusHiSpdFrntRiWhlCntrDirPassdTiThd.Val /end REF_CHARACTERISTIC
 /begin REF_MEASUREMENT /end REF_MEASUREMENT
/end GROUP
/begin GROUP CalRegn01Cmn.FordMsg216BusHiSpdFrntRiWhlVldMissMsgThd.Val "MICROSAR RTE" /begin SUB_GROUP /end SUB_GROUP /begin FUNCTION_LIST /end FUNCTION_LIST /begin REF_CHARACTERISTIC CalRegn01Cmn.FordMsg216BusHiSpdFrntRiWhlVldMissMsgThd.Val /end REF_CHARACTERISTIC /begin REF_MEASUREMENT /end REF_MEASUREMENT /end GROUP
/begin GROUP CalRegn01Cmn.FordMsg216BusHiSpdMissMsgFaildTiThd.Val "MICROSAR RTE" /begin SUB_GROUP /end SUB_GROUP /begin FUNCTION_LIST /end FUNCTION_LIST /begin REF_CHARACTERISTIC CalRegn01Cmn.FordMsg216BusHiSpdMissMsgFaildTiThd.Val /end REF_CHARACTERISTIC /begin REF_MEASUREMENT /end REF_MEASUREMENT /end GROUP
/begin GROUP CalRegn01Cmn.FordMsg216BusHiSpdMissMsgPassdTiThd.Val "MICROSAR RTE" /begin SUB_GROUP /end SUB_GROUP /begin FUNCTION_LIST /end FUNCTION_LIST /begin REF_CHARACTERISTIC CalRegn01Cmn.FordMsg216BusHiSpdMissMsgPassdTiThd.Val /end REF_CHARACTERISTIC /begin REF_MEASUREMENT /end REF_MEASUREMENT /end GROUP
/begin GROUP CalRegn01Cmn.FordMsg216BusHiSpdReLeWhlCntrDirFaildTiThd.Val "MICROSAR RTE" /begin SUB_GROUP /end SUB_GROUP /begin FUNCTION_LIST /end FUNCTION_LIST
 /begin REF_CHARACTERISTIC CalRegn01Cmn.FordMsg216BusHiSpdReLeWhlCntrDirFaildTiThd.Val /end REF_CHARACTERISTIC
 /begin REF_MEASUREMENT /end REF_MEASUREMENT
/end GROUP
/begin GROUP CalRegn01Cmn.FordMsg216BusHiSpdReLeWhlCntrDirPassdTiThd.Val "MICROSAR RTE" /begin SUB_GROUP /end SUB_GROUP /begin FUNCTION_LIST /end FUNCTION_LIST
 /begin REF_CHARACTERISTIC CalRegn01Cmn.FordMsg216BusHiSpdReLeWhlCntrDirPassdTiThd.Val /end REF_CHARACTERISTIC
 /begin REF_MEASUREMENT /end REF_MEASUREMENT
/end GROUP
/begin GROUP CalRegn01Cmn.FordMsg216BusHiSpdReLeWhlVldMissMsgThd.Val "MICROSAR RTE" /begin SUB_GROUP /end SUB_GROUP /begin FUNCTION_LIST /end FUNCTION_LIST /begin REF_CHARACTERISTIC CalRegn01Cmn.FordMsg216BusHiSpdReLeWhlVldMissMsgThd.Val /end REF_CHARACTERISTIC /begin REF_MEASUREMENT /end REF_MEASUREMENT /end GROUP
/begin GROUP CalRegn01Cmn.FordMsg216BusHiSpdReRiWhlCntrDirFaildTiThd.Val "MICROSAR RTE" /begin SUB_GROUP /end SUB_GROUP /begin FUNCTION_LIST /end FUNCTION_LIST
 /begin REF_CHARACTERISTIC CalRegn01Cmn.FordMsg216BusHiSpdReRiWhlCntrDirFaildTiThd.Val /end REF_CHARACTERISTIC
 /begin REF_MEASUREMENT /end REF_MEASUREMENT
/end GROUP
/begin GROUP CalRegn01Cmn.FordMsg216BusHiSpdReRiWhlCntrDirPassdTiThd.Val "MICROSAR RTE" /begin SUB_GROUP /end SUB_GROUP /begin FUNCTION_LIST /end FUNCTION_LIST
 /begin REF_CHARACTERISTIC CalRegn01Cmn.FordMsg216BusHiSpdReRiWhlCntrDirPassdTiThd.Val /end REF_CHARACTERISTIC
 /begin REF_MEASUREMENT /end REF_MEASUREMENT
/end GROUP
/begin GROUP CalRegn01Cmn.FordMsg216BusHiSpdReRiWhlVldMissMsgThd.Val "MICROSAR RTE" /begin SUB_GROUP /end SUB_GROUP /begin FUNCTION_LIST /end FUNCTION_LIST /begin REF_CHARACTERISTIC CalRegn01Cmn.FordMsg216BusHiSpdReRiWhlVldMissMsgThd.Val /end REF_CHARACTERISTIC /begin REF_MEASUREMENT /end REF_MEASUREMENT /end GROUP
/begin GROUP CalRegn01Cmn.FordMsg217BusHiSpdFrntLeWhlSpdInvldFaildThd.Val "MICROSAR RTE" /begin SUB_GROUP /end SUB_GROUP /begin FUNCTION_LIST /end FUNCTION_LIST
 /begin REF_CHARACTERISTIC CalRegn01Cmn.FordMsg217BusHiSpdFrntLeWhlSpdInvldFaildThd.Val /end REF_CHARACTERISTIC
 /begin REF_MEASUREMENT /end REF_MEASUREMENT
/end GROUP
/begin GROUP CalRegn01Cmn.FordMsg217BusHiSpdFrntLeWhlSpdInvldPassdThd.Val "MICROSAR RTE" /begin SUB_GROUP /end SUB_GROUP /begin FUNCTION_LIST /end FUNCTION_LIST
 /begin REF_CHARACTERISTIC CalRegn01Cmn.FordMsg217BusHiSpdFrntLeWhlSpdInvldPassdThd.Val /end REF_CHARACTERISTIC
 /begin REF_MEASUREMENT /end REF_MEASUREMENT
/end GROUP
/begin GROUP CalRegn01Cmn.FordMsg217BusHiSpdFrntLeWhlVldFaildThd.Val "MICROSAR RTE" /begin SUB_GROUP /end SUB_GROUP /begin FUNCTION_LIST /end FUNCTION_LIST /begin REF_CHARACTERISTIC CalRegn01Cmn.FordMsg217BusHiSpdFrntLeWhlVldFaildThd.Val /end REF_CHARACTERISTIC /begin REF_MEASUREMENT /end REF_MEASUREMENT /end GROUP
/begin GROUP CalRegn01Cmn.FordMsg217BusHiSpdFrntLeWhlVldMissThd.Val "MICROSAR RTE" /begin SUB_GROUP /end SUB_GROUP /begin FUNCTION_LIST /end FUNCTION_LIST /begin REF_CHARACTERISTIC CalRegn01Cmn.FordMsg217BusHiSpdFrntLeWhlVldMissThd.Val /end REF_CHARACTERISTIC /begin REF_MEASUREMENT /end REF_MEASUREMENT /end GROUP
/begin GROUP CalRegn01Cmn.FordMsg217BusHiSpdFrntLeWhlVldPassdThd.Val "MICROSAR RTE" /begin SUB_GROUP /end SUB_GROUP /begin FUNCTION_LIST /end FUNCTION_LIST /begin REF_CHARACTERISTIC CalRegn01Cmn.FordMsg217BusHiSpdFrntLeWhlVldPassdThd.Val /end REF_CHARACTERISTIC /begin REF_MEASUREMENT /end REF_MEASUREMENT /end GROUP
/begin GROUP CalRegn01Cmn.FordMsg217BusHiSpdFrntRiWhlSpdInvldFaildThd.Val "MICROSAR RTE" /begin SUB_GROUP /end SUB_GROUP /begin FUNCTION_LIST /end FUNCTION_LIST
 /begin REF_CHARACTERISTIC CalRegn01Cmn.FordMsg217BusHiSpdFrntRiWhlSpdInvldFaildThd.Val /end REF_CHARACTERISTIC
 /begin REF_MEASUREMENT /end REF_MEASUREMENT
/end GROUP
/begin GROUP CalRegn01Cmn.FordMsg217BusHiSpdFrntRiWhlSpdInvldPassdThd.Val "MICROSAR RTE" /begin SUB_GROUP /end SUB_GROUP /begin FUNCTION_LIST /end FUNCTION_LIST
 /begin REF_CHARACTERISTIC CalRegn01Cmn.FordMsg217BusHiSpdFrntRiWhlSpdInvldPassdThd.Val /end REF_CHARACTERISTIC
 /begin REF_MEASUREMENT /end REF_MEASUREMENT
/end GROUP
/begin GROUP CalRegn01Cmn.FordMsg217BusHiSpdFrntRiWhlVldFaildThd.Val "MICROSAR RTE" /begin SUB_GROUP /end SUB_GROUP /begin FUNCTION_LIST /end FUNCTION_LIST /begin REF_CHARACTERISTIC CalRegn01Cmn.FordMsg217BusHiSpdFrntRiWhlVldFaildThd.Val /end REF_CHARACTERISTIC /begin REF_MEASUREMENT /end REF_MEASUREMENT /end GROUP
/begin GROUP CalRegn01Cmn.FordMsg217BusHiSpdFrntRiWhlVldMissThd.Val "MICROSAR RTE" /begin SUB_GROUP /end SUB_GROUP /begin FUNCTION_LIST /end FUNCTION_LIST /begin REF_CHARACTERISTIC CalRegn01Cmn.FordMsg217BusHiSpdFrntRiWhlVldMissThd.Val /end REF_CHARACTERISTIC /begin REF_MEASUREMENT /end REF_MEASUREMENT /end GROUP
/begin GROUP CalRegn01Cmn.FordMsg217BusHiSpdFrntRiWhlVldPassdThd.Val "MICROSAR RTE" /begin SUB_GROUP /end SUB_GROUP /begin FUNCTION_LIST /end FUNCTION_LIST /begin REF_CHARACTERISTIC CalRegn01Cmn.FordMsg217BusHiSpdFrntRiWhlVldPassdThd.Val /end REF_CHARACTERISTIC /begin REF_MEASUREMENT /end REF_MEASUREMENT /end GROUP
/begin GROUP CalRegn01Cmn.FordMsg217BusHiSpdMissMsgFaildThd.Val "MICROSAR RTE" /begin SUB_GROUP /end SUB_GROUP /begin FUNCTION_LIST /end FUNCTION_LIST /begin REF_CHARACTERISTIC CalRegn01Cmn.FordMsg217BusHiSpdMissMsgFaildThd.Val /end REF_CHARACTERISTIC /begin REF_MEASUREMENT /end REF_MEASUREMENT /end GROUP
/begin GROUP CalRegn01Cmn.FordMsg217BusHiSpdMissMsgPassdThd.Val "MICROSAR RTE" /begin SUB_GROUP /end SUB_GROUP /begin FUNCTION_LIST /end FUNCTION_LIST /begin REF_CHARACTERISTIC CalRegn01Cmn.FordMsg217BusHiSpdMissMsgPassdThd.Val /end REF_CHARACTERISTIC /begin REF_MEASUREMENT /end REF_MEASUREMENT /end GROUP
/begin GROUP CalRegn01Cmn.FordMsg217BusHiSpdReLeWhlSpdInvldFaildThd.Val "MICROSAR RTE" /begin SUB_GROUP /end SUB_GROUP /begin FUNCTION_LIST /end FUNCTION_LIST /begin REF_CHARACTERISTIC CalRegn01Cmn.FordMsg217BusHiSpdReLeWhlSpdInvldFaildThd.Val /end REF_CHARACTERISTIC /begin REF_MEASUREMENT /end REF_MEASUREMENT /end GROUP
/begin GROUP CalRegn01Cmn.FordMsg217BusHiSpdReLeWhlSpdInvldPassdThd.Val "MICROSAR RTE" /begin SUB_GROUP /end SUB_GROUP /begin FUNCTION_LIST /end FUNCTION_LIST /begin REF_CHARACTERISTIC CalRegn01Cmn.FordMsg217BusHiSpdReLeWhlSpdInvldPassdThd.Val /end REF_CHARACTERISTIC /begin REF_MEASUREMENT /end REF_MEASUREMENT /end GROUP
/begin GROUP CalRegn01Cmn.FordMsg217BusHiSpdReLeWhlVldFaildThd.Val "MICROSAR RTE" /begin SUB_GROUP /end SUB_GROUP /begin FUNCTION_LIST /end FUNCTION_LIST /begin REF_CHARACTERISTIC CalRegn01Cmn.FordMsg217BusHiSpdReLeWhlVldFaildThd.Val /end REF_CHARACTERISTIC /begin REF_MEASUREMENT /end REF_MEASUREMENT /end GROUP
/begin GROUP CalRegn01Cmn.FordMsg217BusHiSpdReLeWhlVldMissThd.Val "MICROSAR RTE" /begin SUB_GROUP /end SUB_GROUP /begin FUNCTION_LIST /end FUNCTION_LIST /begin REF_CHARACTERISTIC CalRegn01Cmn.FordMsg217BusHiSpdReLeWhlVldMissThd.Val /end REF_CHARACTERISTIC /begin REF_MEASUREMENT /end REF_MEASUREMENT /end GROUP
/begin GROUP CalRegn01Cmn.FordMsg217BusHiSpdReLeWhlVldPassdThd.Val "MICROSAR RTE" /begin SUB_GROUP /end SUB_GROUP /begin FUNCTION_LIST /end FUNCTION_LIST /begin REF_CHARACTERISTIC CalRegn01Cmn.FordMsg217BusHiSpdReLeWhlVldPassdThd.Val /end REF_CHARACTERISTIC /begin REF_MEASUREMENT /end REF_MEASUREMENT /end GROUP
/begin GROUP CalRegn01Cmn.FordMsg217BusHiSpdReRiWhlSpdInvldFaildThd.Val "MICROSAR RTE" /begin SUB_GROUP /end SUB_GROUP /begin FUNCTION_LIST /end FUNCTION_LIST /begin REF_CHARACTERISTIC CalRegn01Cmn.FordMsg217BusHiSpdReRiWhlSpdInvldFaildThd.Val /end REF_CHARACTERISTIC /begin REF_MEASUREMENT /end REF_MEASUREMENT /end GROUP
/begin GROUP CalRegn01Cmn.FordMsg217BusHiSpdReRiWhlSpdInvldPassdThd.Val "MICROSAR RTE" /begin SUB_GROUP /end SUB_GROUP /begin FUNCTION_LIST /end FUNCTION_LIST /begin REF_CHARACTERISTIC CalRegn01Cmn.FordMsg217BusHiSpdReRiWhlSpdInvldPassdThd.Val /end REF_CHARACTERISTIC /begin REF_MEASUREMENT /end REF_MEASUREMENT /end GROUP
/begin GROUP CalRegn01Cmn.FordMsg217BusHiSpdReRiWhlVldFaildThd.Val "MICROSAR RTE" /begin SUB_GROUP /end SUB_GROUP /begin FUNCTION_LIST /end FUNCTION_LIST /begin REF_CHARACTERISTIC CalRegn01Cmn.FordMsg217BusHiSpdReRiWhlVldFaildThd.Val /end REF_CHARACTERISTIC /begin REF_MEASUREMENT /end REF_MEASUREMENT /end GROUP
/begin GROUP CalRegn01Cmn.FordMsg217BusHiSpdReRiWhlVldMissThd.Val "MICROSAR RTE" /begin SUB_GROUP /end SUB_GROUP /begin FUNCTION_LIST /end FUNCTION_LIST /begin REF_CHARACTERISTIC CalRegn01Cmn.FordMsg217BusHiSpdReRiWhlVldMissThd.Val /end REF_CHARACTERISTIC /begin REF_MEASUREMENT /end REF_MEASUREMENT /end GROUP
/begin GROUP CalRegn01Cmn.FordMsg217BusHiSpdReRiWhlVldPassdThd.Val "MICROSAR RTE" /begin SUB_GROUP /end SUB_GROUP /begin FUNCTION_LIST /end FUNCTION_LIST /begin REF_CHARACTERISTIC CalRegn01Cmn.FordMsg217BusHiSpdReRiWhlVldPassdThd.Val /end REF_CHARACTERISTIC /begin REF_MEASUREMENT /end REF_MEASUREMENT /end GROUP
/begin GROUP CalRegn01Cmn.FordMsg230BusHiSpdFordVehGearLvrPosnFaildTiThd.Val "MICROSAR RTE" /begin SUB_GROUP /end SUB_GROUP /begin FUNCTION_LIST /end FUNCTION_LIST
 /begin REF_CHARACTERISTIC CalRegn01Cmn.FordMsg230BusHiSpdFordVehGearLvrPosnFaildTiThd.Val /end REF_CHARACTERISTIC
 /begin REF_MEASUREMENT /end REF_MEASUREMENT
/end GROUP
/begin GROUP CalRegn01Cmn.FordMsg230BusHiSpdFordVehGearLvrPosnPassdTiThd.Val "MICROSAR RTE" /begin SUB_GROUP /end SUB_GROUP /begin FUNCTION_LIST /end FUNCTION_LIST
 /begin REF_CHARACTERISTIC CalRegn01Cmn.FordMsg230BusHiSpdFordVehGearLvrPosnPassdTiThd.Val /end REF_CHARACTERISTIC
 /begin REF_MEASUREMENT /end REF_MEASUREMENT
/end GROUP
/begin GROUP CalRegn01Cmn.FordMsg230BusHiSpdGearLvrPosnMissTiThd.Val "MICROSAR RTE" /begin SUB_GROUP /end SUB_GROUP /begin FUNCTION_LIST /end FUNCTION_LIST /begin REF_CHARACTERISTIC CalRegn01Cmn.FordMsg230BusHiSpdGearLvrPosnMissTiThd.Val /end REF_CHARACTERISTIC /begin REF_MEASUREMENT /end REF_MEASUREMENT /end GROUP
/begin GROUP CalRegn01Cmn.FordMsg230BusHiSpdInvldSigFaildThd.Val "MICROSAR RTE" /begin SUB_GROUP /end SUB_GROUP /begin FUNCTION_LIST /end FUNCTION_LIST /begin REF_CHARACTERISTIC CalRegn01Cmn.FordMsg230BusHiSpdInvldSigFaildThd.Val /end REF_CHARACTERISTIC /begin REF_MEASUREMENT /end REF_MEASUREMENT /end GROUP
/begin GROUP CalRegn01Cmn.FordMsg230BusHiSpdInvldSigPassdThd.Val "MICROSAR RTE" /begin SUB_GROUP /end SUB_GROUP /begin FUNCTION_LIST /end FUNCTION_LIST /begin REF_CHARACTERISTIC CalRegn01Cmn.FordMsg230BusHiSpdInvldSigPassdThd.Val /end REF_CHARACTERISTIC /begin REF_MEASUREMENT /end REF_MEASUREMENT /end GROUP
/begin GROUP CalRegn01Cmn.FordMsg230BusHiSpdMissMsgFaildThd.Val "MICROSAR RTE" /begin SUB_GROUP /end SUB_GROUP /begin FUNCTION_LIST /end FUNCTION_LIST /begin REF_CHARACTERISTIC CalRegn01Cmn.FordMsg230BusHiSpdMissMsgFaildThd.Val /end REF_CHARACTERISTIC /begin REF_MEASUREMENT /end REF_MEASUREMENT /end GROUP
/begin GROUP CalRegn01Cmn.FordMsg230BusHiSpdMissMsgPassdThd.Val "MICROSAR RTE" /begin SUB_GROUP /end SUB_GROUP /begin FUNCTION_LIST /end FUNCTION_LIST /begin REF_CHARACTERISTIC CalRegn01Cmn.FordMsg230BusHiSpdMissMsgPassdThd.Val /end REF_CHARACTERISTIC /begin REF_MEASUREMENT /end REF_MEASUREMENT /end GROUP
/begin GROUP CalRegn01Cmn.FordMsg2FDBusHiSpdFordVehEvasSteerAssiReqVldNotRxdTiThd.Val "MICROSAR RTE" /begin SUB_GROUP /end SUB_GROUP /begin FUNCTION_LIST /end FUNCTION_LIST
 /begin REF_CHARACTERISTIC CalRegn01Cmn.FordMsg2FDBusHiSpdFordVehEvasSteerAssiReqVldNotRxdTiThd.Val /end REF_CHARACTERISTIC
 /begin REF_MEASUREMENT /end REF_MEASUREMENT
/end GROUP
/begin GROUP CalRegn01Cmn.FordMsg2FDBusHiSpdFordVehEvasSteerAssiReqVldRxdTiThd.Val "MICROSAR RTE" /begin SUB_GROUP /end SUB_GROUP /begin FUNCTION_LIST /end FUNCTION_LIST
 /begin REF_CHARACTERISTIC CalRegn01Cmn.FordMsg2FDBusHiSpdFordVehEvasSteerAssiReqVldRxdTiThd.Val /end REF_CHARACTERISTIC
 /begin REF_MEASUREMENT /end REF_MEASUREMENT
/end GROUP
/begin GROUP CalRegn01Cmn.FordMsg2FDBusHiSpdMissMsgFaildTiThd.Val "MICROSAR RTE" /begin SUB_GROUP /end SUB_GROUP /begin FUNCTION_LIST /end FUNCTION_LIST /begin REF_CHARACTERISTIC CalRegn01Cmn.FordMsg2FDBusHiSpdMissMsgFaildTiThd.Val /end REF_CHARACTERISTIC /begin REF_MEASUREMENT /end REF_MEASUREMENT /end GROUP
/begin GROUP CalRegn01Cmn.FordMsg2FDBusHiSpdMissMsgPassdTiThd.Val "MICROSAR RTE" /begin SUB_GROUP /end SUB_GROUP /begin FUNCTION_LIST /end FUNCTION_LIST /begin REF_CHARACTERISTIC CalRegn01Cmn.FordMsg2FDBusHiSpdMissMsgPassdTiThd.Val /end REF_CHARACTERISTIC /begin REF_MEASUREMENT /end REF_MEASUREMENT /end GROUP
/begin GROUP CalRegn01Cmn.FordMsg3B3BusHiSpdIgnStsVldFaildThd.Val "MICROSAR RTE" /begin SUB_GROUP /end SUB_GROUP /begin FUNCTION_LIST /end FUNCTION_LIST /begin REF_CHARACTERISTIC CalRegn01Cmn.FordMsg3B3BusHiSpdIgnStsVldFaildThd.Val /end REF_CHARACTERISTIC /begin REF_MEASUREMENT /end REF_MEASUREMENT /end GROUP
/begin GROUP CalRegn01Cmn.FordMsg3B3BusHiSpdIgnStsVldMissThd.Val "MICROSAR RTE" /begin SUB_GROUP /end SUB_GROUP /begin FUNCTION_LIST /end FUNCTION_LIST /begin REF_CHARACTERISTIC CalRegn01Cmn.FordMsg3B3BusHiSpdIgnStsVldMissThd.Val /end REF_CHARACTERISTIC /begin REF_MEASUREMENT /end REF_MEASUREMENT /end GROUP
/begin GROUP CalRegn01Cmn.FordMsg3B3BusHiSpdIgnStsVldPassdThd.Val "MICROSAR RTE" /begin SUB_GROUP /end SUB_GROUP /begin FUNCTION_LIST /end FUNCTION_LIST /begin REF_CHARACTERISTIC CalRegn01Cmn.FordMsg3B3BusHiSpdIgnStsVldPassdThd.Val /end REF_CHARACTERISTIC /begin REF_MEASUREMENT /end REF_MEASUREMENT /end GROUP
/begin GROUP CalRegn01Cmn.FordMsg3B3BusHiSpdInvldSigFaildThd.Val "MICROSAR RTE" /begin SUB_GROUP /end SUB_GROUP /begin FUNCTION_LIST /end FUNCTION_LIST /begin REF_CHARACTERISTIC CalRegn01Cmn.FordMsg3B3BusHiSpdInvldSigFaildThd.Val /end REF_CHARACTERISTIC /begin REF_MEASUREMENT /end REF_MEASUREMENT /end GROUP
/begin GROUP CalRegn01Cmn.FordMsg3B3BusHiSpdInvldSigPassdThd.Val "MICROSAR RTE" /begin SUB_GROUP /end SUB_GROUP /begin FUNCTION_LIST /end FUNCTION_LIST /begin REF_CHARACTERISTIC CalRegn01Cmn.FordMsg3B3BusHiSpdInvldSigPassdThd.Val /end REF_CHARACTERISTIC /begin REF_MEASUREMENT /end REF_MEASUREMENT /end GROUP
/begin GROUP CalRegn01Cmn.FordMsg3B3BusHiSpdMissMsgFaildThd.Val "MICROSAR RTE" /begin SUB_GROUP /end SUB_GROUP /begin FUNCTION_LIST /end FUNCTION_LIST /begin REF_CHARACTERISTIC CalRegn01Cmn.FordMsg3B3BusHiSpdMissMsgFaildThd.Val /end REF_CHARACTERISTIC /begin REF_MEASUREMENT /end REF_MEASUREMENT /end GROUP
/begin GROUP CalRegn01Cmn.FordMsg3B3BusHiSpdMissMsgPassdThd.Val "MICROSAR RTE" /begin SUB_GROUP /end SUB_GROUP /begin FUNCTION_LIST /end FUNCTION_LIST /begin REF_CHARACTERISTIC CalRegn01Cmn.FordMsg3B3BusHiSpdMissMsgPassdThd.Val /end REF_CHARACTERISTIC /begin REF_MEASUREMENT /end REF_MEASUREMENT /end GROUP
/begin GROUP CalRegn01Cmn.FordMsg3CABusHiSpdLaneAssiImgProcgModlAFaildCrvtTiThd.Val "MICROSAR RTE" /begin SUB_GROUP /end SUB_GROUP /begin FUNCTION_LIST /end FUNCTION_LIST
 /begin REF_CHARACTERISTIC CalRegn01Cmn.FordMsg3CABusHiSpdLaneAssiImgProcgModlAFaildCrvtTiThd.Val /end REF_CHARACTERISTIC
 /begin REF_MEASUREMENT /end REF_MEASUREMENT
/end GROUP
/begin GROUP CalRegn01Cmn.FordMsg3CABusHiSpdLaneAssiImgProcgModlAFaildReqdAgTiThd.Val "MICROSAR RTE" /begin SUB_GROUP /end SUB_GROUP /begin FUNCTION_LIST /end FUNCTION_LIST
 /begin REF_CHARACTERISTIC CalRegn01Cmn.FordMsg3CABusHiSpdLaneAssiImgProcgModlAFaildReqdAgTiThd.Val /end REF_CHARACTERISTIC
 /begin REF_MEASUREMENT /end REF_MEASUREMENT
/end GROUP
/begin GROUP CalRegn01Cmn.FordMsg3CABusHiSpdLaneAssiImgProcgModlAPassdTiThd.Val "MICROSAR RTE" /begin SUB_GROUP /end SUB_GROUP /begin FUNCTION_LIST /end FUNCTION_LIST
 /begin REF_CHARACTERISTIC CalRegn01Cmn.FordMsg3CABusHiSpdLaneAssiImgProcgModlAPassdTiThd.Val /end REF_CHARACTERISTIC
 /begin REF_MEASUREMENT /end REF_MEASUREMENT
/end GROUP
/begin GROUP CalRegn01Cmn.FordMsg3CABusHiSpdLaneAssiImgProcgModlAVldMissTiThd.Val "MICROSAR RTE" /begin SUB_GROUP /end SUB_GROUP /begin FUNCTION_LIST /end FUNCTION_LIST
 /begin REF_CHARACTERISTIC CalRegn01Cmn.FordMsg3CABusHiSpdLaneAssiImgProcgModlAVldMissTiThd.Val /end REF_CHARACTERISTIC
 /begin REF_MEASUREMENT /end REF_MEASUREMENT
/end GROUP
/begin GROUP CalRegn01Cmn.FordMsg3CABusHiSpdLaneKeepSysCrvtInvldFaildTiThd.Val "MICROSAR RTE" /begin SUB_GROUP /end SUB_GROUP /begin FUNCTION_LIST /end FUNCTION_LIST
 /begin REF_CHARACTERISTIC CalRegn01Cmn.FordMsg3CABusHiSpdLaneKeepSysCrvtInvldFaildTiThd.Val /end REF_CHARACTERISTIC
 /begin REF_MEASUREMENT /end REF_MEASUREMENT
/end GROUP
/begin GROUP CalRegn01Cmn.FordMsg3CABusHiSpdLaneKeepSysCrvtInvldPassdTiThd.Val "MICROSAR RTE" /begin SUB_GROUP /end SUB_GROUP /begin FUNCTION_LIST /end FUNCTION_LIST
 /begin REF_CHARACTERISTIC CalRegn01Cmn.FordMsg3CABusHiSpdLaneKeepSysCrvtInvldPassdTiThd.Val /end REF_CHARACTERISTIC
 /begin REF_MEASUREMENT /end REF_MEASUREMENT
/end GROUP
/begin GROUP CalRegn01Cmn.FordMsg3CABusHiSpdLaneKeepSysReqdAgInvldFaildTiThd.Val "MICROSAR RTE" /begin SUB_GROUP /end SUB_GROUP /begin FUNCTION_LIST /end FUNCTION_LIST
 /begin REF_CHARACTERISTIC CalRegn01Cmn.FordMsg3CABusHiSpdLaneKeepSysReqdAgInvldFaildTiThd.Val /end REF_CHARACTERISTIC
 /begin REF_MEASUREMENT /end REF_MEASUREMENT
/end GROUP
/begin GROUP CalRegn01Cmn.FordMsg3CABusHiSpdLaneKeepSysReqdAgInvldPassdTiThd.Val "MICROSAR RTE" /begin SUB_GROUP /end SUB_GROUP /begin FUNCTION_LIST /end FUNCTION_LIST
 /begin REF_CHARACTERISTIC CalRegn01Cmn.FordMsg3CABusHiSpdLaneKeepSysReqdAgInvldPassdTiThd.Val /end REF_CHARACTERISTIC
 /begin REF_MEASUREMENT /end REF_MEASUREMENT
/end GROUP
/begin GROUP CalRegn01Cmn.FordMsg3CABusHiSpdMissMsgFaildTiThd.Val "MICROSAR RTE" /begin SUB_GROUP /end SUB_GROUP /begin FUNCTION_LIST /end FUNCTION_LIST /begin REF_CHARACTERISTIC CalRegn01Cmn.FordMsg3CABusHiSpdMissMsgFaildTiThd.Val /end REF_CHARACTERISTIC /begin REF_MEASUREMENT /end REF_MEASUREMENT /end GROUP
/begin GROUP CalRegn01Cmn.FordMsg3CABusHiSpdMissMsgPassdTiThd.Val "MICROSAR RTE" /begin SUB_GROUP /end SUB_GROUP /begin FUNCTION_LIST /end FUNCTION_LIST /begin REF_CHARACTERISTIC CalRegn01Cmn.FordMsg3CABusHiSpdMissMsgPassdTiThd.Val /end REF_CHARACTERISTIC /begin REF_MEASUREMENT /end REF_MEASUREMENT /end GROUP
/begin GROUP CalRegn01Cmn.FordMsg3D3BusHiSpdImgProcrModlAVldFaildThd.Val "MICROSAR RTE" /begin SUB_GROUP /end SUB_GROUP /begin FUNCTION_LIST /end FUNCTION_LIST
 /begin REF_CHARACTERISTIC CalRegn01Cmn.FordMsg3D3BusHiSpdImgProcrModlAVldFaildThd.Val /end REF_CHARACTERISTIC
 /begin REF_MEASUREMENT /end REF_MEASUREMENT
/end GROUP
/begin GROUP CalRegn01Cmn.FordMsg3D3BusHiSpdImgProcrModlAVldPassdThd.Val "MICROSAR RTE" /begin SUB_GROUP /end SUB_GROUP /begin FUNCTION_LIST /end FUNCTION_LIST
 /begin REF_CHARACTERISTIC CalRegn01Cmn.FordMsg3D3BusHiSpdImgProcrModlAVldPassdThd.Val /end REF_CHARACTERISTIC
 /begin REF_MEASUREMENT /end REF_MEASUREMENT
/end GROUP
/begin GROUP CalRegn01Cmn.FordMsg3D3BusHiSpdMissMsgFaildThd.Val "MICROSAR RTE" /begin SUB_GROUP /end SUB_GROUP /begin FUNCTION_LIST /end FUNCTION_LIST /begin REF_CHARACTERISTIC CalRegn01Cmn.FordMsg3D3BusHiSpdMissMsgFaildThd.Val /end REF_CHARACTERISTIC /begin REF_MEASUREMENT /end REF_MEASUREMENT /end GROUP
/begin GROUP CalRegn01Cmn.FordMsg3D3BusHiSpdMissMsgPassdThd.Val "MICROSAR RTE" /begin SUB_GROUP /end SUB_GROUP /begin FUNCTION_LIST /end FUNCTION_LIST /begin REF_CHARACTERISTIC CalRegn01Cmn.FordMsg3D3BusHiSpdMissMsgPassdThd.Val /end REF_CHARACTERISTIC /begin REF_MEASUREMENT /end REF_MEASUREMENT /end GROUP
/begin GROUP CalRegn01Cmn.FordMsg3D7BusHiSpdImgProcrModlAVldMissThd.Val "MICROSAR RTE" /begin SUB_GROUP /end SUB_GROUP /begin FUNCTION_LIST /end FUNCTION_LIST /begin REF_CHARACTERISTIC CalRegn01Cmn.FordMsg3D7BusHiSpdImgProcrModlAVldMissThd.Val /end REF_CHARACTERISTIC /begin REF_MEASUREMENT /end REF_MEASUREMENT /end GROUP
/begin GROUP CalRegn01Cmn.FordMsg3D7BusHiSpdImgProcrModlAVldPassdThd.Val "MICROSAR RTE" /begin SUB_GROUP /end SUB_GROUP /begin FUNCTION_LIST /end FUNCTION_LIST
 /begin REF_CHARACTERISTIC CalRegn01Cmn.FordMsg3D7BusHiSpdImgProcrModlAVldPassdThd.Val /end REF_CHARACTERISTIC
 /begin REF_MEASUREMENT /end REF_MEASUREMENT
/end GROUP
/begin GROUP CalRegn01Cmn.FordMsg3D7BusHiSpdLatDstInvldFaildThd.Val "MICROSAR RTE" /begin SUB_GROUP /end SUB_GROUP /begin FUNCTION_LIST /end FUNCTION_LIST /begin REF_CHARACTERISTIC CalRegn01Cmn.FordMsg3D7BusHiSpdLatDstInvldFaildThd.Val /end REF_CHARACTERISTIC /begin REF_MEASUREMENT /end REF_MEASUREMENT /end GROUP
/begin GROUP CalRegn01Cmn.FordMsg3D7BusHiSpdLatDstInvldPassdThd.Val "MICROSAR RTE" /begin SUB_GROUP /end SUB_GROUP /begin FUNCTION_LIST /end FUNCTION_LIST /begin REF_CHARACTERISTIC CalRegn01Cmn.FordMsg3D7BusHiSpdLatDstInvldPassdThd.Val /end REF_CHARACTERISTIC /begin REF_MEASUREMENT /end REF_MEASUREMENT /end GROUP
/begin GROUP CalRegn01Cmn.FordMsg3D7BusHiSpdLatDstRawVldFaildThd.Val "MICROSAR RTE" /begin SUB_GROUP /end SUB_GROUP /begin FUNCTION_LIST /end FUNCTION_LIST /begin REF_CHARACTERISTIC CalRegn01Cmn.FordMsg3D7BusHiSpdLatDstRawVldFaildThd.Val /end REF_CHARACTERISTIC /begin REF_MEASUREMENT /end REF_MEASUREMENT /end GROUP
/begin GROUP CalRegn01Cmn.FordMsg3D7BusHiSpdLgtDstInvldFaildThd.Val "MICROSAR RTE" /begin SUB_GROUP /end SUB_GROUP /begin FUNCTION_LIST /end FUNCTION_LIST /begin REF_CHARACTERISTIC CalRegn01Cmn.FordMsg3D7BusHiSpdLgtDstInvldFaildThd.Val /end REF_CHARACTERISTIC /begin REF_MEASUREMENT /end REF_MEASUREMENT /end GROUP
/begin GROUP CalRegn01Cmn.FordMsg3D7BusHiSpdLgtDstInvldPassdThd.Val "MICROSAR RTE" /begin SUB_GROUP /end SUB_GROUP /begin FUNCTION_LIST /end FUNCTION_LIST /begin REF_CHARACTERISTIC CalRegn01Cmn.FordMsg3D7BusHiSpdLgtDstInvldPassdThd.Val /end REF_CHARACTERISTIC /begin REF_MEASUREMENT /end REF_MEASUREMENT /end GROUP
/begin GROUP CalRegn01Cmn.FordMsg3D7BusHiSpdLgtDstRawVldFaildThd.Val "MICROSAR RTE" /begin SUB_GROUP /end SUB_GROUP /begin FUNCTION_LIST /end FUNCTION_LIST /begin REF_CHARACTERISTIC CalRegn01Cmn.FordMsg3D7BusHiSpdLgtDstRawVldFaildThd.Val /end REF_CHARACTERISTIC /begin REF_MEASUREMENT /end REF_MEASUREMENT /end GROUP
/begin GROUP CalRegn01Cmn.FordMsg3D7BusHiSpdMissMsgFaildThd.Val "MICROSAR RTE" /begin SUB_GROUP /end SUB_GROUP /begin FUNCTION_LIST /end FUNCTION_LIST /begin REF_CHARACTERISTIC CalRegn01Cmn.FordMsg3D7BusHiSpdMissMsgFaildThd.Val /end REF_CHARACTERISTIC /begin REF_MEASUREMENT /end REF_MEASUREMENT /end GROUP
/begin GROUP CalRegn01Cmn.FordMsg3D7BusHiSpdMissMsgPassdThd.Val "MICROSAR RTE" /begin SUB_GROUP /end SUB_GROUP /begin FUNCTION_LIST /end FUNCTION_LIST /begin REF_CHARACTERISTIC CalRegn01Cmn.FordMsg3D7BusHiSpdMissMsgPassdThd.Val /end REF_CHARACTERISTIC /begin REF_MEASUREMENT /end REF_MEASUREMENT /end GROUP
/begin GROUP CalRegn01Cmn.FordMsg3D7BusHiSpdRelLatVelInvldFaildThd.Val "MICROSAR RTE" /begin SUB_GROUP /end SUB_GROUP /begin FUNCTION_LIST /end FUNCTION_LIST /begin REF_CHARACTERISTIC CalRegn01Cmn.FordMsg3D7BusHiSpdRelLatVelInvldFaildThd.Val /end REF_CHARACTERISTIC /begin REF_MEASUREMENT /end REF_MEASUREMENT /end GROUP
/begin GROUP CalRegn01Cmn.FordMsg3D7BusHiSpdRelLatVelInvldPassdThd.Val "MICROSAR RTE" /begin SUB_GROUP /end SUB_GROUP /begin FUNCTION_LIST /end FUNCTION_LIST /begin REF_CHARACTERISTIC CalRegn01Cmn.FordMsg3D7BusHiSpdRelLatVelInvldPassdThd.Val /end REF_CHARACTERISTIC /begin REF_MEASUREMENT /end REF_MEASUREMENT /end GROUP
/begin GROUP CalRegn01Cmn.FordMsg3D7BusHiSpdRelLatVelRawVldFaildThd.Val "MICROSAR RTE" /begin SUB_GROUP /end SUB_GROUP /begin FUNCTION_LIST /end FUNCTION_LIST /begin REF_CHARACTERISTIC CalRegn01Cmn.FordMsg3D7BusHiSpdRelLatVelRawVldFaildThd.Val /end REF_CHARACTERISTIC /begin REF_MEASUREMENT /end REF_MEASUREMENT /end GROUP
/begin GROUP CalRegn01Cmn.FordMsg3D7BusHiSpdRelLgtVelInvldFaildThd.Val "MICROSAR RTE" /begin SUB_GROUP /end SUB_GROUP /begin FUNCTION_LIST /end FUNCTION_LIST /begin REF_CHARACTERISTIC CalRegn01Cmn.FordMsg3D7BusHiSpdRelLgtVelInvldFaildThd.Val /end REF_CHARACTERISTIC /begin REF_MEASUREMENT /end REF_MEASUREMENT /end GROUP
/begin GROUP CalRegn01Cmn.FordMsg3D7BusHiSpdRelLgtVelInvldPassdThd.Val "MICROSAR RTE" /begin SUB_GROUP /end SUB_GROUP /begin FUNCTION_LIST /end FUNCTION_LIST /begin REF_CHARACTERISTIC CalRegn01Cmn.FordMsg3D7BusHiSpdRelLgtVelInvldPassdThd.Val /end REF_CHARACTERISTIC /begin REF_MEASUREMENT /end REF_MEASUREMENT /end GROUP
/begin GROUP CalRegn01Cmn.FordMsg3D7BusHiSpdRelLgtVelRawVldFaildThd.Val "MICROSAR RTE" /begin SUB_GROUP /end SUB_GROUP /begin FUNCTION_LIST /end FUNCTION_LIST /begin REF_CHARACTERISTIC CalRegn01Cmn.FordMsg3D7BusHiSpdRelLgtVelRawVldFaildThd.Val /end REF_CHARACTERISTIC /begin REF_MEASUREMENT /end REF_MEASUREMENT /end GROUP
/begin GROUP CalRegn01Cmn.FordMsg3D7BusHiSpdTiToCllsnInvldFaildThd.Val "MICROSAR RTE" /begin SUB_GROUP /end SUB_GROUP /begin FUNCTION_LIST /end FUNCTION_LIST /begin REF_CHARACTERISTIC CalRegn01Cmn.FordMsg3D7BusHiSpdTiToCllsnInvldFaildThd.Val /end REF_CHARACTERISTIC /begin REF_MEASUREMENT /end REF_MEASUREMENT /end GROUP
/begin GROUP CalRegn01Cmn.FordMsg3D7BusHiSpdTiToCllsnInvldPassdThd.Val "MICROSAR RTE" /begin SUB_GROUP /end SUB_GROUP /begin FUNCTION_LIST /end FUNCTION_LIST /begin REF_CHARACTERISTIC CalRegn01Cmn.FordMsg3D7BusHiSpdTiToCllsnInvldPassdThd.Val /end REF_CHARACTERISTIC /begin REF_MEASUREMENT /end REF_MEASUREMENT /end GROUP
/begin GROUP CalRegn01Cmn.FordMsg3D7BusHiSpdTiToCllsnRawVldFaildThd.Val "MICROSAR RTE" /begin SUB_GROUP /end SUB_GROUP /begin FUNCTION_LIST /end FUNCTION_LIST /begin REF_CHARACTERISTIC CalRegn01Cmn.FordMsg3D7BusHiSpdTiToCllsnRawVldFaildThd.Val /end REF_CHARACTERISTIC /begin REF_MEASUREMENT /end REF_MEASUREMENT /end GROUP
/begin GROUP CalRegn01Cmn.FordMsg40ABusHiSpdMissMsgFaildThd.Val "MICROSAR RTE" /begin SUB_GROUP /end SUB_GROUP /begin FUNCTION_LIST /end FUNCTION_LIST /begin REF_CHARACTERISTIC CalRegn01Cmn.FordMsg40ABusHiSpdMissMsgFaildThd.Val /end REF_CHARACTERISTIC /begin REF_MEASUREMENT /end REF_MEASUREMENT /end GROUP
/begin GROUP CalRegn01Cmn.FordMsg40ABusHiSpdMissMsgPassdThd.Val "MICROSAR RTE" /begin SUB_GROUP /end SUB_GROUP /begin FUNCTION_LIST /end FUNCTION_LIST /begin REF_CHARACTERISTIC CalRegn01Cmn.FordMsg40ABusHiSpdMissMsgPassdThd.Val /end REF_CHARACTERISTIC /begin REF_MEASUREMENT /end REF_MEASUREMENT /end GROUP
/begin GROUP CalRegn01Cmn.FordMsg414BusHiSpdAgOffsVldFaildThd.Val "MICROSAR RTE" /begin SUB_GROUP /end SUB_GROUP /begin FUNCTION_LIST /end FUNCTION_LIST /begin REF_CHARACTERISTIC CalRegn01Cmn.FordMsg414BusHiSpdAgOffsVldFaildThd.Val /end REF_CHARACTERISTIC /begin REF_MEASUREMENT /end REF_MEASUREMENT /end GROUP
/begin GROUP CalRegn01Cmn.FordMsg414BusHiSpdAgOffsVldMissThd.Val "MICROSAR RTE" /begin SUB_GROUP /end SUB_GROUP /begin FUNCTION_LIST /end FUNCTION_LIST /begin REF_CHARACTERISTIC CalRegn01Cmn.FordMsg414BusHiSpdAgOffsVldMissThd.Val /end REF_CHARACTERISTIC /begin REF_MEASUREMENT /end REF_MEASUREMENT /end GROUP
/begin GROUP CalRegn01Cmn.FordMsg414BusHiSpdAgOffsVldPassdThd.Val "MICROSAR RTE" /begin SUB_GROUP /end SUB_GROUP /begin FUNCTION_LIST /end FUNCTION_LIST /begin REF_CHARACTERISTIC CalRegn01Cmn.FordMsg414BusHiSpdAgOffsVldPassdThd.Val /end REF_CHARACTERISTIC /begin REF_MEASUREMENT /end REF_MEASUREMENT /end GROUP
/begin GROUP CalRegn01Cmn.FordMsg414BusHiSpdChksVldFaildThd.Val "MICROSAR RTE" /begin SUB_GROUP /end SUB_GROUP /begin FUNCTION_LIST /end FUNCTION_LIST /begin REF_CHARACTERISTIC CalRegn01Cmn.FordMsg414BusHiSpdChksVldFaildThd.Val /end REF_CHARACTERISTIC /begin REF_MEASUREMENT /end REF_MEASUREMENT /end GROUP
/begin GROUP CalRegn01Cmn.FordMsg414BusHiSpdChksVldMissThd.Val "MICROSAR RTE" /begin SUB_GROUP /end SUB_GROUP /begin FUNCTION_LIST /end FUNCTION_LIST /begin REF_CHARACTERISTIC CalRegn01Cmn.FordMsg414BusHiSpdChksVldMissThd.Val /end REF_CHARACTERISTIC /begin REF_MEASUREMENT /end REF_MEASUREMENT /end GROUP
/begin GROUP CalRegn01Cmn.FordMsg414BusHiSpdCntrVldMissThd.Val "MICROSAR RTE" /begin SUB_GROUP /end SUB_GROUP /begin FUNCTION_LIST /end FUNCTION_LIST /begin REF_CHARACTERISTIC CalRegn01Cmn.FordMsg414BusHiSpdCntrVldMissThd.Val /end REF_CHARACTERISTIC /begin REF_MEASUREMENT /end REF_MEASUREMENT /end GROUP
/begin GROUP CalRegn01Cmn.FordMsg415BusHiSpdBrkModlLoQlyVldFaildThd.Val "MICROSAR RTE" /begin SUB_GROUP /end SUB_GROUP /begin FUNCTION_LIST /end FUNCTION_LIST /begin REF_CHARACTERISTIC CalRegn01Cmn.FordMsg415BusHiSpdBrkModlLoQlyVldFaildThd.Val /end REF_CHARACTERISTIC /begin REF_MEASUREMENT /end REF_MEASUREMENT /end GROUP
/begin GROUP CalRegn01Cmn.FordMsg415BusHiSpdBrkModlLoQlyVldMissThd.Val "MICROSAR RTE" /begin SUB_GROUP /end SUB_GROUP /begin FUNCTION_LIST /end FUNCTION_LIST /begin REF_CHARACTERISTIC CalRegn01Cmn.FordMsg415BusHiSpdBrkModlLoQlyVldMissThd.Val /end REF_CHARACTERISTIC /begin REF_MEASUREMENT /end REF_MEASUREMENT /end GROUP
/begin GROUP CalRegn01Cmn.FordMsg415BusHiSpdBrkModlLoQlyVldPassdThd.Val "MICROSAR RTE" /begin SUB_GROUP /end SUB_GROUP /begin FUNCTION_LIST /end FUNCTION_LIST /begin REF_CHARACTERISTIC CalRegn01Cmn.FordMsg415BusHiSpdBrkModlLoQlyVldPassdThd.Val /end REF_CHARACTERISTIC /begin REF_MEASUREMENT /end REF_MEASUREMENT /end GROUP
/begin GROUP CalRegn01Cmn.FordMsg415BusHiSpdBrkModlVldFaildThd.Val "MICROSAR RTE" /begin SUB_GROUP /end SUB_GROUP /begin FUNCTION_LIST /end FUNCTION_LIST /begin REF_CHARACTERISTIC CalRegn01Cmn.FordMsg415BusHiSpdBrkModlVldFaildThd.Val /end REF_CHARACTERISTIC /begin REF_MEASUREMENT /end REF_MEASUREMENT /end GROUP
/begin GROUP CalRegn01Cmn.FordMsg415BusHiSpdBrkModlVldMissThd.Val "MICROSAR RTE" /begin SUB_GROUP /end SUB_GROUP /begin FUNCTION_LIST /end FUNCTION_LIST /begin REF_CHARACTERISTIC CalRegn01Cmn.FordMsg415BusHiSpdBrkModlVldMissThd.Val /end REF_CHARACTERISTIC /begin REF_MEASUREMENT /end REF_MEASUREMENT /end GROUP
/begin GROUP CalRegn01Cmn.FordMsg415BusHiSpdBrkModlVldPassdThd.Val "MICROSAR RTE" /begin SUB_GROUP /end SUB_GROUP /begin FUNCTION_LIST /end FUNCTION_LIST /begin REF_CHARACTERISTIC CalRegn01Cmn.FordMsg415BusHiSpdBrkModlVldPassdThd.Val /end REF_CHARACTERISTIC /begin REF_MEASUREMENT /end REF_MEASUREMENT /end GROUP
/begin GROUP CalRegn01Cmn.FordMsg415BusHiSpdBrkSprtVldMissThd.Val "MICROSAR RTE" /begin SUB_GROUP /end SUB_GROUP /begin FUNCTION_LIST /end FUNCTION_LIST /begin REF_CHARACTERISTIC CalRegn01Cmn.FordMsg415BusHiSpdBrkSprtVldMissThd.Val /end REF_CHARACTERISTIC /begin REF_MEASUREMENT /end REF_MEASUREMENT /end GROUP
/begin GROUP CalRegn01Cmn.FordMsg415BusHiSpdBrkSprtVldPassdThd.Val "MICROSAR RTE" /begin SUB_GROUP /end SUB_GROUP /begin FUNCTION_LIST /end FUNCTION_LIST /begin REF_CHARACTERISTIC CalRegn01Cmn.FordMsg415BusHiSpdBrkSprtVldPassdThd.Val /end REF_CHARACTERISTIC /begin REF_MEASUREMENT /end REF_MEASUREMENT /end GROUP
/begin GROUP CalRegn01Cmn.FordMsg415BusHiSpdChksBrkModlInvldFaildThd.Val "MICROSAR RTE" /begin SUB_GROUP /end SUB_GROUP /begin FUNCTION_LIST /end FUNCTION_LIST
 /begin REF_CHARACTERISTIC CalRegn01Cmn.FordMsg415BusHiSpdChksBrkModlInvldFaildThd.Val /end REF_CHARACTERISTIC
 /begin REF_MEASUREMENT /end REF_MEASUREMENT
/end GROUP
/begin GROUP CalRegn01Cmn.FordMsg415BusHiSpdChksBrkModlInvldPassdThd.Val "MICROSAR RTE" /begin SUB_GROUP /end SUB_GROUP /begin FUNCTION_LIST /end FUNCTION_LIST
 /begin REF_CHARACTERISTIC CalRegn01Cmn.FordMsg415BusHiSpdChksBrkModlInvldPassdThd.Val /end REF_CHARACTERISTIC
 /begin REF_MEASUREMENT /end REF_MEASUREMENT
/end GROUP
/begin GROUP CalRegn01Cmn.FordMsg415BusHiSpdCntrBrkModlInvldFaildThd.Val "MICROSAR RTE" /begin SUB_GROUP /end SUB_GROUP /begin FUNCTION_LIST /end FUNCTION_LIST
 /begin REF_CHARACTERISTIC CalRegn01Cmn.FordMsg415BusHiSpdCntrBrkModlInvldFaildThd.Val /end REF_CHARACTERISTIC
 /begin REF_MEASUREMENT /end REF_MEASUREMENT
/end GROUP
/begin GROUP CalRegn01Cmn.FordMsg415BusHiSpdCntrBrkModlInvldPassdThd.Val "MICROSAR RTE" /begin SUB_GROUP /end SUB_GROUP /begin FUNCTION_LIST /end FUNCTION_LIST
 /begin REF_CHARACTERISTIC CalRegn01Cmn.FordMsg415BusHiSpdCntrBrkModlInvldPassdThd.Val /end REF_CHARACTERISTIC
 /begin REF_MEASUREMENT /end REF_MEASUREMENT
/end GROUP
/begin GROUP CalRegn01Cmn.FordMsg415BusHiSpdMissMsgFaildThd.Val "MICROSAR RTE" /begin SUB_GROUP /end SUB_GROUP /begin FUNCTION_LIST /end FUNCTION_LIST /begin REF_CHARACTERISTIC CalRegn01Cmn.FordMsg415BusHiSpdMissMsgFaildThd.Val /end REF_CHARACTERISTIC /begin REF_MEASUREMENT /end REF_MEASUREMENT /end GROUP
/begin GROUP CalRegn01Cmn.FordMsg415BusHiSpdMissMsgPassdThd.Val "MICROSAR RTE" /begin SUB_GROUP /end SUB_GROUP /begin FUNCTION_LIST /end FUNCTION_LIST /begin REF_CHARACTERISTIC CalRegn01Cmn.FordMsg415BusHiSpdMissMsgPassdThd.Val /end REF_CHARACTERISTIC /begin REF_MEASUREMENT /end REF_MEASUREMENT /end GROUP
/begin GROUP CalRegn01Cmn.FordMsg415BusHiSpdQlyFacBrkModlInvldFaildThd.Val "MICROSAR RTE" /begin SUB_GROUP /end SUB_GROUP /begin FUNCTION_LIST /end FUNCTION_LIST
 /begin REF_CHARACTERISTIC CalRegn01Cmn.FordMsg415BusHiSpdQlyFacBrkModlInvldFaildThd.Val /end REF_CHARACTERISTIC
 /begin REF_MEASUREMENT /end REF_MEASUREMENT
/end GROUP
/begin GROUP CalRegn01Cmn.FordMsg415BusHiSpdQlyFacBrkModlInvldSigPassdThd.Val "MICROSAR RTE" /begin SUB_GROUP /end SUB_GROUP /begin FUNCTION_LIST /end FUNCTION_LIST
 /begin REF_CHARACTERISTIC CalRegn01Cmn.FordMsg415BusHiSpdQlyFacBrkModlInvldSigPassdThd.Val /end REF_CHARACTERISTIC
 /begin REF_MEASUREMENT /end REF_MEASUREMENT
/end GROUP
/begin GROUP CalRegn01Cmn.FordMsg41ABusHiSpdMissMsgFaildThd.Val "MICROSAR RTE" /begin SUB_GROUP /end SUB_GROUP /begin FUNCTION_LIST /end FUNCTION_LIST /begin REF_CHARACTERISTIC CalRegn01Cmn.FordMsg41ABusHiSpdMissMsgFaildThd.Val /end REF_CHARACTERISTIC /begin REF_MEASUREMENT /end REF_MEASUREMENT /end GROUP
/begin GROUP CalRegn01Cmn.FordMsg41ABusHiSpdMissMsgPassdThd.Val "MICROSAR RTE" /begin SUB_GROUP /end SUB_GROUP /begin FUNCTION_LIST /end FUNCTION_LIST /begin REF_CHARACTERISTIC CalRegn01Cmn.FordMsg41ABusHiSpdMissMsgPassdThd.Val /end REF_CHARACTERISTIC /begin REF_MEASUREMENT /end REF_MEASUREMENT /end GROUP
/begin GROUP CalRegn01Cmn.FordMsg41EBusHiSpdChassisVldMissFaildThd.Val "MICROSAR RTE" /begin SUB_GROUP /end SUB_GROUP /begin FUNCTION_LIST /end FUNCTION_LIST /begin REF_CHARACTERISTIC CalRegn01Cmn.FordMsg41EBusHiSpdChassisVldMissFaildThd.Val /end REF_CHARACTERISTIC /begin REF_MEASUREMENT /end REF_MEASUREMENT /end GROUP
/begin GROUP CalRegn01Cmn.FordMsg41EBusHiSpdChassisVldSigFaildThd.Val "MICROSAR RTE" /begin SUB_GROUP /end SUB_GROUP /begin FUNCTION_LIST /end FUNCTION_LIST /begin REF_CHARACTERISTIC CalRegn01Cmn.FordMsg41EBusHiSpdChassisVldSigFaildThd.Val /end REF_CHARACTERISTIC /begin REF_MEASUREMENT /end REF_MEASUREMENT /end GROUP
/begin GROUP CalRegn01Cmn.FordMsg41EBusHiSpdChassisVldSigPassdThd.Val "MICROSAR RTE" /begin SUB_GROUP /end SUB_GROUP /begin FUNCTION_LIST /end FUNCTION_LIST /begin REF_CHARACTERISTIC CalRegn01Cmn.FordMsg41EBusHiSpdChassisVldSigPassdThd.Val /end REF_CHARACTERISTIC /begin REF_MEASUREMENT /end REF_MEASUREMENT /end GROUP
/begin GROUP CalRegn01Cmn.FordMsg41EBusHiSpdInvldMsgFaildThd.Val "MICROSAR RTE" /begin SUB_GROUP /end SUB_GROUP /begin FUNCTION_LIST /end FUNCTION_LIST /begin REF_CHARACTERISTIC CalRegn01Cmn.FordMsg41EBusHiSpdInvldMsgFaildThd.Val /end REF_CHARACTERISTIC /begin REF_MEASUREMENT /end REF_MEASUREMENT /end GROUP
/begin GROUP CalRegn01Cmn.FordMsg41EBusHiSpdInvldMsgPassdThd.Val "MICROSAR RTE" /begin SUB_GROUP /end SUB_GROUP /begin FUNCTION_LIST /end FUNCTION_LIST /begin REF_CHARACTERISTIC CalRegn01Cmn.FordMsg41EBusHiSpdInvldMsgPassdThd.Val /end REF_CHARACTERISTIC /begin REF_MEASUREMENT /end REF_MEASUREMENT /end GROUP
/begin GROUP CalRegn01Cmn.FordMsg41EBusHiSpdMissMsgFaildThd.Val "MICROSAR RTE" /begin SUB_GROUP /end SUB_GROUP /begin FUNCTION_LIST /end FUNCTION_LIST /begin REF_CHARACTERISTIC CalRegn01Cmn.FordMsg41EBusHiSpdMissMsgFaildThd.Val /end REF_CHARACTERISTIC /begin REF_MEASUREMENT /end REF_MEASUREMENT /end GROUP
/begin GROUP CalRegn01Cmn.FordMsg41EBusHiSpdMissMsgPassdThd.Val "MICROSAR RTE" /begin SUB_GROUP /end SUB_GROUP /begin FUNCTION_LIST /end FUNCTION_LIST /begin REF_CHARACTERISTIC CalRegn01Cmn.FordMsg41EBusHiSpdMissMsgPassdThd.Val /end REF_CHARACTERISTIC /begin REF_MEASUREMENT /end REF_MEASUREMENT /end GROUP
/begin GROUP CalRegn01Cmn.FordMsg430BusHiSpdMissMsgFaildThd.Val "MICROSAR RTE" /begin SUB_GROUP /end SUB_GROUP /begin FUNCTION_LIST /end FUNCTION_LIST /begin REF_CHARACTERISTIC CalRegn01Cmn.FordMsg430BusHiSpdMissMsgFaildThd.Val /end REF_CHARACTERISTIC /begin REF_MEASUREMENT /end REF_MEASUREMENT /end GROUP
/begin GROUP CalRegn01Cmn.FordMsg430BusHiSpdMissMsgPassdThd.Val "MICROSAR RTE" /begin SUB_GROUP /end SUB_GROUP /begin FUNCTION_LIST /end FUNCTION_LIST /begin REF_CHARACTERISTIC CalRegn01Cmn.FordMsg430BusHiSpdMissMsgPassdThd.Val /end REF_CHARACTERISTIC /begin REF_MEASUREMENT /end REF_MEASUREMENT /end GROUP
/begin GROUP CalRegn01Cmn.FordMsg443BusHiSpdMissMsgFaildThd.Val "MICROSAR RTE" /begin SUB_GROUP /end SUB_GROUP /begin FUNCTION_LIST /end FUNCTION_LIST /begin REF_CHARACTERISTIC CalRegn01Cmn.FordMsg443BusHiSpdMissMsgFaildThd.Val /end REF_CHARACTERISTIC /begin REF_MEASUREMENT /end REF_MEASUREMENT /end GROUP
/begin GROUP CalRegn01Cmn.FordMsg443BusHiSpdMissMsgPassdThd.Val "MICROSAR RTE" /begin SUB_GROUP /end SUB_GROUP /begin FUNCTION_LIST /end FUNCTION_LIST /begin REF_CHARACTERISTIC CalRegn01Cmn.FordMsg443BusHiSpdMissMsgPassdThd.Val /end REF_CHARACTERISTIC /begin REF_MEASUREMENT /end REF_MEASUREMENT /end GROUP
/begin GROUP CalRegn01Cmn.FordMsg459BusHiSpdDiagMsgMissTmrThd.Val "MICROSAR RTE" /begin SUB_GROUP /end SUB_GROUP /begin FUNCTION_LIST /end FUNCTION_LIST /begin REF_CHARACTERISTIC CalRegn01Cmn.FordMsg459BusHiSpdDiagMsgMissTmrThd.Val /end REF_CHARACTERISTIC /begin REF_MEASUREMENT /end REF_MEASUREMENT /end GROUP
/begin GROUP CalRegn01Cmn.FordMsg459BusHiSpdHitchAgInvldFaildThd.Val "MICROSAR RTE" /begin SUB_GROUP /end SUB_GROUP /begin FUNCTION_LIST /end FUNCTION_LIST /begin REF_CHARACTERISTIC CalRegn01Cmn.FordMsg459BusHiSpdHitchAgInvldFaildThd.Val /end REF_CHARACTERISTIC /begin REF_MEASUREMENT /end REF_MEASUREMENT /end GROUP
/begin GROUP CalRegn01Cmn.FordMsg459BusHiSpdHitchAgInvldPassdThd.Val "MICROSAR RTE" /begin SUB_GROUP /end SUB_GROUP /begin FUNCTION_LIST /end FUNCTION_LIST /begin REF_CHARACTERISTIC CalRegn01Cmn.FordMsg459BusHiSpdHitchAgInvldPassdThd.Val /end REF_CHARACTERISTIC /begin REF_MEASUREMENT /end REF_MEASUREMENT /end GROUP
/begin GROUP CalRegn01Cmn.FordMsg459BusHiSpdHitchAgRateInvldFaildThd.Val "MICROSAR RTE" /begin SUB_GROUP /end SUB_GROUP /begin FUNCTION_LIST /end FUNCTION_LIST
 /begin REF_CHARACTERISTIC CalRegn01Cmn.FordMsg459BusHiSpdHitchAgRateInvldFaildThd.Val /end REF_CHARACTERISTIC
 /begin REF_MEASUREMENT /end REF_MEASUREMENT
/end GROUP
/begin GROUP CalRegn01Cmn.FordMsg459BusHiSpdHitchAgRateInvldPassdThd.Val "MICROSAR RTE" /begin SUB_GROUP /end SUB_GROUP /begin FUNCTION_LIST /end FUNCTION_LIST
 /begin REF_CHARACTERISTIC CalRegn01Cmn.FordMsg459BusHiSpdHitchAgRateInvldPassdThd.Val /end REF_CHARACTERISTIC
 /begin REF_MEASUREMENT /end REF_MEASUREMENT
/end GROUP
/begin GROUP CalRegn01Cmn.FordMsg459BusHiSpdPrsntFlgMsgMissTmrThd.Val "MICROSAR RTE" /begin SUB_GROUP /end SUB_GROUP /begin FUNCTION_LIST /end FUNCTION_LIST /begin REF_CHARACTERISTIC CalRegn01Cmn.FordMsg459BusHiSpdPrsntFlgMsgMissTmrThd.Val /end REF_CHARACTERISTIC /begin REF_MEASUREMENT /end REF_MEASUREMENT /end GROUP
/begin GROUP CalRegn01Cmn.FordMsg459BusHiSpdRcvrDiagMsgMissTmrThd.Val "MICROSAR RTE" /begin SUB_GROUP /end SUB_GROUP /begin FUNCTION_LIST /end FUNCTION_LIST /begin REF_CHARACTERISTIC CalRegn01Cmn.FordMsg459BusHiSpdRcvrDiagMsgMissTmrThd.Val /end REF_CHARACTERISTIC /begin REF_MEASUREMENT /end REF_MEASUREMENT /end GROUP
/begin GROUP CalRegn01Cmn.FordMsg459BusHiSpdRcvrPrsntFlgTmrThd.Val "MICROSAR RTE" /begin SUB_GROUP /end SUB_GROUP /begin FUNCTION_LIST /end FUNCTION_LIST /begin REF_CHARACTERISTIC CalRegn01Cmn.FordMsg459BusHiSpdRcvrPrsntFlgTmrThd.Val /end REF_CHARACTERISTIC /begin REF_MEASUREMENT /end REF_MEASUREMENT /end GROUP
/begin GROUP CalRegn01Cmn.FordMsg459BusHiSpdTrackStInvldFaildThd.Val "MICROSAR RTE" /begin SUB_GROUP /end SUB_GROUP /begin FUNCTION_LIST /end FUNCTION_LIST /begin REF_CHARACTERISTIC CalRegn01Cmn.FordMsg459BusHiSpdTrackStInvldFaildThd.Val /end REF_CHARACTERISTIC /begin REF_MEASUREMENT /end REF_MEASUREMENT /end GROUP
/begin GROUP CalRegn01Cmn.FordMsg459BusHiSpdTrackStInvldPassdThd.Val "MICROSAR RTE" /begin SUB_GROUP /end SUB_GROUP /begin FUNCTION_LIST /end FUNCTION_LIST /begin REF_CHARACTERISTIC CalRegn01Cmn.FordMsg459BusHiSpdTrackStInvldPassdThd.Val /end REF_CHARACTERISTIC /begin REF_MEASUREMENT /end REF_MEASUREMENT /end GROUP
/begin GROUP CalRegn01Cmn.FordMsg459BusHiSpdTrlrHitchAgVldInvldMsgThd.Val "MICROSAR RTE" /begin SUB_GROUP /end SUB_GROUP /begin FUNCTION_LIST /end FUNCTION_LIST
 /begin REF_CHARACTERISTIC CalRegn01Cmn.FordMsg459BusHiSpdTrlrHitchAgVldInvldMsgThd.Val /end REF_CHARACTERISTIC
 /begin REF_MEASUREMENT /end REF_MEASUREMENT
/end GROUP
/begin GROUP CalRegn01Cmn.FordMsg459BusHiSpdTrlrHitchAgVldMissMsgThd.Val "MICROSAR RTE" /begin SUB_GROUP /end SUB_GROUP /begin FUNCTION_LIST /end FUNCTION_LIST
 /begin REF_CHARACTERISTIC CalRegn01Cmn.FordMsg459BusHiSpdTrlrHitchAgVldMissMsgThd.Val /end REF_CHARACTERISTIC
 /begin REF_MEASUREMENT /end REF_MEASUREMENT
/end GROUP
/begin GROUP CalRegn01Cmn.FordMsg459BusHiSpdTrlrHitchRateVldInvldMsgThd.Val "MICROSAR RTE" /begin SUB_GROUP /end SUB_GROUP /begin FUNCTION_LIST /end FUNCTION_LIST
 /begin REF_CHARACTERISTIC CalRegn01Cmn.FordMsg459BusHiSpdTrlrHitchRateVldInvldMsgThd.Val /end REF_CHARACTERISTIC
 /begin REF_MEASUREMENT /end REF_MEASUREMENT
/end GROUP
/begin GROUP CalRegn01Cmn.FordMsg459BusHiSpdTrlrHitchRateVldMissMsgThd.Val "MICROSAR RTE" /begin SUB_GROUP /end SUB_GROUP /begin FUNCTION_LIST /end FUNCTION_LIST
 /begin REF_CHARACTERISTIC CalRegn01Cmn.FordMsg459BusHiSpdTrlrHitchRateVldMissMsgThd.Val /end REF_CHARACTERISTIC
 /begin REF_MEASUREMENT /end REF_MEASUREMENT
/end GROUP
/begin GROUP CalRegn01Cmn.FordMsg459BusHiSpdTrlrRcvrHitchAgVldThd.Val "MICROSAR RTE" /begin SUB_GROUP /end SUB_GROUP /begin FUNCTION_LIST /end FUNCTION_LIST /begin REF_CHARACTERISTIC CalRegn01Cmn.FordMsg459BusHiSpdTrlrRcvrHitchAgVldThd.Val /end REF_CHARACTERISTIC /begin REF_MEASUREMENT /end REF_MEASUREMENT /end GROUP
/begin GROUP CalRegn01Cmn.FordMsg459BusHiSpdTrlrRcvrHitchRateVldThd.Val "MICROSAR RTE" /begin SUB_GROUP /end SUB_GROUP /begin FUNCTION_LIST /end FUNCTION_LIST /begin REF_CHARACTERISTIC CalRegn01Cmn.FordMsg459BusHiSpdTrlrRcvrHitchRateVldThd.Val /end REF_CHARACTERISTIC /begin REF_MEASUREMENT /end REF_MEASUREMENT /end GROUP
/begin GROUP CalRegn01Cmn.FordMsg459BusHiSpdTrlrRcvrTarVldThd.Val "MICROSAR RTE" /begin SUB_GROUP /end SUB_GROUP /begin FUNCTION_LIST /end FUNCTION_LIST /begin REF_CHARACTERISTIC CalRegn01Cmn.FordMsg459BusHiSpdTrlrRcvrTarVldThd.Val /end REF_CHARACTERISTIC /begin REF_MEASUREMENT /end REF_MEASUREMENT /end GROUP
/begin GROUP CalRegn01Cmn.FordMsg459BusHiSpdTrlrRcvrTrackStVldThd.Val "MICROSAR RTE" /begin SUB_GROUP /end SUB_GROUP /begin FUNCTION_LIST /end FUNCTION_LIST /begin REF_CHARACTERISTIC CalRegn01Cmn.FordMsg459BusHiSpdTrlrRcvrTrackStVldThd.Val /end REF_CHARACTERISTIC /begin REF_MEASUREMENT /end REF_MEASUREMENT /end GROUP
/begin GROUP CalRegn01Cmn.FordMsg459BusHiSpdTrlrTarVldMissMsgThd.Val "MICROSAR RTE" /begin SUB_GROUP /end SUB_GROUP /begin FUNCTION_LIST /end FUNCTION_LIST /begin REF_CHARACTERISTIC CalRegn01Cmn.FordMsg459BusHiSpdTrlrTarVldMissMsgThd.Val /end REF_CHARACTERISTIC /begin REF_MEASUREMENT /end REF_MEASUREMENT /end GROUP
/begin GROUP CalRegn01Cmn.FordMsg459BusHiSpdTrlrTrackStVldInvldMsgThd.Val "MICROSAR RTE" /begin SUB_GROUP /end SUB_GROUP /begin FUNCTION_LIST /end FUNCTION_LIST
 /begin REF_CHARACTERISTIC CalRegn01Cmn.FordMsg459BusHiSpdTrlrTrackStVldInvldMsgThd.Val /end REF_CHARACTERISTIC
 /begin REF_MEASUREMENT /end REF_MEASUREMENT
/end GROUP
/begin GROUP CalRegn01Cmn.FordMsg459BusHiSpdTrlrTrackStVldMissMsgThd.Val "MICROSAR RTE" /begin SUB_GROUP /end SUB_GROUP /begin FUNCTION_LIST /end FUNCTION_LIST
 /begin REF_CHARACTERISTIC CalRegn01Cmn.FordMsg459BusHiSpdTrlrTrackStVldMissMsgThd.Val /end REF_CHARACTERISTIC
 /begin REF_MEASUREMENT /end REF_MEASUREMENT
/end GROUP
/begin GROUP CalRegn01Cmn.FordMsg47ABusHiSpdMissMsgFaildTiThd.Val "MICROSAR RTE" /begin SUB_GROUP /end SUB_GROUP /begin FUNCTION_LIST /end FUNCTION_LIST /begin REF_CHARACTERISTIC CalRegn01Cmn.FordMsg47ABusHiSpdMissMsgFaildTiThd.Val /end REF_CHARACTERISTIC /begin REF_MEASUREMENT /end REF_MEASUREMENT /end GROUP
/begin GROUP CalRegn01Cmn.FordMsg47ABusHiSpdMissMsgPassdTiThd.Val "MICROSAR RTE" /begin SUB_GROUP /end SUB_GROUP /begin FUNCTION_LIST /end FUNCTION_LIST /begin REF_CHARACTERISTIC CalRegn01Cmn.FordMsg47ABusHiSpdMissMsgPassdTiThd.Val /end REF_CHARACTERISTIC /begin REF_MEASUREMENT /end REF_MEASUREMENT /end GROUP
/begin GROUP CalRegn01Cmn.FordMsg47ABusHiSpdTrlrAidKnobBtnFaildTiThd.Val "MICROSAR RTE" /begin SUB_GROUP /end SUB_GROUP /begin FUNCTION_LIST /end FUNCTION_LIST
 /begin REF_CHARACTERISTIC CalRegn01Cmn.FordMsg47ABusHiSpdTrlrAidKnobBtnFaildTiThd.Val /end REF_CHARACTERISTIC
 /begin REF_MEASUREMENT /end REF_MEASUREMENT
/end GROUP
/begin GROUP CalRegn01Cmn.FordMsg47ABusHiSpdTrlrAidKnobBtnInvldPassdTiThd.Val "MICROSAR RTE" /begin SUB_GROUP /end SUB_GROUP /begin FUNCTION_LIST /end FUNCTION_LIST
 /begin REF_CHARACTERISTIC CalRegn01Cmn.FordMsg47ABusHiSpdTrlrAidKnobBtnInvldPassdTiThd.Val /end REF_CHARACTERISTIC
 /begin REF_MEASUREMENT /end REF_MEASUREMENT
/end GROUP
/begin GROUP CalRegn01Cmn.FordMsg47ABusHiSpdTrlrAidKnobBtnMissTiThd.Val "MICROSAR RTE" /begin SUB_GROUP /end SUB_GROUP /begin FUNCTION_LIST /end FUNCTION_LIST /begin REF_CHARACTERISTIC CalRegn01Cmn.FordMsg47ABusHiSpdTrlrAidKnobBtnMissTiThd.Val /end REF_CHARACTERISTIC /begin REF_MEASUREMENT /end REF_MEASUREMENT /end GROUP
/begin RECORD_LAYOUT RTE_RL_UWORD FNC_VALUES 1 UWORD ROW_DIR DIRECT /end RECORD_LAYOUT
/begin RECORD_LAYOUT RTE_RL_SWORD FNC_VALUES 1 SWORD ROW_DIR DIRECT /end RECORD_LAYOUT
/begin RECORD_LAYOUT RTE_RL_FLOAT32_IEEE FNC_VALUES 1 FLOAT32_IEEE ROW_DIR DIRECT /end RECORD_LAYOUT
/begin RECORD_LAYOUT RTE_RL_BOOLEAN FNC_VALUES 1 UBYTE ROW_DIR DIRECT /end RECORD_LAYOUT
/**********************************************************************************************************************
* COMPU_METHOD / COMPU_VTAB_RANGE
*********************************************************************************************************************/
/begin COMPU_METHOD RTE_CM_BOOLEAN "" TAB_VERB "%3.1" "" COMPU_TAB_REF RTE_CM_BOOLEAN /end COMPU_METHOD
/begin COMPU_VTAB_RANGE RTE_CM_BOOLEAN "" 2 0 0 "false" 1 255 "true" /end COMPU_VTAB_RANGE
