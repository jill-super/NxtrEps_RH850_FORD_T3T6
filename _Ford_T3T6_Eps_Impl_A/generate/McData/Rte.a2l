/begin CHARACTERISTIC MotRplCoggCfg.MotCtrlPrmEstimnMotBackEmfConNom.Val "MICROSAR RTE" VALUE 0x0 RTE_RL_FLOAT32_IEEE 0 NO_COMPU_METHOD -3.402823466e+38 3.402823466e+38 SYMBOL_LINK "Rte_CalprmRom_CalRegn01Cmn_DEFAULT_RTE_CALPRM_GROUP.MotCtrlPrmEstimnMotBackEmfConNom_Val" 0 DISPLAY_IDENTIFIER MotRplCoggCfg.CalibrationPorts.MotCtrlPrmEstimnMotBackEmfConNom.Val /end CHARACTERISTIC
/begin CHARACTERISTIC MotRplCoggCfg.MotRplCoggCfgMotAgTiDly.Val "MICROSAR RTE" VALUE 0x0 RTE_RL_FLOAT32_IEEE 0 NO_COMPU_METHOD -3.402823466e+38 3.402823466e+38 SYMBOL_LINK "Rte_CalprmRom_CalRegn02Cmn_DEFAULT_RTE_CALPRM_GROUP.MotRplCoggCfgMotAgTiDly_Val" 0 DISPLAY_IDENTIFIER MotRplCoggCfg.CalibrationPorts.MotRplCoggCfgMotAgTiDly.Val /end CHARACTERISTIC
/begin CHARACTERISTIC MotRplCoggCfg.MotRplCoggCfgMotCurrDaxRplBilnrSeln.Ary1D "MICROSAR RTE" VAL_BLK 0x0 RTE_RL_UWORD 0 NO_COMPU_METHOD 0 65535 MATRIX_DIM 10 1 1 SYMBOL_LINK "Rte_CalprmRom_CalRegn02Cmn_DEFAULT_RTE_CALPRM_GROUP.MotRplCoggCfgMotCurrDaxRplBilnrSeln_Ary1D" 0 DISPLAY_IDENTIFIER MotRplCoggCfg.CalibrationPorts.MotRplCoggCfgMotCurrDaxRplBilnrSeln.Ary1D /end CHARACTERISTIC
/begin CHARACTERISTIC MotRplCoggCfg.MotRplCoggCfgMotCurrQaxRpl.Ary1D "MICROSAR RTE" VAL_BLK 0x0 RTE_RL_UWORD 0 NO_COMPU_METHOD 0 65535 MATRIX_DIM 12 1 1 SYMBOL_LINK "Rte_CalprmRom_CalRegn02Cmn_DEFAULT_RTE_CALPRM_GROUP.MotRplCoggCfgMotCurrQaxRpl_Ary1D" 0 DISPLAY_IDENTIFIER MotRplCoggCfg.CalibrationPorts.MotRplCoggCfgMotCurrQaxRpl.Ary1D /end CHARACTERISTIC
/begin CHARACTERISTIC MotRplCoggCfg.MotRplCoggCfgMotTqCmdCurrRgltrBwCmpMgnY.Ary2D "MICROSAR RTE" VAL_BLK 0x0 RTE_RL_UWORD 0 NO_COMPU_METHOD 0 65535 MATRIX_DIM 8 20 1 SYMBOL_LINK "Rte_CalprmRom_CalRegn02Cmn_DEFAULT_RTE_CALPRM_GROUP.MotRplCoggCfgMotTqCmdCurrRgltrBwCmpMgnY_Ary2D" 0 DISPLAY_IDENTIFIER MotRplCoggCfg.CalibrationPorts.MotRplCoggCfgMotTqCmdCurrRgltrBwCmpMgnY.Ary2D /end CHARACTERISTIC
/begin CHARACTERISTIC MotRplCoggCfg.MotRplCoggCfgMotTqCmdCurrRgltrBwCmpPhaY.Ary2D "MICROSAR RTE" VAL_BLK 0x0 RTE_RL_UWORD 0 NO_COMPU_METHOD 0 65535 MATRIX_DIM 8 20 1 SYMBOL_LINK "Rte_CalprmRom_CalRegn02Cmn_DEFAULT_RTE_CALPRM_GROUP.MotRplCoggCfgMotTqCmdCurrRgltrBwCmpPhaY_Ary2D" 0 DISPLAY_IDENTIFIER MotRplCoggCfg.CalibrationPorts.MotRplCoggCfgMotTqCmdCurrRgltrBwCmpPhaY.Ary2D /end CHARACTERISTIC
/begin CHARACTERISTIC MotRplCoggCfg.MotRplCoggCfgMotTqCmdCurrRgltrBwCmpX.Ary1D "MICROSAR RTE" VAL_BLK 0x0 RTE_RL_UWORD 0 NO_COMPU_METHOD 0 65535 MATRIX_DIM 8 1 1 SYMBOL_LINK "Rte_CalprmRom_CalRegn02Cmn_DEFAULT_RTE_CALPRM_GROUP.MotRplCoggCfgMotTqCmdCurrRgltrBwCmpX_Ary1D" 0 DISPLAY_IDENTIFIER MotRplCoggCfg.CalibrationPorts.MotRplCoggCfgMotTqCmdCurrRgltrBwCmpX.Ary1D /end CHARACTERISTIC
/begin CHARACTERISTIC MotRplCoggCfg.MotRplCoggCfgMotTqRplOrder1X.Ary2D "MICROSAR RTE" VAL_BLK 0x0 RTE_RL_SWORD 0 NO_COMPU_METHOD -32768 32767 MATRIX_DIM 12 10 1 SYMBOL_LINK "Rte_CalprmRom_CalRegn02Cmn_DEFAULT_RTE_CALPRM_GROUP.MotRplCoggCfgMotTqRplOrder1X_Ary2D" 0 DISPLAY_IDENTIFIER MotRplCoggCfg.CalibrationPorts.MotRplCoggCfgMotTqRplOrder1X.Ary2D /end CHARACTERISTIC
/begin CHARACTERISTIC MotRplCoggCfg.MotRplCoggCfgMotTqRplOrder1Y.Ary2D "MICROSAR RTE" VAL_BLK 0x0 RTE_RL_SWORD 0 NO_COMPU_METHOD -32768 32767 MATRIX_DIM 12 10 1 SYMBOL_LINK "Rte_CalprmRom_CalRegn02Cmn_DEFAULT_RTE_CALPRM_GROUP.MotRplCoggCfgMotTqRplOrder1Y_Ary2D" 0 DISPLAY_IDENTIFIER MotRplCoggCfg.CalibrationPorts.MotRplCoggCfgMotTqRplOrder1Y.Ary2D /end CHARACTERISTIC
/begin CHARACTERISTIC MotRplCoggCfg.MotRplCoggCfgMotTqRplOrder2X.Ary2D "MICROSAR RTE" VAL_BLK 0x0 RTE_RL_SWORD 0 NO_COMPU_METHOD -32768 32767 MATRIX_DIM 12 10 1 SYMBOL_LINK "Rte_CalprmRom_CalRegn02Cmn_DEFAULT_RTE_CALPRM_GROUP.MotRplCoggCfgMotTqRplOrder2X_Ary2D" 0 DISPLAY_IDENTIFIER MotRplCoggCfg.CalibrationPorts.MotRplCoggCfgMotTqRplOrder2X.Ary2D /end CHARACTERISTIC
/begin CHARACTERISTIC MotRplCoggCfg.MotRplCoggCfgMotTqRplOrder2Y.Ary2D "MICROSAR RTE" VAL_BLK 0x0 RTE_RL_SWORD 0 NO_COMPU_METHOD -32768 32767 MATRIX_DIM 12 10 1 SYMBOL_LINK "Rte_CalprmRom_CalRegn02Cmn_DEFAULT_RTE_CALPRM_GROUP.MotRplCoggCfgMotTqRplOrder2Y_Ary2D" 0 DISPLAY_IDENTIFIER MotRplCoggCfg.CalibrationPorts.MotRplCoggCfgMotTqRplOrder2Y.Ary2D /end CHARACTERISTIC
/begin CHARACTERISTIC MotRplCoggCfg.MotRplCoggCfgMotTqRplOrder3X.Ary2D "MICROSAR RTE" VAL_BLK 0x0 RTE_RL_SWORD 0 NO_COMPU_METHOD -32768 32767 MATRIX_DIM 12 10 1 SYMBOL_LINK "Rte_CalprmRom_CalRegn02Cmn_DEFAULT_RTE_CALPRM_GROUP.MotRplCoggCfgMotTqRplOrder3X_Ary2D" 0 DISPLAY_IDENTIFIER MotRplCoggCfg.CalibrationPorts.MotRplCoggCfgMotTqRplOrder3X.Ary2D /end CHARACTERISTIC
/begin CHARACTERISTIC MotRplCoggCfg.MotRplCoggCfgMotTqRplOrder3Y.Ary2D "MICROSAR RTE" VAL_BLK 0x0 RTE_RL_SWORD 0 NO_COMPU_METHOD -32768 32767 MATRIX_DIM 12 10 1 SYMBOL_LINK "Rte_CalprmRom_CalRegn02Cmn_DEFAULT_RTE_CALPRM_GROUP.MotRplCoggCfgMotTqRplOrder3Y_Ary2D" 0 DISPLAY_IDENTIFIER MotRplCoggCfg.CalibrationPorts.MotRplCoggCfgMotTqRplOrder3Y.Ary2D /end CHARACTERISTIC
/begin CHARACTERISTIC MotRplCoggCfg.MotRplCoggCfgMotVelBilnrSeln.Ary1D "MICROSAR RTE" VAL_BLK 0x0 RTE_RL_UWORD 0 NO_COMPU_METHOD 0 65535 MATRIX_DIM 20 1 1 SYMBOL_LINK "Rte_CalprmRom_CalRegn02Cmn_DEFAULT_RTE_CALPRM_GROUP.MotRplCoggCfgMotVelBilnrSeln_Ary1D" 0 DISPLAY_IDENTIFIER MotRplCoggCfg.CalibrationPorts.MotRplCoggCfgMotVelBilnrSeln.Ary1D /end CHARACTERISTIC
/begin CHARACTERISTIC MotRplCoggCfg.MotRplCoggCmdHrmncOrder1Elec.Val "MICROSAR RTE" VALUE 0x0 RTE_RL_UBYTE 0 NO_COMPU_METHOD 0 255 SYMBOL_LINK "Rte_CalprmRom_CalRegn02Cmn_DEFAULT_RTE_CALPRM_GROUP.MotRplCoggCmdHrmncOrder1Elec_Val" 0 DISPLAY_IDENTIFIER MotRplCoggCfg.CalibrationPorts.MotRplCoggCmdHrmncOrder1Elec.Val /end CHARACTERISTIC
/begin CHARACTERISTIC MotRplCoggCfg.MotRplCoggCmdHrmncOrder2Elec.Val "MICROSAR RTE" VALUE 0x0 RTE_RL_UBYTE 0 NO_COMPU_METHOD 0 255 SYMBOL_LINK "Rte_CalprmRom_CalRegn02Cmn_DEFAULT_RTE_CALPRM_GROUP.MotRplCoggCmdHrmncOrder2Elec_Val" 0 DISPLAY_IDENTIFIER MotRplCoggCfg.CalibrationPorts.MotRplCoggCmdHrmncOrder2Elec.Val /end CHARACTERISTIC
/begin CHARACTERISTIC MotRplCoggCfg.MotRplCoggCmdHrmncOrder3Elec.Val "MICROSAR RTE" VALUE 0x0 RTE_RL_UBYTE 0 NO_COMPU_METHOD 0 255 SYMBOL_LINK "Rte_CalprmRom_CalRegn02Cmn_DEFAULT_RTE_CALPRM_GROUP.MotRplCoggCmdHrmncOrder3Elec_Val" 0 DISPLAY_IDENTIFIER MotRplCoggCfg.CalibrationPorts.MotRplCoggCmdHrmncOrder3Elec.Val /end CHARACTERISTIC
/begin CHARACTERISTIC MotRplCoggCfg.SysGlbPrmMotPoleCnt.Val "MICROSAR RTE" VALUE 0x0 RTE_RL_UBYTE 0 NO_COMPU_METHOD 0 255 SYMBOL_LINK "Rte_CalprmRom_CalRegn01Inin00_DEFAULT_RTE_CALPRM_GROUP.SysGlbPrmMotPoleCnt_Val" 0 DISPLAY_IDENTIFIER MotRplCoggCfg.CalibrationPorts.SysGlbPrmMotPoleCnt.Val /end CHARACTERISTIC
/begin CHARACTERISTIC MotTqCmdSca.MotTqCmdScaMax.Val "MICROSAR RTE" VALUE 0x0 RTE_RL_FLOAT32_IEEE 0 NO_COMPU_METHOD -3.402823466e+38 3.402823466e+38 SYMBOL_LINK "Rte_CalprmRom_CalRegn01Inin00_DEFAULT_RTE_CALPRM_GROUP.MotTqCmdScaMax_Val" 0 DISPLAY_IDENTIFIER MotTqCmdSca.CalibrationPorts.MotTqCmdScaMax.Val /end CHARACTERISTIC
/begin CHARACTERISTIC MotTqCmdSca.MotTqCmdScaMin.Val "MICROSAR RTE" VALUE 0x0 RTE_RL_FLOAT32_IEEE 0 NO_COMPU_METHOD -3.402823466e+38 3.402823466e+38 SYMBOL_LINK "Rte_CalprmRom_CalRegn01Inin00_DEFAULT_RTE_CALPRM_GROUP.MotTqCmdScaMin_Val" 0 DISPLAY_IDENTIFIER MotTqCmdSca.CalibrationPorts.MotTqCmdScaMin.Val /end CHARACTERISTIC
/begin CHARACTERISTIC MotTqTranlDampg.MotTqTranlDampgCmdLim.Val "MICROSAR RTE" VALUE 0x0 RTE_RL_FLOAT32_IEEE 0 NO_COMPU_METHOD -3.402823466e+38 3.402823466e+38 SYMBOL_LINK "Rte_CalprmRom_CalRegn01Inin00_DEFAULT_RTE_CALPRM_GROUP.MotTqTranlDampgCmdLim_Val" 0 DISPLAY_IDENTIFIER MotTqTranlDampg.CalibrationPorts.MotTqTranlDampgCmdLim.Val /end CHARACTERISTIC
/begin CHARACTERISTIC MotTqTranlDampg.MotTqTranlDampgDampgCoeff.Val "MICROSAR RTE" VALUE 0x0 RTE_RL_FLOAT32_IEEE 0 NO_COMPU_METHOD -3.402823466e+38 3.402823466e+38 SYMBOL_LINK "Rte_CalprmRom_CalRegn01Inin00_DEFAULT_RTE_CALPRM_GROUP.MotTqTranlDampgDampgCoeff_Val" 0 DISPLAY_IDENTIFIER MotTqTranlDampg.CalibrationPorts.MotTqTranlDampgDampgCoeff.Val /end CHARACTERISTIC
/begin CHARACTERISTIC MotTqTranlDampg.MotTqTranlDampgRampEnd.Val "MICROSAR RTE" VALUE 0x0 RTE_RL_UWORD 0 NO_COMPU_METHOD 0 65535 SYMBOL_LINK "Rte_CalprmRom_CalRegn01Inin00_DEFAULT_RTE_CALPRM_GROUP.MotTqTranlDampgRampEnd_Val" 0 DISPLAY_IDENTIFIER MotTqTranlDampg.CalibrationPorts.MotTqTranlDampgRampEnd.Val /end CHARACTERISTIC
/begin CHARACTERISTIC MotTqTranlDampg.MotTqTranlDampgTmrPt1.Val "MICROSAR RTE" VALUE 0x0 RTE_RL_FLOAT32_IEEE 0 NO_COMPU_METHOD -3.402823466e+38 3.402823466e+38 SYMBOL_LINK "Rte_CalprmRom_CalRegn01Inin00_DEFAULT_RTE_CALPRM_GROUP.MotTqTranlDampgTmrPt1_Val" 0 DISPLAY_IDENTIFIER MotTqTranlDampg.CalibrationPorts.MotTqTranlDampgTmrPt1.Val /end CHARACTERISTIC
/begin CHARACTERISTIC MotTqTranlDampg.MotTqTranlDampgTmrPt2.Val "MICROSAR RTE" VALUE 0x0 RTE_RL_FLOAT32_IEEE 0 NO_COMPU_METHOD -3.402823466e+38 3.402823466e+38 SYMBOL_LINK "Rte_CalprmRom_CalRegn01Inin00_DEFAULT_RTE_CALPRM_GROUP.MotTqTranlDampgTmrPt2_Val" 0 DISPLAY_IDENTIFIER MotTqTranlDampg.CalibrationPorts.MotTqTranlDampgTmrPt2.Val /end CHARACTERISTIC
/begin CHARACTERISTIC MotTqTranlDampg.MotTqTranlDampgVehSpdBlndX.Ary1D "MICROSAR RTE" VAL_BLK 0x0 RTE_RL_UWORD 0 NO_COMPU_METHOD 0 65535 MATRIX_DIM 4 1 1 SYMBOL_LINK "Rte_CalprmRom_CalRegn01Inin00_DEFAULT_RTE_CALPRM_GROUP.MotTqTranlDampgVehSpdBlndX_Ary1D" 0 DISPLAY_IDENTIFIER MotTqTranlDampg.CalibrationPorts.MotTqTranlDampgVehSpdBlndX.Ary1D /end CHARACTERISTIC
/begin CHARACTERISTIC MotTqTranlDampg.MotTqTranlDampgVehSpdBlndY.Ary1D "MICROSAR RTE" VAL_BLK 0x0 RTE_RL_UWORD 0 NO_COMPU_METHOD 0 65535 MATRIX_DIM 4 1 1 SYMBOL_LINK "Rte_CalprmRom_CalRegn01Cmn_DEFAULT_RTE_CALPRM_GROUP.MotTqTranlDampgVehSpdBlndY_Ary1D" 0 DISPLAY_IDENTIFIER MotTqTranlDampg.CalibrationPorts.MotTqTranlDampgVehSpdBlndY.Ary1D /end CHARACTERISTIC
/begin CHARACTERISTIC MotTqTranlDampg.MotTqTranlDampgVelThd.Val "MICROSAR RTE" VALUE 0x0 RTE_RL_FLOAT32_IEEE 0 NO_COMPU_METHOD -3.402823466e+38 3.402823466e+38 SYMBOL_LINK "Rte_CalprmRom_CalRegn01Inin00_DEFAULT_RTE_CALPRM_GROUP.MotTqTranlDampgVelThd_Val" 0 DISPLAY_IDENTIFIER MotTqTranlDampg.CalibrationPorts.MotTqTranlDampgVelThd.Val /end CHARACTERISTIC
/begin CHARACTERISTIC NxtrCalIds.NxtrCalIdsCal0DevlpAuthor.Ary1D "MICROSAR RTE" VAL_BLK 0x0 RTE_RL_UBYTE 0 NO_COMPU_METHOD 0 255 MATRIX_DIM 6 1 1 SYMBOL_LINK "Rte_CalprmRom_CalRegn01Cmn_DEFAULT_RTE_CALPRM_GROUP.NxtrCalIdsCal0DevlpAuthor_Ary1D" 0 DISPLAY_IDENTIFIER NxtrCalIds.CalibrationPorts.NxtrCalIdsCal0DevlpAuthor.Ary1D /end CHARACTERISTIC
/begin CHARACTERISTIC NxtrCalIds.NxtrCalIdsCal0DevlpDescr.Ary1D "MICROSAR RTE" VAL_BLK 0x0 RTE_RL_UBYTE 0 NO_COMPU_METHOD 0 255 MATRIX_DIM 48 1 1 SYMBOL_LINK "Rte_CalprmRom_CalRegn01Cmn_DEFAULT_RTE_CALPRM_GROUP.NxtrCalIdsCal0DevlpDesc_Ary1D" 0 DISPLAY_IDENTIFIER NxtrCalIds.CalibrationPorts.NxtrCalIdsCal0DevlpDescr.Ary1D /end CHARACTERISTIC
/begin CHARACTERISTIC NxtrCalIds.NxtrCalIdsCal0DevlpRelNr.Val "MICROSAR RTE" VALUE 0x0 RTE_RL_ULONG 0 NO_COMPU_METHOD 0 4294967295 SYMBOL_LINK "Rte_CalprmRom_CalRegn01Cmn_DEFAULT_RTE_CALPRM_GROUP.NxtrCalIdsCal0DevlpRelNr_Val" 0 DISPLAY_IDENTIFIER NxtrCalIds.CalibrationPorts.NxtrCalIdsCal0DevlpRelNr.Val /end CHARACTERISTIC
/begin CHARACTERISTIC NxtrCalIds.NxtrCalIdsCal0DevlpRelSt.Val "MICROSAR RTE" VALUE 0x0 RTE_RL_UBYTE 0 NO_COMPU_METHOD 0 255 SYMBOL_LINK "Rte_CalprmRom_CalRegn01Cmn_DEFAULT_RTE_CALPRM_GROUP.NxtrCalIdsCal0DevlpRelSt_Val" 0 DISPLAY_IDENTIFIER NxtrCalIds.CalibrationPorts.NxtrCalIdsCal0DevlpRelSt.Val /end CHARACTERISTIC
/begin CHARACTERISTIC NxtrCalIds.NxtrCalIdsCal0DevlpTiStamp.Val "MICROSAR RTE" VALUE 0x0 RTE_RL_ULONG 0 NO_COMPU_METHOD 0 4294967295 SYMBOL_LINK "Rte_CalprmRom_CalRegn01Cmn_DEFAULT_RTE_CALPRM_GROUP.NxtrCalIdsCal0DevlpTiStamp_Val" 0 DISPLAY_IDENTIFIER NxtrCalIds.CalibrationPorts.NxtrCalIdsCal0DevlpTiStamp.Val /end CHARACTERISTIC
/begin CHARACTERISTIC NxtrCalIds.NxtrCalIdsCal0DevlpVers.Val "MICROSAR RTE" VALUE 0x0 RTE_RL_UBYTE 0 NO_COMPU_METHOD 0 255 SYMBOL_LINK "Rte_CalprmRom_CalRegn01Cmn_DEFAULT_RTE_CALPRM_GROUP.NxtrCalIdsCal0DevlpVers_Val" 0 DISPLAY_IDENTIFIER NxtrCalIds.CalibrationPorts.NxtrCalIdsCal0DevlpVers.Val /end CHARACTERISTIC
/begin CHARACTERISTIC NxtrCalIds.NxtrCalIdsCal1DevlpAuthor.Ary1D "MICROSAR RTE" VAL_BLK 0x0 RTE_RL_UBYTE 0 NO_COMPU_METHOD 0 255 MATRIX_DIM 6 1 1 SYMBOL_LINK "Rte_CalprmRom_CalRegn02Cmn_DEFAULT_RTE_CALPRM_GROUP.NxtrCalIdsCal1DevlpAuthor_Ary1D" 0 DISPLAY_IDENTIFIER NxtrCalIds.CalibrationPorts.NxtrCalIdsCal1DevlpAuthor.Ary1D /end CHARACTERISTIC
/begin CHARACTERISTIC NxtrCalIds.NxtrCalIdsCal1DevlpRelNr.Val "MICROSAR RTE" VALUE 0x0 RTE_RL_ULONG 0 NO_COMPU_METHOD 0 4294967295 SYMBOL_LINK "Rte_CalprmRom_CalRegn02Cmn_DEFAULT_RTE_CALPRM_GROUP.NxtrCalIdsCal1DevlpRelNr_Val" 0 DISPLAY_IDENTIFIER NxtrCalIds.CalibrationPorts.NxtrCalIdsCal1DevlpRelNr.Val /end CHARACTERISTIC
/begin CHARACTERISTIC NxtrCalIds.NxtrCalIdsCal1DevlpRelSt.Val "MICROSAR RTE" VALUE 0x0 RTE_RL_UBYTE 0 NO_COMPU_METHOD 0 255 SYMBOL_LINK "Rte_CalprmRom_CalRegn02Cmn_DEFAULT_RTE_CALPRM_GROUP.NxtrCalIdsCal1DevlpRelSt_Val" 0 DISPLAY_IDENTIFIER NxtrCalIds.CalibrationPorts.NxtrCalIdsCal1DevlpRelSt.Val /end CHARACTERISTIC
/begin CHARACTERISTIC NxtrCalIds.NxtrCalIdsCal1DevlpTiStamp.Val "MICROSAR RTE" VALUE 0x0 RTE_RL_ULONG 0 NO_COMPU_METHOD 0 4294967295 SYMBOL_LINK "Rte_CalprmRom_CalRegn02Cmn_DEFAULT_RTE_CALPRM_GROUP.NxtrCalIdsCal1DevlpTiStamp_Val" 0 DISPLAY_IDENTIFIER NxtrCalIds.CalibrationPorts.NxtrCalIdsCal1DevlpTiStamp.Val /end CHARACTERISTIC
/begin CHARACTERISTIC NxtrCalIds.NxtrCalIdsCal1DevlpVers.Val "MICROSAR RTE" VALUE 0x0 RTE_RL_UBYTE 0 NO_COMPU_METHOD 0 255 SYMBOL_LINK "Rte_CalprmRom_CalRegn02Cmn_DEFAULT_RTE_CALPRM_GROUP.NxtrCalIdsCal1DevlpVers_Val" 0 DISPLAY_IDENTIFIER NxtrCalIds.CalibrationPorts.NxtrCalIdsCal1DevlpVers.Val /end CHARACTERISTIC
/begin CHARACTERISTIC NxtrCalIds.NxtrCalIdsCal2DevlpAuthor.Ary1D "MICROSAR RTE" VAL_BLK 0x0 RTE_RL_UBYTE 0 NO_COMPU_METHOD 0 255 MATRIX_DIM 6 1 1 SYMBOL_LINK "Rte_CalprmRom_CalRegn01Cmn_DEFAULT_RTE_CALPRM_GROUP.NxtrCalIdsCal2DevlpAuthor_Ary1D" 0 DISPLAY_IDENTIFIER NxtrCalIds.CalibrationPorts.NxtrCalIdsCal2DevlpAuthor.Ary1D /end CHARACTERISTIC
/begin CHARACTERISTIC NxtrCalIds.NxtrCalIdsCal2DevlpDescr.Ary1D "MICROSAR RTE" VAL_BLK 0x0 RTE_RL_UBYTE 0 NO_COMPU_METHOD 0 255 MATRIX_DIM 48 1 1 SYMBOL_LINK "Rte_CalprmRom_CalRegn01Cmn_DEFAULT_RTE_CALPRM_GROUP.NxtrCalIdsCal2DevlpDesc_Ary1D" 0 DISPLAY_IDENTIFIER NxtrCalIds.CalibrationPorts.NxtrCalIdsCal2DevlpDescr.Ary1D /end CHARACTERISTIC
/begin CHARACTERISTIC NxtrCalIds.NxtrCalIdsCal2DevlpRelNr.Val "MICROSAR RTE" VALUE 0x0 RTE_RL_ULONG 0 NO_COMPU_METHOD 0 4294967295 SYMBOL_LINK "Rte_CalprmRom_CalRegn01Cmn_DEFAULT_RTE_CALPRM_GROUP.NxtrCalIdsCal2DevlpRelNr_Val" 0 DISPLAY_IDENTIFIER NxtrCalIds.CalibrationPorts.NxtrCalIdsCal2DevlpRelNr.Val /end CHARACTERISTIC
/begin CHARACTERISTIC NxtrCalIds.NxtrCalIdsCal2DevlpRelSt.Val "MICROSAR RTE" VALUE 0x0 RTE_RL_UBYTE 0 NO_COMPU_METHOD 0 255 SYMBOL_LINK "Rte_CalprmRom_CalRegn01Cmn_DEFAULT_RTE_CALPRM_GROUP.NxtrCalIdsCal2DevlpRelSt_Val" 0 DISPLAY_IDENTIFIER NxtrCalIds.CalibrationPorts.NxtrCalIdsCal2DevlpRelSt.Val /end CHARACTERISTIC
/begin CHARACTERISTIC NxtrCalIds.NxtrCalIdsCal2DevlpTiStamp.Val "MICROSAR RTE" VALUE 0x0 RTE_RL_ULONG 0 NO_COMPU_METHOD 0 4294967295 SYMBOL_LINK "Rte_CalprmRom_CalRegn01Cmn_DEFAULT_RTE_CALPRM_GROUP.NxtrCalIdsCal2DevlpTiStamp_Val" 0 DISPLAY_IDENTIFIER NxtrCalIds.CalibrationPorts.NxtrCalIdsCal2DevlpTiStamp.Val /end CHARACTERISTIC
/begin CHARACTERISTIC NxtrCalIds.NxtrCalIdsCal2DevlpVers.Val "MICROSAR RTE" VALUE 0x0 RTE_RL_UBYTE 0 NO_COMPU_METHOD 0 255 SYMBOL_LINK "Rte_CalprmRom_CalRegn01Cmn_DEFAULT_RTE_CALPRM_GROUP.NxtrCalIdsCal2DevlpVers_Val" 0 DISPLAY_IDENTIFIER NxtrCalIds.CalibrationPorts.NxtrCalIdsCal2DevlpVers.Val /end CHARACTERISTIC
/begin CHARACTERISTIC PolarityCfg.PolarityCfgSavedDft "MICROSAR RTE" VALUE 0x0 RTE_RL_ULONG 0 NO_COMPU_METHOD 0 4294967295 SYMBOL_LINK "Rte_CalprmRom_PolarityCfg_DEFAULT_RTE_CDATA_GROUP.PolarityCfgSavedDft" 0 DISPLAY_IDENTIFIER PolarityCfg.CalibrationParameters.PolarityCfgSavedDft /end CHARACTERISTIC
/begin CHARACTERISTIC PosnTrakgServo.PosnTrakgServoArbnFltMtgtnLpFilCutOffFrq.Val "MICROSAR RTE" VALUE 0x0 RTE_RL_FLOAT32_IEEE 0 NO_COMPU_METHOD -3.402823466e+38 3.402823466e+38 SYMBOL_LINK "Rte_CalprmRom_CalRegn01Inin00GroupB_DEFAULT_RTE_CALPRM_GROUP.PosnTrakgServoArbnFltMtgtnLpFilCutOffFrq_Val" 0 DISPLAY_IDENTIFIER PosnTrakgServo.CalibrationPorts.PosnTrakgServoArbnFltMtgtnLpFilCutOffFrq.Val /end CHARACTERISTIC
/begin CHARACTERISTIC PosnTrakgServo.PosnTrakgServoEnaBlndFacTblX.Ary1D "MICROSAR RTE" VAL_BLK 0x0 RTE_RL_UWORD 0 NO_COMPU_METHOD 0 65535 MATRIX_DIM 10 1 1 SYMBOL_LINK "Rte_CalprmRom_CalRegn01Inin00GroupB_DEFAULT_RTE_CALPRM_GROUP.PosnTrakgServoEnaBlndFacTblX_Ary1D" 0 DISPLAY_IDENTIFIER PosnTrakgServo.CalibrationPorts.PosnTrakgServoEnaBlndFacTblX.Ary1D /end CHARACTERISTIC
/begin CHARACTERISTIC PosnTrakgServo.PosnTrakgServoEnaBlndFacTblY.Ary1D "MICROSAR RTE" VAL_BLK 0x0 RTE_RL_UWORD 0 NO_COMPU_METHOD 0 65535 MATRIX_DIM 10 1 1 SYMBOL_LINK "Rte_CalprmRom_CalRegn01Inin00GroupB_DEFAULT_RTE_CALPRM_GROUP.PosnTrakgServoEnaBlndFacTblY_Ary1D" 0 DISPLAY_IDENTIFIER PosnTrakgServo.CalibrationPorts.PosnTrakgServoEnaBlndFacTblY.Ary1D /end CHARACTERISTIC
/begin CHARACTERISTIC PosnTrakgServo.PosnTrakgServoFfGain.Ary1D "MICROSAR RTE" VAL_BLK 0x0 RTE_RL_UWORD 0 NO_COMPU_METHOD 0 65535 MATRIX_DIM 12 1 1 SYMBOL_LINK "Rte_CalprmRom_CalRegn01Inin00GroupB_DEFAULT_RTE_CALPRM_GROUP.PosnTrakgServoFfGain_Ary1D" 0 DISPLAY_IDENTIFIER PosnTrakgServo.CalibrationPorts.PosnTrakgServoFfGain.Ary1D /end CHARACTERISTIC
/begin CHARACTERISTIC PosnTrakgServo.PosnTrakgServoFfVelGain.Ary1D "MICROSAR RTE" VAL_BLK 0x0 RTE_RL_UWORD 0 NO_COMPU_METHOD 0 65535 MATRIX_DIM 12 1 1 SYMBOL_LINK "Rte_CalprmRom_CalRegn01Inin00GroupB_DEFAULT_RTE_CALPRM_GROUP.PosnTrakgServoFfVelGain_Ary1D" 0 DISPLAY_IDENTIFIER PosnTrakgServo.CalibrationPorts.PosnTrakgServoFfVelGain.Ary1D /end CHARACTERISTIC
/begin CHARACTERISTIC PosnTrakgServo.PosnTrakgServoGain1.Ary1D "MICROSAR RTE" VAL_BLK 0x0 RTE_RL_UWORD 0 NO_COMPU_METHOD 0 65535 MATRIX_DIM 12 1 1 SYMBOL_LINK "Rte_CalprmRom_CalRegn01Inin00GroupB_DEFAULT_RTE_CALPRM_GROUP.PosnTrakgServoGain1_Ary1D" 0 DISPLAY_IDENTIFIER PosnTrakgServo.CalibrationPorts.PosnTrakgServoGain1.Ary1D /end CHARACTERISTIC
/begin CHARACTERISTIC PosnTrakgServo.PosnTrakgServoGain2.Ary1D "MICROSAR RTE" VAL_BLK 0x0 RTE_RL_UWORD 0 NO_COMPU_METHOD 0 65535 MATRIX_DIM 12 1 1 SYMBOL_LINK "Rte_CalprmRom_CalRegn01Inin00GroupB_DEFAULT_RTE_CALPRM_GROUP.PosnTrakgServoGain2_Ary1D" 0 DISPLAY_IDENTIFIER PosnTrakgServo.CalibrationPorts.PosnTrakgServoGain2.Ary1D /end CHARACTERISTIC
/begin CHARACTERISTIC PosnTrakgServo.PosnTrakgServoGain3.Ary1D "MICROSAR RTE" VAL_BLK 0x0 RTE_RL_SWORD 0 NO_COMPU_METHOD -32768 32767 MATRIX_DIM 12 1 1 SYMBOL_LINK "Rte_CalprmRom_CalRegn01Inin00GroupB_DEFAULT_RTE_CALPRM_GROUP.PosnTrakgServoGain3_Ary1D" 0 DISPLAY_IDENTIFIER PosnTrakgServo.CalibrationPorts.PosnTrakgServoGain3.Ary1D /end CHARACTERISTIC
/begin CHARACTERISTIC PosnTrakgServo.PosnTrakgServoGain4.Ary1D "MICROSAR RTE" VAL_BLK 0x0 RTE_RL_SWORD 0 NO_COMPU_METHOD -32768 32767 MATRIX_DIM 12 1 1 SYMBOL_LINK "Rte_CalprmRom_CalRegn01Inin00GroupB_DEFAULT_RTE_CALPRM_GROUP.PosnTrakgServoGain4_Ary1D" 0 DISPLAY_IDENTIFIER PosnTrakgServo.CalibrationPorts.PosnTrakgServoGain4.Ary1D /end CHARACTERISTIC
/begin CHARACTERISTIC PosnTrakgServo.PosnTrakgServoGainArbnFltMtgtn.Ary1D "MICROSAR RTE" VAL_BLK 0x0 RTE_RL_UWORD 0 NO_COMPU_METHOD 0 65535 MATRIX_DIM 12 1 1 SYMBOL_LINK "Rte_CalprmRom_CalRegn01Inin00GroupB_DEFAULT_RTE_CALPRM_GROUP.PosnTrakgServoGainArbnFltMtgtn_Ary1D" 0 DISPLAY_IDENTIFIER PosnTrakgServo.CalibrationPorts.PosnTrakgServoGainArbnFltMtgtn.Ary1D /end CHARACTERISTIC
/begin CHARACTERISTIC PosnTrakgServo.PosnTrakgServoHwAgTarMgnLimTblY.Ary1D "MICROSAR RTE" VAL_BLK 0x0 RTE_RL_UWORD 0 NO_COMPU_METHOD 0 65535 MATRIX_DIM 12 1 1 SYMBOL_LINK "Rte_CalprmRom_CalRegn01Inin00GroupB_DEFAULT_RTE_CALPRM_GROUP.PosnTrakgServoHwAgTarMgnLimTblY_Ary1D" 0 DISPLAY_IDENTIFIER PosnTrakgServo.CalibrationPorts.PosnTrakgServoHwAgTarMgnLimTblY.Ary1D /end CHARACTERISTIC
/begin CHARACTERISTIC PosnTrakgServo.PosnTrakgServoHwAgTarRateLimTblY.Ary1D "MICROSAR RTE" VAL_BLK 0x0 RTE_RL_UWORD 0 NO_COMPU_METHOD 0 65535 MATRIX_DIM 12 1 1 SYMBOL_LINK "Rte_CalprmRom_CalRegn01Inin00GroupB_DEFAULT_RTE_CALPRM_GROUP.PosnTrakgServoHwAgTarRateLimTblY_Ary1D" 0 DISPLAY_IDENTIFIER PosnTrakgServo.CalibrationPorts.PosnTrakgServoHwAgTarRateLimTblY.Ary1D /end CHARACTERISTIC
/begin CHARACTERISTIC PosnTrakgServo.PosnTrakgServoHwVelTarRateLimTblY.Ary1D "MICROSAR RTE" VAL_BLK 0x0 RTE_RL_UWORD 0 NO_COMPU_METHOD 0 65535 MATRIX_DIM 12 1 1 SYMBOL_LINK "Rte_CalprmRom_CalRegn01Inin00GroupB_DEFAULT_RTE_CALPRM_GROUP.PosnTrakgServoHwVelTarRateLimTblY_Ary1D" 0 DISPLAY_IDENTIFIER PosnTrakgServo.CalibrationPorts.PosnTrakgServoHwVelTarRateLimTblY.Ary1D /end CHARACTERISTIC
/begin CHARACTERISTIC PosnTrakgServo.PosnTrakgServoIntglGain.Ary1D "MICROSAR RTE" VAL_BLK 0x0 RTE_RL_UWORD 0 NO_COMPU_METHOD 0 65535 MATRIX_DIM 12 1 1 SYMBOL_LINK "Rte_CalprmRom_CalRegn01Inin00GroupB_DEFAULT_RTE_CALPRM_GROUP.PosnTrakgServoIntglGain_Ary1D" 0 DISPLAY_IDENTIFIER PosnTrakgServo.CalibrationPorts.PosnTrakgServoIntglGain.Ary1D /end CHARACTERISTIC
/begin CHARACTERISTIC PosnTrakgServo.PosnTrakgServoIntglLim.Ary1D "MICROSAR RTE" VAL_BLK 0x0 RTE_RL_UWORD 0 NO_COMPU_METHOD 0 65535 MATRIX_DIM 12 1 1 SYMBOL_LINK "Rte_CalprmRom_CalRegn01Inin00GroupB_DEFAULT_RTE_CALPRM_GROUP.PosnTrakgServoIntglLim_Ary1D" 0 DISPLAY_IDENTIFIER PosnTrakgServo.CalibrationPorts.PosnTrakgServoIntglLim.Ary1D /end CHARACTERISTIC
/begin CHARACTERISTIC PosnTrakgServo.PosnTrakgServoIntgtrAntiWdupGain.Val "MICROSAR RTE" VALUE 0x0 RTE_RL_FLOAT32_IEEE 0 NO_COMPU_METHOD -3.402823466e+38 3.402823466e+38 SYMBOL_LINK "Rte_CalprmRom_CalRegn01Inin00GroupB_DEFAULT_RTE_CALPRM_GROUP.PosnTrakgServoIntgtrAntiWdupGain_Val" 0 DISPLAY_IDENTIFIER PosnTrakgServo.CalibrationPorts.PosnTrakgServoIntgtrAntiWdupGain.Val /end CHARACTERISTIC
/begin CHARACTERISTIC PosnTrakgServo.PosnTrakgServoIntgtrStCorrnGain.Val "MICROSAR RTE" VALUE 0x0 RTE_RL_FLOAT32_IEEE 0 NO_COMPU_METHOD -3.402823466e+38 3.402823466e+38 SYMBOL_LINK "Rte_CalprmRom_CalRegn01Inin00GroupB_DEFAULT_RTE_CALPRM_GROUP.PosnTrakgServoIntgtrStCorrnGain_Val" 0 DISPLAY_IDENTIFIER PosnTrakgServo.CalibrationPorts.PosnTrakgServoIntgtrStCorrnGain.Val /end CHARACTERISTIC
/begin CHARACTERISTIC PosnTrakgServo.PosnTrakgServoLpFilCutOffFrq.Val "MICROSAR RTE" VALUE 0x0 RTE_RL_FLOAT32_IEEE 0 NO_COMPU_METHOD -3.402823466e+38 3.402823466e+38 SYMBOL_LINK "Rte_CalprmRom_CalRegn01Inin00GroupB_DEFAULT_RTE_CALPRM_GROUP.PosnTrakgServoLpFilCutOffFrq_Val" 0 DISPLAY_IDENTIFIER PosnTrakgServo.CalibrationPorts.PosnTrakgServoLpFilCutOffFrq.Val /end CHARACTERISTIC
/begin CHARACTERISTIC PosnTrakgServo.PosnTrakgServoOutpAntiWdupGain.Val "MICROSAR RTE" VALUE 0x0 RTE_RL_FLOAT32_IEEE 0 NO_COMPU_METHOD -3.402823466e+38 3.402823466e+38 SYMBOL_LINK "Rte_CalprmRom_CalRegn01Inin00GroupB_DEFAULT_RTE_CALPRM_GROUP.PosnTrakgServoOutpAntiWdupGain_Val" 0 DISPLAY_IDENTIFIER PosnTrakgServo.CalibrationPorts.PosnTrakgServoOutpAntiWdupGain.Val /end CHARACTERISTIC
/begin CHARACTERISTIC PosnTrakgServo.PosnTrakgServoOutpLim.Ary1D "MICROSAR RTE" VAL_BLK 0x0 RTE_RL_UWORD 0 NO_COMPU_METHOD 0 65535 MATRIX_DIM 12 1 1 SYMBOL_LINK "Rte_CalprmRom_CalRegn01Inin00GroupB_DEFAULT_RTE_CALPRM_GROUP.PosnTrakgServoOutpLim_Ary1D" 0 DISPLAY_IDENTIFIER PosnTrakgServo.CalibrationPorts.PosnTrakgServoOutpLim.Ary1D /end CHARACTERISTIC
/begin CHARACTERISTIC PosnTrakgServo.PosnTrakgServoVehSpdTbl.Ary1D "MICROSAR RTE" VAL_BLK 0x0 RTE_RL_UWORD 0 NO_COMPU_METHOD 0 65535 MATRIX_DIM 12 1 1 SYMBOL_LINK "Rte_CalprmRom_CalRegn01Inin00GroupB_DEFAULT_RTE_CALPRM_GROUP.PosnTrakgServoVehSpdTbl_Ary1D" 0 DISPLAY_IDENTIFIER PosnTrakgServo.CalibrationPorts.PosnTrakgServoVehSpdTbl.Ary1D /end CHARACTERISTIC
/begin CHARACTERISTIC PosnTrakgServo.SysGlbPrmSysKineRat.Val "MICROSAR RTE" VALUE 0x0 RTE_RL_FLOAT32_IEEE 0 NO_COMPU_METHOD -3.402823466e+38 3.402823466e+38 SYMBOL_LINK "Rte_CalprmRom_CalRegn02Inin00_DEFAULT_RTE_CALPRM_GROUP.SysGlbPrmSysKineRat_Val" 0 DISPLAY_IDENTIFIER PosnTrakgServo.CalibrationPorts.SysGlbPrmSysKineRat.Val /end CHARACTERISTIC
/begin CHARACTERISTIC PosnTrakgServo.SysGlbPrmSysTqRat.Val "MICROSAR RTE" VALUE 0x0 RTE_RL_FLOAT32_IEEE 0 NO_COMPU_METHOD -3.402823466e+38 3.402823466e+38 SYMBOL_LINK "Rte_CalprmRom_CalRegn01Inin00_DEFAULT_RTE_CALPRM_GROUP.SysGlbPrmSysTqRat_Val" 0 DISPLAY_IDENTIFIER PosnTrakgServo.CalibrationPorts.SysGlbPrmSysTqRat.Val /end CHARACTERISTIC
/begin CHARACTERISTIC PwrDiscnct.BattVltgSwdMax.Val "MICROSAR RTE" VALUE 0x0 RTE_RL_FLOAT32_IEEE 0 NO_COMPU_METHOD -3.402823466e+38 3.402823466e+38 SYMBOL_LINK "Rte_CalprmRom_CalRegn01Cmn_DEFAULT_RTE_CALPRM_GROUP.BattVltgSwdMax_Val" 0 DISPLAY_IDENTIFIER PwrDiscnct.CalibrationPorts.BattVltgSwdMax.Val /end CHARACTERISTIC
/begin CHARACTERISTIC PwrDiscnct.PwrDiscnctBattVltgExtdNormThd.Val "MICROSAR RTE" VALUE 0x0 RTE_RL_FLOAT32_IEEE 0 NO_COMPU_METHOD -3.402823466e+38 3.402823466e+38 SYMBOL_LINK "Rte_CalprmRom_CalRegn01Inin00_DEFAULT_RTE_CALPRM_GROUP.PwrDiscnctBattVltgExtdNormThd_Val" 0 DISPLAY_IDENTIFIER PwrDiscnct.CalibrationPorts.PwrDiscnctBattVltgExtdNormThd.Val /end CHARACTERISTIC
/begin CHARACTERISTIC PwrDiscnct.PwrDiscnctBattVltgNonExtdThd.Val "MICROSAR RTE" VALUE 0x0 RTE_RL_FLOAT32_IEEE 0 NO_COMPU_METHOD -3.402823466e+38 3.402823466e+38 SYMBOL_LINK "Rte_CalprmRom_CalRegn01Inin00_DEFAULT_RTE_CALPRM_GROUP.PwrDiscnctBattVltgNonExtdThd_Val" 0 DISPLAY_IDENTIFIER PwrDiscnct.CalibrationPorts.PwrDiscnctBattVltgNonExtdThd.Val /end CHARACTERISTIC
/begin CHARACTERISTIC PwrDiscnct.PwrDiscnctChrgMinDeltaExtOper.Val "MICROSAR RTE" VALUE 0x0 RTE_RL_FLOAT32_IEEE 0 NO_COMPU_METHOD -3.402823466e+38 3.402823466e+38 SYMBOL_LINK "Rte_CalprmRom_CalRegn01Inin00_DEFAULT_RTE_CALPRM_GROUP.PwrDiscnctChrgMinDeltaExtOper_Val" 0 DISPLAY_IDENTIFIER PwrDiscnct.CalibrationPorts.PwrDiscnctChrgMinDeltaExtOper.Val /end CHARACTERISTIC
/begin CHARACTERISTIC PwrDiscnct.PwrDiscnctChrgMinDeltaNonOper.Val "MICROSAR RTE" VALUE 0x0 RTE_RL_FLOAT32_IEEE 0 NO_COMPU_METHOD -3.402823466e+38 3.402823466e+38 SYMBOL_LINK "Rte_CalprmRom_CalRegn01Inin00_DEFAULT_RTE_CALPRM_GROUP.PwrDiscnctChrgMinDeltaNonOper_Val" 0 DISPLAY_IDENTIFIER PwrDiscnct.CalibrationPorts.PwrDiscnctChrgMinDeltaNonOper.Val /end CHARACTERISTIC
/begin CHARACTERISTIC PwrDiscnct.PwrDiscnctChrgMinDeltaNormOper.Val "MICROSAR RTE" VALUE 0x0 RTE_RL_FLOAT32_IEEE 0 NO_COMPU_METHOD -3.402823466e+38 3.402823466e+38 SYMBOL_LINK "Rte_CalprmRom_CalRegn01Inin00_DEFAULT_RTE_CALPRM_GROUP.PwrDiscnctChrgMinDeltaNormOper_Val" 0 DISPLAY_IDENTIFIER PwrDiscnct.CalibrationPorts.PwrDiscnctChrgMinDeltaNormOper.Val /end CHARACTERISTIC
/begin CHARACTERISTIC PwrDiscnct.PwrDiscnctChrgPmpDiagOpenThd.Val "MICROSAR RTE" VALUE 0x0 RTE_RL_FLOAT32_IEEE 0 NO_COMPU_METHOD -3.402823466e+38 3.402823466e+38 SYMBOL_LINK "Rte_CalprmRom_CalRegn01Inin00_DEFAULT_RTE_CALPRM_GROUP.PwrDiscnctChrgPmpDiagOpenThd_Val" 0 DISPLAY_IDENTIFIER PwrDiscnct.CalibrationPorts.PwrDiscnctChrgPmpDiagOpenThd.Val /end CHARACTERISTIC
/begin CHARACTERISTIC PwrDiscnct.PwrDiscnctDeltaSwtClsThd.Val "MICROSAR RTE" VALUE 0x0 RTE_RL_FLOAT32_IEEE 0 NO_COMPU_METHOD -3.402823466e+38 3.402823466e+38 SYMBOL_LINK "Rte_CalprmRom_CalRegn01Inin00_DEFAULT_RTE_CALPRM_GROUP.PwrDiscnctDeltaSwtClsThd_Val" 0 DISPLAY_IDENTIFIER PwrDiscnct.CalibrationPorts.PwrDiscnctDeltaSwtClsThd.Val /end CHARACTERISTIC
/begin CHARACTERISTIC PwrDiscnct.PwrDiscnctDeltaVltgClsThd.Val "MICROSAR RTE" VALUE 0x0 RTE_RL_FLOAT32_IEEE 0 NO_COMPU_METHOD -3.402823466e+38 3.402823466e+38 SYMBOL_LINK "Rte_CalprmRom_CalRegn01Inin00_DEFAULT_RTE_CALPRM_GROUP.PwrDiscnctDeltaVltgClsThd_Val" 0 DISPLAY_IDENTIFIER PwrDiscnct.CalibrationPorts.PwrDiscnctDeltaVltgClsThd.Val /end CHARACTERISTIC
/begin CHARACTERISTIC PwrDiscnct.PwrDiscnctDeltaVltgOpenThd.Val "MICROSAR RTE" VALUE 0x0 RTE_RL_FLOAT32_IEEE 0 NO_COMPU_METHOD -3.402823466e+38 3.402823466e+38 SYMBOL_LINK "Rte_CalprmRom_CalRegn01Inin00_DEFAULT_RTE_CALPRM_GROUP.PwrDiscnctDeltaVltgOpenThd_Val" 0 DISPLAY_IDENTIFIER PwrDiscnct.CalibrationPorts.PwrDiscnctDeltaVltgOpenThd.Val /end CHARACTERISTIC
/begin CHARACTERISTIC PwrDiscnct.PwrDiscnctFltFailStep.Val "MICROSAR RTE" VALUE 0x0 RTE_RL_UWORD 0 NO_COMPU_METHOD 0 65535 SYMBOL_LINK "Rte_CalprmRom_CalRegn01Inin00_DEFAULT_RTE_CALPRM_GROUP.PwrDiscnctFltFailStep_Val" 0 DISPLAY_IDENTIFIER PwrDiscnct.CalibrationPorts.PwrDiscnctFltFailStep.Val /end CHARACTERISTIC
/begin CHARACTERISTIC PwrDiscnct.PwrDiscnctFltPassStep.Val "MICROSAR RTE" VALUE 0x0 RTE_RL_UWORD 0 NO_COMPU_METHOD 0 65535 SYMBOL_LINK "Rte_CalprmRom_CalRegn01Inin00_DEFAULT_RTE_CALPRM_GROUP.PwrDiscnctFltPassStep_Val" 0 DISPLAY_IDENTIFIER PwrDiscnct.CalibrationPorts.PwrDiscnctFltPassStep.Val /end CHARACTERISTIC
/begin CHARACTERISTIC PwrDiscnct.PwrDiscnctFltThd.Val "MICROSAR RTE" VALUE 0x0 RTE_RL_UWORD 0 NO_COMPU_METHOD 0 65535 SYMBOL_LINK "Rte_CalprmRom_CalRegn01Inin00_DEFAULT_RTE_CALPRM_GROUP.PwrDiscnctFltThd_Val" 0 DISPLAY_IDENTIFIER PwrDiscnct.CalibrationPorts.PwrDiscnctFltThd.Val /end CHARACTERISTIC
/begin CHARACTERISTIC PwrDiscnct.PwrDiscnctMtrMtnThd.Val "MICROSAR RTE" VALUE 0x0 RTE_RL_FLOAT32_IEEE 0 NO_COMPU_METHOD -3.402823466e+38 3.402823466e+38 SYMBOL_LINK "Rte_CalprmRom_CalRegn01Inin00_DEFAULT_RTE_CALPRM_GROUP.PwrDiscnctMtrMtnThd_Val" 0 DISPLAY_IDENTIFIER PwrDiscnct.CalibrationPorts.PwrDiscnctMtrMtnThd.Val /end CHARACTERISTIC
/begin CHARACTERISTIC PwrDiscnct.PwrDiscnctPwrDiscnctRtFltFailStep.Val "MICROSAR RTE" VALUE 0x0 RTE_RL_UWORD 0 NO_COMPU_METHOD 0 65535 SYMBOL_LINK "Rte_CalprmRom_CalRegn01Inin00_DEFAULT_RTE_CALPRM_GROUP.PwrDiscnctPwrDiscnctRtFltFailStep_Val" 0 DISPLAY_IDENTIFIER PwrDiscnct.CalibrationPorts.PwrDiscnctPwrDiscnctRtFltFailStep.Val /end CHARACTERISTIC
/begin CHARACTERISTIC PwrDiscnct.PwrDiscnctPwrDiscnctRtFltPassStep.Val "MICROSAR RTE" VALUE 0x0 RTE_RL_UWORD 0 NO_COMPU_METHOD 0 65535 SYMBOL_LINK "Rte_CalprmRom_CalRegn01Inin00_DEFAULT_RTE_CALPRM_GROUP.PwrDiscnctPwrDiscnctRtFltPassStep_Val" 0 DISPLAY_IDENTIFIER PwrDiscnct.CalibrationPorts.PwrDiscnctPwrDiscnctRtFltPassStep.Val /end CHARACTERISTIC
/begin CHARACTERISTIC PwrDiscnct.PwrDiscnctSwtDiagOpenThd.Val "MICROSAR RTE" VALUE 0x0 RTE_RL_FLOAT32_IEEE 0 NO_COMPU_METHOD -3.402823466e+38 3.402823466e+38 SYMBOL_LINK "Rte_CalprmRom_CalRegn01Inin00_DEFAULT_RTE_CALPRM_GROUP.PwrDiscnctSwtDiagOpenThd_Val" 0 DISPLAY_IDENTIFIER PwrDiscnct.CalibrationPorts.PwrDiscnctSwtDiagOpenThd.Val /end CHARACTERISTIC
/begin CHARACTERISTIC PwrLimr.PwrLimrAssiRednLpFilFrq.Val "MICROSAR RTE" VALUE 0x0 RTE_RL_FLOAT32_IEEE 0 NO_COMPU_METHOD -3.402823466e+38 3.402823466e+38 SYMBOL_LINK "Rte_CalprmRom_CalRegn01Cmn_DEFAULT_RTE_CALPRM_GROUP.PwrLimrAssiRednLpFilFrq_Val" 0 DISPLAY_IDENTIFIER PwrLimr.CalibrationPorts.PwrLimrAssiRednLpFilFrq.Val /end CHARACTERISTIC
/begin CHARACTERISTIC PwrLimr.PwrLimrBackEmfConStdT.Val "MICROSAR RTE" VALUE 0x0 RTE_RL_FLOAT32_IEEE 0 NO_COMPU_METHOD -3.402823466e+38 3.402823466e+38 SYMBOL_LINK "Rte_CalprmRom_CalRegn01Cmn_DEFAULT_RTE_CALPRM_GROUP.PwrLimrBackEmfConStdT_Val" 0 DISPLAY_IDENTIFIER PwrLimr.CalibrationPorts.PwrLimrBackEmfConStdT.Val /end CHARACTERISTIC
/begin CHARACTERISTIC PwrLimr.PwrLimrBrdgVltgAdjSlew.Val "MICROSAR RTE" VALUE 0x0 RTE_RL_FLOAT32_IEEE 0 NO_COMPU_METHOD -3.402823466e+38 3.402823466e+38 SYMBOL_LINK "Rte_CalprmRom_CalRegn01Cmn_DEFAULT_RTE_CALPRM_GROUP.PwrLimrBrdgVltgAdjSlew_Val" 0 DISPLAY_IDENTIFIER PwrLimr.CalibrationPorts.PwrLimrBrdgVltgAdjSlew.Val /end CHARACTERISTIC
/begin CHARACTERISTIC PwrLimr.PwrLimrBrdgVltgAltFltAdj.Val "MICROSAR RTE" VALUE 0x0 RTE_RL_FLOAT32_IEEE 0 NO_COMPU_METHOD -3.402823466e+38 3.402823466e+38 SYMBOL_LINK "Rte_CalprmRom_CalRegn01Cmn_DEFAULT_RTE_CALPRM_GROUP.PwrLimrBrdgVltgAltFltAdj_Val" 0 DISPLAY_IDENTIFIER PwrLimr.CalibrationPorts.PwrLimrBrdgVltgAltFltAdj.Val /end CHARACTERISTIC
/begin CHARACTERISTIC PwrLimr.PwrLimrFilAssiRednThd.Val "MICROSAR RTE" VALUE 0x0 RTE_RL_FLOAT32_IEEE 0 NO_COMPU_METHOD -3.402823466e+38 3.402823466e+38 SYMBOL_LINK "Rte_CalprmRom_CalRegn01Cmn_DEFAULT_RTE_CALPRM_GROUP.PwrLimrFilAssiRednThd_Val" 0 DISPLAY_IDENTIFIER PwrLimr.CalibrationPorts.PwrLimrFilAssiRednThd.Val /end CHARACTERISTIC
/begin CHARACTERISTIC PwrLimr.PwrLimrLoVoltAssiRcvrThd.Val "MICROSAR RTE" VALUE 0x0 RTE_RL_FLOAT32_IEEE 0 NO_COMPU_METHOD -3.402823466e+38 3.402823466e+38 SYMBOL_LINK "Rte_CalprmRom_CalRegn01Cmn_DEFAULT_RTE_CALPRM_GROUP.PwrLimrLoVoltAssiRcvrThd_Val" 0 DISPLAY_IDENTIFIER PwrLimr.CalibrationPorts.PwrLimrLoVoltAssiRcvrThd.Val /end CHARACTERISTIC
/begin CHARACTERISTIC PwrLimr.PwrLimrLoVoltAssiRcvrTi.Val "MICROSAR RTE" VALUE 0x0 RTE_RL_UWORD 0 NO_COMPU_METHOD 0 65535 SYMBOL_LINK "Rte_CalprmRom_CalRegn01Cmn_DEFAULT_RTE_CALPRM_GROUP.PwrLimrLoVoltAssiRcvrTi_Val" 0 DISPLAY_IDENTIFIER PwrLimr.CalibrationPorts.PwrLimrLoVoltAssiRcvrTi.Val /end CHARACTERISTIC
/begin CHARACTERISTIC PwrLimr.PwrLimrMotEnvlpX.Ary1D "MICROSAR RTE" VAL_BLK 0x0 RTE_RL_SWORD 0 NO_COMPU_METHOD -32768 32767 MATRIX_DIM 14 1 1 SYMBOL_LINK "Rte_CalprmRom_CalRegn01Cmn_DEFAULT_RTE_CALPRM_GROUP.PwrLimrMotEnvlpX_Ary1D" 0 DISPLAY_IDENTIFIER PwrLimr.CalibrationPorts.PwrLimrMotEnvlpX.Ary1D /end CHARACTERISTIC
/begin CHARACTERISTIC PwrLimr.PwrLimrMotEnvlpY.Ary1D "MICROSAR RTE" VAL_BLK 0x0 RTE_RL_UWORD 0 NO_COMPU_METHOD 0 65535 MATRIX_DIM 14 1 1 SYMBOL_LINK "Rte_CalprmRom_CalRegn01Cmn_DEFAULT_RTE_CALPRM_GROUP.PwrLimrMotEnvlpY_Ary1D" 0 DISPLAY_IDENTIFIER PwrLimr.CalibrationPorts.PwrLimrMotEnvlpY.Ary1D /end CHARACTERISTIC
/begin CHARACTERISTIC PwrLimr.PwrLimrMotVelLpFilFrq.Val "MICROSAR RTE" VALUE 0x0 RTE_RL_FLOAT32_IEEE 0 NO_COMPU_METHOD -3.402823466e+38 3.402823466e+38 SYMBOL_LINK "Rte_CalprmRom_CalRegn01Cmn_DEFAULT_RTE_CALPRM_GROUP.PwrLimrMotVelLpFilFrq_Val" 0 DISPLAY_IDENTIFIER PwrLimr.CalibrationPorts.PwrLimrMotVelLpFilFrq.Val /end CHARACTERISTIC
/begin CHARACTERISTIC PwrLimr.PwrLimrSpdAdjSlewDec.Val "MICROSAR RTE" VALUE 0x0 RTE_RL_FLOAT32_IEEE 0 NO_COMPU_METHOD -3.402823466e+38 3.402823466e+38 SYMBOL_LINK "Rte_CalprmRom_CalRegn01Cmn_DEFAULT_RTE_CALPRM_GROUP.PwrLimrSpdAdjSlewDec_Val" 0 DISPLAY_IDENTIFIER PwrLimr.CalibrationPorts.PwrLimrSpdAdjSlewDec.Val /end CHARACTERISTIC
/begin CHARACTERISTIC PwrLimr.PwrLimrSpdAdjSlewEna.Logl "MICROSAR RTE" VALUE 0x0 RTE_RL_BOOLEAN 0 RTE_CM_BOOLEAN 0 255 SYMBOL_LINK "Rte_CalprmRom_CalRegn01Cmn_DEFAULT_RTE_CALPRM_GROUP.PwrLimrSpdAdjSlewEna_Logl" 0 DISPLAY_IDENTIFIER PwrLimr.CalibrationPorts.PwrLimrSpdAdjSlewEna.Logl /end CHARACTERISTIC
/begin CHARACTERISTIC PwrLimr.PwrLimrSpdAdjSlewInc.Val "MICROSAR RTE" VALUE 0x0 RTE_RL_FLOAT32_IEEE 0 NO_COMPU_METHOD -3.402823466e+38 3.402823466e+38 SYMBOL_LINK "Rte_CalprmRom_CalRegn01Cmn_DEFAULT_RTE_CALPRM_GROUP.PwrLimrSpdAdjSlewInc_Val" 0 DISPLAY_IDENTIFIER PwrLimr.CalibrationPorts.PwrLimrSpdAdjSlewInc.Val /end CHARACTERISTIC
/begin CHARACTERISTIC PwrLimr.PwrLimrStdOperMotEnvlpX.Ary1D "MICROSAR RTE" VAL_BLK 0x0 RTE_RL_UWORD 0 NO_COMPU_METHOD 0 65535 MATRIX_DIM 6 1 1 SYMBOL_LINK "Rte_CalprmRom_CalRegn01Cmn_DEFAULT_RTE_CALPRM_GROUP.PwrLimrStdOperMotEnvlpX_Ary1D" 0 DISPLAY_IDENTIFIER PwrLimr.CalibrationPorts.PwrLimrStdOperMotEnvlpX.Ary1D /end CHARACTERISTIC
/begin CHARACTERISTIC PwrLimr.PwrLimrStdOperMotEnvlpY.Ary1D "MICROSAR RTE" VAL_BLK 0x0 RTE_RL_UWORD 0 NO_COMPU_METHOD 0 65535 MATRIX_DIM 6 1 1 SYMBOL_LINK "Rte_CalprmRom_CalRegn01Cmn_DEFAULT_RTE_CALPRM_GROUP.PwrLimrStdOperMotEnvlpY_Ary1D" 0 DISPLAY_IDENTIFIER PwrLimr.CalibrationPorts.PwrLimrStdOperMotEnvlpY.Ary1D /end CHARACTERISTIC
/begin CHARACTERISTIC PwrLimr.PwrLimrVltgDptMotVelOffsX.Ary1D "MICROSAR RTE" VAL_BLK 0x0 RTE_RL_UWORD 0 NO_COMPU_METHOD 0 65535 MATRIX_DIM 10 1 1 SYMBOL_LINK "Rte_CalprmRom_CalRegn01Cmn_DEFAULT_RTE_CALPRM_GROUP.PwrLimrVltgDptMotVelOffsX_Ary1D" 0 DISPLAY_IDENTIFIER PwrLimr.CalibrationPorts.PwrLimrVltgDptMotVelOffsX.Ary1D /end CHARACTERISTIC
/begin CHARACTERISTIC PwrLimr.PwrLimrVltgDptMotVelOffsY.Ary1D "MICROSAR RTE" VAL_BLK 0x0 RTE_RL_UWORD 0 NO_COMPU_METHOD 0 65535 MATRIX_DIM 10 1 1 SYMBOL_LINK "Rte_CalprmRom_CalRegn01Cmn_DEFAULT_RTE_CALPRM_GROUP.PwrLimrVltgDptMotVelOffsY_Ary1D" 0 DISPLAY_IDENTIFIER PwrLimr.CalibrationPorts.PwrLimrVltgDptMotVelOffsY.Ary1D /end CHARACTERISTIC
/begin MEASUREMENT MotRefMdl.dMotRefMdlReacncDaxOverR "MICROSAR RTE" FLOAT32_IEEE NO_COMPU_METHOD 0 0 -100.0 100.0 ECU_ADDRESS 0 SYMBOL_LINK "Rte_MotRefMdl_dMotRefMdlReacncDaxOverR" 0 DISPLAY_IDENTIFIER MotRefMdl.PerInstanceMemories.dMotRefMdlReacncDaxOverR /end MEASUREMENT
/begin MEASUREMENT MotRefMdl.dMotRefMdlReacncQaxOverR "MICROSAR RTE" FLOAT32_IEEE NO_COMPU_METHOD 0 0 -100.0 100.0 ECU_ADDRESS 0 SYMBOL_LINK "Rte_MotRefMdl_dMotRefMdlReacncQaxOverR" 0 DISPLAY_IDENTIFIER MotRefMdl.PerInstanceMemories.dMotRefMdlReacncQaxOverR /end MEASUREMENT
/begin MEASUREMENT MotRefMdl.dMotRefMdlRelncTqCoeff "MICROSAR RTE" FLOAT32_IEEE NO_COMPU_METHOD 0 0 0.0 0.0023 ECU_ADDRESS 0 SYMBOL_LINK "Rte_MotRefMdl_dMotRefMdlRelncTqCoeff" 0 DISPLAY_IDENTIFIER MotRefMdl.PerInstanceMemories.dMotRefMdlRelncTqCoeff /end MEASUREMENT
/begin MEASUREMENT MotRplCoggCfg.MotAgElecDlyRpl.Val "MICROSAR RTE" FLOAT32_IEEE NO_COMPU_METHOD 0 0 -3.402823466e+38 3.402823466e+38 ECU_ADDRESS 0 SYMBOL_LINK "Rte_MotRplCoggCfg_MotAgElecDlyRpl_Val" 0 DISPLAY_IDENTIFIER MotRplCoggCfg.SenderPorts.MotAgElecDlyRpl.Val /end MEASUREMENT
/begin MEASUREMENT MotRplCoggCfg.MotBackEmfConEstimd.Val "MICROSAR RTE" FLOAT32_IEEE NO_COMPU_METHOD 0 0 -3.402823466e+38 3.402823466e+38 ECU_ADDRESS 0 SYMBOL_LINK "Rte_MotCtrlPrmEstimn_MotBackEmfConEstimd_Val" 0 DISPLAY_IDENTIFIER MotRplCoggCfg.ReceiverPorts.MotBackEmfConEstimd.Val /end MEASUREMENT
/begin MEASUREMENT MotRplCoggCfg.MotCurrDaxCmd.Val "MICROSAR RTE" FLOAT32_IEEE NO_COMPU_METHOD 0 0 -3.402823466e+38 3.402823466e+38 ECU_ADDRESS 0 SYMBOL_LINK "Rte_MotRefMdl_MotCurrDaxCmd_Val" 0 DISPLAY_IDENTIFIER MotRplCoggCfg.ReceiverPorts.MotCurrDaxCmd.Val /end MEASUREMENT
/begin MEASUREMENT MotRplCoggCfg.MotCurrQaxCmd.Val "MICROSAR RTE" FLOAT32_IEEE NO_COMPU_METHOD 0 0 -3.402823466e+38 3.402823466e+38 ECU_ADDRESS 0 SYMBOL_LINK "Rte_MotRefMdl_MotCurrQaxCmd_Val" 0 DISPLAY_IDENTIFIER MotRplCoggCfg.ReceiverPorts.MotCurrQaxCmd.Val /end MEASUREMENT
/begin MEASUREMENT MotRplCoggCfg.MotCurrQaxToMotTqGain.Val "MICROSAR RTE" FLOAT32_IEEE NO_COMPU_METHOD 0 0 -3.402823466e+38 3.402823466e+38 ECU_ADDRESS 0 SYMBOL_LINK "Rte_MotRplCoggCfg_MotCurrQaxToMotTqGain_Val" 0 DISPLAY_IDENTIFIER MotRplCoggCfg.SenderPorts.MotCurrQaxToMotTqGain.Val /end MEASUREMENT
/begin MEASUREMENT MotRplCoggCfg.MotInduDaxEstimd.Val "MICROSAR RTE" FLOAT32_IEEE NO_COMPU_METHOD 0 0 -3.402823466e+38 3.402823466e+38 ECU_ADDRESS 0 SYMBOL_LINK "Rte_MotCtrlPrmEstimn_MotInduDaxEstimd_Val" 0 DISPLAY_IDENTIFIER MotRplCoggCfg.ReceiverPorts.MotInduDaxEstimd.Val /end MEASUREMENT
/begin MEASUREMENT MotRplCoggCfg.MotInduQaxEstimd.Val "MICROSAR RTE" FLOAT32_IEEE NO_COMPU_METHOD 0 0 -3.402823466e+38 3.402823466e+38 ECU_ADDRESS 0 SYMBOL_LINK "Rte_MotCtrlPrmEstimn_MotInduQaxEstimd_Val" 0 DISPLAY_IDENTIFIER MotRplCoggCfg.ReceiverPorts.MotInduQaxEstimd.Val /end MEASUREMENT
/begin MEASUREMENT MotRplCoggCfg.MotRplCoggPrm.CoggOrder1 "MICROSAR RTE" UWORD NO_COMPU_METHOD 0 0 0 65535 ECU_ADDRESS 0 SYMBOL_LINK "Rte_MotRplCoggCfg_MotRplCoggPrm.CoggOrder1" 0 DISPLAY_IDENTIFIER MotRplCoggCfg.PerInstanceMemories.MotRplCoggPrm.CoggOrder1 /end MEASUREMENT
/begin MEASUREMENT MotRplCoggCfg.MotRplCoggPrm.CoggOrder1X "MICROSAR RTE" SWORD NO_COMPU_METHOD 0 0 -32768 32767 ECU_ADDRESS 0 SYMBOL_LINK "Rte_MotRplCoggCfg_MotRplCoggPrm.CoggOrder1X" 0 DISPLAY_IDENTIFIER MotRplCoggCfg.PerInstanceMemories.MotRplCoggPrm.CoggOrder1X /end MEASUREMENT
/begin MEASUREMENT MotRplCoggCfg.MotRplCoggPrm.CoggOrder1Y "MICROSAR RTE" SWORD NO_COMPU_METHOD 0 0 -32768 32767 ECU_ADDRESS 0 SYMBOL_LINK "Rte_MotRplCoggCfg_MotRplCoggPrm.CoggOrder1Y" 0 DISPLAY_IDENTIFIER MotRplCoggCfg.PerInstanceMemories.MotRplCoggPrm.CoggOrder1Y /end MEASUREMENT
/begin MEASUREMENT MotRplCoggCfg.MotRplCoggPrm.CoggOrder2 "MICROSAR RTE" UWORD NO_COMPU_METHOD 0 0 0 65535 ECU_ADDRESS 0 SYMBOL_LINK "Rte_MotRplCoggCfg_MotRplCoggPrm.CoggOrder2" 0 DISPLAY_IDENTIFIER MotRplCoggCfg.PerInstanceMemories.MotRplCoggPrm.CoggOrder2 /end MEASUREMENT
/begin MEASUREMENT MotRplCoggCfg.MotRplCoggPrm.CoggOrder2X "MICROSAR RTE" SWORD NO_COMPU_METHOD 0 0 -32768 32767 ECU_ADDRESS 0 SYMBOL_LINK "Rte_MotRplCoggCfg_MotRplCoggPrm.CoggOrder2X" 0 DISPLAY_IDENTIFIER MotRplCoggCfg.PerInstanceMemories.MotRplCoggPrm.CoggOrder2X /end MEASUREMENT
/begin MEASUREMENT MotRplCoggCfg.MotRplCoggPrm.CoggOrder2Y "MICROSAR RTE" SWORD NO_COMPU_METHOD 0 0 -32768 32767 ECU_ADDRESS 0 SYMBOL_LINK "Rte_MotRplCoggCfg_MotRplCoggPrm.CoggOrder2Y" 0 DISPLAY_IDENTIFIER MotRplCoggCfg.PerInstanceMemories.MotRplCoggPrm.CoggOrder2Y /end MEASUREMENT
/begin MEASUREMENT MotRplCoggCfg.MotRplCoggPrm.CoggOrder3 "MICROSAR RTE" UWORD NO_COMPU_METHOD 0 0 0 65535 ECU_ADDRESS 0 SYMBOL_LINK "Rte_MotRplCoggCfg_MotRplCoggPrm.CoggOrder3" 0 DISPLAY_IDENTIFIER MotRplCoggCfg.PerInstanceMemories.MotRplCoggPrm.CoggOrder3 /end MEASUREMENT
/begin MEASUREMENT MotRplCoggCfg.MotRplCoggPrm.CoggOrder3X "MICROSAR RTE" SWORD NO_COMPU_METHOD 0 0 -32768 32767 ECU_ADDRESS 0 SYMBOL_LINK "Rte_MotRplCoggCfg_MotRplCoggPrm.CoggOrder3X" 0 DISPLAY_IDENTIFIER MotRplCoggCfg.PerInstanceMemories.MotRplCoggPrm.CoggOrder3X /end MEASUREMENT
/begin MEASUREMENT MotRplCoggCfg.MotRplCoggPrm.CoggOrder3Y "MICROSAR RTE" SWORD NO_COMPU_METHOD 0 0 -32768 32767 ECU_ADDRESS 0 SYMBOL_LINK "Rte_MotRplCoggCfg_MotRplCoggPrm.CoggOrder3Y" 0 DISPLAY_IDENTIFIER MotRplCoggCfg.PerInstanceMemories.MotRplCoggPrm.CoggOrder3Y /end MEASUREMENT
/begin MEASUREMENT MotRplCoggCfg.MotTqCmdMrfScad.Val "MICROSAR RTE" FLOAT32_IEEE NO_COMPU_METHOD 0 0 -3.402823466e+38 3.402823466e+38 ECU_ADDRESS 0 SYMBOL_LINK "Rte_MotTqCmdSca_MotTqCmdMrfScad_Val" 0 DISPLAY_IDENTIFIER MotRplCoggCfg.ReceiverPorts.MotTqCmdMrfScad.Val /end MEASUREMENT
/begin MEASUREMENT MotRplCoggCfg.MotTqRplCoggOrder1Mgn.Val "MICROSAR RTE" FLOAT32_IEEE NO_COMPU_METHOD 0 0 -3.402823466e+38 3.402823466e+38 ECU_ADDRESS 0 SYMBOL_LINK "Rte_MotRplCoggCfg_MotTqRplCoggOrder1Mgn_Val" 0 DISPLAY_IDENTIFIER MotRplCoggCfg.SenderPorts.MotTqRplCoggOrder1Mgn.Val /end MEASUREMENT
/begin MEASUREMENT MotRplCoggCfg.MotTqRplCoggOrder1Pha.Val "MICROSAR RTE" FLOAT32_IEEE NO_COMPU_METHOD 0 0 -3.402823466e+38 3.402823466e+38 ECU_ADDRESS 0 SYMBOL_LINK "Rte_MotRplCoggCfg_MotTqRplCoggOrder1Pha_Val" 0 DISPLAY_IDENTIFIER MotRplCoggCfg.SenderPorts.MotTqRplCoggOrder1Pha.Val /end MEASUREMENT
/begin MEASUREMENT MotRplCoggCfg.MotTqRplCoggOrder2Mgn.Val "MICROSAR RTE" FLOAT32_IEEE NO_COMPU_METHOD 0 0 -3.402823466e+38 3.402823466e+38 ECU_ADDRESS 0 SYMBOL_LINK "Rte_MotRplCoggCfg_MotTqRplCoggOrder2Mgn_Val" 0 DISPLAY_IDENTIFIER MotRplCoggCfg.SenderPorts.MotTqRplCoggOrder2Mgn.Val /end MEASUREMENT
/begin MEASUREMENT MotRplCoggCfg.MotTqRplCoggOrder2Pha.Val "MICROSAR RTE" FLOAT32_IEEE NO_COMPU_METHOD 0 0 -3.402823466e+38 3.402823466e+38 ECU_ADDRESS 0 SYMBOL_LINK "Rte_MotRplCoggCfg_MotTqRplCoggOrder2Pha_Val" 0 DISPLAY_IDENTIFIER MotRplCoggCfg.SenderPorts.MotTqRplCoggOrder2Pha.Val /end MEASUREMENT
/begin MEASUREMENT MotRplCoggCfg.MotTqRplCoggOrder3Mgn.Val "MICROSAR RTE" FLOAT32_IEEE NO_COMPU_METHOD 0 0 -3.402823466e+38 3.402823466e+38 ECU_ADDRESS 0 SYMBOL_LINK "Rte_MotRplCoggCfg_MotTqRplCoggOrder3Mgn_Val" 0 DISPLAY_IDENTIFIER MotRplCoggCfg.SenderPorts.MotTqRplCoggOrder3Mgn.Val /end MEASUREMENT
/begin MEASUREMENT MotRplCoggCfg.MotTqRplCoggOrder3Pha.Val "MICROSAR RTE" FLOAT32_IEEE NO_COMPU_METHOD 0 0 -3.402823466e+38 3.402823466e+38 ECU_ADDRESS 0 SYMBOL_LINK "Rte_MotRplCoggCfg_MotTqRplCoggOrder3Pha_Val" 0 DISPLAY_IDENTIFIER MotRplCoggCfg.SenderPorts.MotTqRplCoggOrder3Pha.Val /end MEASUREMENT
/begin MEASUREMENT MotRplCoggCfg.MotTqRplOrder1X "MICROSAR RTE" SWORD NO_COMPU_METHOD 0 0 -32768 32767 MATRIX_DIM 12 10 1 ECU_ADDRESS 0 SYMBOL_LINK "Rte_MotRplCoggCfg_MotTqRplOrder1X" 0 DISPLAY_IDENTIFIER MotRplCoggCfg.PerInstanceMemories.MotTqRplOrder1X /end MEASUREMENT
/begin MEASUREMENT MotRplCoggCfg.MotTqRplOrder1Y "MICROSAR RTE" SWORD NO_COMPU_METHOD 0 0 -32768 32767 MATRIX_DIM 12 10 1 ECU_ADDRESS 0 SYMBOL_LINK "Rte_MotRplCoggCfg_MotTqRplOrder1Y" 0 DISPLAY_IDENTIFIER MotRplCoggCfg.PerInstanceMemories.MotTqRplOrder1Y /end MEASUREMENT
/begin MEASUREMENT MotRplCoggCfg.MotTqRplOrder2X "MICROSAR RTE" SWORD NO_COMPU_METHOD 0 0 -32768 32767 MATRIX_DIM 12 10 1 ECU_ADDRESS 0 SYMBOL_LINK "Rte_MotRplCoggCfg_MotTqRplOrder2X" 0 DISPLAY_IDENTIFIER MotRplCoggCfg.PerInstanceMemories.MotTqRplOrder2X /end MEASUREMENT
/begin MEASUREMENT MotRplCoggCfg.MotTqRplOrder2Y "MICROSAR RTE" SWORD NO_COMPU_METHOD 0 0 -32768 32767 MATRIX_DIM 12 10 1 ECU_ADDRESS 0 SYMBOL_LINK "Rte_MotRplCoggCfg_MotTqRplOrder2Y" 0 DISPLAY_IDENTIFIER MotRplCoggCfg.PerInstanceMemories.MotTqRplOrder2Y /end MEASUREMENT
/begin MEASUREMENT MotRplCoggCfg.MotTqRplOrder3X "MICROSAR RTE" SWORD NO_COMPU_METHOD 0 0 -32768 32767 MATRIX_DIM 12 10 1 ECU_ADDRESS 0 SYMBOL_LINK "Rte_MotRplCoggCfg_MotTqRplOrder3X" 0 DISPLAY_IDENTIFIER MotRplCoggCfg.PerInstanceMemories.MotTqRplOrder3X /end MEASUREMENT
/begin MEASUREMENT MotRplCoggCfg.MotTqRplOrder3Y "MICROSAR RTE" SWORD NO_COMPU_METHOD 0 0 -32768 32767 MATRIX_DIM 12 10 1 ECU_ADDRESS 0 SYMBOL_LINK "Rte_MotRplCoggCfg_MotTqRplOrder3Y" 0 DISPLAY_IDENTIFIER MotRplCoggCfg.PerInstanceMemories.MotTqRplOrder3Y /end MEASUREMENT
/begin MEASUREMENT MotRplCoggCfg.MotVelMrf.Val "MICROSAR RTE" FLOAT32_IEEE NO_COMPU_METHOD 0 0 -3.402823466e+38 3.402823466e+38 ECU_ADDRESS 0 SYMBOL_LINK "Rte_CDD_MotVel_MotVelMrf_Val" 0 DISPLAY_IDENTIFIER MotRplCoggCfg.ReceiverPorts.MotVelMrf.Val /end MEASUREMENT
/begin MEASUREMENT MotRplCoggCfg.dMotRplCoggCfgMotAgElecDlyRpl "MICROSAR RTE" FLOAT32_IEEE NO_COMPU_METHOD 0 0 -3.402823466e+38 3.402823466e+38 ECU_ADDRESS 0 SYMBOL_LINK "Rte_MotRplCoggCfg_dMotRplCoggCfgMotAgElecDlyRpl" 0 DISPLAY_IDENTIFIER MotRplCoggCfg.PerInstanceMemories.dMotRplCoggCfgMotAgElecDlyRpl /end MEASUREMENT
/begin MEASUREMENT MotRplCoggCfg.dMotRplCoggCfgMotCurrQaxToMotTqGain "MICROSAR RTE" FLOAT32_IEEE NO_COMPU_METHOD 0 0 -3.402823466e+38 3.402823466e+38 ECU_ADDRESS 0 SYMBOL_LINK "Rte_MotRplCoggCfg_dMotRplCoggCfgMotCurrQaxToMotTqGain" 0 DISPLAY_IDENTIFIER MotRplCoggCfg.PerInstanceMemories.dMotRplCoggCfgMotCurrQaxToMotTqGain /end MEASUREMENT
/begin MEASUREMENT MotRplCoggCfg.dMotRplCoggCfgMotTqRplOrder1Mgn "MICROSAR RTE" FLOAT32_IEEE NO_COMPU_METHOD 0 0 -3.402823466e+38 3.402823466e+38 ECU_ADDRESS 0 SYMBOL_LINK "Rte_MotRplCoggCfg_dMotRplCoggCfgMotTqRplOrder1Mgn" 0 DISPLAY_IDENTIFIER MotRplCoggCfg.PerInstanceMemories.dMotRplCoggCfgMotTqRplOrder1Mgn /end MEASUREMENT
/begin MEASUREMENT MotRplCoggCfg.dMotRplCoggCfgMotTqRplOrder1Pha "MICROSAR RTE" FLOAT32_IEEE NO_COMPU_METHOD 0 0 -3.402823466e+38 3.402823466e+38 ECU_ADDRESS 0 SYMBOL_LINK "Rte_MotRplCoggCfg_dMotRplCoggCfgMotTqRplOrder1Pha" 0 DISPLAY_IDENTIFIER MotRplCoggCfg.PerInstanceMemories.dMotRplCoggCfgMotTqRplOrder1Pha /end MEASUREMENT
/begin MEASUREMENT MotRplCoggCfg.dMotRplCoggCfgMotTqRplOrder2Mgn "MICROSAR RTE" FLOAT32_IEEE NO_COMPU_METHOD 0 0 -3.402823466e+38 3.402823466e+38 ECU_ADDRESS 0 SYMBOL_LINK "Rte_MotRplCoggCfg_dMotRplCoggCfgMotTqRplOrder2Mgn" 0 DISPLAY_IDENTIFIER MotRplCoggCfg.PerInstanceMemories.dMotRplCoggCfgMotTqRplOrder2Mgn /end MEASUREMENT
/begin MEASUREMENT MotRplCoggCfg.dMotRplCoggCfgMotTqRplOrder2Pha "MICROSAR RTE" FLOAT32_IEEE NO_COMPU_METHOD 0 0 -3.402823466e+38 3.402823466e+38 ECU_ADDRESS 0 SYMBOL_LINK "Rte_MotRplCoggCfg_dMotRplCoggCfgMotTqRplOrder2Pha" 0 DISPLAY_IDENTIFIER MotRplCoggCfg.PerInstanceMemories.dMotRplCoggCfgMotTqRplOrder2Pha /end MEASUREMENT
/begin MEASUREMENT MotRplCoggCfg.dMotRplCoggCfgMotTqRplOrder3Mgn "MICROSAR RTE" FLOAT32_IEEE NO_COMPU_METHOD 0 0 -3.402823466e+38 3.402823466e+38 ECU_ADDRESS 0 SYMBOL_LINK "Rte_MotRplCoggCfg_dMotRplCoggCfgMotTqRplOrder3Mgn" 0 DISPLAY_IDENTIFIER MotRplCoggCfg.PerInstanceMemories.dMotRplCoggCfgMotTqRplOrder3Mgn /end MEASUREMENT
/begin MEASUREMENT MotRplCoggCfg.dMotRplCoggCfgMotTqRplOrder3Pha "MICROSAR RTE" FLOAT32_IEEE NO_COMPU_METHOD 0 0 -3.402823466e+38 3.402823466e+38 ECU_ADDRESS 0 SYMBOL_LINK "Rte_MotRplCoggCfg_dMotRplCoggCfgMotTqRplOrder3Pha" 0 DISPLAY_IDENTIFIER MotRplCoggCfg.PerInstanceMemories.dMotRplCoggCfgMotTqRplOrder3Pha /end MEASUREMENT
/begin MEASUREMENT MotTqCmdSca.MotTqCmdMrf.Val "MICROSAR RTE" FLOAT32_IEEE NO_COMPU_METHOD 0 0 -3.402823466e+38 3.402823466e+38 ECU_ADDRESS 0 SYMBOL_LINK "Rte_PwrLimr_MotTqCmdPwrLimd_Val" 0 DISPLAY_IDENTIFIER MotTqCmdSca.ReceiverPorts.MotTqCmdMrf.Val /end MEASUREMENT
/begin MEASUREMENT MotTqCmdSca.MotTqCmdMrfScad.Val "MICROSAR RTE" FLOAT32_IEEE NO_COMPU_METHOD 0 0 -3.402823466e+38 3.402823466e+38 ECU_ADDRESS 0 SYMBOL_LINK "Rte_MotTqCmdSca_MotTqCmdMrfScad_Val" 0 DISPLAY_IDENTIFIER MotTqCmdSca.SenderPorts.MotTqCmdMrfScad.Val /end MEASUREMENT
/begin MEASUREMENT MotTqCmdSca.MotTqScaFac "MICROSAR RTE" FLOAT32_IEEE NO_COMPU_METHOD 0 0 -3.402823466e+38 3.402823466e+38 ECU_ADDRESS 0 SYMBOL_LINK "Rte_MotTqCmdSca_MotTqScaFac" 0 DISPLAY_IDENTIFIER MotTqCmdSca.PerInstanceMemories.MotTqScaFac /end MEASUREMENT
/begin MEASUREMENT MotTqTranlDampg.AssiMechPolarity.Val "MICROSAR RTE" SBYTE NO_COMPU_METHOD 0 0 -128 127 ECU_ADDRESS 0 SYMBOL_LINK "Rte_PolarityCfg_AssiMechPolarity_Val" 0 DISPLAY_IDENTIFIER MotTqTranlDampg.ReceiverPorts.AssiMechPolarity.Val /end MEASUREMENT
/begin MEASUREMENT MotTqTranlDampg.DiagStsPrev "MICROSAR RTE" UBYTE RTE_CM_BOOLEAN 0 0 0 255 ECU_ADDRESS 0 SYMBOL_LINK "Rte_MotTqTranlDampg_DiagStsPrev" 0 DISPLAY_IDENTIFIER MotTqTranlDampg.PerInstanceMemories.DiagStsPrev /end MEASUREMENT
/begin MEASUREMENT MotTqTranlDampg.DiagcStsCtrldShtDwnFltPrsnt.Logl "MICROSAR RTE" UBYTE RTE_CM_BOOLEAN 0 0 0 255 ECU_ADDRESS 0 SYMBOL_LINK "Rte_DiagcMgr_DiagcStsCtrldShtDwnFltPrsnt_Logl" 0 DISPLAY_IDENTIFIER MotTqTranlDampg.ReceiverPorts.DiagcStsCtrldShtDwnFltPrsnt.Logl /end MEASUREMENT
/begin MEASUREMENT MotTqTranlDampg.HwAg.Val "MICROSAR RTE" FLOAT32_IEEE NO_COMPU_METHOD 0 0 -3.402823466e+38 3.402823466e+38 ECU_ADDRESS 0 SYMBOL_LINK "Rte_ImcSigArbn_HwAgImcCorrd_Val" 0 DISPLAY_IDENTIFIER MotTqTranlDampg.ReceiverPorts.HwAg.Val /end MEASUREMENT
/begin MEASUREMENT MotTqTranlDampg.LoaSt.Val "MICROSAR RTE" UBYTE RTE_CM_ENUM_LoaSt1 0 0 0 255 ECU_ADDRESS 0 SYMBOL_LINK "Rte_LoaMgr_LoaSt_Val" 0 DISPLAY_IDENTIFIER MotTqTranlDampg.ReceiverPorts.LoaSt.Val /end MEASUREMENT
/begin MEASUREMENT MotTqTranlDampg.LoaStPrev "MICROSAR RTE" UBYTE RTE_CM_ENUM_LoaSt1 0 0 0 255 ECU_ADDRESS 0 SYMBOL_LINK "Rte_MotTqTranlDampg_LoaStPrev" 0 DISPLAY_IDENTIFIER MotTqTranlDampg.PerInstanceMemories.LoaStPrev /end MEASUREMENT
/begin MEASUREMENT MotTqTranlDampg.MotTqCmdCrf.Val "MICROSAR RTE" FLOAT32_IEEE NO_COMPU_METHOD 0 0 -3.402823466e+38 3.402823466e+38 ECU_ADDRESS 0 SYMBOL_LINK "Rte_Swp_MotTqCmdSwp_Val" 0 DISPLAY_IDENTIFIER MotTqTranlDampg.ReceiverPorts.MotTqCmdCrf.Val /end MEASUREMENT
/begin MEASUREMENT MotTqTranlDampg.MotTqCmdCrfDampd.Val "MICROSAR RTE" FLOAT32_IEEE NO_COMPU_METHOD 0 0 -3.402823466e+38 3.402823466e+38 ECU_ADDRESS 0 SYMBOL_LINK "Rte_MotTqTranlDampg_MotTqCmdCrfDampd_Val" 0 DISPLAY_IDENTIFIER MotTqTranlDampg.SenderPorts.MotTqCmdCrfDampd.Val /end MEASUREMENT
/begin MEASUREMENT MotTqTranlDampg.MotTqCmdMrfDampd.Val "MICROSAR RTE" FLOAT32_IEEE NO_COMPU_METHOD 0 0 -3.402823466e+38 3.402823466e+38 ECU_ADDRESS 0 SYMBOL_LINK "Rte_MotTqTranlDampg_MotTqCmdMrfDampd_Val" 0 DISPLAY_IDENTIFIER MotTqTranlDampg.SenderPorts.MotTqCmdMrfDampd.Val /end MEASUREMENT
/begin MEASUREMENT MotTqTranlDampg.MotTqTranlDampgCmpl.Logl "MICROSAR RTE" UBYTE RTE_CM_BOOLEAN 0 0 0 255 ECU_ADDRESS 0 SYMBOL_LINK "Rte_MotTqTranlDampg_MotTqTranlDampgCmpl_Logl" 0 DISPLAY_IDENTIFIER MotTqTranlDampg.SenderPorts.MotTqTranlDampgCmpl.Logl /end MEASUREMENT
/begin MEASUREMENT MotTqTranlDampg.MotVelCrf.Val "MICROSAR RTE" FLOAT32_IEEE NO_COMPU_METHOD 0 0 -3.402823466e+38 3.402823466e+38 ECU_ADDRESS 0 SYMBOL_LINK "Rte_ImcSigArbn_MotVelCrfImcCorrd_Val" 0 DISPLAY_IDENTIFIER MotTqTranlDampg.ReceiverPorts.MotVelCrf.Val /end MEASUREMENT
/begin MEASUREMENT MotTqTranlDampg.StLtchPrev "MICROSAR RTE" UBYTE RTE_CM_BOOLEAN 0 0 0 255 ECU_ADDRESS 0 SYMBOL_LINK "Rte_MotTqTranlDampg_StLtchPrev" 0 DISPLAY_IDENTIFIER MotTqTranlDampg.PerInstanceMemories.StLtchPrev /end MEASUREMENT
/begin MEASUREMENT MotTqTranlDampg.SysSt.Val "MICROSAR RTE" UBYTE RTE_CM_ENUM_SysSt1 0 0 0 255 ECU_ADDRESS 0 SYMBOL_LINK "Rte_SysStMod_SysSt_Val" 0 DISPLAY_IDENTIFIER MotTqTranlDampg.ReceiverPorts.SysSt.Val /end MEASUREMENT
/begin MEASUREMENT MotTqTranlDampg.TmrRefTi "MICROSAR RTE" ULONG NO_COMPU_METHOD 0 0 0 4294967295 ECU_ADDRESS 0 SYMBOL_LINK "Rte_MotTqTranlDampg_TmrRefTi" 0 DISPLAY_IDENTIFIER MotTqTranlDampg.PerInstanceMemories.TmrRefTi /end MEASUREMENT
/begin MEASUREMENT MotTqTranlDampg.VehSpd.Val "MICROSAR RTE" FLOAT32_IEEE NO_COMPU_METHOD 0 0 -3.402823466e+38 3.402823466e+38 ECU_ADDRESS 0 SYMBOL_LINK "Rte_ImcSigArbn_VehSpdImcCorrd_Val" 0 DISPLAY_IDENTIFIER MotTqTranlDampg.ReceiverPorts.VehSpd.Val /end MEASUREMENT
/begin MEASUREMENT MotTqTranlDampg.dMotTqTranlDampgCmdCtrld "MICROSAR RTE" FLOAT32_IEEE NO_COMPU_METHOD 0 0 -3.402823466e+38 3.402823466e+38 ECU_ADDRESS 0 SYMBOL_LINK "Rte_MotTqTranlDampg_dMotTqTranlDampgCmdCtrld" 0 DISPLAY_IDENTIFIER MotTqTranlDampg.PerInstanceMemories.dMotTqTranlDampgCmdCtrld /end MEASUREMENT
/begin MEASUREMENT MotTqTranlDampg.dMotTqTranlDampgSignPhaSca "MICROSAR RTE" FLOAT32_IEEE NO_COMPU_METHOD 0 0 -3.402823466e+38 3.402823466e+38 ECU_ADDRESS 0 SYMBOL_LINK "Rte_MotTqTranlDampg_dMotTqTranlDampgSignPhaSca" 0 DISPLAY_IDENTIFIER MotTqTranlDampg.PerInstanceMemories.dMotTqTranlDampgSignPhaSca /end MEASUREMENT
/begin MEASUREMENT MotTqTranlDampg.dMotTqTranlDampgTiElpd "MICROSAR RTE" FLOAT32_IEEE NO_COMPU_METHOD 0 0 -3.402823466e+38 3.402823466e+38 ECU_ADDRESS 0 SYMBOL_LINK "Rte_MotTqTranlDampg_dMotTqTranlDampgTiElpd" 0 DISPLAY_IDENTIFIER MotTqTranlDampg.PerInstanceMemories.dMotTqTranlDampgTiElpd /end MEASUREMENT
/begin MEASUREMENT MotTqTranlDampg.dMotTqTranlDampgTmrEna "MICROSAR RTE" UBYTE RTE_CM_BOOLEAN 0 0 0 255 ECU_ADDRESS 0 SYMBOL_LINK "Rte_MotTqTranlDampg_dMotTqTranlDampgTmrEna" 0 DISPLAY_IDENTIFIER MotTqTranlDampg.PerInstanceMemories.dMotTqTranlDampgTmrEna /end MEASUREMENT
/begin MEASUREMENT MotTqTranlDampg.dMotTqTranlDampgVelDampgCmd "MICROSAR RTE" FLOAT32_IEEE NO_COMPU_METHOD 0 0 -3.402823466e+38 3.402823466e+38 ECU_ADDRESS 0 SYMBOL_LINK "Rte_MotTqTranlDampg_dMotTqTranlDampgVelDampgCmd" 0 DISPLAY_IDENTIFIER MotTqTranlDampg.PerInstanceMemories.dMotTqTranlDampgVelDampgCmd /end MEASUREMENT
/begin MEASUREMENT MotVelCtrl.EnaCtrl "MICROSAR RTE" UBYTE RTE_CM_BOOLEAN 0 0 0 255 ECU_ADDRESS 0 SYMBOL_LINK "Rte_MotVelCtrl_EnaCtrl" 0 DISPLAY_IDENTIFIER MotVelCtrl.PerInstanceMemories.EnaCtrl /end MEASUREMENT
/begin MEASUREMENT MotVelCtrl.EnaCtrlStVari "MICROSAR RTE" UBYTE RTE_CM_BOOLEAN 0 0 0 255 ECU_ADDRESS 0 SYMBOL_LINK "Rte_MotVelCtrl_EnaCtrlStVari" 0 DISPLAY_IDENTIFIER MotVelCtrl.PerInstanceMemories.EnaCtrlStVari /end MEASUREMENT
/begin MEASUREMENT MotVelCtrl.FctActvSts "MICROSAR RTE" UBYTE RTE_CM_BOOLEAN 0 0 0 255 ECU_ADDRESS 0 SYMBOL_LINK "Rte_MotVelCtrl_FctActvSts" 0 DISPLAY_IDENTIFIER MotVelCtrl.PerInstanceMemories.FctActvSts /end MEASUREMENT
/begin MEASUREMENT MotVelCtrl.MotVelCrf.Val "MICROSAR RTE" FLOAT32_IEEE NO_COMPU_METHOD 0 0 -3.402823466e+38 3.402823466e+38 ECU_ADDRESS 0 SYMBOL_LINK "Rte_ImcSigArbn_MotVelCrfImcCorrd_Val" 0 DISPLAY_IDENTIFIER MotVelCtrl.ReceiverPorts.MotVelCrf.Val /end MEASUREMENT
/begin MEASUREMENT MotVelCtrl.MotVelTar "MICROSAR RTE" FLOAT32_IEEE NO_COMPU_METHOD 0 0 -3.402823466e+38 3.402823466e+38 ECU_ADDRESS 0 SYMBOL_LINK "Rte_MotVelCtrl_MotVelTar" 0 DISPLAY_IDENTIFIER MotVelCtrl.PerInstanceMemories.MotVelTar /end MEASUREMENT
/begin MEASUREMENT MotVelCtrl.PrevAntiWdupCmd "MICROSAR RTE" FLOAT32_IEEE NO_COMPU_METHOD 0 0 -3.402823466e+38 3.402823466e+38 ECU_ADDRESS 0 SYMBOL_LINK "Rte_MotVelCtrl_PrevAntiWdupCmd" 0 DISPLAY_IDENTIFIER MotVelCtrl.PerInstanceMemories.PrevAntiWdupCmd /end MEASUREMENT
/begin MEASUREMENT MotVelCtrl.PrevDerivtvOutp "MICROSAR RTE" FLOAT32_IEEE NO_COMPU_METHOD 0 0 -3.402823466e+38 3.402823466e+38 ECU_ADDRESS 0 SYMBOL_LINK "Rte_MotVelCtrl_PrevDerivtvOutp" 0 DISPLAY_IDENTIFIER MotVelCtrl.PerInstanceMemories.PrevDerivtvOutp /end MEASUREMENT
/begin MEASUREMENT MotVelCtrl.PrevIntgtrInp "MICROSAR RTE" FLOAT32_IEEE NO_COMPU_METHOD 0 0 -3.402823466e+38 3.402823466e+38 ECU_ADDRESS 0 SYMBOL_LINK "Rte_MotVelCtrl_PrevIntgtrInp" 0 DISPLAY_IDENTIFIER MotVelCtrl.PerInstanceMemories.PrevIntgtrInp /end MEASUREMENT
/begin MEASUREMENT MotVelCtrl.PrevIntgtrOutp "MICROSAR RTE" FLOAT32_IEEE NO_COMPU_METHOD 0 0 -3.402823466e+38 3.402823466e+38 ECU_ADDRESS 0 SYMBOL_LINK "Rte_MotVelCtrl_PrevIntgtrOutp" 0 DISPLAY_IDENTIFIER MotVelCtrl.PerInstanceMemories.PrevIntgtrOutp /end MEASUREMENT
/begin MEASUREMENT MotVelCtrl.PrevMotVelErr "MICROSAR RTE" FLOAT32_IEEE NO_COMPU_METHOD 0 0 -3.402823466e+38 3.402823466e+38 ECU_ADDRESS 0 SYMBOL_LINK "Rte_MotVelCtrl_PrevMotVelErr" 0 DISPLAY_IDENTIFIER MotVelCtrl.PerInstanceMemories.PrevMotVelErr /end MEASUREMENT
/begin MEASUREMENT MotVelCtrl.PrevMotVelTar "MICROSAR RTE" FLOAT32_IEEE NO_COMPU_METHOD 0 0 -3.402823466e+38 3.402823466e+38 ECU_ADDRESS 0 SYMBOL_LINK "Rte_MotVelCtrl_PrevMotVelTar" 0 DISPLAY_IDENTIFIER MotVelCtrl.PerInstanceMemories.PrevMotVelTar /end MEASUREMENT
/begin MEASUREMENT MotVelCtrl.RampDwnCmpl "MICROSAR RTE" UBYTE RTE_CM_BOOLEAN 0 0 0 255 ECU_ADDRESS 0 SYMBOL_LINK "Rte_MotVelCtrl_RampDwnCmpl" 0 DISPLAY_IDENTIFIER MotVelCtrl.PerInstanceMemories.RampDwnCmpl /end MEASUREMENT
/begin MEASUREMENT MotVelCtrl.RefTiRampDwn "MICROSAR RTE" ULONG NO_COMPU_METHOD 0 0 0 4294967295 ECU_ADDRESS 0 SYMBOL_LINK "Rte_MotVelCtrl_RefTiRampDwn" 0 DISPLAY_IDENTIFIER MotVelCtrl.PerInstanceMemories.RefTiRampDwn /end MEASUREMENT
/begin MEASUREMENT MotVelCtrl.VelSlewRate "MICROSAR RTE" FLOAT32_IEEE NO_COMPU_METHOD 0 0 -3.402823466e+38 3.402823466e+38 ECU_ADDRESS 0 SYMBOL_LINK "Rte_MotVelCtrl_VelSlewRate" 0 DISPLAY_IDENTIFIER MotVelCtrl.PerInstanceMemories.VelSlewRate /end MEASUREMENT
/begin MEASUREMENT PolarityCfg.AssiMechPolarity.Val "MICROSAR RTE" SBYTE NO_COMPU_METHOD 0 0 -128 127 ECU_ADDRESS 0 SYMBOL_LINK "Rte_PolarityCfg_AssiMechPolarity_Val" 0 DISPLAY_IDENTIFIER PolarityCfg.SenderPorts.AssiMechPolarity.Val /end MEASUREMENT
/begin MEASUREMENT PolarityCfg.HwAg0Polarity.Val "MICROSAR RTE" SBYTE NO_COMPU_METHOD 0 0 -128 127 ECU_ADDRESS 0 SYMBOL_LINK "Rte_PolarityCfg_HwAg0Polarity_Val" 0 DISPLAY_IDENTIFIER PolarityCfg.SenderPorts.HwAg0Polarity.Val /end MEASUREMENT
/begin MEASUREMENT PolarityCfg.HwAg1Polarity.Val "MICROSAR RTE" SBYTE NO_COMPU_METHOD 0 0 -128 127 ECU_ADDRESS 0 SYMBOL_LINK "Rte_PolarityCfg_HwAg1Polarity_Val" 0 DISPLAY_IDENTIFIER PolarityCfg.SenderPorts.HwAg1Polarity.Val /end MEASUREMENT
/begin MEASUREMENT PolarityCfg.HwAg2Polarity.Val "MICROSAR RTE" SBYTE NO_COMPU_METHOD 0 0 -128 127 ECU_ADDRESS 0 SYMBOL_LINK "Rte_PolarityCfg_HwAg2Polarity_Val" 0 DISPLAY_IDENTIFIER PolarityCfg.SenderPorts.HwAg2Polarity.Val /end MEASUREMENT
/begin MEASUREMENT PolarityCfg.HwAg3Polarity.Val "MICROSAR RTE" SBYTE NO_COMPU_METHOD 0 0 -128 127 ECU_ADDRESS 0 SYMBOL_LINK "Rte_PolarityCfg_HwAg3Polarity_Val" 0 DISPLAY_IDENTIFIER PolarityCfg.SenderPorts.HwAg3Polarity.Val /end MEASUREMENT
/begin MEASUREMENT PolarityCfg.HwAg4Polarity.Val "MICROSAR RTE" SBYTE NO_COMPU_METHOD 0 0 -128 127 ECU_ADDRESS 0 SYMBOL_LINK "Rte_PolarityCfg_HwAg4Polarity_Val" 0 DISPLAY_IDENTIFIER PolarityCfg.SenderPorts.HwAg4Polarity.Val /end MEASUREMENT
/begin MEASUREMENT PolarityCfg.HwAg5Polarity.Val "MICROSAR RTE" SBYTE NO_COMPU_METHOD 0 0 -128 127 ECU_ADDRESS 0 SYMBOL_LINK "Rte_PolarityCfg_HwAg5Polarity_Val" 0 DISPLAY_IDENTIFIER PolarityCfg.SenderPorts.HwAg5Polarity.Val /end MEASUREMENT
/begin MEASUREMENT PolarityCfg.HwAg6Polarity.Val "MICROSAR RTE" SBYTE NO_COMPU_METHOD 0 0 -128 127 ECU_ADDRESS 0 SYMBOL_LINK "Rte_PolarityCfg_HwAg6Polarity_Val" 0 DISPLAY_IDENTIFIER PolarityCfg.SenderPorts.HwAg6Polarity.Val /end MEASUREMENT
/begin MEASUREMENT PolarityCfg.HwAg7Polarity.Val "MICROSAR RTE" SBYTE NO_COMPU_METHOD 0 0 -128 127 ECU_ADDRESS 0 SYMBOL_LINK "Rte_PolarityCfg_HwAg7Polarity_Val" 0 DISPLAY_IDENTIFIER PolarityCfg.SenderPorts.HwAg7Polarity.Val /end MEASUREMENT
/begin MEASUREMENT PolarityCfg.HwTq0Polarity.Val "MICROSAR RTE" SBYTE NO_COMPU_METHOD 0 0 -128 127 ECU_ADDRESS 0 SYMBOL_LINK "Rte_PolarityCfg_HwTq0Polarity_Val" 0 DISPLAY_IDENTIFIER PolarityCfg.SenderPorts.HwTq0Polarity.Val /end MEASUREMENT
/begin MEASUREMENT PolarityCfg.HwTq1Polarity.Val "MICROSAR RTE" SBYTE NO_COMPU_METHOD 0 0 -128 127 ECU_ADDRESS 0 SYMBOL_LINK "Rte_PolarityCfg_HwTq1Polarity_Val" 0 DISPLAY_IDENTIFIER PolarityCfg.SenderPorts.HwTq1Polarity.Val /end MEASUREMENT
/begin MEASUREMENT PolarityCfg.HwTq2Polarity.Val "MICROSAR RTE" SBYTE NO_COMPU_METHOD 0 0 -128 127 ECU_ADDRESS 0 SYMBOL_LINK "Rte_PolarityCfg_HwTq2Polarity_Val" 0 DISPLAY_IDENTIFIER PolarityCfg.SenderPorts.HwTq2Polarity.Val /end MEASUREMENT
/begin MEASUREMENT PolarityCfg.HwTq3Polarity.Val "MICROSAR RTE" SBYTE NO_COMPU_METHOD 0 0 -128 127 ECU_ADDRESS 0 SYMBOL_LINK "Rte_PolarityCfg_HwTq3Polarity_Val" 0 DISPLAY_IDENTIFIER PolarityCfg.SenderPorts.HwTq3Polarity.Val /end MEASUREMENT
/begin MEASUREMENT PolarityCfg.HwTq4Polarity.Val "MICROSAR RTE" SBYTE NO_COMPU_METHOD 0 0 -128 127 ECU_ADDRESS 0 SYMBOL_LINK "Rte_PolarityCfg_HwTq4Polarity_Val" 0 DISPLAY_IDENTIFIER PolarityCfg.SenderPorts.HwTq4Polarity.Val /end MEASUREMENT
/begin MEASUREMENT PolarityCfg.HwTq5Polarity.Val "MICROSAR RTE" SBYTE NO_COMPU_METHOD 0 0 -128 127 ECU_ADDRESS 0 SYMBOL_LINK "Rte_PolarityCfg_HwTq5Polarity_Val" 0 DISPLAY_IDENTIFIER PolarityCfg.SenderPorts.HwTq5Polarity.Val /end MEASUREMENT
/begin MEASUREMENT PolarityCfg.HwTq6Polarity.Val "MICROSAR RTE" SBYTE NO_COMPU_METHOD 0 0 -128 127 ECU_ADDRESS 0 SYMBOL_LINK "Rte_PolarityCfg_HwTq6Polarity_Val" 0 DISPLAY_IDENTIFIER PolarityCfg.SenderPorts.HwTq6Polarity.Val /end MEASUREMENT
/begin MEASUREMENT PolarityCfg.HwTq7Polarity.Val "MICROSAR RTE" SBYTE NO_COMPU_METHOD 0 0 -128 127 ECU_ADDRESS 0 SYMBOL_LINK "Rte_PolarityCfg_HwTq7Polarity_Val" 0 DISPLAY_IDENTIFIER PolarityCfg.SenderPorts.HwTq7Polarity.Val /end MEASUREMENT
/begin MEASUREMENT PolarityCfg.MotAgMecl0Polarity.Val "MICROSAR RTE" SBYTE NO_COMPU_METHOD 0 0 -128 127 ECU_ADDRESS 0 SYMBOL_LINK "Rte_PolarityCfg_MotAgMecl0Polarity_Val" 0 DISPLAY_IDENTIFIER PolarityCfg.SenderPorts.MotAgMecl0Polarity.Val /end MEASUREMENT
/begin MEASUREMENT PolarityCfg.MotAgMecl1Polarity.Val "MICROSAR RTE" SBYTE NO_COMPU_METHOD 0 0 -128 127 ECU_ADDRESS 0 SYMBOL_LINK "Rte_PolarityCfg_MotAgMecl1Polarity_Val" 0 DISPLAY_IDENTIFIER PolarityCfg.SenderPorts.MotAgMecl1Polarity.Val /end MEASUREMENT
/begin MEASUREMENT PolarityCfg.MotAgMecl2Polarity.Val "MICROSAR RTE" SBYTE NO_COMPU_METHOD 0 0 -128 127 ECU_ADDRESS 0 SYMBOL_LINK "Rte_PolarityCfg_MotAgMecl2Polarity_Val" 0 DISPLAY_IDENTIFIER PolarityCfg.SenderPorts.MotAgMecl2Polarity.Val /end MEASUREMENT
/begin MEASUREMENT PolarityCfg.MotAgMecl3Polarity.Val "MICROSAR RTE" SBYTE NO_COMPU_METHOD 0 0 -128 127 ECU_ADDRESS 0 SYMBOL_LINK "Rte_PolarityCfg_MotAgMecl3Polarity_Val" 0 DISPLAY_IDENTIFIER PolarityCfg.SenderPorts.MotAgMecl3Polarity.Val /end MEASUREMENT
/begin MEASUREMENT PolarityCfg.MotAgMecl4Polarity.Val "MICROSAR RTE" SBYTE NO_COMPU_METHOD 0 0 -128 127 ECU_ADDRESS 0 SYMBOL_LINK "Rte_PolarityCfg_MotAgMecl4Polarity_Val" 0 DISPLAY_IDENTIFIER PolarityCfg.SenderPorts.MotAgMecl4Polarity.Val /end MEASUREMENT
/begin MEASUREMENT PolarityCfg.MotAgMecl5Polarity.Val "MICROSAR RTE" SBYTE NO_COMPU_METHOD 0 0 -128 127 ECU_ADDRESS 0 SYMBOL_LINK "Rte_PolarityCfg_MotAgMecl5Polarity_Val" 0 DISPLAY_IDENTIFIER PolarityCfg.SenderPorts.MotAgMecl5Polarity.Val /end MEASUREMENT
/begin MEASUREMENT PolarityCfg.MotAgMecl6Polarity.Val "MICROSAR RTE" SBYTE NO_COMPU_METHOD 0 0 -128 127 ECU_ADDRESS 0 SYMBOL_LINK "Rte_PolarityCfg_MotAgMecl6Polarity_Val" 0 DISPLAY_IDENTIFIER PolarityCfg.SenderPorts.MotAgMecl6Polarity.Val /end MEASUREMENT
/begin MEASUREMENT PolarityCfg.MotAgMecl7Polarity.Val "MICROSAR RTE" SBYTE NO_COMPU_METHOD 0 0 -128 127 ECU_ADDRESS 0 SYMBOL_LINK "Rte_PolarityCfg_MotAgMecl7Polarity_Val" 0 DISPLAY_IDENTIFIER PolarityCfg.SenderPorts.MotAgMecl7Polarity.Val /end MEASUREMENT
/begin MEASUREMENT PolarityCfg.MotElecMeclPolarity.Val "MICROSAR RTE" SBYTE NO_COMPU_METHOD 0 0 -128 127 ECU_ADDRESS 0 SYMBOL_LINK "Rte_PolarityCfg_MotElecMeclPolarity_Val" 0 DISPLAY_IDENTIFIER PolarityCfg.SenderPorts.MotElecMeclPolarity.Val /end MEASUREMENT
/begin MEASUREMENT PolarityCfg.PolarityCfgSaved "MICROSAR RTE" ULONG NO_COMPU_METHOD 0 0 0 4294967295 ECU_ADDRESS 0 SYMBOL_LINK "Rte_PolarityCfg_PolarityCfgSaved" 0 DISPLAY_IDENTIFIER PolarityCfg.PerInstanceMemories.PolarityCfgSaved /end MEASUREMENT
/begin MEASUREMENT PosnTrakgServo.AntiWdupCmdPrev "MICROSAR RTE" FLOAT32_IEEE NO_COMPU_METHOD 0 0 -3.402823466e+38 3.402823466e+38 ECU_ADDRESS 0 SYMBOL_LINK "Rte_PosnTrakgServo_AntiWdupCmdPrev" 0 DISPLAY_IDENTIFIER PosnTrakgServo.PerInstanceMemories.AntiWdupCmdPrev /end MEASUREMENT
/begin MEASUREMENT PosnTrakgServo.HwAg.Val "MICROSAR RTE" FLOAT32_IEEE NO_COMPU_METHOD 0 0 -3.402823466e+38 3.402823466e+38 ECU_ADDRESS 0 SYMBOL_LINK "Rte_ImcSigArbn_HwAgImcCorrd_Val" 0 DISPLAY_IDENTIFIER PosnTrakgServo.ReceiverPorts.HwAg.Val /end MEASUREMENT
/begin MEASUREMENT PosnTrakgServo.HwTq.Val "MICROSAR RTE" FLOAT32_IEEE NO_COMPU_METHOD 0 0 -3.402823466e+38 3.402823466e+38 ECU_ADDRESS 0 SYMBOL_LINK "Rte_ImcSigArbn_HwTqImcCorrd_Val" 0 DISPLAY_IDENTIFIER PosnTrakgServo.ReceiverPorts.HwTq.Val /end MEASUREMENT
/begin MEASUREMENT PosnTrakgServo.HwTqDerivtvPrev "MICROSAR RTE" FLOAT32_IEEE NO_COMPU_METHOD 0 0 -3.402823466e+38 3.402823466e+38 ECU_ADDRESS 0 SYMBOL_LINK "Rte_PosnTrakgServo_HwTqDerivtvPrev" 0 DISPLAY_IDENTIFIER PosnTrakgServo.PerInstanceMemories.HwTqDerivtvPrev /end MEASUREMENT
/begin MEASUREMENT PosnTrakgServo.HwTqPrev "MICROSAR RTE" FLOAT32_IEEE NO_COMPU_METHOD 0 0 -3.402823466e+38 3.402823466e+38 ECU_ADDRESS 0 SYMBOL_LINK "Rte_PosnTrakgServo_HwTqPrev" 0 DISPLAY_IDENTIFIER PosnTrakgServo.PerInstanceMemories.HwTqPrev /end MEASUREMENT
/begin MEASUREMENT PosnTrakgServo.IntgtrInpPrev "MICROSAR RTE" FLOAT32_IEEE NO_COMPU_METHOD 0 0 -3.402823466e+38 3.402823466e+38 ECU_ADDRESS 0 SYMBOL_LINK "Rte_PosnTrakgServo_IntgtrInpPrev" 0 DISPLAY_IDENTIFIER PosnTrakgServo.PerInstanceMemories.IntgtrInpPrev /end MEASUREMENT
/begin MEASUREMENT PosnTrakgServo.IntgtrOutpPrev "MICROSAR RTE" FLOAT32_IEEE NO_COMPU_METHOD 0 0 -3.402823466e+38 3.402823466e+38 ECU_ADDRESS 0 SYMBOL_LINK "Rte_PosnTrakgServo_IntgtrOutpPrev" 0 DISPLAY_IDENTIFIER PosnTrakgServo.PerInstanceMemories.IntgtrOutpPrev /end MEASUREMENT
/begin MEASUREMENT PosnTrakgServo.MotVelCrf.Val "MICROSAR RTE" FLOAT32_IEEE NO_COMPU_METHOD 0 0 -3.402823466e+38 3.402823466e+38 ECU_ADDRESS 0 SYMBOL_LINK "Rte_ImcSigArbn_MotVelCrfImcCorrd_Val" 0 DISPLAY_IDENTIFIER PosnTrakgServo.ReceiverPorts.MotVelCrf.Val /end MEASUREMENT
/begin MEASUREMENT PosnTrakgServo.OutpAntiWdupCmdPrev "MICROSAR RTE" FLOAT32_IEEE NO_COMPU_METHOD 0 0 -3.402823466e+38 3.402823466e+38 ECU_ADDRESS 0 SYMBOL_LINK "Rte_PosnTrakgServo_OutpAntiWdupCmdPrev" 0 DISPLAY_IDENTIFIER PosnTrakgServo.PerInstanceMemories.OutpAntiWdupCmdPrev /end MEASUREMENT
/begin MEASUREMENT PosnTrakgServo.PosnServoCmd.Val "MICROSAR RTE" FLOAT32_IEEE NO_COMPU_METHOD 0 0 -3.402823466e+38 3.402823466e+38 ECU_ADDRESS 0 SYMBOL_LINK "Rte_PosnTrakgServo_PosnServoCmd_Val" 0 DISPLAY_IDENTIFIER PosnTrakgServo.SenderPorts.PosnServoCmd.Val /end MEASUREMENT
/begin MEASUREMENT PosnTrakgServo.PosnServoCmdInpArbnFltMtgtnPrev "MICROSAR RTE" FLOAT32_IEEE NO_COMPU_METHOD 0 0 -3.402823466e+38 3.402823466e+38 ECU_ADDRESS 0 SYMBOL_LINK "Rte_PosnTrakgServo_PosnServoCmdInpArbnFltMtgtnPrev" 0 DISPLAY_IDENTIFIER PosnTrakgServo.PerInstanceMemories.PosnServoCmdInpArbnFltMtgtnPrev /end MEASUREMENT
/begin MEASUREMENT PosnTrakgServo.PosnServoCmdOutpArbnFltMtgtnPrev "MICROSAR RTE" FLOAT32_IEEE NO_COMPU_METHOD 0 0 -3.402823466e+38 3.402823466e+38 ECU_ADDRESS 0 SYMBOL_LINK "Rte_PosnTrakgServo_PosnServoCmdOutpArbnFltMtgtnPrev" 0 DISPLAY_IDENTIFIER PosnTrakgServo.PerInstanceMemories.PosnServoCmdOutpArbnFltMtgtnPrev /end MEASUREMENT
/begin MEASUREMENT PosnTrakgServo.PosnServoEna.Logl "MICROSAR RTE" UBYTE RTE_CM_BOOLEAN 0 0 0 255 ECU_ADDRESS 0 SYMBOL_LINK "Rte_PosnTrakgServo_PosnServoEna_Logl" 0 DISPLAY_IDENTIFIER PosnTrakgServo.ReceiverPorts.PosnServoEna.Logl /end MEASUREMENT
/begin MEASUREMENT PosnTrakgServo.PosnServoEnaTiPrev "MICROSAR RTE" FLOAT32_IEEE NO_COMPU_METHOD 0 0 -3.402823466e+38 3.402823466e+38 ECU_ADDRESS 0 SYMBOL_LINK "Rte_PosnTrakgServo_PosnServoEnaTiPrev" 0 DISPLAY_IDENTIFIER PosnTrakgServo.PerInstanceMemories.PosnServoEnaTiPrev /end MEASUREMENT
/begin MEASUREMENT PosnTrakgServo.PosnServoHwAg.Val "MICROSAR RTE" FLOAT32_IEEE NO_COMPU_METHOD 0 0 -3.402823466e+38 3.402823466e+38 ECU_ADDRESS 0 SYMBOL_LINK "Rte_PosnTrakgServo_PosnServoHwAg_Val" 0 DISPLAY_IDENTIFIER PosnTrakgServo.ReceiverPorts.PosnServoHwAg.Val /end MEASUREMENT
/begin MEASUREMENT PosnTrakgServo.PosnServoHwAgValRateLim "MICROSAR RTE" FLOAT32_IEEE NO_COMPU_METHOD 0 0 -3.402823466e+38 3.402823466e+38 ECU_ADDRESS 0 SYMBOL_LINK "Rte_PosnTrakgServo_PosnServoHwAgValRateLim" 0 DISPLAY_IDENTIFIER PosnTrakgServo.PerInstanceMemories.PosnServoHwAgValRateLim /end MEASUREMENT
/begin MEASUREMENT PosnTrakgServo.PosnServoHwVel.Val "MICROSAR RTE" FLOAT32_IEEE NO_COMPU_METHOD 0 0 -3.402823466e+38 3.402823466e+38 ECU_ADDRESS 0 SYMBOL_LINK "Rte_PosnTrakgServo_PosnServoHwVel_Val" 0 DISPLAY_IDENTIFIER PosnTrakgServo.ReceiverPorts.PosnServoHwVel.Val /end MEASUREMENT
/begin MEASUREMENT PosnTrakgServo.PosnServoHwVelValRateLim "MICROSAR RTE" FLOAT32_IEEE NO_COMPU_METHOD 0 0 -3.402823466e+38 3.402823466e+38 ECU_ADDRESS 0 SYMBOL_LINK "Rte_PosnTrakgServo_PosnServoHwVelValRateLim" 0 DISPLAY_IDENTIFIER PosnTrakgServo.PerInstanceMemories.PosnServoHwVelValRateLim /end MEASUREMENT
/begin MEASUREMENT PosnTrakgServo.PosnServoIntgtrOffs.Val "MICROSAR RTE" FLOAT32_IEEE NO_COMPU_METHOD 0 0 -3.402823466e+38 3.402823466e+38 ECU_ADDRESS 0 SYMBOL_LINK "Rte_ImcSigArbn_PosnServoIntgtrOffs_Val" 0 DISPLAY_IDENTIFIER PosnTrakgServo.ReceiverPorts.PosnServoIntgtrOffs.Val /end MEASUREMENT
/begin MEASUREMENT PosnTrakgServo.PosnServoIntgtrSt.Val "MICROSAR RTE" FLOAT32_IEEE NO_COMPU_METHOD 0 0 -3.402823466e+38 3.402823466e+38 ECU_ADDRESS 0 SYMBOL_LINK "Rte_PosnTrakgServo_PosnServoIntgtrSt_Val" 0 DISPLAY_IDENTIFIER PosnTrakgServo.SenderPorts.PosnServoIntgtrSt.Val /end MEASUREMENT
/begin MEASUREMENT PosnTrakgServo.PosnTrakgArbnFltMtgtnEna.Logl "MICROSAR RTE" UBYTE RTE_CM_BOOLEAN 0 0 0 255 ECU_ADDRESS 0 SYMBOL_LINK "Rte_ImcSigArbn_PosnTrakgArbnFltMtgtnEna_Logl" 0 DISPLAY_IDENTIFIER PosnTrakgServo.ReceiverPorts.PosnTrakgArbnFltMtgtnEna.Logl /end MEASUREMENT
/begin MEASUREMENT PosnTrakgServo.VehSpd.Val "MICROSAR RTE" FLOAT32_IEEE NO_COMPU_METHOD 0 0 -3.402823466e+38 3.402823466e+38 ECU_ADDRESS 0 SYMBOL_LINK "Rte_ImcSigArbn_VehSpdImcCorrd_Val" 0 DISPLAY_IDENTIFIER PosnTrakgServo.ReceiverPorts.VehSpd.Val /end MEASUREMENT
/begin MEASUREMENT PosnTrakgServo.dPosnTrakgServoCmdPreLimd "MICROSAR RTE" FLOAT32_IEEE NO_COMPU_METHOD 0 0 -3.402823466e+38 3.402823466e+38 ECU_ADDRESS 0 SYMBOL_LINK "Rte_PosnTrakgServo_dPosnTrakgServoCmdPreLimd" 0 DISPLAY_IDENTIFIER PosnTrakgServo.PerInstanceMemories.dPosnTrakgServoCmdPreLimd /end MEASUREMENT
/begin MEASUREMENT PosnTrakgServo.dPosnTrakgServoEnaBlndFac "MICROSAR RTE" FLOAT32_IEEE NO_COMPU_METHOD 0 0 -3.402823466e+38 3.402823466e+38 ECU_ADDRESS 0 SYMBOL_LINK "Rte_PosnTrakgServo_dPosnTrakgServoEnaBlndFac" 0 DISPLAY_IDENTIFIER PosnTrakgServo.PerInstanceMemories.dPosnTrakgServoEnaBlndFac /end MEASUREMENT
/begin MEASUREMENT PosnTrakgServo.dPosnTrakgServoFfCmd "MICROSAR RTE" FLOAT32_IEEE NO_COMPU_METHOD 0 0 -3.402823466e+38 3.402823466e+38 ECU_ADDRESS 0 SYMBOL_LINK "Rte_PosnTrakgServo_dPosnTrakgServoFfCmd" 0 DISPLAY_IDENTIFIER PosnTrakgServo.PerInstanceMemories.dPosnTrakgServoFfCmd /end MEASUREMENT
/begin MEASUREMENT PosnTrakgServo.dPosnTrakgServoHwAg "MICROSAR RTE" FLOAT32_IEEE NO_COMPU_METHOD 0 0 -3.402823466e+38 3.402823466e+38 ECU_ADDRESS 0 SYMBOL_LINK "Rte_PosnTrakgServo_dPosnTrakgServoHwAg" 0 DISPLAY_IDENTIFIER PosnTrakgServo.PerInstanceMemories.dPosnTrakgServoHwAg /end MEASUREMENT
/begin MEASUREMENT PosnTrakgServo.dPosnTrakgServoHwAgErr "MICROSAR RTE" FLOAT32_IEEE NO_COMPU_METHOD 0 0 -3.402823466e+38 3.402823466e+38 ECU_ADDRESS 0 SYMBOL_LINK "Rte_PosnTrakgServo_dPosnTrakgServoHwAgErr" 0 DISPLAY_IDENTIFIER PosnTrakgServo.PerInstanceMemories.dPosnTrakgServoHwAgErr /end MEASUREMENT
/begin MEASUREMENT PosnTrakgServo.dPosnTrakgServoHwAgTarLimd "MICROSAR RTE" FLOAT32_IEEE NO_COMPU_METHOD 0 0 -3.402823466e+38 3.402823466e+38 ECU_ADDRESS 0 SYMBOL_LINK "Rte_PosnTrakgServo_dPosnTrakgServoHwAgTarLimd" 0 DISPLAY_IDENTIFIER PosnTrakgServo.PerInstanceMemories.dPosnTrakgServoHwAgTarLimd /end MEASUREMENT
/begin MEASUREMENT PosnTrakgServo.dPosnTrakgServoHwVelTarLimd "MICROSAR RTE" FLOAT32_IEEE NO_COMPU_METHOD 0 0 -3.402823466e+38 3.402823466e+38 ECU_ADDRESS 0 SYMBOL_LINK "Rte_PosnTrakgServo_dPosnTrakgServoHwVelTarLimd" 0 DISPLAY_IDENTIFIER PosnTrakgServo.PerInstanceMemories.dPosnTrakgServoHwVelTarLimd /end MEASUREMENT
/begin MEASUREMENT PosnTrakgServo.dPosnTrakgServoIntgtrCmdLimd "MICROSAR RTE" FLOAT32_IEEE NO_COMPU_METHOD 0 0 -3.402823466e+38 3.402823466e+38 ECU_ADDRESS 0 SYMBOL_LINK "Rte_PosnTrakgServo_dPosnTrakgServoIntgtrCmdLimd" 0 DISPLAY_IDENTIFIER PosnTrakgServo.PerInstanceMemories.dPosnTrakgServoIntgtrCmdLimd /end MEASUREMENT
/begin MEASUREMENT PosnTrakgServo.dPosnTrakgServoPtlStFbCmd "MICROSAR RTE" FLOAT32_IEEE NO_COMPU_METHOD 0 0 -3.402823466e+38 3.402823466e+38 ECU_ADDRESS 0 SYMBOL_LINK "Rte_PosnTrakgServo_dPosnTrakgServoPtlStFbCmd" 0 DISPLAY_IDENTIFIER PosnTrakgServo.PerInstanceMemories.dPosnTrakgServoPtlStFbCmd /end MEASUREMENT
/begin MEASUREMENT PwrDiscnct.BattVltg.Val "MICROSAR RTE" FLOAT32_IEEE NO_COMPU_METHOD 0 0 -3.402823466e+38 3.402823466e+38 ECU_ADDRESS 0 SYMBOL_LINK "Rte_CDD_FordT3T6McuCfg_BattVltg_Val" 0 DISPLAY_IDENTIFIER PwrDiscnct.ReceiverPorts.BattVltg.Val /end MEASUREMENT
/begin MEASUREMENT PwrDiscnct.BattVltgAdcFaild.Logl "MICROSAR RTE" UBYTE RTE_CM_BOOLEAN 0 0 0 255 ECU_ADDRESS 0 SYMBOL_LINK "Rte_CDD_FordT3T6McuCfg_BattVltgAdcFaild_Logl" 0 DISPLAY_IDENTIFIER PwrDiscnct.ReceiverPorts.BattVltgAdcFaild.Logl /end MEASUREMENT
/begin MEASUREMENT PwrDiscnct.BattVltgSwd1.Val "MICROSAR RTE" FLOAT32_IEEE NO_COMPU_METHOD 0 0 -3.402823466e+38 3.402823466e+38 ECU_ADDRESS 0 SYMBOL_LINK "Rte_CDD_FordT3T6McuCfg_BattVltgSwd1_Val" 0 DISPLAY_IDENTIFIER PwrDiscnct.ReceiverPorts.BattVltgSwd1.Val /end MEASUREMENT
/begin MEASUREMENT PwrDiscnct.ChrgPmpDiag.Val "MICROSAR RTE" FLOAT32_IEEE NO_COMPU_METHOD 0 0 -3.402823466e+38 3.402823466e+38 ECU_ADDRESS 0 SYMBOL_LINK "Rte_CDD_FordT3T6McuCfg_ChrgPmpDiag_Val" 0 DISPLAY_IDENTIFIER PwrDiscnct.ReceiverPorts.ChrgPmpDiag.Val /end MEASUREMENT
/begin MEASUREMENT PwrDiscnct.ChrgPmpDiagAdcFaild.Logl "MICROSAR RTE" UBYTE RTE_CM_BOOLEAN 0 0 0 255 ECU_ADDRESS 0 SYMBOL_LINK "Rte_CDD_FordT3T6McuCfg_ChrgPmpDiagAdcFaild_Logl" 0 DISPLAY_IDENTIFIER PwrDiscnct.ReceiverPorts.ChrgPmpDiagAdcFaild.Logl /end MEASUREMENT
/begin MEASUREMENT PwrDiscnct.FirstRunCmpl "MICROSAR RTE" UBYTE RTE_CM_BOOLEAN 0 0 0 255 ECU_ADDRESS 0 SYMBOL_LINK "Rte_PwrDiscnct_FirstRunCmpl" 0 DISPLAY_IDENTIFIER PwrDiscnct.PerInstanceMemories.FirstRunCmpl /end MEASUREMENT
/begin MEASUREMENT PwrDiscnct.MotVelMrf.Val "MICROSAR RTE" FLOAT32_IEEE NO_COMPU_METHOD 0 0 -3.402823466e+38 3.402823466e+38 ECU_ADDRESS 0 SYMBOL_LINK "Rte_CDD_MotVel_MotVelMrf_Val" 0 DISPLAY_IDENTIFIER PwrDiscnct.ReceiverPorts.MotVelMrf.Val /end MEASUREMENT
/begin MEASUREMENT PwrDiscnct.Ntc042PrmByte "MICROSAR RTE" UBYTE NO_COMPU_METHOD 0 0 0 255 ECU_ADDRESS 0 SYMBOL_LINK "Rte_PwrDiscnct_Ntc042PrmByte" 0 DISPLAY_IDENTIFIER PwrDiscnct.PerInstanceMemories.Ntc042PrmByte /end MEASUREMENT
/begin MEASUREMENT PwrDiscnct.PwrDiscnctATestCmpl.Logl "MICROSAR RTE" UBYTE RTE_CM_BOOLEAN 0 0 0 255 ECU_ADDRESS 0 SYMBOL_LINK "Rte_PwrDiscnct_PwrDiscnctATestCmpl_Logl" 0 DISPLAY_IDENTIFIER PwrDiscnct.SenderPorts.PwrDiscnctATestCmpl.Logl /end MEASUREMENT
/begin MEASUREMENT PwrDiscnct.PwrDiscnctBTestCmpl.Logl "MICROSAR RTE" UBYTE RTE_CM_BOOLEAN 0 0 0 255 ECU_ADDRESS 0 SYMBOL_LINK "Rte_PwrDiscnct_PwrDiscnctBTestCmpl_Logl" 0 DISPLAY_IDENTIFIER PwrDiscnct.SenderPorts.PwrDiscnctBTestCmpl.Logl /end MEASUREMENT
/begin MEASUREMENT PwrDiscnct.PwrDiscnctClsd.Logl "MICROSAR RTE" UBYTE RTE_CM_BOOLEAN 0 0 0 255 ECU_ADDRESS 0 SYMBOL_LINK "Rte_PwrDiscnct_PwrDiscnctClsd_Logl" 0 DISPLAY_IDENTIFIER PwrDiscnct.SenderPorts.PwrDiscnctClsd.Logl /end MEASUREMENT
/begin MEASUREMENT PwrDiscnct.PwrDiscnctClsdSts "MICROSAR RTE" UBYTE RTE_CM_BOOLEAN 0 0 0 255 ECU_ADDRESS 0 SYMBOL_LINK "Rte_PwrDiscnct_PwrDiscnctClsdSts" 0 DISPLAY_IDENTIFIER PwrDiscnct.PerInstanceMemories.PwrDiscnctClsdSts /end MEASUREMENT
/begin MEASUREMENT PwrDiscnct.PwrDiscnctFltAtInitErrAcc "MICROSAR RTE" UWORD NO_COMPU_METHOD 0 0 0 65535 ECU_ADDRESS 0 SYMBOL_LINK "Rte_PwrDiscnct_PwrDiscnctFltAtInitErrAcc" 0 DISPLAY_IDENTIFIER PwrDiscnct.PerInstanceMemories.PwrDiscnctFltAtInitErrAcc /end MEASUREMENT
/begin MEASUREMENT PwrDiscnct.PwrDiscnctSt "MICROSAR RTE" UBYTE RTE_CM_ENUM_PwrDiscnctSts1 0 0 0 255 ECU_ADDRESS 0 SYMBOL_LINK "Rte_PwrDiscnct_PwrDiscnctSt" 0 DISPLAY_IDENTIFIER PwrDiscnct.PerInstanceMemories.PwrDiscnctSt /end MEASUREMENT
/begin MEASUREMENT PwrDiscnct.PwrDiscnctSwtDiag.Val "MICROSAR RTE" FLOAT32_IEEE NO_COMPU_METHOD 0 0 -3.402823466e+38 3.402823466e+38 ECU_ADDRESS 0 SYMBOL_LINK "Rte_CDD_FordT3T6McuCfg_PwrDiscnctSwtDiag_Val" 0 DISPLAY_IDENTIFIER PwrDiscnct.ReceiverPorts.PwrDiscnctSwtDiag.Val /end MEASUREMENT
/begin MEASUREMENT PwrDiscnct.PwrDiscnctTestACmpl "MICROSAR RTE" UBYTE RTE_CM_BOOLEAN 0 0 0 255 ECU_ADDRESS 0 SYMBOL_LINK "Rte_PwrDiscnct_PwrDiscnctTestACmpl" 0 DISPLAY_IDENTIFIER PwrDiscnct.PerInstanceMemories.PwrDiscnctTestACmpl /end MEASUREMENT
/begin MEASUREMENT PwrDiscnct.PwrDiscnctTestBCmpl "MICROSAR RTE" UBYTE RTE_CM_BOOLEAN 0 0 0 255 ECU_ADDRESS 0 SYMBOL_LINK "Rte_PwrDiscnct_PwrDiscnctTestBCmpl" 0 DISPLAY_IDENTIFIER PwrDiscnct.PerInstanceMemories.PwrDiscnctTestBCmpl /end MEASUREMENT
/begin MEASUREMENT PwrDiscnct.StrtUpSt.Val "MICROSAR RTE" UBYTE NO_COMPU_METHOD 0 0 0 255 ECU_ADDRESS 0 SYMBOL_LINK "Rte_PwrUpSeq_StrtUpSt_Val" 0 DISPLAY_IDENTIFIER PwrDiscnct.ReceiverPorts.StrtUpSt.Val /end MEASUREMENT
/begin MEASUREMENT PwrDiscnct.SysSt.Val "MICROSAR RTE" UBYTE RTE_CM_ENUM_SysSt1 0 0 0 255 ECU_ADDRESS 0 SYMBOL_LINK "Rte_SysStMod_SysSt_Val" 0 DISPLAY_IDENTIFIER PwrDiscnct.ReceiverPorts.SysSt.Val /end MEASUREMENT
/begin MEASUREMENT PwrLimr.AltFltActv.Logl "MICROSAR RTE" UBYTE RTE_CM_BOOLEAN 0 0 0 255 ECU_ADDRESS 0 SYMBOL_LINK "Rte_PwrLimr_AltFltActv_Logl" 0 DISPLAY_IDENTIFIER PwrLimr.ReceiverPorts.AltFltActv.Logl /end MEASUREMENT
/begin MEASUREMENT PwrLimr.BrdgVltg.Val "MICROSAR RTE" FLOAT32_IEEE NO_COMPU_METHOD 0 0 -3.402823466e+38 3.402823466e+38 ECU_ADDRESS 0 SYMBOL_LINK "Rte_BattVltg_BrdgVltg_Val" 0 DISPLAY_IDENTIFIER PwrLimr.ReceiverPorts.BrdgVltg.Val /end MEASUREMENT
/begin MEASUREMENT PwrLimr.BrdgVltgRateLim "MICROSAR RTE" FLOAT32_IEEE NO_COMPU_METHOD 0 0 -3.402823466e+38 3.402823466e+38 ECU_ADDRESS 0 SYMBOL_LINK "Rte_PwrLimr_BrdgVltgRateLim" 0 DISPLAY_IDENTIFIER PwrLimr.PerInstanceMemories.BrdgVltgRateLim /end MEASUREMENT
/begin MEASUREMENT PwrLimr.DualEcuFltMtgtnSca.Val "MICROSAR RTE" FLOAT32_IEEE NO_COMPU_METHOD 0 0 -3.402823466e+38 3.402823466e+38 ECU_ADDRESS 0 SYMBOL_LINK "Rte_DualCtrlrOutpMgr_DualEcuFltMtgtnSca_Val" 0 DISPLAY_IDENTIFIER PwrLimr.ReceiverPorts.DualEcuFltMtgtnSca.Val /end MEASUREMENT
/begin MEASUREMENT PwrLimr.LimdAssiLoVltgPrev "MICROSAR RTE" UBYTE RTE_CM_BOOLEAN 0 0 0 255 ECU_ADDRESS 0 SYMBOL_LINK "Rte_PwrLimr_LimdAssiLoVltgPrev" 0 DISPLAY_IDENTIFIER PwrLimr.PerInstanceMemories.LimdAssiLoVltgPrev /end MEASUREMENT
/begin MEASUREMENT PwrLimr.MotAndThermProtnLoaMod.Val "MICROSAR RTE" UBYTE NO_COMPU_METHOD 0 0 0 255 ECU_ADDRESS 0 SYMBOL_LINK "Rte_LoaMgr_MotAndThermProtnLoaMod_Val" 0 DISPLAY_IDENTIFIER PwrLimr.ReceiverPorts.MotAndThermProtnLoaMod.Val /end MEASUREMENT
/begin MEASUREMENT PwrLimr.MotBackEmfConEstimd.Val "MICROSAR RTE" FLOAT32_IEEE NO_COMPU_METHOD 0 0 -3.402823466e+38 3.402823466e+38 ECU_ADDRESS 0 SYMBOL_LINK "Rte_MotCtrlPrmEstimn_MotBackEmfConEstimd_Val" 0 DISPLAY_IDENTIFIER PwrLimr.ReceiverPorts.MotBackEmfConEstimd.Val /end MEASUREMENT
/begin MEASUREMENT PwrLimr.MotTqCmdMrf.Val "MICROSAR RTE" FLOAT32_IEEE NO_COMPU_METHOD 0 0 -3.402823466e+38 3.402823466e+38 ECU_ADDRESS 0 SYMBOL_LINK "Rte_MotTqTranlDampg_MotTqCmdMrfDampd_Val" 0 DISPLAY_IDENTIFIER PwrLimr.ReceiverPorts.MotTqCmdMrf.Val /end MEASUREMENT
/begin MEASUREMENT PwrLimr.MotTqCmdPwrLimd.Val "MICROSAR RTE" FLOAT32_IEEE NO_COMPU_METHOD 0 0 -3.402823466e+38 3.402823466e+38 ECU_ADDRESS 0 SYMBOL_LINK "Rte_PwrLimr_MotTqCmdPwrLimd_Val" 0 DISPLAY_IDENTIFIER PwrLimr.SenderPorts.MotTqCmdPwrLimd.Val /end MEASUREMENT
/begin MEASUREMENT PwrLimr.MotVelLpFil.FilGain "MICROSAR RTE" FLOAT32_IEEE NO_COMPU_METHOD 0 0 -3.402823466e+38 3.402823466e+38 ECU_ADDRESS 0 SYMBOL_LINK "Rte_PwrLimr_MotVelLpFil.FilGain" 0 DISPLAY_IDENTIFIER PwrLimr.PerInstanceMemories.MotVelLpFil.FilGain /end MEASUREMENT
/begin MEASUREMENT PwrLimr.MotVelLpFil.FilSt "MICROSAR RTE" FLOAT32_IEEE NO_COMPU_METHOD 0 0 -3.402823466e+38 3.402823466e+38 ECU_ADDRESS 0 SYMBOL_LINK "Rte_PwrLimr_MotVelLpFil.FilSt" 0 DISPLAY_IDENTIFIER PwrLimr.PerInstanceMemories.MotVelLpFil.FilSt /end MEASUREMENT
/begin MEASUREMENT PwrLimr.MotVelMrf.Val "MICROSAR RTE" FLOAT32_IEEE NO_COMPU_METHOD 0 0 -3.402823466e+38 3.402823466e+38 ECU_ADDRESS 0 SYMBOL_LINK "Rte_CDD_MotVel_MotVelMrf_Val" 0 DISPLAY_IDENTIFIER PwrLimr.ReceiverPorts.MotVelMrf.Val /end MEASUREMENT
/begin MEASUREMENT PwrLimr.OutpVelOffsRateLimd "MICROSAR RTE" FLOAT32_IEEE NO_COMPU_METHOD 0 0 -3.402823466e+38 3.402823466e+38 ECU_ADDRESS 0 SYMBOL_LINK "Rte_PwrLimr_OutpVelOffsRateLimd" 0 DISPLAY_IDENTIFIER PwrLimr.PerInstanceMemories.OutpVelOffsRateLimd /end MEASUREMENT
/begin MEASUREMENT PwrLimr.PwrLimrRednFac.Val "MICROSAR RTE" FLOAT32_IEEE NO_COMPU_METHOD 0 0 -3.402823466e+38 3.402823466e+38 ECU_ADDRESS 0 SYMBOL_LINK "Rte_PwrLimr_PwrLimrRednFac_Val" 0 DISPLAY_IDENTIFIER PwrLimr.SenderPorts.PwrLimrRednFac.Val /end MEASUREMENT
/begin MEASUREMENT PwrLimr.RefTmr "MICROSAR RTE" ULONG NO_COMPU_METHOD 0 0 0 4294967295 ECU_ADDRESS 0 SYMBOL_LINK "Rte_PwrLimr_RefTmr" 0 DISPLAY_IDENTIFIER PwrLimr.PerInstanceMemories.RefTmr /end MEASUREMENT
/begin MEASUREMENT PwrLimr.RefTmrPrev "MICROSAR RTE" ULONG NO_COMPU_METHOD 0 0 0 4294967295 ECU_ADDRESS 0 SYMBOL_LINK "Rte_PwrLimr_RefTmrPrev" 0 DISPLAY_IDENTIFIER PwrLimr.PerInstanceMemories.RefTmrPrev /end MEASUREMENT
/begin MEASUREMENT PwrLimr.TqLimLpFil.FilGain "MICROSAR RTE" FLOAT32_IEEE NO_COMPU_METHOD 0 0 -3.402823466e+38 3.402823466e+38 ECU_ADDRESS 0 SYMBOL_LINK "Rte_PwrLimr_TqLimLpFil.FilGain" 0 DISPLAY_IDENTIFIER PwrLimr.PerInstanceMemories.TqLimLpFil.FilGain /end MEASUREMENT
/begin MEASUREMENT PwrLimr.TqLimLpFil.FilSt "MICROSAR RTE" FLOAT32_IEEE NO_COMPU_METHOD 0 0 -3.402823466e+38 3.402823466e+38 ECU_ADDRESS 0 SYMBOL_LINK "Rte_PwrLimr_TqLimLpFil.FilSt" 0 DISPLAY_IDENTIFIER PwrLimr.PerInstanceMemories.TqLimLpFil.FilSt /end MEASUREMENT
/begin MEASUREMENT PwrLimr.dPwrLimrFildMotVel "MICROSAR RTE" FLOAT32_IEEE NO_COMPU_METHOD 0 0 -3.402823466e+38 3.402823466e+38 ECU_ADDRESS 0 SYMBOL_LINK "Rte_PwrLimr_dPwrLimrFildMotVel" 0 DISPLAY_IDENTIFIER PwrLimr.PerInstanceMemories.dPwrLimrFildMotVel /end MEASUREMENT
/begin MEASUREMENT PwrLimr.dPwrLimrLimDif "MICROSAR RTE" FLOAT32_IEEE NO_COMPU_METHOD 0 0 -3.402823466e+38 3.402823466e+38 ECU_ADDRESS 0 SYMBOL_LINK "Rte_PwrLimr_dPwrLimrLimDif" 0 DISPLAY_IDENTIFIER PwrLimr.PerInstanceMemories.dPwrLimrLimDif /end MEASUREMENT
/begin MEASUREMENT PwrLimr.dPwrLimrMinStdOperLim "MICROSAR RTE" FLOAT32_IEEE NO_COMPU_METHOD 0 0 -3.402823466e+38 3.402823466e+38 ECU_ADDRESS 0 SYMBOL_LINK "Rte_PwrLimr_dPwrLimrMinStdOperLim" 0 DISPLAY_IDENTIFIER PwrLimr.PerInstanceMemories.dPwrLimrMinStdOperLim /end MEASUREMENT
/begin MEASUREMENT PwrLimr.dPwrLimrMotEnvlpSpd "MICROSAR RTE" FLOAT32_IEEE NO_COMPU_METHOD 0 0 -3.402823466e+38 3.402823466e+38 ECU_ADDRESS 0 SYMBOL_LINK "Rte_PwrLimr_dPwrLimrMotEnvlpSpd" 0 DISPLAY_IDENTIFIER PwrLimr.PerInstanceMemories.dPwrLimrMotEnvlpSpd /end MEASUREMENT
/begin MEASUREMENT PwrLimr.dPwrLimrMotTqCmdIvtrLoaSca "MICROSAR RTE" FLOAT32_IEEE NO_COMPU_METHOD 0 0 -3.402823466e+38 3.402823466e+38 ECU_ADDRESS 0 SYMBOL_LINK "Rte_PwrLimr_dPwrLimrMotTqCmdIvtrLoaSca" 0 DISPLAY_IDENTIFIER PwrLimr.PerInstanceMemories.dPwrLimrMotTqCmdIvtrLoaSca /end MEASUREMENT
/begin MEASUREMENT PwrLimr.dPwrLimrOutpVelOffs "MICROSAR RTE" FLOAT32_IEEE NO_COMPU_METHOD 0 0 -3.402823466e+38 3.402823466e+38 ECU_ADDRESS 0 SYMBOL_LINK "Rte_PwrLimr_dPwrLimrOutpVelOffs" 0 DISPLAY_IDENTIFIER PwrLimr.PerInstanceMemories.dPwrLimrOutpVelOffs /end MEASUREMENT
/begin GROUP MotRefMdl.dMotRefMdlReacncDaxOverR "MICROSAR RTE" /begin SUB_GROUP /end SUB_GROUP /begin FUNCTION_LIST /end FUNCTION_LIST /begin REF_CHARACTERISTIC /end REF_CHARACTERISTIC /begin REF_MEASUREMENT MotRefMdl.dMotRefMdlReacncDaxOverR /end REF_MEASUREMENT /end GROUP
/begin GROUP MotRefMdl.dMotRefMdlReacncQaxOverR "MICROSAR RTE" /begin SUB_GROUP /end SUB_GROUP /begin FUNCTION_LIST /end FUNCTION_LIST /begin REF_CHARACTERISTIC /end REF_CHARACTERISTIC /begin REF_MEASUREMENT MotRefMdl.dMotRefMdlReacncQaxOverR /end REF_MEASUREMENT /end GROUP
/begin GROUP MotRefMdl.dMotRefMdlRelncTqCoeff "MICROSAR RTE" /begin SUB_GROUP /end SUB_GROUP /begin FUNCTION_LIST /end FUNCTION_LIST /begin REF_CHARACTERISTIC /end REF_CHARACTERISTIC /begin REF_MEASUREMENT MotRefMdl.dMotRefMdlRelncTqCoeff /end REF_MEASUREMENT /end GROUP
/begin GROUP MotRplCoggCfg "MICROSAR RTE"
 /begin SUB_GROUP MotRplCoggCfg.CalibrationPorts MotRplCoggCfg.PerInstanceMemories MotRplCoggCfg.ReceiverPorts MotRplCoggCfg.SenderPorts /end SUB_GROUP
 /begin FUNCTION_LIST /end FUNCTION_LIST
 /begin REF_CHARACTERISTIC /end REF_CHARACTERISTIC
 /begin REF_MEASUREMENT /end REF_MEASUREMENT
/end GROUP
/begin GROUP MotRplCoggCfg.CalibrationPorts "MICROSAR RTE"
 /begin SUB_GROUP MotRplCoggCfg.MotCtrlPrmEstimnMotBackEmfConNom.Val MotRplCoggCfg.MotRplCoggCfgMotAgTiDly.Val MotRplCoggCfg.MotRplCoggCfgMotCurrDaxRplBilnrSeln.Ary1D MotRplCoggCfg.MotRplCoggCfgMotCurrQaxRpl.Ary1D MotRplCoggCfg.MotRplCoggCfgMotTqCmdCurrRgltrBwCmpMgnY.Ary2D MotRplCoggCfg.MotRplCoggCfgMotTqCmdCurrRgltrBwCmpPhaY.Ary2D MotRplCoggCfg.MotRplCoggCfgMotTqCmdCurrRgltrBwCmpX.Ary1D MotRplCoggCfg.MotRplCoggCfgMotTqRplOrder1X.Ary2D MotRplCoggCfg.MotRplCoggCfgMotTqRplOrder1Y.Ary2D MotRplCoggCfg.MotRplCoggCfgMotTqRplOrder2X.Ary2D MotRplCoggCfg.MotRplCoggCfgMotTqRplOrder2Y.Ary2D MotRplCoggCfg.MotRplCoggCfgMotTqRplOrder3X.Ary2D MotRplCoggCfg.MotRplCoggCfgMotTqRplOrder3Y.Ary2D MotRplCoggCfg.MotRplCoggCfgMotVelBilnrSeln.Ary1D MotRplCoggCfg.MotRplCoggCmdHrmncOrder1Elec.Val MotRplCoggCfg.MotRplCoggCmdHrmncOrder2Elec.Val MotRplCoggCfg.MotRplCoggCmdHrmncOrder3Elec.Val MotRplCoggCfg.SysGlbPrmMotPoleCnt.Val /end SUB_GROUP
 /begin FUNCTION_LIST /end FUNCTION_LIST
 /begin REF_CHARACTERISTIC /end REF_CHARACTERISTIC
 /begin REF_MEASUREMENT /end REF_MEASUREMENT
/end GROUP
/begin GROUP MotRplCoggCfg.MotAgElecDlyRpl.Val "MICROSAR RTE" /begin SUB_GROUP /end SUB_GROUP /begin FUNCTION_LIST /end FUNCTION_LIST /begin REF_CHARACTERISTIC /end REF_CHARACTERISTIC /begin REF_MEASUREMENT MotRplCoggCfg.MotAgElecDlyRpl.Val /end REF_MEASUREMENT /end GROUP
/begin GROUP MotRplCoggCfg.MotBackEmfConEstimd.Val "MICROSAR RTE" /begin SUB_GROUP /end SUB_GROUP /begin FUNCTION_LIST /end FUNCTION_LIST /begin REF_CHARACTERISTIC /end REF_CHARACTERISTIC /begin REF_MEASUREMENT MotRplCoggCfg.MotBackEmfConEstimd.Val /end REF_MEASUREMENT /end GROUP
/begin GROUP MotRplCoggCfg.MotCtrlPrmEstimnMotBackEmfConNom.Val "MICROSAR RTE" /begin SUB_GROUP /end SUB_GROUP /begin FUNCTION_LIST /end FUNCTION_LIST /begin REF_CHARACTERISTIC MotRplCoggCfg.MotCtrlPrmEstimnMotBackEmfConNom.Val /end REF_CHARACTERISTIC /begin REF_MEASUREMENT /end REF_MEASUREMENT /end GROUP
/begin GROUP MotRplCoggCfg.MotCurrDaxCmd.Val "MICROSAR RTE" /begin SUB_GROUP /end SUB_GROUP /begin FUNCTION_LIST /end FUNCTION_LIST /begin REF_CHARACTERISTIC /end REF_CHARACTERISTIC /begin REF_MEASUREMENT MotRplCoggCfg.MotCurrDaxCmd.Val /end REF_MEASUREMENT /end GROUP
/begin GROUP MotRplCoggCfg.MotCurrQaxCmd.Val "MICROSAR RTE" /begin SUB_GROUP /end SUB_GROUP /begin FUNCTION_LIST /end FUNCTION_LIST /begin REF_CHARACTERISTIC /end REF_CHARACTERISTIC /begin REF_MEASUREMENT MotRplCoggCfg.MotCurrQaxCmd.Val /end REF_MEASUREMENT /end GROUP
/begin GROUP MotRplCoggCfg.MotCurrQaxToMotTqGain.Val "MICROSAR RTE" /begin SUB_GROUP /end SUB_GROUP /begin FUNCTION_LIST /end FUNCTION_LIST /begin REF_CHARACTERISTIC /end REF_CHARACTERISTIC /begin REF_MEASUREMENT MotRplCoggCfg.MotCurrQaxToMotTqGain.Val /end REF_MEASUREMENT /end GROUP
/begin GROUP MotRplCoggCfg.MotInduDaxEstimd.Val "MICROSAR RTE" /begin SUB_GROUP /end SUB_GROUP /begin FUNCTION_LIST /end FUNCTION_LIST /begin REF_CHARACTERISTIC /end REF_CHARACTERISTIC /begin REF_MEASUREMENT MotRplCoggCfg.MotInduDaxEstimd.Val /end REF_MEASUREMENT /end GROUP
/begin GROUP MotRplCoggCfg.MotInduQaxEstimd.Val "MICROSAR RTE" /begin SUB_GROUP /end SUB_GROUP /begin FUNCTION_LIST /end FUNCTION_LIST /begin REF_CHARACTERISTIC /end REF_CHARACTERISTIC /begin REF_MEASUREMENT MotRplCoggCfg.MotInduQaxEstimd.Val /end REF_MEASUREMENT /end GROUP
/begin GROUP MotRplCoggCfg.MotRplCoggCfgMotAgTiDly.Val "MICROSAR RTE" /begin SUB_GROUP /end SUB_GROUP /begin FUNCTION_LIST /end FUNCTION_LIST /begin REF_CHARACTERISTIC MotRplCoggCfg.MotRplCoggCfgMotAgTiDly.Val /end REF_CHARACTERISTIC /begin REF_MEASUREMENT /end REF_MEASUREMENT /end GROUP
/begin GROUP MotRplCoggCfg.MotRplCoggCfgMotCurrDaxRplBilnrSeln.Ary1D "MICROSAR RTE" /begin SUB_GROUP /end SUB_GROUP /begin FUNCTION_LIST /end FUNCTION_LIST /begin REF_CHARACTERISTIC MotRplCoggCfg.MotRplCoggCfgMotCurrDaxRplBilnrSeln.Ary1D /end REF_CHARACTERISTIC /begin REF_MEASUREMENT /end REF_MEASUREMENT /end GROUP
/begin GROUP MotRplCoggCfg.MotRplCoggCfgMotCurrQaxRpl.Ary1D "MICROSAR RTE" /begin SUB_GROUP /end SUB_GROUP /begin FUNCTION_LIST /end FUNCTION_LIST /begin REF_CHARACTERISTIC MotRplCoggCfg.MotRplCoggCfgMotCurrQaxRpl.Ary1D /end REF_CHARACTERISTIC /begin REF_MEASUREMENT /end REF_MEASUREMENT /end GROUP
/begin GROUP MotRplCoggCfg.MotRplCoggCfgMotTqCmdCurrRgltrBwCmpMgnY.Ary2D "MICROSAR RTE" /begin SUB_GROUP /end SUB_GROUP /begin FUNCTION_LIST /end FUNCTION_LIST
 /begin REF_CHARACTERISTIC MotRplCoggCfg.MotRplCoggCfgMotTqCmdCurrRgltrBwCmpMgnY.Ary2D /end REF_CHARACTERISTIC
 /begin REF_MEASUREMENT /end REF_MEASUREMENT
/end GROUP
/begin GROUP MotRplCoggCfg.MotRplCoggCfgMotTqCmdCurrRgltrBwCmpPhaY.Ary2D "MICROSAR RTE" /begin SUB_GROUP /end SUB_GROUP /begin FUNCTION_LIST /end FUNCTION_LIST
 /begin REF_CHARACTERISTIC MotRplCoggCfg.MotRplCoggCfgMotTqCmdCurrRgltrBwCmpPhaY.Ary2D /end REF_CHARACTERISTIC
 /begin REF_MEASUREMENT /end REF_MEASUREMENT
/end GROUP
/begin GROUP MotRplCoggCfg.MotRplCoggCfgMotTqCmdCurrRgltrBwCmpX.Ary1D "MICROSAR RTE" /begin SUB_GROUP /end SUB_GROUP /begin FUNCTION_LIST /end FUNCTION_LIST /begin REF_CHARACTERISTIC MotRplCoggCfg.MotRplCoggCfgMotTqCmdCurrRgltrBwCmpX.Ary1D /end REF_CHARACTERISTIC /begin REF_MEASUREMENT /end REF_MEASUREMENT /end GROUP
/begin GROUP MotRplCoggCfg.MotRplCoggCfgMotTqRplOrder1X.Ary2D "MICROSAR RTE" /begin SUB_GROUP /end SUB_GROUP /begin FUNCTION_LIST /end FUNCTION_LIST /begin REF_CHARACTERISTIC MotRplCoggCfg.MotRplCoggCfgMotTqRplOrder1X.Ary2D /end REF_CHARACTERISTIC /begin REF_MEASUREMENT /end REF_MEASUREMENT /end GROUP
/begin GROUP MotRplCoggCfg.MotRplCoggCfgMotTqRplOrder1Y.Ary2D "MICROSAR RTE" /begin SUB_GROUP /end SUB_GROUP /begin FUNCTION_LIST /end FUNCTION_LIST /begin REF_CHARACTERISTIC MotRplCoggCfg.MotRplCoggCfgMotTqRplOrder1Y.Ary2D /end REF_CHARACTERISTIC /begin REF_MEASUREMENT /end REF_MEASUREMENT /end GROUP
/begin GROUP MotRplCoggCfg.MotRplCoggCfgMotTqRplOrder2X.Ary2D "MICROSAR RTE" /begin SUB_GROUP /end SUB_GROUP /begin FUNCTION_LIST /end FUNCTION_LIST /begin REF_CHARACTERISTIC MotRplCoggCfg.MotRplCoggCfgMotTqRplOrder2X.Ary2D /end REF_CHARACTERISTIC /begin REF_MEASUREMENT /end REF_MEASUREMENT /end GROUP
/begin GROUP MotRplCoggCfg.MotRplCoggCfgMotTqRplOrder2Y.Ary2D "MICROSAR RTE" /begin SUB_GROUP /end SUB_GROUP /begin FUNCTION_LIST /end FUNCTION_LIST /begin REF_CHARACTERISTIC MotRplCoggCfg.MotRplCoggCfgMotTqRplOrder2Y.Ary2D /end REF_CHARACTERISTIC /begin REF_MEASUREMENT /end REF_MEASUREMENT /end GROUP
/begin GROUP MotRplCoggCfg.MotRplCoggCfgMotTqRplOrder3X.Ary2D "MICROSAR RTE" /begin SUB_GROUP /end SUB_GROUP /begin FUNCTION_LIST /end FUNCTION_LIST /begin REF_CHARACTERISTIC MotRplCoggCfg.MotRplCoggCfgMotTqRplOrder3X.Ary2D /end REF_CHARACTERISTIC /begin REF_MEASUREMENT /end REF_MEASUREMENT /end GROUP
/begin GROUP MotRplCoggCfg.MotRplCoggCfgMotTqRplOrder3Y.Ary2D "MICROSAR RTE" /begin SUB_GROUP /end SUB_GROUP /begin FUNCTION_LIST /end FUNCTION_LIST /begin REF_CHARACTERISTIC MotRplCoggCfg.MotRplCoggCfgMotTqRplOrder3Y.Ary2D /end REF_CHARACTERISTIC /begin REF_MEASUREMENT /end REF_MEASUREMENT /end GROUP
/begin GROUP MotRplCoggCfg.MotRplCoggCfgMotVelBilnrSeln.Ary1D "MICROSAR RTE" /begin SUB_GROUP /end SUB_GROUP /begin FUNCTION_LIST /end FUNCTION_LIST /begin REF_CHARACTERISTIC MotRplCoggCfg.MotRplCoggCfgMotVelBilnrSeln.Ary1D /end REF_CHARACTERISTIC /begin REF_MEASUREMENT /end REF_MEASUREMENT /end GROUP
/begin GROUP MotRplCoggCfg.MotRplCoggCmdHrmncOrder1Elec.Val "MICROSAR RTE" /begin SUB_GROUP /end SUB_GROUP /begin FUNCTION_LIST /end FUNCTION_LIST /begin REF_CHARACTERISTIC MotRplCoggCfg.MotRplCoggCmdHrmncOrder1Elec.Val /end REF_CHARACTERISTIC /begin REF_MEASUREMENT /end REF_MEASUREMENT /end GROUP
/begin GROUP MotRplCoggCfg.MotRplCoggCmdHrmncOrder2Elec.Val "MICROSAR RTE" /begin SUB_GROUP /end SUB_GROUP /begin FUNCTION_LIST /end FUNCTION_LIST /begin REF_CHARACTERISTIC MotRplCoggCfg.MotRplCoggCmdHrmncOrder2Elec.Val /end REF_CHARACTERISTIC /begin REF_MEASUREMENT /end REF_MEASUREMENT /end GROUP
/begin GROUP MotRplCoggCfg.MotRplCoggCmdHrmncOrder3Elec.Val "MICROSAR RTE" /begin SUB_GROUP /end SUB_GROUP /begin FUNCTION_LIST /end FUNCTION_LIST /begin REF_CHARACTERISTIC MotRplCoggCfg.MotRplCoggCmdHrmncOrder3Elec.Val /end REF_CHARACTERISTIC /begin REF_MEASUREMENT /end REF_MEASUREMENT /end GROUP
/begin GROUP MotRplCoggCfg.MotRplCoggPrm "MICROSAR RTE" /begin SUB_GROUP /end SUB_GROUP /begin FUNCTION_LIST /end FUNCTION_LIST /begin REF_CHARACTERISTIC /end REF_CHARACTERISTIC
 /begin REF_MEASUREMENT MotRplCoggCfg.MotRplCoggPrm.CoggOrder1 MotRplCoggCfg.MotRplCoggPrm.CoggOrder1X MotRplCoggCfg.MotRplCoggPrm.CoggOrder1Y MotRplCoggCfg.MotRplCoggPrm.CoggOrder2 MotRplCoggCfg.MotRplCoggPrm.CoggOrder2X MotRplCoggCfg.MotRplCoggPrm.CoggOrder2Y MotRplCoggCfg.MotRplCoggPrm.CoggOrder3 MotRplCoggCfg.MotRplCoggPrm.CoggOrder3X MotRplCoggCfg.MotRplCoggPrm.CoggOrder3Y /end REF_MEASUREMENT
/end GROUP
/begin GROUP MotRplCoggCfg.MotTqCmdMrfScad.Val "MICROSAR RTE" /begin SUB_GROUP /end SUB_GROUP /begin FUNCTION_LIST /end FUNCTION_LIST /begin REF_CHARACTERISTIC /end REF_CHARACTERISTIC /begin REF_MEASUREMENT MotRplCoggCfg.MotTqCmdMrfScad.Val /end REF_MEASUREMENT /end GROUP
/begin GROUP MotRplCoggCfg.MotTqRplCoggOrder1Mgn.Val "MICROSAR RTE" /begin SUB_GROUP /end SUB_GROUP /begin FUNCTION_LIST /end FUNCTION_LIST /begin REF_CHARACTERISTIC /end REF_CHARACTERISTIC /begin REF_MEASUREMENT MotRplCoggCfg.MotTqRplCoggOrder1Mgn.Val /end REF_MEASUREMENT /end GROUP
/begin GROUP MotRplCoggCfg.MotTqRplCoggOrder1Pha.Val "MICROSAR RTE" /begin SUB_GROUP /end SUB_GROUP /begin FUNCTION_LIST /end FUNCTION_LIST /begin REF_CHARACTERISTIC /end REF_CHARACTERISTIC /begin REF_MEASUREMENT MotRplCoggCfg.MotTqRplCoggOrder1Pha.Val /end REF_MEASUREMENT /end GROUP
/begin GROUP MotRplCoggCfg.MotTqRplCoggOrder2Mgn.Val "MICROSAR RTE" /begin SUB_GROUP /end SUB_GROUP /begin FUNCTION_LIST /end FUNCTION_LIST /begin REF_CHARACTERISTIC /end REF_CHARACTERISTIC /begin REF_MEASUREMENT MotRplCoggCfg.MotTqRplCoggOrder2Mgn.Val /end REF_MEASUREMENT /end GROUP
/begin GROUP MotRplCoggCfg.MotTqRplCoggOrder2Pha.Val "MICROSAR RTE" /begin SUB_GROUP /end SUB_GROUP /begin FUNCTION_LIST /end FUNCTION_LIST /begin REF_CHARACTERISTIC /end REF_CHARACTERISTIC /begin REF_MEASUREMENT MotRplCoggCfg.MotTqRplCoggOrder2Pha.Val /end REF_MEASUREMENT /end GROUP
/begin GROUP MotRplCoggCfg.MotTqRplCoggOrder3Mgn.Val "MICROSAR RTE" /begin SUB_GROUP /end SUB_GROUP /begin FUNCTION_LIST /end FUNCTION_LIST /begin REF_CHARACTERISTIC /end REF_CHARACTERISTIC /begin REF_MEASUREMENT MotRplCoggCfg.MotTqRplCoggOrder3Mgn.Val /end REF_MEASUREMENT /end GROUP
/begin GROUP MotRplCoggCfg.MotTqRplCoggOrder3Pha.Val "MICROSAR RTE" /begin SUB_GROUP /end SUB_GROUP /begin FUNCTION_LIST /end FUNCTION_LIST /begin REF_CHARACTERISTIC /end REF_CHARACTERISTIC /begin REF_MEASUREMENT MotRplCoggCfg.MotTqRplCoggOrder3Pha.Val /end REF_MEASUREMENT /end GROUP
/begin GROUP MotRplCoggCfg.MotTqRplOrder1X "MICROSAR RTE" /begin SUB_GROUP /end SUB_GROUP /begin FUNCTION_LIST /end FUNCTION_LIST /begin REF_CHARACTERISTIC /end REF_CHARACTERISTIC /begin REF_MEASUREMENT MotRplCoggCfg.MotTqRplOrder1X /end REF_MEASUREMENT /end GROUP
/begin GROUP MotRplCoggCfg.MotTqRplOrder1Y "MICROSAR RTE" /begin SUB_GROUP /end SUB_GROUP /begin FUNCTION_LIST /end FUNCTION_LIST /begin REF_CHARACTERISTIC /end REF_CHARACTERISTIC /begin REF_MEASUREMENT MotRplCoggCfg.MotTqRplOrder1Y /end REF_MEASUREMENT /end GROUP
/begin GROUP MotRplCoggCfg.MotTqRplOrder2X "MICROSAR RTE" /begin SUB_GROUP /end SUB_GROUP /begin FUNCTION_LIST /end FUNCTION_LIST /begin REF_CHARACTERISTIC /end REF_CHARACTERISTIC /begin REF_MEASUREMENT MotRplCoggCfg.MotTqRplOrder2X /end REF_MEASUREMENT /end GROUP
/begin GROUP MotRplCoggCfg.MotTqRplOrder2Y "MICROSAR RTE" /begin SUB_GROUP /end SUB_GROUP /begin FUNCTION_LIST /end FUNCTION_LIST /begin REF_CHARACTERISTIC /end REF_CHARACTERISTIC /begin REF_MEASUREMENT MotRplCoggCfg.MotTqRplOrder2Y /end REF_MEASUREMENT /end GROUP
/begin GROUP MotRplCoggCfg.MotTqRplOrder3X "MICROSAR RTE" /begin SUB_GROUP /end SUB_GROUP /begin FUNCTION_LIST /end FUNCTION_LIST /begin REF_CHARACTERISTIC /end REF_CHARACTERISTIC /begin REF_MEASUREMENT MotRplCoggCfg.MotTqRplOrder3X /end REF_MEASUREMENT /end GROUP
/begin GROUP MotRplCoggCfg.MotTqRplOrder3Y "MICROSAR RTE" /begin SUB_GROUP /end SUB_GROUP /begin FUNCTION_LIST /end FUNCTION_LIST /begin REF_CHARACTERISTIC /end REF_CHARACTERISTIC /begin REF_MEASUREMENT MotRplCoggCfg.MotTqRplOrder3Y /end REF_MEASUREMENT /end GROUP
/begin GROUP MotRplCoggCfg.MotVelMrf.Val "MICROSAR RTE" /begin SUB_GROUP /end SUB_GROUP /begin FUNCTION_LIST /end FUNCTION_LIST /begin REF_CHARACTERISTIC /end REF_CHARACTERISTIC /begin REF_MEASUREMENT MotRplCoggCfg.MotVelMrf.Val /end REF_MEASUREMENT /end GROUP
/begin GROUP MotRplCoggCfg.PerInstanceMemories "MICROSAR RTE"
 /begin SUB_GROUP MotRplCoggCfg.MotRplCoggPrm MotRplCoggCfg.MotTqRplOrder1X MotRplCoggCfg.MotTqRplOrder1Y MotRplCoggCfg.MotTqRplOrder2X MotRplCoggCfg.MotTqRplOrder2Y MotRplCoggCfg.MotTqRplOrder3X MotRplCoggCfg.MotTqRplOrder3Y MotRplCoggCfg.dMotRplCoggCfgMotAgElecDlyRpl MotRplCoggCfg.dMotRplCoggCfgMotCurrQaxToMotTqGain MotRplCoggCfg.dMotRplCoggCfgMotTqRplOrder1Mgn MotRplCoggCfg.dMotRplCoggCfgMotTqRplOrder1Pha MotRplCoggCfg.dMotRplCoggCfgMotTqRplOrder2Mgn MotRplCoggCfg.dMotRplCoggCfgMotTqRplOrder2Pha MotRplCoggCfg.dMotRplCoggCfgMotTqRplOrder3Mgn MotRplCoggCfg.dMotRplCoggCfgMotTqRplOrder3Pha /end SUB_GROUP
 /begin FUNCTION_LIST /end FUNCTION_LIST
 /begin REF_CHARACTERISTIC /end REF_CHARACTERISTIC
 /begin REF_MEASUREMENT /end REF_MEASUREMENT
/end GROUP
/begin GROUP MotRplCoggCfg.ReceiverPorts "MICROSAR RTE"
 /begin SUB_GROUP MotRplCoggCfg.MotBackEmfConEstimd.Val MotRplCoggCfg.MotCurrDaxCmd.Val MotRplCoggCfg.MotCurrQaxCmd.Val MotRplCoggCfg.MotInduDaxEstimd.Val MotRplCoggCfg.MotInduQaxEstimd.Val MotRplCoggCfg.MotTqCmdMrfScad.Val MotRplCoggCfg.MotVelMrf.Val /end SUB_GROUP
 /begin FUNCTION_LIST /end FUNCTION_LIST
 /begin REF_CHARACTERISTIC /end REF_CHARACTERISTIC
 /begin REF_MEASUREMENT /end REF_MEASUREMENT
/end GROUP
/begin GROUP MotRplCoggCfg.SenderPorts "MICROSAR RTE"
 /begin SUB_GROUP MotRplCoggCfg.MotAgElecDlyRpl.Val MotRplCoggCfg.MotCurrQaxToMotTqGain.Val MotRplCoggCfg.MotTqRplCoggOrder1Mgn.Val MotRplCoggCfg.MotTqRplCoggOrder1Pha.Val MotRplCoggCfg.MotTqRplCoggOrder2Mgn.Val MotRplCoggCfg.MotTqRplCoggOrder2Pha.Val MotRplCoggCfg.MotTqRplCoggOrder3Mgn.Val MotRplCoggCfg.MotTqRplCoggOrder3Pha.Val /end SUB_GROUP
 /begin FUNCTION_LIST /end FUNCTION_LIST
 /begin REF_CHARACTERISTIC /end REF_CHARACTERISTIC
 /begin REF_MEASUREMENT /end REF_MEASUREMENT
/end GROUP
/begin GROUP MotRplCoggCfg.SysGlbPrmMotPoleCnt.Val "MICROSAR RTE" /begin SUB_GROUP /end SUB_GROUP /begin FUNCTION_LIST /end FUNCTION_LIST /begin REF_CHARACTERISTIC MotRplCoggCfg.SysGlbPrmMotPoleCnt.Val /end REF_CHARACTERISTIC /begin REF_MEASUREMENT /end REF_MEASUREMENT /end GROUP
/begin GROUP MotRplCoggCfg.dMotRplCoggCfgMotAgElecDlyRpl "MICROSAR RTE" /begin SUB_GROUP /end SUB_GROUP /begin FUNCTION_LIST /end FUNCTION_LIST /begin REF_CHARACTERISTIC /end REF_CHARACTERISTIC /begin REF_MEASUREMENT MotRplCoggCfg.dMotRplCoggCfgMotAgElecDlyRpl /end REF_MEASUREMENT /end GROUP
/begin GROUP MotRplCoggCfg.dMotRplCoggCfgMotCurrQaxToMotTqGain "MICROSAR RTE" /begin SUB_GROUP /end SUB_GROUP /begin FUNCTION_LIST /end FUNCTION_LIST /begin REF_CHARACTERISTIC /end REF_CHARACTERISTIC /begin REF_MEASUREMENT MotRplCoggCfg.dMotRplCoggCfgMotCurrQaxToMotTqGain /end REF_MEASUREMENT /end GROUP
/begin GROUP MotRplCoggCfg.dMotRplCoggCfgMotTqRplOrder1Mgn "MICROSAR RTE" /begin SUB_GROUP /end SUB_GROUP /begin FUNCTION_LIST /end FUNCTION_LIST /begin REF_CHARACTERISTIC /end REF_CHARACTERISTIC /begin REF_MEASUREMENT MotRplCoggCfg.dMotRplCoggCfgMotTqRplOrder1Mgn /end REF_MEASUREMENT /end GROUP
/begin GROUP MotRplCoggCfg.dMotRplCoggCfgMotTqRplOrder1Pha "MICROSAR RTE" /begin SUB_GROUP /end SUB_GROUP /begin FUNCTION_LIST /end FUNCTION_LIST /begin REF_CHARACTERISTIC /end REF_CHARACTERISTIC /begin REF_MEASUREMENT MotRplCoggCfg.dMotRplCoggCfgMotTqRplOrder1Pha /end REF_MEASUREMENT /end GROUP
/begin GROUP MotRplCoggCfg.dMotRplCoggCfgMotTqRplOrder2Mgn "MICROSAR RTE" /begin SUB_GROUP /end SUB_GROUP /begin FUNCTION_LIST /end FUNCTION_LIST /begin REF_CHARACTERISTIC /end REF_CHARACTERISTIC /begin REF_MEASUREMENT MotRplCoggCfg.dMotRplCoggCfgMotTqRplOrder2Mgn /end REF_MEASUREMENT /end GROUP
/begin GROUP MotRplCoggCfg.dMotRplCoggCfgMotTqRplOrder2Pha "MICROSAR RTE" /begin SUB_GROUP /end SUB_GROUP /begin FUNCTION_LIST /end FUNCTION_LIST /begin REF_CHARACTERISTIC /end REF_CHARACTERISTIC /begin REF_MEASUREMENT MotRplCoggCfg.dMotRplCoggCfgMotTqRplOrder2Pha /end REF_MEASUREMENT /end GROUP
/begin GROUP MotRplCoggCfg.dMotRplCoggCfgMotTqRplOrder3Mgn "MICROSAR RTE" /begin SUB_GROUP /end SUB_GROUP /begin FUNCTION_LIST /end FUNCTION_LIST /begin REF_CHARACTERISTIC /end REF_CHARACTERISTIC /begin REF_MEASUREMENT MotRplCoggCfg.dMotRplCoggCfgMotTqRplOrder3Mgn /end REF_MEASUREMENT /end GROUP
/begin GROUP MotRplCoggCfg.dMotRplCoggCfgMotTqRplOrder3Pha "MICROSAR RTE" /begin SUB_GROUP /end SUB_GROUP /begin FUNCTION_LIST /end FUNCTION_LIST /begin REF_CHARACTERISTIC /end REF_CHARACTERISTIC /begin REF_MEASUREMENT MotRplCoggCfg.dMotRplCoggCfgMotTqRplOrder3Pha /end REF_MEASUREMENT /end GROUP
/begin GROUP MotTqCmdSca "MICROSAR RTE"
 /begin SUB_GROUP MotTqCmdSca.CalibrationPorts MotTqCmdSca.PerInstanceMemories MotTqCmdSca.ReceiverPorts MotTqCmdSca.SenderPorts /end SUB_GROUP
 /begin FUNCTION_LIST /end FUNCTION_LIST
 /begin REF_CHARACTERISTIC /end REF_CHARACTERISTIC
 /begin REF_MEASUREMENT /end REF_MEASUREMENT
/end GROUP
/begin GROUP MotTqCmdSca.CalibrationPorts "MICROSAR RTE"
 /begin SUB_GROUP MotTqCmdSca.MotTqCmdScaMax.Val MotTqCmdSca.MotTqCmdScaMin.Val /end SUB_GROUP
 /begin FUNCTION_LIST /end FUNCTION_LIST
 /begin REF_CHARACTERISTIC /end REF_CHARACTERISTIC
 /begin REF_MEASUREMENT /end REF_MEASUREMENT
/end GROUP
/begin GROUP MotTqCmdSca.MotTqCmdMrf.Val "MICROSAR RTE" /begin SUB_GROUP /end SUB_GROUP /begin FUNCTION_LIST /end FUNCTION_LIST /begin REF_CHARACTERISTIC /end REF_CHARACTERISTIC /begin REF_MEASUREMENT MotTqCmdSca.MotTqCmdMrf.Val /end REF_MEASUREMENT /end GROUP
/begin GROUP MotTqCmdSca.MotTqCmdMrfScad.Val "MICROSAR RTE" /begin SUB_GROUP /end SUB_GROUP /begin FUNCTION_LIST /end FUNCTION_LIST /begin REF_CHARACTERISTIC /end REF_CHARACTERISTIC /begin REF_MEASUREMENT MotTqCmdSca.MotTqCmdMrfScad.Val /end REF_MEASUREMENT /end GROUP
/begin GROUP MotTqCmdSca.MotTqCmdScaMax.Val "MICROSAR RTE" /begin SUB_GROUP /end SUB_GROUP /begin FUNCTION_LIST /end FUNCTION_LIST /begin REF_CHARACTERISTIC MotTqCmdSca.MotTqCmdScaMax.Val /end REF_CHARACTERISTIC /begin REF_MEASUREMENT /end REF_MEASUREMENT /end GROUP
/begin GROUP MotTqCmdSca.MotTqCmdScaMin.Val "MICROSAR RTE" /begin SUB_GROUP /end SUB_GROUP /begin FUNCTION_LIST /end FUNCTION_LIST /begin REF_CHARACTERISTIC MotTqCmdSca.MotTqCmdScaMin.Val /end REF_CHARACTERISTIC /begin REF_MEASUREMENT /end REF_MEASUREMENT /end GROUP
/begin GROUP MotTqCmdSca.MotTqScaFac "MICROSAR RTE" /begin SUB_GROUP /end SUB_GROUP /begin FUNCTION_LIST /end FUNCTION_LIST /begin REF_CHARACTERISTIC /end REF_CHARACTERISTIC /begin REF_MEASUREMENT MotTqCmdSca.MotTqScaFac /end REF_MEASUREMENT /end GROUP
/begin GROUP MotTqCmdSca.PerInstanceMemories "MICROSAR RTE" /begin SUB_GROUP MotTqCmdSca.MotTqScaFac /end SUB_GROUP /begin FUNCTION_LIST /end FUNCTION_LIST /begin REF_CHARACTERISTIC /end REF_CHARACTERISTIC /begin REF_MEASUREMENT /end REF_MEASUREMENT /end GROUP
/begin GROUP MotTqCmdSca.ReceiverPorts "MICROSAR RTE" /begin SUB_GROUP MotTqCmdSca.MotTqCmdMrf.Val /end SUB_GROUP /begin FUNCTION_LIST /end FUNCTION_LIST /begin REF_CHARACTERISTIC /end REF_CHARACTERISTIC /begin REF_MEASUREMENT /end REF_MEASUREMENT /end GROUP
/begin GROUP MotTqCmdSca.SenderPorts "MICROSAR RTE" /begin SUB_GROUP MotTqCmdSca.MotTqCmdMrfScad.Val /end SUB_GROUP /begin FUNCTION_LIST /end FUNCTION_LIST /begin REF_CHARACTERISTIC /end REF_CHARACTERISTIC /begin REF_MEASUREMENT /end REF_MEASUREMENT /end GROUP
/begin GROUP MotTqTranlDampg "MICROSAR RTE"
 /begin SUB_GROUP MotTqTranlDampg.CalibrationPorts MotTqTranlDampg.PerInstanceMemories MotTqTranlDampg.ReceiverPorts MotTqTranlDampg.SenderPorts /end SUB_GROUP
 /begin FUNCTION_LIST /end FUNCTION_LIST
 /begin REF_CHARACTERISTIC /end REF_CHARACTERISTIC
 /begin REF_MEASUREMENT /end REF_MEASUREMENT
/end GROUP
/begin GROUP MotTqTranlDampg.AssiMechPolarity.Val "MICROSAR RTE" /begin SUB_GROUP /end SUB_GROUP /begin FUNCTION_LIST /end FUNCTION_LIST /begin REF_CHARACTERISTIC /end REF_CHARACTERISTIC /begin REF_MEASUREMENT MotTqTranlDampg.AssiMechPolarity.Val /end REF_MEASUREMENT /end GROUP
/begin GROUP MotTqTranlDampg.CalibrationPorts "MICROSAR RTE"
 /begin SUB_GROUP MotTqTranlDampg.MotTqTranlDampgCmdLim.Val MotTqTranlDampg.MotTqTranlDampgDampgCoeff.Val MotTqTranlDampg.MotTqTranlDampgRampEnd.Val MotTqTranlDampg.MotTqTranlDampgTmrPt1.Val MotTqTranlDampg.MotTqTranlDampgTmrPt2.Val MotTqTranlDampg.MotTqTranlDampgVehSpdBlndX.Ary1D MotTqTranlDampg.MotTqTranlDampgVehSpdBlndY.Ary1D MotTqTranlDampg.MotTqTranlDampgVelThd.Val /end SUB_GROUP
 /begin FUNCTION_LIST /end FUNCTION_LIST
 /begin REF_CHARACTERISTIC /end REF_CHARACTERISTIC
 /begin REF_MEASUREMENT /end REF_MEASUREMENT
/end GROUP
/begin GROUP MotTqTranlDampg.DiagStsPrev "MICROSAR RTE" /begin SUB_GROUP /end SUB_GROUP /begin FUNCTION_LIST /end FUNCTION_LIST /begin REF_CHARACTERISTIC /end REF_CHARACTERISTIC /begin REF_MEASUREMENT MotTqTranlDampg.DiagStsPrev /end REF_MEASUREMENT /end GROUP
/begin GROUP MotTqTranlDampg.DiagcStsCtrldShtDwnFltPrsnt.Logl "MICROSAR RTE" /begin SUB_GROUP /end SUB_GROUP /begin FUNCTION_LIST /end FUNCTION_LIST /begin REF_CHARACTERISTIC /end REF_CHARACTERISTIC /begin REF_MEASUREMENT MotTqTranlDampg.DiagcStsCtrldShtDwnFltPrsnt.Logl /end REF_MEASUREMENT /end GROUP
/begin GROUP MotTqTranlDampg.HwAg.Val "MICROSAR RTE" /begin SUB_GROUP /end SUB_GROUP /begin FUNCTION_LIST /end FUNCTION_LIST /begin REF_CHARACTERISTIC /end REF_CHARACTERISTIC /begin REF_MEASUREMENT MotTqTranlDampg.HwAg.Val /end REF_MEASUREMENT /end GROUP
/begin GROUP MotTqTranlDampg.LoaSt.Val "MICROSAR RTE" /begin SUB_GROUP /end SUB_GROUP /begin FUNCTION_LIST /end FUNCTION_LIST /begin REF_CHARACTERISTIC /end REF_CHARACTERISTIC /begin REF_MEASUREMENT MotTqTranlDampg.LoaSt.Val /end REF_MEASUREMENT /end GROUP
/begin GROUP MotTqTranlDampg.LoaStPrev "MICROSAR RTE" /begin SUB_GROUP /end SUB_GROUP /begin FUNCTION_LIST /end FUNCTION_LIST /begin REF_CHARACTERISTIC /end REF_CHARACTERISTIC /begin REF_MEASUREMENT MotTqTranlDampg.LoaStPrev /end REF_MEASUREMENT /end GROUP
/begin GROUP MotTqTranlDampg.MotTqCmdCrf.Val "MICROSAR RTE" /begin SUB_GROUP /end SUB_GROUP /begin FUNCTION_LIST /end FUNCTION_LIST /begin REF_CHARACTERISTIC /end REF_CHARACTERISTIC /begin REF_MEASUREMENT MotTqTranlDampg.MotTqCmdCrf.Val /end REF_MEASUREMENT /end GROUP
/begin GROUP MotTqTranlDampg.MotTqCmdCrfDampd.Val "MICROSAR RTE" /begin SUB_GROUP /end SUB_GROUP /begin FUNCTION_LIST /end FUNCTION_LIST /begin REF_CHARACTERISTIC /end REF_CHARACTERISTIC /begin REF_MEASUREMENT MotTqTranlDampg.MotTqCmdCrfDampd.Val /end REF_MEASUREMENT /end GROUP
/begin GROUP MotTqTranlDampg.MotTqCmdMrfDampd.Val "MICROSAR RTE" /begin SUB_GROUP /end SUB_GROUP /begin FUNCTION_LIST /end FUNCTION_LIST /begin REF_CHARACTERISTIC /end REF_CHARACTERISTIC /begin REF_MEASUREMENT MotTqTranlDampg.MotTqCmdMrfDampd.Val /end REF_MEASUREMENT /end GROUP
/begin GROUP MotTqTranlDampg.MotTqTranlDampgCmdLim.Val "MICROSAR RTE" /begin SUB_GROUP /end SUB_GROUP /begin FUNCTION_LIST /end FUNCTION_LIST /begin REF_CHARACTERISTIC MotTqTranlDampg.MotTqTranlDampgCmdLim.Val /end REF_CHARACTERISTIC /begin REF_MEASUREMENT /end REF_MEASUREMENT /end GROUP
/begin GROUP MotTqTranlDampg.MotTqTranlDampgCmpl.Logl "MICROSAR RTE" /begin SUB_GROUP /end SUB_GROUP /begin FUNCTION_LIST /end FUNCTION_LIST /begin REF_CHARACTERISTIC /end REF_CHARACTERISTIC /begin REF_MEASUREMENT MotTqTranlDampg.MotTqTranlDampgCmpl.Logl /end REF_MEASUREMENT /end GROUP
/begin GROUP MotTqTranlDampg.MotTqTranlDampgDampgCoeff.Val "MICROSAR RTE" /begin SUB_GROUP /end SUB_GROUP /begin FUNCTION_LIST /end FUNCTION_LIST /begin REF_CHARACTERISTIC MotTqTranlDampg.MotTqTranlDampgDampgCoeff.Val /end REF_CHARACTERISTIC /begin REF_MEASUREMENT /end REF_MEASUREMENT /end GROUP
/begin GROUP MotTqTranlDampg.MotTqTranlDampgRampEnd.Val "MICROSAR RTE" /begin SUB_GROUP /end SUB_GROUP /begin FUNCTION_LIST /end FUNCTION_LIST /begin REF_CHARACTERISTIC MotTqTranlDampg.MotTqTranlDampgRampEnd.Val /end REF_CHARACTERISTIC /begin REF_MEASUREMENT /end REF_MEASUREMENT /end GROUP
/begin GROUP MotTqTranlDampg.MotTqTranlDampgTmrPt1.Val "MICROSAR RTE" /begin SUB_GROUP /end SUB_GROUP /begin FUNCTION_LIST /end FUNCTION_LIST /begin REF_CHARACTERISTIC MotTqTranlDampg.MotTqTranlDampgTmrPt1.Val /end REF_CHARACTERISTIC /begin REF_MEASUREMENT /end REF_MEASUREMENT /end GROUP
/begin GROUP MotTqTranlDampg.MotTqTranlDampgTmrPt2.Val "MICROSAR RTE" /begin SUB_GROUP /end SUB_GROUP /begin FUNCTION_LIST /end FUNCTION_LIST /begin REF_CHARACTERISTIC MotTqTranlDampg.MotTqTranlDampgTmrPt2.Val /end REF_CHARACTERISTIC /begin REF_MEASUREMENT /end REF_MEASUREMENT /end GROUP
/begin GROUP MotTqTranlDampg.MotTqTranlDampgVehSpdBlndX.Ary1D "MICROSAR RTE" /begin SUB_GROUP /end SUB_GROUP /begin FUNCTION_LIST /end FUNCTION_LIST /begin REF_CHARACTERISTIC MotTqTranlDampg.MotTqTranlDampgVehSpdBlndX.Ary1D /end REF_CHARACTERISTIC /begin REF_MEASUREMENT /end REF_MEASUREMENT /end GROUP
/begin GROUP MotTqTranlDampg.MotTqTranlDampgVehSpdBlndY.Ary1D "MICROSAR RTE" /begin SUB_GROUP /end SUB_GROUP /begin FUNCTION_LIST /end FUNCTION_LIST /begin REF_CHARACTERISTIC MotTqTranlDampg.MotTqTranlDampgVehSpdBlndY.Ary1D /end REF_CHARACTERISTIC /begin REF_MEASUREMENT /end REF_MEASUREMENT /end GROUP
/begin GROUP MotTqTranlDampg.MotTqTranlDampgVelThd.Val "MICROSAR RTE" /begin SUB_GROUP /end SUB_GROUP /begin FUNCTION_LIST /end FUNCTION_LIST /begin REF_CHARACTERISTIC MotTqTranlDampg.MotTqTranlDampgVelThd.Val /end REF_CHARACTERISTIC /begin REF_MEASUREMENT /end REF_MEASUREMENT /end GROUP
/begin GROUP MotTqTranlDampg.MotVelCrf.Val "MICROSAR RTE" /begin SUB_GROUP /end SUB_GROUP /begin FUNCTION_LIST /end FUNCTION_LIST /begin REF_CHARACTERISTIC /end REF_CHARACTERISTIC /begin REF_MEASUREMENT MotTqTranlDampg.MotVelCrf.Val /end REF_MEASUREMENT /end GROUP
/begin GROUP MotTqTranlDampg.PerInstanceMemories "MICROSAR RTE"
 /begin SUB_GROUP MotTqTranlDampg.DiagStsPrev MotTqTranlDampg.LoaStPrev MotTqTranlDampg.StLtchPrev MotTqTranlDampg.TmrRefTi MotTqTranlDampg.dMotTqTranlDampgCmdCtrld MotTqTranlDampg.dMotTqTranlDampgSignPhaSca MotTqTranlDampg.dMotTqTranlDampgTiElpd MotTqTranlDampg.dMotTqTranlDampgTmrEna MotTqTranlDampg.dMotTqTranlDampgVelDampgCmd /end SUB_GROUP
 /begin FUNCTION_LIST /end FUNCTION_LIST
 /begin REF_CHARACTERISTIC /end REF_CHARACTERISTIC
 /begin REF_MEASUREMENT /end REF_MEASUREMENT
/end GROUP
/begin GROUP MotTqTranlDampg.ReceiverPorts "MICROSAR RTE"
 /begin SUB_GROUP MotTqTranlDampg.AssiMechPolarity.Val MotTqTranlDampg.DiagcStsCtrldShtDwnFltPrsnt.Logl MotTqTranlDampg.HwAg.Val MotTqTranlDampg.LoaSt.Val MotTqTranlDampg.MotTqCmdCrf.Val MotTqTranlDampg.MotVelCrf.Val MotTqTranlDampg.SysSt.Val MotTqTranlDampg.VehSpd.Val /end SUB_GROUP
 /begin FUNCTION_LIST /end FUNCTION_LIST
 /begin REF_CHARACTERISTIC /end REF_CHARACTERISTIC
 /begin REF_MEASUREMENT /end REF_MEASUREMENT
/end GROUP
/begin GROUP MotTqTranlDampg.SenderPorts "MICROSAR RTE"
 /begin SUB_GROUP MotTqTranlDampg.MotTqCmdCrfDampd.Val MotTqTranlDampg.MotTqCmdMrfDampd.Val MotTqTranlDampg.MotTqTranlDampgCmpl.Logl /end SUB_GROUP
 /begin FUNCTION_LIST /end FUNCTION_LIST
 /begin REF_CHARACTERISTIC /end REF_CHARACTERISTIC
 /begin REF_MEASUREMENT /end REF_MEASUREMENT
/end GROUP
/begin GROUP MotTqTranlDampg.StLtchPrev "MICROSAR RTE" /begin SUB_GROUP /end SUB_GROUP /begin FUNCTION_LIST /end FUNCTION_LIST /begin REF_CHARACTERISTIC /end REF_CHARACTERISTIC /begin REF_MEASUREMENT MotTqTranlDampg.StLtchPrev /end REF_MEASUREMENT /end GROUP
/begin GROUP MotTqTranlDampg.SysSt.Val "MICROSAR RTE" /begin SUB_GROUP /end SUB_GROUP /begin FUNCTION_LIST /end FUNCTION_LIST /begin REF_CHARACTERISTIC /end REF_CHARACTERISTIC /begin REF_MEASUREMENT MotTqTranlDampg.SysSt.Val /end REF_MEASUREMENT /end GROUP
/begin GROUP MotTqTranlDampg.TmrRefTi "MICROSAR RTE" /begin SUB_GROUP /end SUB_GROUP /begin FUNCTION_LIST /end FUNCTION_LIST /begin REF_CHARACTERISTIC /end REF_CHARACTERISTIC /begin REF_MEASUREMENT MotTqTranlDampg.TmrRefTi /end REF_MEASUREMENT /end GROUP
/begin GROUP MotTqTranlDampg.VehSpd.Val "MICROSAR RTE" /begin SUB_GROUP /end SUB_GROUP /begin FUNCTION_LIST /end FUNCTION_LIST /begin REF_CHARACTERISTIC /end REF_CHARACTERISTIC /begin REF_MEASUREMENT MotTqTranlDampg.VehSpd.Val /end REF_MEASUREMENT /end GROUP
/begin GROUP MotTqTranlDampg.dMotTqTranlDampgCmdCtrld "MICROSAR RTE" /begin SUB_GROUP /end SUB_GROUP /begin FUNCTION_LIST /end FUNCTION_LIST /begin REF_CHARACTERISTIC /end REF_CHARACTERISTIC /begin REF_MEASUREMENT MotTqTranlDampg.dMotTqTranlDampgCmdCtrld /end REF_MEASUREMENT /end GROUP
/begin GROUP MotTqTranlDampg.dMotTqTranlDampgSignPhaSca "MICROSAR RTE" /begin SUB_GROUP /end SUB_GROUP /begin FUNCTION_LIST /end FUNCTION_LIST /begin REF_CHARACTERISTIC /end REF_CHARACTERISTIC /begin REF_MEASUREMENT MotTqTranlDampg.dMotTqTranlDampgSignPhaSca /end REF_MEASUREMENT /end GROUP
/begin GROUP MotTqTranlDampg.dMotTqTranlDampgTiElpd "MICROSAR RTE" /begin SUB_GROUP /end SUB_GROUP /begin FUNCTION_LIST /end FUNCTION_LIST /begin REF_CHARACTERISTIC /end REF_CHARACTERISTIC /begin REF_MEASUREMENT MotTqTranlDampg.dMotTqTranlDampgTiElpd /end REF_MEASUREMENT /end GROUP
/begin GROUP MotTqTranlDampg.dMotTqTranlDampgTmrEna "MICROSAR RTE" /begin SUB_GROUP /end SUB_GROUP /begin FUNCTION_LIST /end FUNCTION_LIST /begin REF_CHARACTERISTIC /end REF_CHARACTERISTIC /begin REF_MEASUREMENT MotTqTranlDampg.dMotTqTranlDampgTmrEna /end REF_MEASUREMENT /end GROUP
/begin GROUP MotTqTranlDampg.dMotTqTranlDampgVelDampgCmd "MICROSAR RTE" /begin SUB_GROUP /end SUB_GROUP /begin FUNCTION_LIST /end FUNCTION_LIST /begin REF_CHARACTERISTIC /end REF_CHARACTERISTIC /begin REF_MEASUREMENT MotTqTranlDampg.dMotTqTranlDampgVelDampgCmd /end REF_MEASUREMENT /end GROUP
/begin GROUP MotVelCtrl "MICROSAR RTE" /begin SUB_GROUP MotVelCtrl.PerInstanceMemories MotVelCtrl.ReceiverPorts /end SUB_GROUP /begin FUNCTION_LIST /end FUNCTION_LIST /begin REF_CHARACTERISTIC /end REF_CHARACTERISTIC /begin REF_MEASUREMENT /end REF_MEASUREMENT /end GROUP
/begin GROUP MotVelCtrl.EnaCtrl "MICROSAR RTE" /begin SUB_GROUP /end SUB_GROUP /begin FUNCTION_LIST /end FUNCTION_LIST /begin REF_CHARACTERISTIC /end REF_CHARACTERISTIC /begin REF_MEASUREMENT MotVelCtrl.EnaCtrl /end REF_MEASUREMENT /end GROUP
/begin GROUP MotVelCtrl.EnaCtrlStVari "MICROSAR RTE" /begin SUB_GROUP /end SUB_GROUP /begin FUNCTION_LIST /end FUNCTION_LIST /begin REF_CHARACTERISTIC /end REF_CHARACTERISTIC /begin REF_MEASUREMENT MotVelCtrl.EnaCtrlStVari /end REF_MEASUREMENT /end GROUP
/begin GROUP MotVelCtrl.FctActvSts "MICROSAR RTE" /begin SUB_GROUP /end SUB_GROUP /begin FUNCTION_LIST /end FUNCTION_LIST /begin REF_CHARACTERISTIC /end REF_CHARACTERISTIC /begin REF_MEASUREMENT MotVelCtrl.FctActvSts /end REF_MEASUREMENT /end GROUP
/begin GROUP MotVelCtrl.MotVelCrf.Val "MICROSAR RTE" /begin SUB_GROUP /end SUB_GROUP /begin FUNCTION_LIST /end FUNCTION_LIST /begin REF_CHARACTERISTIC /end REF_CHARACTERISTIC /begin REF_MEASUREMENT MotVelCtrl.MotVelCrf.Val /end REF_MEASUREMENT /end GROUP
/begin GROUP MotVelCtrl.MotVelTar "MICROSAR RTE" /begin SUB_GROUP /end SUB_GROUP /begin FUNCTION_LIST /end FUNCTION_LIST /begin REF_CHARACTERISTIC /end REF_CHARACTERISTIC /begin REF_MEASUREMENT MotVelCtrl.MotVelTar /end REF_MEASUREMENT /end GROUP
/begin GROUP MotVelCtrl.PerInstanceMemories "MICROSAR RTE"
 /begin SUB_GROUP MotVelCtrl.EnaCtrl MotVelCtrl.EnaCtrlStVari MotVelCtrl.FctActvSts MotVelCtrl.MotVelTar MotVelCtrl.PrevAntiWdupCmd MotVelCtrl.PrevDerivtvOutp MotVelCtrl.PrevIntgtrInp MotVelCtrl.PrevIntgtrOutp MotVelCtrl.PrevMotVelErr MotVelCtrl.PrevMotVelTar MotVelCtrl.RampDwnCmpl MotVelCtrl.RefTiRampDwn MotVelCtrl.VelSlewRate /end SUB_GROUP
 /begin FUNCTION_LIST /end FUNCTION_LIST
 /begin REF_CHARACTERISTIC /end REF_CHARACTERISTIC
 /begin REF_MEASUREMENT /end REF_MEASUREMENT
/end GROUP
/begin GROUP MotVelCtrl.PrevAntiWdupCmd "MICROSAR RTE" /begin SUB_GROUP /end SUB_GROUP /begin FUNCTION_LIST /end FUNCTION_LIST /begin REF_CHARACTERISTIC /end REF_CHARACTERISTIC /begin REF_MEASUREMENT MotVelCtrl.PrevAntiWdupCmd /end REF_MEASUREMENT /end GROUP
/begin GROUP MotVelCtrl.PrevDerivtvOutp "MICROSAR RTE" /begin SUB_GROUP /end SUB_GROUP /begin FUNCTION_LIST /end FUNCTION_LIST /begin REF_CHARACTERISTIC /end REF_CHARACTERISTIC /begin REF_MEASUREMENT MotVelCtrl.PrevDerivtvOutp /end REF_MEASUREMENT /end GROUP
/begin GROUP MotVelCtrl.PrevIntgtrInp "MICROSAR RTE" /begin SUB_GROUP /end SUB_GROUP /begin FUNCTION_LIST /end FUNCTION_LIST /begin REF_CHARACTERISTIC /end REF_CHARACTERISTIC /begin REF_MEASUREMENT MotVelCtrl.PrevIntgtrInp /end REF_MEASUREMENT /end GROUP
/begin GROUP MotVelCtrl.PrevIntgtrOutp "MICROSAR RTE" /begin SUB_GROUP /end SUB_GROUP /begin FUNCTION_LIST /end FUNCTION_LIST /begin REF_CHARACTERISTIC /end REF_CHARACTERISTIC /begin REF_MEASUREMENT MotVelCtrl.PrevIntgtrOutp /end REF_MEASUREMENT /end GROUP
/begin GROUP MotVelCtrl.PrevMotVelErr "MICROSAR RTE" /begin SUB_GROUP /end SUB_GROUP /begin FUNCTION_LIST /end FUNCTION_LIST /begin REF_CHARACTERISTIC /end REF_CHARACTERISTIC /begin REF_MEASUREMENT MotVelCtrl.PrevMotVelErr /end REF_MEASUREMENT /end GROUP
/begin GROUP MotVelCtrl.PrevMotVelTar "MICROSAR RTE" /begin SUB_GROUP /end SUB_GROUP /begin FUNCTION_LIST /end FUNCTION_LIST /begin REF_CHARACTERISTIC /end REF_CHARACTERISTIC /begin REF_MEASUREMENT MotVelCtrl.PrevMotVelTar /end REF_MEASUREMENT /end GROUP
/begin GROUP MotVelCtrl.RampDwnCmpl "MICROSAR RTE" /begin SUB_GROUP /end SUB_GROUP /begin FUNCTION_LIST /end FUNCTION_LIST /begin REF_CHARACTERISTIC /end REF_CHARACTERISTIC /begin REF_MEASUREMENT MotVelCtrl.RampDwnCmpl /end REF_MEASUREMENT /end GROUP
/begin GROUP MotVelCtrl.ReceiverPorts "MICROSAR RTE" /begin SUB_GROUP MotVelCtrl.MotVelCrf.Val /end SUB_GROUP /begin FUNCTION_LIST /end FUNCTION_LIST /begin REF_CHARACTERISTIC /end REF_CHARACTERISTIC /begin REF_MEASUREMENT /end REF_MEASUREMENT /end GROUP
/begin GROUP MotVelCtrl.RefTiRampDwn "MICROSAR RTE" /begin SUB_GROUP /end SUB_GROUP /begin FUNCTION_LIST /end FUNCTION_LIST /begin REF_CHARACTERISTIC /end REF_CHARACTERISTIC /begin REF_MEASUREMENT MotVelCtrl.RefTiRampDwn /end REF_MEASUREMENT /end GROUP
/begin GROUP MotVelCtrl.VelSlewRate "MICROSAR RTE" /begin SUB_GROUP /end SUB_GROUP /begin FUNCTION_LIST /end FUNCTION_LIST /begin REF_CHARACTERISTIC /end REF_CHARACTERISTIC /begin REF_MEASUREMENT MotVelCtrl.VelSlewRate /end REF_MEASUREMENT /end GROUP
/begin GROUP NxtrCalIds "MICROSAR RTE" /begin SUB_GROUP NxtrCalIds.CalibrationPorts /end SUB_GROUP /begin FUNCTION_LIST /end FUNCTION_LIST /begin REF_CHARACTERISTIC /end REF_CHARACTERISTIC /begin REF_MEASUREMENT /end REF_MEASUREMENT /end GROUP
/begin GROUP NxtrCalIds.CalibrationPorts "MICROSAR RTE"
 /begin SUB_GROUP NxtrCalIds.NxtrCalIdsCal0DevlpAuthor.Ary1D NxtrCalIds.NxtrCalIdsCal0DevlpDescr.Ary1D NxtrCalIds.NxtrCalIdsCal0DevlpRelNr.Val NxtrCalIds.NxtrCalIdsCal0DevlpRelSt.Val NxtrCalIds.NxtrCalIdsCal0DevlpTiStamp.Val NxtrCalIds.NxtrCalIdsCal0DevlpVers.Val NxtrCalIds.NxtrCalIdsCal1DevlpAuthor.Ary1D NxtrCalIds.NxtrCalIdsCal1DevlpRelNr.Val NxtrCalIds.NxtrCalIdsCal1DevlpRelSt.Val NxtrCalIds.NxtrCalIdsCal1DevlpTiStamp.Val NxtrCalIds.NxtrCalIdsCal1DevlpVers.Val NxtrCalIds.NxtrCalIdsCal2DevlpAuthor.Ary1D NxtrCalIds.NxtrCalIdsCal2DevlpDescr.Ary1D NxtrCalIds.NxtrCalIdsCal2DevlpRelNr.Val NxtrCalIds.NxtrCalIdsCal2DevlpRelSt.Val NxtrCalIds.NxtrCalIdsCal2DevlpTiStamp.Val NxtrCalIds.NxtrCalIdsCal2DevlpVers.Val /end SUB_GROUP
 /begin FUNCTION_LIST /end FUNCTION_LIST
 /begin REF_CHARACTERISTIC /end REF_CHARACTERISTIC
 /begin REF_MEASUREMENT /end REF_MEASUREMENT
/end GROUP
/begin GROUP NxtrCalIds.NxtrCalIdsCal0DevlpAuthor.Ary1D "MICROSAR RTE" /begin SUB_GROUP /end SUB_GROUP /begin FUNCTION_LIST /end FUNCTION_LIST /begin REF_CHARACTERISTIC NxtrCalIds.NxtrCalIdsCal0DevlpAuthor.Ary1D /end REF_CHARACTERISTIC /begin REF_MEASUREMENT /end REF_MEASUREMENT /end GROUP
/begin GROUP NxtrCalIds.NxtrCalIdsCal0DevlpDescr.Ary1D "MICROSAR RTE" /begin SUB_GROUP /end SUB_GROUP /begin FUNCTION_LIST /end FUNCTION_LIST /begin REF_CHARACTERISTIC NxtrCalIds.NxtrCalIdsCal0DevlpDescr.Ary1D /end REF_CHARACTERISTIC /begin REF_MEASUREMENT /end REF_MEASUREMENT /end GROUP
/begin GROUP NxtrCalIds.NxtrCalIdsCal0DevlpRelNr.Val "MICROSAR RTE" /begin SUB_GROUP /end SUB_GROUP /begin FUNCTION_LIST /end FUNCTION_LIST /begin REF_CHARACTERISTIC NxtrCalIds.NxtrCalIdsCal0DevlpRelNr.Val /end REF_CHARACTERISTIC /begin REF_MEASUREMENT /end REF_MEASUREMENT /end GROUP
/begin GROUP NxtrCalIds.NxtrCalIdsCal0DevlpRelSt.Val "MICROSAR RTE" /begin SUB_GROUP /end SUB_GROUP /begin FUNCTION_LIST /end FUNCTION_LIST /begin REF_CHARACTERISTIC NxtrCalIds.NxtrCalIdsCal0DevlpRelSt.Val /end REF_CHARACTERISTIC /begin REF_MEASUREMENT /end REF_MEASUREMENT /end GROUP
/begin GROUP NxtrCalIds.NxtrCalIdsCal0DevlpTiStamp.Val "MICROSAR RTE" /begin SUB_GROUP /end SUB_GROUP /begin FUNCTION_LIST /end FUNCTION_LIST /begin REF_CHARACTERISTIC NxtrCalIds.NxtrCalIdsCal0DevlpTiStamp.Val /end REF_CHARACTERISTIC /begin REF_MEASUREMENT /end REF_MEASUREMENT /end GROUP
/begin GROUP NxtrCalIds.NxtrCalIdsCal0DevlpVers.Val "MICROSAR RTE" /begin SUB_GROUP /end SUB_GROUP /begin FUNCTION_LIST /end FUNCTION_LIST /begin REF_CHARACTERISTIC NxtrCalIds.NxtrCalIdsCal0DevlpVers.Val /end REF_CHARACTERISTIC /begin REF_MEASUREMENT /end REF_MEASUREMENT /end GROUP
/begin GROUP NxtrCalIds.NxtrCalIdsCal1DevlpAuthor.Ary1D "MICROSAR RTE" /begin SUB_GROUP /end SUB_GROUP /begin FUNCTION_LIST /end FUNCTION_LIST /begin REF_CHARACTERISTIC NxtrCalIds.NxtrCalIdsCal1DevlpAuthor.Ary1D /end REF_CHARACTERISTIC /begin REF_MEASUREMENT /end REF_MEASUREMENT /end GROUP
/begin GROUP NxtrCalIds.NxtrCalIdsCal1DevlpRelNr.Val "MICROSAR RTE" /begin SUB_GROUP /end SUB_GROUP /begin FUNCTION_LIST /end FUNCTION_LIST /begin REF_CHARACTERISTIC NxtrCalIds.NxtrCalIdsCal1DevlpRelNr.Val /end REF_CHARACTERISTIC /begin REF_MEASUREMENT /end REF_MEASUREMENT /end GROUP
/begin GROUP NxtrCalIds.NxtrCalIdsCal1DevlpRelSt.Val "MICROSAR RTE" /begin SUB_GROUP /end SUB_GROUP /begin FUNCTION_LIST /end FUNCTION_LIST /begin REF_CHARACTERISTIC NxtrCalIds.NxtrCalIdsCal1DevlpRelSt.Val /end REF_CHARACTERISTIC /begin REF_MEASUREMENT /end REF_MEASUREMENT /end GROUP
/begin GROUP NxtrCalIds.NxtrCalIdsCal1DevlpTiStamp.Val "MICROSAR RTE" /begin SUB_GROUP /end SUB_GROUP /begin FUNCTION_LIST /end FUNCTION_LIST /begin REF_CHARACTERISTIC NxtrCalIds.NxtrCalIdsCal1DevlpTiStamp.Val /end REF_CHARACTERISTIC /begin REF_MEASUREMENT /end REF_MEASUREMENT /end GROUP
/begin GROUP NxtrCalIds.NxtrCalIdsCal1DevlpVers.Val "MICROSAR RTE" /begin SUB_GROUP /end SUB_GROUP /begin FUNCTION_LIST /end FUNCTION_LIST /begin REF_CHARACTERISTIC NxtrCalIds.NxtrCalIdsCal1DevlpVers.Val /end REF_CHARACTERISTIC /begin REF_MEASUREMENT /end REF_MEASUREMENT /end GROUP
/begin GROUP NxtrCalIds.NxtrCalIdsCal2DevlpAuthor.Ary1D "MICROSAR RTE" /begin SUB_GROUP /end SUB_GROUP /begin FUNCTION_LIST /end FUNCTION_LIST /begin REF_CHARACTERISTIC NxtrCalIds.NxtrCalIdsCal2DevlpAuthor.Ary1D /end REF_CHARACTERISTIC /begin REF_MEASUREMENT /end REF_MEASUREMENT /end GROUP
/begin GROUP NxtrCalIds.NxtrCalIdsCal2DevlpDescr.Ary1D "MICROSAR RTE" /begin SUB_GROUP /end SUB_GROUP /begin FUNCTION_LIST /end FUNCTION_LIST /begin REF_CHARACTERISTIC NxtrCalIds.NxtrCalIdsCal2DevlpDescr.Ary1D /end REF_CHARACTERISTIC /begin REF_MEASUREMENT /end REF_MEASUREMENT /end GROUP
/begin GROUP NxtrCalIds.NxtrCalIdsCal2DevlpRelNr.Val "MICROSAR RTE" /begin SUB_GROUP /end SUB_GROUP /begin FUNCTION_LIST /end FUNCTION_LIST /begin REF_CHARACTERISTIC NxtrCalIds.NxtrCalIdsCal2DevlpRelNr.Val /end REF_CHARACTERISTIC /begin REF_MEASUREMENT /end REF_MEASUREMENT /end GROUP
/begin GROUP NxtrCalIds.NxtrCalIdsCal2DevlpRelSt.Val "MICROSAR RTE" /begin SUB_GROUP /end SUB_GROUP /begin FUNCTION_LIST /end FUNCTION_LIST /begin REF_CHARACTERISTIC NxtrCalIds.NxtrCalIdsCal2DevlpRelSt.Val /end REF_CHARACTERISTIC /begin REF_MEASUREMENT /end REF_MEASUREMENT /end GROUP
/begin GROUP NxtrCalIds.NxtrCalIdsCal2DevlpTiStamp.Val "MICROSAR RTE" /begin SUB_GROUP /end SUB_GROUP /begin FUNCTION_LIST /end FUNCTION_LIST /begin REF_CHARACTERISTIC NxtrCalIds.NxtrCalIdsCal2DevlpTiStamp.Val /end REF_CHARACTERISTIC /begin REF_MEASUREMENT /end REF_MEASUREMENT /end GROUP
/begin GROUP NxtrCalIds.NxtrCalIdsCal2DevlpVers.Val "MICROSAR RTE" /begin SUB_GROUP /end SUB_GROUP /begin FUNCTION_LIST /end FUNCTION_LIST /begin REF_CHARACTERISTIC NxtrCalIds.NxtrCalIdsCal2DevlpVers.Val /end REF_CHARACTERISTIC /begin REF_MEASUREMENT /end REF_MEASUREMENT /end GROUP
/begin GROUP PolarityCfg "MICROSAR RTE"
 /begin SUB_GROUP PolarityCfg.CalibrationParameters PolarityCfg.PerInstanceMemories PolarityCfg.SenderPorts /end SUB_GROUP
 /begin FUNCTION_LIST /end FUNCTION_LIST
 /begin REF_CHARACTERISTIC /end REF_CHARACTERISTIC
 /begin REF_MEASUREMENT /end REF_MEASUREMENT
/end GROUP
/begin GROUP PolarityCfg.AssiMechPolarity.Val "MICROSAR RTE" /begin SUB_GROUP /end SUB_GROUP /begin FUNCTION_LIST /end FUNCTION_LIST /begin REF_CHARACTERISTIC /end REF_CHARACTERISTIC /begin REF_MEASUREMENT PolarityCfg.AssiMechPolarity.Val /end REF_MEASUREMENT /end GROUP
/begin GROUP PolarityCfg.CalibrationParameters "MICROSAR RTE" /begin SUB_GROUP PolarityCfg.PolarityCfgSavedDft /end SUB_GROUP /begin FUNCTION_LIST /end FUNCTION_LIST /begin REF_CHARACTERISTIC /end REF_CHARACTERISTIC /begin REF_MEASUREMENT /end REF_MEASUREMENT /end GROUP
/begin GROUP PolarityCfg.HwAg0Polarity.Val "MICROSAR RTE" /begin SUB_GROUP /end SUB_GROUP /begin FUNCTION_LIST /end FUNCTION_LIST /begin REF_CHARACTERISTIC /end REF_CHARACTERISTIC /begin REF_MEASUREMENT PolarityCfg.HwAg0Polarity.Val /end REF_MEASUREMENT /end GROUP
/begin GROUP PolarityCfg.HwAg1Polarity.Val "MICROSAR RTE" /begin SUB_GROUP /end SUB_GROUP /begin FUNCTION_LIST /end FUNCTION_LIST /begin REF_CHARACTERISTIC /end REF_CHARACTERISTIC /begin REF_MEASUREMENT PolarityCfg.HwAg1Polarity.Val /end REF_MEASUREMENT /end GROUP
/begin GROUP PolarityCfg.HwAg2Polarity.Val "MICROSAR RTE" /begin SUB_GROUP /end SUB_GROUP /begin FUNCTION_LIST /end FUNCTION_LIST /begin REF_CHARACTERISTIC /end REF_CHARACTERISTIC /begin REF_MEASUREMENT PolarityCfg.HwAg2Polarity.Val /end REF_MEASUREMENT /end GROUP
/begin GROUP PolarityCfg.HwAg3Polarity.Val "MICROSAR RTE" /begin SUB_GROUP /end SUB_GROUP /begin FUNCTION_LIST /end FUNCTION_LIST /begin REF_CHARACTERISTIC /end REF_CHARACTERISTIC /begin REF_MEASUREMENT PolarityCfg.HwAg3Polarity.Val /end REF_MEASUREMENT /end GROUP
/begin GROUP PolarityCfg.HwAg4Polarity.Val "MICROSAR RTE" /begin SUB_GROUP /end SUB_GROUP /begin FUNCTION_LIST /end FUNCTION_LIST /begin REF_CHARACTERISTIC /end REF_CHARACTERISTIC /begin REF_MEASUREMENT PolarityCfg.HwAg4Polarity.Val /end REF_MEASUREMENT /end GROUP
/begin GROUP PolarityCfg.HwAg5Polarity.Val "MICROSAR RTE" /begin SUB_GROUP /end SUB_GROUP /begin FUNCTION_LIST /end FUNCTION_LIST /begin REF_CHARACTERISTIC /end REF_CHARACTERISTIC /begin REF_MEASUREMENT PolarityCfg.HwAg5Polarity.Val /end REF_MEASUREMENT /end GROUP
/begin GROUP PolarityCfg.HwAg6Polarity.Val "MICROSAR RTE" /begin SUB_GROUP /end SUB_GROUP /begin FUNCTION_LIST /end FUNCTION_LIST /begin REF_CHARACTERISTIC /end REF_CHARACTERISTIC /begin REF_MEASUREMENT PolarityCfg.HwAg6Polarity.Val /end REF_MEASUREMENT /end GROUP
/begin GROUP PolarityCfg.HwAg7Polarity.Val "MICROSAR RTE" /begin SUB_GROUP /end SUB_GROUP /begin FUNCTION_LIST /end FUNCTION_LIST /begin REF_CHARACTERISTIC /end REF_CHARACTERISTIC /begin REF_MEASUREMENT PolarityCfg.HwAg7Polarity.Val /end REF_MEASUREMENT /end GROUP
/begin GROUP PolarityCfg.HwTq0Polarity.Val "MICROSAR RTE" /begin SUB_GROUP /end SUB_GROUP /begin FUNCTION_LIST /end FUNCTION_LIST /begin REF_CHARACTERISTIC /end REF_CHARACTERISTIC /begin REF_MEASUREMENT PolarityCfg.HwTq0Polarity.Val /end REF_MEASUREMENT /end GROUP
/begin GROUP PolarityCfg.HwTq1Polarity.Val "MICROSAR RTE" /begin SUB_GROUP /end SUB_GROUP /begin FUNCTION_LIST /end FUNCTION_LIST /begin REF_CHARACTERISTIC /end REF_CHARACTERISTIC /begin REF_MEASUREMENT PolarityCfg.HwTq1Polarity.Val /end REF_MEASUREMENT /end GROUP
/begin GROUP PolarityCfg.HwTq2Polarity.Val "MICROSAR RTE" /begin SUB_GROUP /end SUB_GROUP /begin FUNCTION_LIST /end FUNCTION_LIST /begin REF_CHARACTERISTIC /end REF_CHARACTERISTIC /begin REF_MEASUREMENT PolarityCfg.HwTq2Polarity.Val /end REF_MEASUREMENT /end GROUP
/begin GROUP PolarityCfg.HwTq3Polarity.Val "MICROSAR RTE" /begin SUB_GROUP /end SUB_GROUP /begin FUNCTION_LIST /end FUNCTION_LIST /begin REF_CHARACTERISTIC /end REF_CHARACTERISTIC /begin REF_MEASUREMENT PolarityCfg.HwTq3Polarity.Val /end REF_MEASUREMENT /end GROUP
/begin GROUP PolarityCfg.HwTq4Polarity.Val "MICROSAR RTE" /begin SUB_GROUP /end SUB_GROUP /begin FUNCTION_LIST /end FUNCTION_LIST /begin REF_CHARACTERISTIC /end REF_CHARACTERISTIC /begin REF_MEASUREMENT PolarityCfg.HwTq4Polarity.Val /end REF_MEASUREMENT /end GROUP
/begin GROUP PolarityCfg.HwTq5Polarity.Val "MICROSAR RTE" /begin SUB_GROUP /end SUB_GROUP /begin FUNCTION_LIST /end FUNCTION_LIST /begin REF_CHARACTERISTIC /end REF_CHARACTERISTIC /begin REF_MEASUREMENT PolarityCfg.HwTq5Polarity.Val /end REF_MEASUREMENT /end GROUP
/begin GROUP PolarityCfg.HwTq6Polarity.Val "MICROSAR RTE" /begin SUB_GROUP /end SUB_GROUP /begin FUNCTION_LIST /end FUNCTION_LIST /begin REF_CHARACTERISTIC /end REF_CHARACTERISTIC /begin REF_MEASUREMENT PolarityCfg.HwTq6Polarity.Val /end REF_MEASUREMENT /end GROUP
/begin GROUP PolarityCfg.HwTq7Polarity.Val "MICROSAR RTE" /begin SUB_GROUP /end SUB_GROUP /begin FUNCTION_LIST /end FUNCTION_LIST /begin REF_CHARACTERISTIC /end REF_CHARACTERISTIC /begin REF_MEASUREMENT PolarityCfg.HwTq7Polarity.Val /end REF_MEASUREMENT /end GROUP
/begin GROUP PolarityCfg.MotAgMecl0Polarity.Val "MICROSAR RTE" /begin SUB_GROUP /end SUB_GROUP /begin FUNCTION_LIST /end FUNCTION_LIST /begin REF_CHARACTERISTIC /end REF_CHARACTERISTIC /begin REF_MEASUREMENT PolarityCfg.MotAgMecl0Polarity.Val /end REF_MEASUREMENT /end GROUP
/begin GROUP PolarityCfg.MotAgMecl1Polarity.Val "MICROSAR RTE" /begin SUB_GROUP /end SUB_GROUP /begin FUNCTION_LIST /end FUNCTION_LIST /begin REF_CHARACTERISTIC /end REF_CHARACTERISTIC /begin REF_MEASUREMENT PolarityCfg.MotAgMecl1Polarity.Val /end REF_MEASUREMENT /end GROUP
/begin GROUP PolarityCfg.MotAgMecl2Polarity.Val "MICROSAR RTE" /begin SUB_GROUP /end SUB_GROUP /begin FUNCTION_LIST /end FUNCTION_LIST /begin REF_CHARACTERISTIC /end REF_CHARACTERISTIC /begin REF_MEASUREMENT PolarityCfg.MotAgMecl2Polarity.Val /end REF_MEASUREMENT /end GROUP
/begin GROUP PolarityCfg.MotAgMecl3Polarity.Val "MICROSAR RTE" /begin SUB_GROUP /end SUB_GROUP /begin FUNCTION_LIST /end FUNCTION_LIST /begin REF_CHARACTERISTIC /end REF_CHARACTERISTIC /begin REF_MEASUREMENT PolarityCfg.MotAgMecl3Polarity.Val /end REF_MEASUREMENT /end GROUP
/begin GROUP PolarityCfg.MotAgMecl4Polarity.Val "MICROSAR RTE" /begin SUB_GROUP /end SUB_GROUP /begin FUNCTION_LIST /end FUNCTION_LIST /begin REF_CHARACTERISTIC /end REF_CHARACTERISTIC /begin REF_MEASUREMENT PolarityCfg.MotAgMecl4Polarity.Val /end REF_MEASUREMENT /end GROUP
/begin GROUP PolarityCfg.MotAgMecl5Polarity.Val "MICROSAR RTE" /begin SUB_GROUP /end SUB_GROUP /begin FUNCTION_LIST /end FUNCTION_LIST /begin REF_CHARACTERISTIC /end REF_CHARACTERISTIC /begin REF_MEASUREMENT PolarityCfg.MotAgMecl5Polarity.Val /end REF_MEASUREMENT /end GROUP
/begin GROUP PolarityCfg.MotAgMecl6Polarity.Val "MICROSAR RTE" /begin SUB_GROUP /end SUB_GROUP /begin FUNCTION_LIST /end FUNCTION_LIST /begin REF_CHARACTERISTIC /end REF_CHARACTERISTIC /begin REF_MEASUREMENT PolarityCfg.MotAgMecl6Polarity.Val /end REF_MEASUREMENT /end GROUP
/begin GROUP PolarityCfg.MotAgMecl7Polarity.Val "MICROSAR RTE" /begin SUB_GROUP /end SUB_GROUP /begin FUNCTION_LIST /end FUNCTION_LIST /begin REF_CHARACTERISTIC /end REF_CHARACTERISTIC /begin REF_MEASUREMENT PolarityCfg.MotAgMecl7Polarity.Val /end REF_MEASUREMENT /end GROUP
/begin GROUP PolarityCfg.MotElecMeclPolarity.Val "MICROSAR RTE" /begin SUB_GROUP /end SUB_GROUP /begin FUNCTION_LIST /end FUNCTION_LIST /begin REF_CHARACTERISTIC /end REF_CHARACTERISTIC /begin REF_MEASUREMENT PolarityCfg.MotElecMeclPolarity.Val /end REF_MEASUREMENT /end GROUP
/begin GROUP PolarityCfg.PerInstanceMemories "MICROSAR RTE" /begin SUB_GROUP PolarityCfg.PolarityCfgSaved /end SUB_GROUP /begin FUNCTION_LIST /end FUNCTION_LIST /begin REF_CHARACTERISTIC /end REF_CHARACTERISTIC /begin REF_MEASUREMENT /end REF_MEASUREMENT /end GROUP
/begin GROUP PolarityCfg.PolarityCfgSaved "MICROSAR RTE" /begin SUB_GROUP /end SUB_GROUP /begin FUNCTION_LIST /end FUNCTION_LIST /begin REF_CHARACTERISTIC /end REF_CHARACTERISTIC /begin REF_MEASUREMENT PolarityCfg.PolarityCfgSaved /end REF_MEASUREMENT /end GROUP
/begin GROUP PolarityCfg.PolarityCfgSavedDft "MICROSAR RTE" /begin SUB_GROUP /end SUB_GROUP /begin FUNCTION_LIST /end FUNCTION_LIST /begin REF_CHARACTERISTIC PolarityCfg.PolarityCfgSavedDft /end REF_CHARACTERISTIC /begin REF_MEASUREMENT /end REF_MEASUREMENT /end GROUP
/begin GROUP PolarityCfg.SenderPorts "MICROSAR RTE"
 /begin SUB_GROUP PolarityCfg.AssiMechPolarity.Val PolarityCfg.HwAg0Polarity.Val PolarityCfg.HwAg1Polarity.Val PolarityCfg.HwAg2Polarity.Val PolarityCfg.HwAg3Polarity.Val PolarityCfg.HwAg4Polarity.Val PolarityCfg.HwAg5Polarity.Val PolarityCfg.HwAg6Polarity.Val PolarityCfg.HwAg7Polarity.Val PolarityCfg.HwTq0Polarity.Val PolarityCfg.HwTq1Polarity.Val PolarityCfg.HwTq2Polarity.Val PolarityCfg.HwTq3Polarity.Val PolarityCfg.HwTq4Polarity.Val PolarityCfg.HwTq5Polarity.Val PolarityCfg.HwTq6Polarity.Val PolarityCfg.HwTq7Polarity.Val PolarityCfg.MotAgMecl0Polarity.Val PolarityCfg.MotAgMecl1Polarity.Val PolarityCfg.MotAgMecl2Polarity.Val PolarityCfg.MotAgMecl3Polarity.Val PolarityCfg.MotAgMecl4Polarity.Val PolarityCfg.MotAgMecl5Polarity.Val PolarityCfg.MotAgMecl6Polarity.Val PolarityCfg.MotAgMecl7Polarity.Val PolarityCfg.MotElecMeclPolarity.Val /end SUB_GROUP
 /begin FUNCTION_LIST /end FUNCTION_LIST
 /begin REF_CHARACTERISTIC /end REF_CHARACTERISTIC
 /begin REF_MEASUREMENT /end REF_MEASUREMENT
/end GROUP
/begin GROUP PosnTrakgServo "MICROSAR RTE"
 /begin SUB_GROUP PosnTrakgServo.CalibrationPorts PosnTrakgServo.PerInstanceMemories PosnTrakgServo.ReceiverPorts PosnTrakgServo.SenderPorts /end SUB_GROUP
 /begin FUNCTION_LIST /end FUNCTION_LIST
 /begin REF_CHARACTERISTIC /end REF_CHARACTERISTIC
 /begin REF_MEASUREMENT /end REF_MEASUREMENT
/end GROUP
/begin GROUP PosnTrakgServo.AntiWdupCmdPrev "MICROSAR RTE" /begin SUB_GROUP /end SUB_GROUP /begin FUNCTION_LIST /end FUNCTION_LIST /begin REF_CHARACTERISTIC /end REF_CHARACTERISTIC /begin REF_MEASUREMENT PosnTrakgServo.AntiWdupCmdPrev /end REF_MEASUREMENT /end GROUP
/begin GROUP PosnTrakgServo.CalibrationPorts "MICROSAR RTE"
 /begin SUB_GROUP PosnTrakgServo.PosnTrakgServoArbnFltMtgtnLpFilCutOffFrq.Val PosnTrakgServo.PosnTrakgServoEnaBlndFacTblX.Ary1D PosnTrakgServo.PosnTrakgServoEnaBlndFacTblY.Ary1D PosnTrakgServo.PosnTrakgServoFfGain.Ary1D PosnTrakgServo.PosnTrakgServoFfVelGain.Ary1D PosnTrakgServo.PosnTrakgServoGain1.Ary1D PosnTrakgServo.PosnTrakgServoGain2.Ary1D PosnTrakgServo.PosnTrakgServoGain3.Ary1D PosnTrakgServo.PosnTrakgServoGain4.Ary1D PosnTrakgServo.PosnTrakgServoGainArbnFltMtgtn.Ary1D PosnTrakgServo.PosnTrakgServoHwAgTarMgnLimTblY.Ary1D PosnTrakgServo.PosnTrakgServoHwAgTarRateLimTblY.Ary1D PosnTrakgServo.PosnTrakgServoHwVelTarRateLimTblY.Ary1D PosnTrakgServo.PosnTrakgServoIntglGain.Ary1D PosnTrakgServo.PosnTrakgServoIntglLim.Ary1D PosnTrakgServo.PosnTrakgServoIntgtrAntiWdupGain.Val PosnTrakgServo.PosnTrakgServoIntgtrStCorrnGain.Val PosnTrakgServo.PosnTrakgServoLpFilCutOffFrq.Val PosnTrakgServo.PosnTrakgServoOutpAntiWdupGain.Val PosnTrakgServo.PosnTrakgServoOutpLim.Ary1D PosnTrakgServo.PosnTrakgServoVehSpdTbl.Ary1D PosnTrakgServo.SysGlbPrmSysKineRat.Val PosnTrakgServo.SysGlbPrmSysTqRat.Val /end SUB_GROUP
 /begin FUNCTION_LIST /end FUNCTION_LIST
 /begin REF_CHARACTERISTIC /end REF_CHARACTERISTIC
 /begin REF_MEASUREMENT /end REF_MEASUREMENT
/end GROUP
/begin GROUP PosnTrakgServo.HwAg.Val "MICROSAR RTE" /begin SUB_GROUP /end SUB_GROUP /begin FUNCTION_LIST /end FUNCTION_LIST /begin REF_CHARACTERISTIC /end REF_CHARACTERISTIC /begin REF_MEASUREMENT PosnTrakgServo.HwAg.Val /end REF_MEASUREMENT /end GROUP
/begin GROUP PosnTrakgServo.HwTq.Val "MICROSAR RTE" /begin SUB_GROUP /end SUB_GROUP /begin FUNCTION_LIST /end FUNCTION_LIST /begin REF_CHARACTERISTIC /end REF_CHARACTERISTIC /begin REF_MEASUREMENT PosnTrakgServo.HwTq.Val /end REF_MEASUREMENT /end GROUP
/begin GROUP PosnTrakgServo.HwTqDerivtvPrev "MICROSAR RTE" /begin SUB_GROUP /end SUB_GROUP /begin FUNCTION_LIST /end FUNCTION_LIST /begin REF_CHARACTERISTIC /end REF_CHARACTERISTIC /begin REF_MEASUREMENT PosnTrakgServo.HwTqDerivtvPrev /end REF_MEASUREMENT /end GROUP
/begin GROUP PosnTrakgServo.HwTqPrev "MICROSAR RTE" /begin SUB_GROUP /end SUB_GROUP /begin FUNCTION_LIST /end FUNCTION_LIST /begin REF_CHARACTERISTIC /end REF_CHARACTERISTIC /begin REF_MEASUREMENT PosnTrakgServo.HwTqPrev /end REF_MEASUREMENT /end GROUP
/begin GROUP PosnTrakgServo.IntgtrInpPrev "MICROSAR RTE" /begin SUB_GROUP /end SUB_GROUP /begin FUNCTION_LIST /end FUNCTION_LIST /begin REF_CHARACTERISTIC /end REF_CHARACTERISTIC /begin REF_MEASUREMENT PosnTrakgServo.IntgtrInpPrev /end REF_MEASUREMENT /end GROUP
/begin GROUP PosnTrakgServo.IntgtrOutpPrev "MICROSAR RTE" /begin SUB_GROUP /end SUB_GROUP /begin FUNCTION_LIST /end FUNCTION_LIST /begin REF_CHARACTERISTIC /end REF_CHARACTERISTIC /begin REF_MEASUREMENT PosnTrakgServo.IntgtrOutpPrev /end REF_MEASUREMENT /end GROUP
/begin GROUP PosnTrakgServo.MotVelCrf.Val "MICROSAR RTE" /begin SUB_GROUP /end SUB_GROUP /begin FUNCTION_LIST /end FUNCTION_LIST /begin REF_CHARACTERISTIC /end REF_CHARACTERISTIC /begin REF_MEASUREMENT PosnTrakgServo.MotVelCrf.Val /end REF_MEASUREMENT /end GROUP
/begin GROUP PosnTrakgServo.OutpAntiWdupCmdPrev "MICROSAR RTE" /begin SUB_GROUP /end SUB_GROUP /begin FUNCTION_LIST /end FUNCTION_LIST /begin REF_CHARACTERISTIC /end REF_CHARACTERISTIC /begin REF_MEASUREMENT PosnTrakgServo.OutpAntiWdupCmdPrev /end REF_MEASUREMENT /end GROUP
/begin GROUP PosnTrakgServo.PerInstanceMemories "MICROSAR RTE"
 /begin SUB_GROUP PosnTrakgServo.AntiWdupCmdPrev PosnTrakgServo.HwTqDerivtvPrev PosnTrakgServo.HwTqPrev PosnTrakgServo.IntgtrInpPrev PosnTrakgServo.IntgtrOutpPrev PosnTrakgServo.OutpAntiWdupCmdPrev PosnTrakgServo.PosnServoCmdInpArbnFltMtgtnPrev PosnTrakgServo.PosnServoCmdOutpArbnFltMtgtnPrev PosnTrakgServo.PosnServoEnaTiPrev PosnTrakgServo.PosnServoHwAgValRateLim PosnTrakgServo.PosnServoHwVelValRateLim PosnTrakgServo.dPosnTrakgServoCmdPreLimd PosnTrakgServo.dPosnTrakgServoEnaBlndFac PosnTrakgServo.dPosnTrakgServoFfCmd PosnTrakgServo.dPosnTrakgServoHwAg PosnTrakgServo.dPosnTrakgServoHwAgErr PosnTrakgServo.dPosnTrakgServoHwAgTarLimd PosnTrakgServo.dPosnTrakgServoHwVelTarLimd PosnTrakgServo.dPosnTrakgServoIntgtrCmdLimd PosnTrakgServo.dPosnTrakgServoPtlStFbCmd /end SUB_GROUP
 /begin FUNCTION_LIST /end FUNCTION_LIST
 /begin REF_CHARACTERISTIC /end REF_CHARACTERISTIC
 /begin REF_MEASUREMENT /end REF_MEASUREMENT
/end GROUP
/begin GROUP PosnTrakgServo.PosnServoCmd.Val "MICROSAR RTE" /begin SUB_GROUP /end SUB_GROUP /begin FUNCTION_LIST /end FUNCTION_LIST /begin REF_CHARACTERISTIC /end REF_CHARACTERISTIC /begin REF_MEASUREMENT PosnTrakgServo.PosnServoCmd.Val /end REF_MEASUREMENT /end GROUP
/begin GROUP PosnTrakgServo.PosnServoCmdInpArbnFltMtgtnPrev "MICROSAR RTE" /begin SUB_GROUP /end SUB_GROUP /begin FUNCTION_LIST /end FUNCTION_LIST /begin REF_CHARACTERISTIC /end REF_CHARACTERISTIC /begin REF_MEASUREMENT PosnTrakgServo.PosnServoCmdInpArbnFltMtgtnPrev /end REF_MEASUREMENT /end GROUP
/begin GROUP PosnTrakgServo.PosnServoCmdOutpArbnFltMtgtnPrev "MICROSAR RTE" /begin SUB_GROUP /end SUB_GROUP /begin FUNCTION_LIST /end FUNCTION_LIST /begin REF_CHARACTERISTIC /end REF_CHARACTERISTIC /begin REF_MEASUREMENT PosnTrakgServo.PosnServoCmdOutpArbnFltMtgtnPrev /end REF_MEASUREMENT /end GROUP
/begin GROUP PosnTrakgServo.PosnServoEna.Logl "MICROSAR RTE" /begin SUB_GROUP /end SUB_GROUP /begin FUNCTION_LIST /end FUNCTION_LIST /begin REF_CHARACTERISTIC /end REF_CHARACTERISTIC /begin REF_MEASUREMENT PosnTrakgServo.PosnServoEna.Logl /end REF_MEASUREMENT /end GROUP
/begin GROUP PosnTrakgServo.PosnServoEnaTiPrev "MICROSAR RTE" /begin SUB_GROUP /end SUB_GROUP /begin FUNCTION_LIST /end FUNCTION_LIST /begin REF_CHARACTERISTIC /end REF_CHARACTERISTIC /begin REF_MEASUREMENT PosnTrakgServo.PosnServoEnaTiPrev /end REF_MEASUREMENT /end GROUP
/begin GROUP PosnTrakgServo.PosnServoHwAg.Val "MICROSAR RTE" /begin SUB_GROUP /end SUB_GROUP /begin FUNCTION_LIST /end FUNCTION_LIST /begin REF_CHARACTERISTIC /end REF_CHARACTERISTIC /begin REF_MEASUREMENT PosnTrakgServo.PosnServoHwAg.Val /end REF_MEASUREMENT /end GROUP
/begin GROUP PosnTrakgServo.PosnServoHwAgValRateLim "MICROSAR RTE" /begin SUB_GROUP /end SUB_GROUP /begin FUNCTION_LIST /end FUNCTION_LIST /begin REF_CHARACTERISTIC /end REF_CHARACTERISTIC /begin REF_MEASUREMENT PosnTrakgServo.PosnServoHwAgValRateLim /end REF_MEASUREMENT /end GROUP
/begin GROUP PosnTrakgServo.PosnServoHwVel.Val "MICROSAR RTE" /begin SUB_GROUP /end SUB_GROUP /begin FUNCTION_LIST /end FUNCTION_LIST /begin REF_CHARACTERISTIC /end REF_CHARACTERISTIC /begin REF_MEASUREMENT PosnTrakgServo.PosnServoHwVel.Val /end REF_MEASUREMENT /end GROUP
/begin GROUP PosnTrakgServo.PosnServoHwVelValRateLim "MICROSAR RTE" /begin SUB_GROUP /end SUB_GROUP /begin FUNCTION_LIST /end FUNCTION_LIST /begin REF_CHARACTERISTIC /end REF_CHARACTERISTIC /begin REF_MEASUREMENT PosnTrakgServo.PosnServoHwVelValRateLim /end REF_MEASUREMENT /end GROUP
/begin GROUP PosnTrakgServo.PosnServoIntgtrOffs.Val "MICROSAR RTE" /begin SUB_GROUP /end SUB_GROUP /begin FUNCTION_LIST /end FUNCTION_LIST /begin REF_CHARACTERISTIC /end REF_CHARACTERISTIC /begin REF_MEASUREMENT PosnTrakgServo.PosnServoIntgtrOffs.Val /end REF_MEASUREMENT /end GROUP
/begin GROUP PosnTrakgServo.PosnServoIntgtrSt.Val "MICROSAR RTE" /begin SUB_GROUP /end SUB_GROUP /begin FUNCTION_LIST /end FUNCTION_LIST /begin REF_CHARACTERISTIC /end REF_CHARACTERISTIC /begin REF_MEASUREMENT PosnTrakgServo.PosnServoIntgtrSt.Val /end REF_MEASUREMENT /end GROUP
/begin GROUP PosnTrakgServo.PosnTrakgArbnFltMtgtnEna.Logl "MICROSAR RTE" /begin SUB_GROUP /end SUB_GROUP /begin FUNCTION_LIST /end FUNCTION_LIST /begin REF_CHARACTERISTIC /end REF_CHARACTERISTIC /begin REF_MEASUREMENT PosnTrakgServo.PosnTrakgArbnFltMtgtnEna.Logl /end REF_MEASUREMENT /end GROUP
/begin GROUP PosnTrakgServo.PosnTrakgServoArbnFltMtgtnLpFilCutOffFrq.Val "MICROSAR RTE" /begin SUB_GROUP /end SUB_GROUP /begin FUNCTION_LIST /end FUNCTION_LIST
 /begin REF_CHARACTERISTIC PosnTrakgServo.PosnTrakgServoArbnFltMtgtnLpFilCutOffFrq.Val /end REF_CHARACTERISTIC
 /begin REF_MEASUREMENT /end REF_MEASUREMENT
/end GROUP
/begin GROUP PosnTrakgServo.PosnTrakgServoEnaBlndFacTblX.Ary1D "MICROSAR RTE" /begin SUB_GROUP /end SUB_GROUP /begin FUNCTION_LIST /end FUNCTION_LIST /begin REF_CHARACTERISTIC PosnTrakgServo.PosnTrakgServoEnaBlndFacTblX.Ary1D /end REF_CHARACTERISTIC /begin REF_MEASUREMENT /end REF_MEASUREMENT /end GROUP
/begin GROUP PosnTrakgServo.PosnTrakgServoEnaBlndFacTblY.Ary1D "MICROSAR RTE" /begin SUB_GROUP /end SUB_GROUP /begin FUNCTION_LIST /end FUNCTION_LIST /begin REF_CHARACTERISTIC PosnTrakgServo.PosnTrakgServoEnaBlndFacTblY.Ary1D /end REF_CHARACTERISTIC /begin REF_MEASUREMENT /end REF_MEASUREMENT /end GROUP
/begin GROUP PosnTrakgServo.PosnTrakgServoFfGain.Ary1D "MICROSAR RTE" /begin SUB_GROUP /end SUB_GROUP /begin FUNCTION_LIST /end FUNCTION_LIST /begin REF_CHARACTERISTIC PosnTrakgServo.PosnTrakgServoFfGain.Ary1D /end REF_CHARACTERISTIC /begin REF_MEASUREMENT /end REF_MEASUREMENT /end GROUP
/begin GROUP PosnTrakgServo.PosnTrakgServoFfVelGain.Ary1D "MICROSAR RTE" /begin SUB_GROUP /end SUB_GROUP /begin FUNCTION_LIST /end FUNCTION_LIST /begin REF_CHARACTERISTIC PosnTrakgServo.PosnTrakgServoFfVelGain.Ary1D /end REF_CHARACTERISTIC /begin REF_MEASUREMENT /end REF_MEASUREMENT /end GROUP
/begin GROUP PosnTrakgServo.PosnTrakgServoGain1.Ary1D "MICROSAR RTE" /begin SUB_GROUP /end SUB_GROUP /begin FUNCTION_LIST /end FUNCTION_LIST /begin REF_CHARACTERISTIC PosnTrakgServo.PosnTrakgServoGain1.Ary1D /end REF_CHARACTERISTIC /begin REF_MEASUREMENT /end REF_MEASUREMENT /end GROUP
/begin GROUP PosnTrakgServo.PosnTrakgServoGain2.Ary1D "MICROSAR RTE" /begin SUB_GROUP /end SUB_GROUP /begin FUNCTION_LIST /end FUNCTION_LIST /begin REF_CHARACTERISTIC PosnTrakgServo.PosnTrakgServoGain2.Ary1D /end REF_CHARACTERISTIC /begin REF_MEASUREMENT /end REF_MEASUREMENT /end GROUP
/begin GROUP PosnTrakgServo.PosnTrakgServoGain3.Ary1D "MICROSAR RTE" /begin SUB_GROUP /end SUB_GROUP /begin FUNCTION_LIST /end FUNCTION_LIST /begin REF_CHARACTERISTIC PosnTrakgServo.PosnTrakgServoGain3.Ary1D /end REF_CHARACTERISTIC /begin REF_MEASUREMENT /end REF_MEASUREMENT /end GROUP
/begin GROUP PosnTrakgServo.PosnTrakgServoGain4.Ary1D "MICROSAR RTE" /begin SUB_GROUP /end SUB_GROUP /begin FUNCTION_LIST /end FUNCTION_LIST /begin REF_CHARACTERISTIC PosnTrakgServo.PosnTrakgServoGain4.Ary1D /end REF_CHARACTERISTIC /begin REF_MEASUREMENT /end REF_MEASUREMENT /end GROUP
/begin GROUP PosnTrakgServo.PosnTrakgServoGainArbnFltMtgtn.Ary1D "MICROSAR RTE" /begin SUB_GROUP /end SUB_GROUP /begin FUNCTION_LIST /end FUNCTION_LIST /begin REF_CHARACTERISTIC PosnTrakgServo.PosnTrakgServoGainArbnFltMtgtn.Ary1D /end REF_CHARACTERISTIC /begin REF_MEASUREMENT /end REF_MEASUREMENT /end GROUP
/begin GROUP PosnTrakgServo.PosnTrakgServoHwAgTarMgnLimTblY.Ary1D "MICROSAR RTE" /begin SUB_GROUP /end SUB_GROUP /begin FUNCTION_LIST /end FUNCTION_LIST /begin REF_CHARACTERISTIC PosnTrakgServo.PosnTrakgServoHwAgTarMgnLimTblY.Ary1D /end REF_CHARACTERISTIC /begin REF_MEASUREMENT /end REF_MEASUREMENT /end GROUP
/begin GROUP PosnTrakgServo.PosnTrakgServoHwAgTarRateLimTblY.Ary1D "MICROSAR RTE" /begin SUB_GROUP /end SUB_GROUP /begin FUNCTION_LIST /end FUNCTION_LIST /begin REF_CHARACTERISTIC PosnTrakgServo.PosnTrakgServoHwAgTarRateLimTblY.Ary1D /end REF_CHARACTERISTIC /begin REF_MEASUREMENT /end REF_MEASUREMENT /end GROUP
/begin GROUP PosnTrakgServo.PosnTrakgServoHwVelTarRateLimTblY.Ary1D "MICROSAR RTE" /begin SUB_GROUP /end SUB_GROUP /begin FUNCTION_LIST /end FUNCTION_LIST /begin REF_CHARACTERISTIC PosnTrakgServo.PosnTrakgServoHwVelTarRateLimTblY.Ary1D /end REF_CHARACTERISTIC /begin REF_MEASUREMENT /end REF_MEASUREMENT /end GROUP
/begin GROUP PosnTrakgServo.PosnTrakgServoIntglGain.Ary1D "MICROSAR RTE" /begin SUB_GROUP /end SUB_GROUP /begin FUNCTION_LIST /end FUNCTION_LIST /begin REF_CHARACTERISTIC PosnTrakgServo.PosnTrakgServoIntglGain.Ary1D /end REF_CHARACTERISTIC /begin REF_MEASUREMENT /end REF_MEASUREMENT /end GROUP
/begin GROUP PosnTrakgServo.PosnTrakgServoIntglLim.Ary1D "MICROSAR RTE" /begin SUB_GROUP /end SUB_GROUP /begin FUNCTION_LIST /end FUNCTION_LIST /begin REF_CHARACTERISTIC PosnTrakgServo.PosnTrakgServoIntglLim.Ary1D /end REF_CHARACTERISTIC /begin REF_MEASUREMENT /end REF_MEASUREMENT /end GROUP
/begin GROUP PosnTrakgServo.PosnTrakgServoIntgtrAntiWdupGain.Val "MICROSAR RTE" /begin SUB_GROUP /end SUB_GROUP /begin FUNCTION_LIST /end FUNCTION_LIST /begin REF_CHARACTERISTIC PosnTrakgServo.PosnTrakgServoIntgtrAntiWdupGain.Val /end REF_CHARACTERISTIC /begin REF_MEASUREMENT /end REF_MEASUREMENT /end GROUP
/begin GROUP PosnTrakgServo.PosnTrakgServoIntgtrStCorrnGain.Val "MICROSAR RTE" /begin SUB_GROUP /end SUB_GROUP /begin FUNCTION_LIST /end FUNCTION_LIST /begin REF_CHARACTERISTIC PosnTrakgServo.PosnTrakgServoIntgtrStCorrnGain.Val /end REF_CHARACTERISTIC /begin REF_MEASUREMENT /end REF_MEASUREMENT /end GROUP
/begin GROUP PosnTrakgServo.PosnTrakgServoLpFilCutOffFrq.Val "MICROSAR RTE" /begin SUB_GROUP /end SUB_GROUP /begin FUNCTION_LIST /end FUNCTION_LIST /begin REF_CHARACTERISTIC PosnTrakgServo.PosnTrakgServoLpFilCutOffFrq.Val /end REF_CHARACTERISTIC /begin REF_MEASUREMENT /end REF_MEASUREMENT /end GROUP
/begin GROUP PosnTrakgServo.PosnTrakgServoOutpAntiWdupGain.Val "MICROSAR RTE" /begin SUB_GROUP /end SUB_GROUP /begin FUNCTION_LIST /end FUNCTION_LIST /begin REF_CHARACTERISTIC PosnTrakgServo.PosnTrakgServoOutpAntiWdupGain.Val /end REF_CHARACTERISTIC /begin REF_MEASUREMENT /end REF_MEASUREMENT /end GROUP
/begin GROUP PosnTrakgServo.PosnTrakgServoOutpLim.Ary1D "MICROSAR RTE" /begin SUB_GROUP /end SUB_GROUP /begin FUNCTION_LIST /end FUNCTION_LIST /begin REF_CHARACTERISTIC PosnTrakgServo.PosnTrakgServoOutpLim.Ary1D /end REF_CHARACTERISTIC /begin REF_MEASUREMENT /end REF_MEASUREMENT /end GROUP
/begin GROUP PosnTrakgServo.PosnTrakgServoVehSpdTbl.Ary1D "MICROSAR RTE" /begin SUB_GROUP /end SUB_GROUP /begin FUNCTION_LIST /end FUNCTION_LIST /begin REF_CHARACTERISTIC PosnTrakgServo.PosnTrakgServoVehSpdTbl.Ary1D /end REF_CHARACTERISTIC /begin REF_MEASUREMENT /end REF_MEASUREMENT /end GROUP
/begin GROUP PosnTrakgServo.ReceiverPorts "MICROSAR RTE"
 /begin SUB_GROUP PosnTrakgServo.HwAg.Val PosnTrakgServo.HwTq.Val PosnTrakgServo.MotVelCrf.Val PosnTrakgServo.PosnServoEna.Logl PosnTrakgServo.PosnServoHwAg.Val PosnTrakgServo.PosnServoHwVel.Val PosnTrakgServo.PosnServoIntgtrOffs.Val PosnTrakgServo.PosnTrakgArbnFltMtgtnEna.Logl PosnTrakgServo.VehSpd.Val /end SUB_GROUP
 /begin FUNCTION_LIST /end FUNCTION_LIST
 /begin REF_CHARACTERISTIC /end REF_CHARACTERISTIC
 /begin REF_MEASUREMENT /end REF_MEASUREMENT
/end GROUP
/begin GROUP PosnTrakgServo.SenderPorts "MICROSAR RTE"
 /begin SUB_GROUP PosnTrakgServo.PosnServoCmd.Val PosnTrakgServo.PosnServoIntgtrSt.Val /end SUB_GROUP
 /begin FUNCTION_LIST /end FUNCTION_LIST
 /begin REF_CHARACTERISTIC /end REF_CHARACTERISTIC
 /begin REF_MEASUREMENT /end REF_MEASUREMENT
/end GROUP
/begin GROUP PosnTrakgServo.SysGlbPrmSysKineRat.Val "MICROSAR RTE" /begin SUB_GROUP /end SUB_GROUP /begin FUNCTION_LIST /end FUNCTION_LIST /begin REF_CHARACTERISTIC PosnTrakgServo.SysGlbPrmSysKineRat.Val /end REF_CHARACTERISTIC /begin REF_MEASUREMENT /end REF_MEASUREMENT /end GROUP
/begin GROUP PosnTrakgServo.SysGlbPrmSysTqRat.Val "MICROSAR RTE" /begin SUB_GROUP /end SUB_GROUP /begin FUNCTION_LIST /end FUNCTION_LIST /begin REF_CHARACTERISTIC PosnTrakgServo.SysGlbPrmSysTqRat.Val /end REF_CHARACTERISTIC /begin REF_MEASUREMENT /end REF_MEASUREMENT /end GROUP
/begin GROUP PosnTrakgServo.VehSpd.Val "MICROSAR RTE" /begin SUB_GROUP /end SUB_GROUP /begin FUNCTION_LIST /end FUNCTION_LIST /begin REF_CHARACTERISTIC /end REF_CHARACTERISTIC /begin REF_MEASUREMENT PosnTrakgServo.VehSpd.Val /end REF_MEASUREMENT /end GROUP
/begin GROUP PosnTrakgServo.dPosnTrakgServoCmdPreLimd "MICROSAR RTE" /begin SUB_GROUP /end SUB_GROUP /begin FUNCTION_LIST /end FUNCTION_LIST /begin REF_CHARACTERISTIC /end REF_CHARACTERISTIC /begin REF_MEASUREMENT PosnTrakgServo.dPosnTrakgServoCmdPreLimd /end REF_MEASUREMENT /end GROUP
/begin GROUP PosnTrakgServo.dPosnTrakgServoEnaBlndFac "MICROSAR RTE" /begin SUB_GROUP /end SUB_GROUP /begin FUNCTION_LIST /end FUNCTION_LIST /begin REF_CHARACTERISTIC /end REF_CHARACTERISTIC /begin REF_MEASUREMENT PosnTrakgServo.dPosnTrakgServoEnaBlndFac /end REF_MEASUREMENT /end GROUP
/begin GROUP PosnTrakgServo.dPosnTrakgServoFfCmd "MICROSAR RTE" /begin SUB_GROUP /end SUB_GROUP /begin FUNCTION_LIST /end FUNCTION_LIST /begin REF_CHARACTERISTIC /end REF_CHARACTERISTIC /begin REF_MEASUREMENT PosnTrakgServo.dPosnTrakgServoFfCmd /end REF_MEASUREMENT /end GROUP
/begin GROUP PosnTrakgServo.dPosnTrakgServoHwAg "MICROSAR RTE" /begin SUB_GROUP /end SUB_GROUP /begin FUNCTION_LIST /end FUNCTION_LIST /begin REF_CHARACTERISTIC /end REF_CHARACTERISTIC /begin REF_MEASUREMENT PosnTrakgServo.dPosnTrakgServoHwAg /end REF_MEASUREMENT /end GROUP
/begin GROUP PosnTrakgServo.dPosnTrakgServoHwAgErr "MICROSAR RTE" /begin SUB_GROUP /end SUB_GROUP /begin FUNCTION_LIST /end FUNCTION_LIST /begin REF_CHARACTERISTIC /end REF_CHARACTERISTIC /begin REF_MEASUREMENT PosnTrakgServo.dPosnTrakgServoHwAgErr /end REF_MEASUREMENT /end GROUP
/begin GROUP PosnTrakgServo.dPosnTrakgServoHwAgTarLimd "MICROSAR RTE" /begin SUB_GROUP /end SUB_GROUP /begin FUNCTION_LIST /end FUNCTION_LIST /begin REF_CHARACTERISTIC /end REF_CHARACTERISTIC /begin REF_MEASUREMENT PosnTrakgServo.dPosnTrakgServoHwAgTarLimd /end REF_MEASUREMENT /end GROUP
/begin GROUP PosnTrakgServo.dPosnTrakgServoHwVelTarLimd "MICROSAR RTE" /begin SUB_GROUP /end SUB_GROUP /begin FUNCTION_LIST /end FUNCTION_LIST /begin REF_CHARACTERISTIC /end REF_CHARACTERISTIC /begin REF_MEASUREMENT PosnTrakgServo.dPosnTrakgServoHwVelTarLimd /end REF_MEASUREMENT /end GROUP
/begin GROUP PosnTrakgServo.dPosnTrakgServoIntgtrCmdLimd "MICROSAR RTE" /begin SUB_GROUP /end SUB_GROUP /begin FUNCTION_LIST /end FUNCTION_LIST /begin REF_CHARACTERISTIC /end REF_CHARACTERISTIC /begin REF_MEASUREMENT PosnTrakgServo.dPosnTrakgServoIntgtrCmdLimd /end REF_MEASUREMENT /end GROUP
/begin GROUP PosnTrakgServo.dPosnTrakgServoPtlStFbCmd "MICROSAR RTE" /begin SUB_GROUP /end SUB_GROUP /begin FUNCTION_LIST /end FUNCTION_LIST /begin REF_CHARACTERISTIC /end REF_CHARACTERISTIC /begin REF_MEASUREMENT PosnTrakgServo.dPosnTrakgServoPtlStFbCmd /end REF_MEASUREMENT /end GROUP
/begin GROUP PwrDiscnct "MICROSAR RTE"
 /begin SUB_GROUP PwrDiscnct.CalibrationPorts PwrDiscnct.PerInstanceMemories PwrDiscnct.ReceiverPorts PwrDiscnct.SenderPorts /end SUB_GROUP
 /begin FUNCTION_LIST /end FUNCTION_LIST
 /begin REF_CHARACTERISTIC /end REF_CHARACTERISTIC
 /begin REF_MEASUREMENT /end REF_MEASUREMENT
/end GROUP
/begin GROUP PwrDiscnct.BattVltg.Val "MICROSAR RTE" /begin SUB_GROUP /end SUB_GROUP /begin FUNCTION_LIST /end FUNCTION_LIST /begin REF_CHARACTERISTIC /end REF_CHARACTERISTIC /begin REF_MEASUREMENT PwrDiscnct.BattVltg.Val /end REF_MEASUREMENT /end GROUP
/begin GROUP PwrDiscnct.BattVltgAdcFaild.Logl "MICROSAR RTE" /begin SUB_GROUP /end SUB_GROUP /begin FUNCTION_LIST /end FUNCTION_LIST /begin REF_CHARACTERISTIC /end REF_CHARACTERISTIC /begin REF_MEASUREMENT PwrDiscnct.BattVltgAdcFaild.Logl /end REF_MEASUREMENT /end GROUP
/begin GROUP PwrDiscnct.BattVltgSwd1.Val "MICROSAR RTE" /begin SUB_GROUP /end SUB_GROUP /begin FUNCTION_LIST /end FUNCTION_LIST /begin REF_CHARACTERISTIC /end REF_CHARACTERISTIC /begin REF_MEASUREMENT PwrDiscnct.BattVltgSwd1.Val /end REF_MEASUREMENT /end GROUP
/begin GROUP PwrDiscnct.BattVltgSwdMax.Val "MICROSAR RTE" /begin SUB_GROUP /end SUB_GROUP /begin FUNCTION_LIST /end FUNCTION_LIST /begin REF_CHARACTERISTIC PwrDiscnct.BattVltgSwdMax.Val /end REF_CHARACTERISTIC /begin REF_MEASUREMENT /end REF_MEASUREMENT /end GROUP
/begin GROUP PwrDiscnct.CalibrationPorts "MICROSAR RTE"
 /begin SUB_GROUP PwrDiscnct.BattVltgSwdMax.Val PwrDiscnct.PwrDiscnctBattVltgExtdNormThd.Val PwrDiscnct.PwrDiscnctBattVltgNonExtdThd.Val PwrDiscnct.PwrDiscnctChrgMinDeltaExtOper.Val PwrDiscnct.PwrDiscnctChrgMinDeltaNonOper.Val PwrDiscnct.PwrDiscnctChrgMinDeltaNormOper.Val PwrDiscnct.PwrDiscnctChrgPmpDiagOpenThd.Val PwrDiscnct.PwrDiscnctDeltaSwtClsThd.Val PwrDiscnct.PwrDiscnctDeltaVltgClsThd.Val PwrDiscnct.PwrDiscnctDeltaVltgOpenThd.Val PwrDiscnct.PwrDiscnctFltFailStep.Val PwrDiscnct.PwrDiscnctFltPassStep.Val PwrDiscnct.PwrDiscnctFltThd.Val PwrDiscnct.PwrDiscnctMtrMtnThd.Val PwrDiscnct.PwrDiscnctPwrDiscnctRtFltFailStep.Val PwrDiscnct.PwrDiscnctPwrDiscnctRtFltPassStep.Val PwrDiscnct.PwrDiscnctSwtDiagOpenThd.Val /end SUB_GROUP
 /begin FUNCTION_LIST /end FUNCTION_LIST
 /begin REF_CHARACTERISTIC /end REF_CHARACTERISTIC
 /begin REF_MEASUREMENT /end REF_MEASUREMENT
/end GROUP
/begin GROUP PwrDiscnct.ChrgPmpDiag.Val "MICROSAR RTE" /begin SUB_GROUP /end SUB_GROUP /begin FUNCTION_LIST /end FUNCTION_LIST /begin REF_CHARACTERISTIC /end REF_CHARACTERISTIC /begin REF_MEASUREMENT PwrDiscnct.ChrgPmpDiag.Val /end REF_MEASUREMENT /end GROUP
/begin GROUP PwrDiscnct.ChrgPmpDiagAdcFaild.Logl "MICROSAR RTE" /begin SUB_GROUP /end SUB_GROUP /begin FUNCTION_LIST /end FUNCTION_LIST /begin REF_CHARACTERISTIC /end REF_CHARACTERISTIC /begin REF_MEASUREMENT PwrDiscnct.ChrgPmpDiagAdcFaild.Logl /end REF_MEASUREMENT /end GROUP
/begin GROUP PwrDiscnct.FirstRunCmpl "MICROSAR RTE" /begin SUB_GROUP /end SUB_GROUP /begin FUNCTION_LIST /end FUNCTION_LIST /begin REF_CHARACTERISTIC /end REF_CHARACTERISTIC /begin REF_MEASUREMENT PwrDiscnct.FirstRunCmpl /end REF_MEASUREMENT /end GROUP
/begin GROUP PwrDiscnct.MotVelMrf.Val "MICROSAR RTE" /begin SUB_GROUP /end SUB_GROUP /begin FUNCTION_LIST /end FUNCTION_LIST /begin REF_CHARACTERISTIC /end REF_CHARACTERISTIC /begin REF_MEASUREMENT PwrDiscnct.MotVelMrf.Val /end REF_MEASUREMENT /end GROUP
/begin GROUP PwrDiscnct.Ntc042PrmByte "MICROSAR RTE" /begin SUB_GROUP /end SUB_GROUP /begin FUNCTION_LIST /end FUNCTION_LIST /begin REF_CHARACTERISTIC /end REF_CHARACTERISTIC /begin REF_MEASUREMENT PwrDiscnct.Ntc042PrmByte /end REF_MEASUREMENT /end GROUP
/begin GROUP PwrDiscnct.PerInstanceMemories "MICROSAR RTE"
 /begin SUB_GROUP PwrDiscnct.FirstRunCmpl PwrDiscnct.Ntc042PrmByte PwrDiscnct.PwrDiscnctClsdSts PwrDiscnct.PwrDiscnctFltAtInitErrAcc PwrDiscnct.PwrDiscnctSt PwrDiscnct.PwrDiscnctTestACmpl PwrDiscnct.PwrDiscnctTestBCmpl /end SUB_GROUP
 /begin FUNCTION_LIST /end FUNCTION_LIST
 /begin REF_CHARACTERISTIC /end REF_CHARACTERISTIC
 /begin REF_MEASUREMENT /end REF_MEASUREMENT
/end GROUP
/begin GROUP PwrDiscnct.PwrDiscnctATestCmpl.Logl "MICROSAR RTE" /begin SUB_GROUP /end SUB_GROUP /begin FUNCTION_LIST /end FUNCTION_LIST /begin REF_CHARACTERISTIC /end REF_CHARACTERISTIC /begin REF_MEASUREMENT PwrDiscnct.PwrDiscnctATestCmpl.Logl /end REF_MEASUREMENT /end GROUP
/begin GROUP PwrDiscnct.PwrDiscnctBTestCmpl.Logl "MICROSAR RTE" /begin SUB_GROUP /end SUB_GROUP /begin FUNCTION_LIST /end FUNCTION_LIST /begin REF_CHARACTERISTIC /end REF_CHARACTERISTIC /begin REF_MEASUREMENT PwrDiscnct.PwrDiscnctBTestCmpl.Logl /end REF_MEASUREMENT /end GROUP
/begin GROUP PwrDiscnct.PwrDiscnctBattVltgExtdNormThd.Val "MICROSAR RTE" /begin SUB_GROUP /end SUB_GROUP /begin FUNCTION_LIST /end FUNCTION_LIST /begin REF_CHARACTERISTIC PwrDiscnct.PwrDiscnctBattVltgExtdNormThd.Val /end REF_CHARACTERISTIC /begin REF_MEASUREMENT /end REF_MEASUREMENT /end GROUP
/begin GROUP PwrDiscnct.PwrDiscnctBattVltgNonExtdThd.Val "MICROSAR RTE" /begin SUB_GROUP /end SUB_GROUP /begin FUNCTION_LIST /end FUNCTION_LIST /begin REF_CHARACTERISTIC PwrDiscnct.PwrDiscnctBattVltgNonExtdThd.Val /end REF_CHARACTERISTIC /begin REF_MEASUREMENT /end REF_MEASUREMENT /end GROUP
/begin GROUP PwrDiscnct.PwrDiscnctChrgMinDeltaExtOper.Val "MICROSAR RTE" /begin SUB_GROUP /end SUB_GROUP /begin FUNCTION_LIST /end FUNCTION_LIST /begin REF_CHARACTERISTIC PwrDiscnct.PwrDiscnctChrgMinDeltaExtOper.Val /end REF_CHARACTERISTIC /begin REF_MEASUREMENT /end REF_MEASUREMENT /end GROUP
/begin GROUP PwrDiscnct.PwrDiscnctChrgMinDeltaNonOper.Val "MICROSAR RTE" /begin SUB_GROUP /end SUB_GROUP /begin FUNCTION_LIST /end FUNCTION_LIST /begin REF_CHARACTERISTIC PwrDiscnct.PwrDiscnctChrgMinDeltaNonOper.Val /end REF_CHARACTERISTIC /begin REF_MEASUREMENT /end REF_MEASUREMENT /end GROUP
/begin GROUP PwrDiscnct.PwrDiscnctChrgMinDeltaNormOper.Val "MICROSAR RTE" /begin SUB_GROUP /end SUB_GROUP /begin FUNCTION_LIST /end FUNCTION_LIST /begin REF_CHARACTERISTIC PwrDiscnct.PwrDiscnctChrgMinDeltaNormOper.Val /end REF_CHARACTERISTIC /begin REF_MEASUREMENT /end REF_MEASUREMENT /end GROUP
/begin GROUP PwrDiscnct.PwrDiscnctChrgPmpDiagOpenThd.Val "MICROSAR RTE" /begin SUB_GROUP /end SUB_GROUP /begin FUNCTION_LIST /end FUNCTION_LIST /begin REF_CHARACTERISTIC PwrDiscnct.PwrDiscnctChrgPmpDiagOpenThd.Val /end REF_CHARACTERISTIC /begin REF_MEASUREMENT /end REF_MEASUREMENT /end GROUP
/begin GROUP PwrDiscnct.PwrDiscnctClsd.Logl "MICROSAR RTE" /begin SUB_GROUP /end SUB_GROUP /begin FUNCTION_LIST /end FUNCTION_LIST /begin REF_CHARACTERISTIC /end REF_CHARACTERISTIC /begin REF_MEASUREMENT PwrDiscnct.PwrDiscnctClsd.Logl /end REF_MEASUREMENT /end GROUP
/begin GROUP PwrDiscnct.PwrDiscnctClsdSts "MICROSAR RTE" /begin SUB_GROUP /end SUB_GROUP /begin FUNCTION_LIST /end FUNCTION_LIST /begin REF_CHARACTERISTIC /end REF_CHARACTERISTIC /begin REF_MEASUREMENT PwrDiscnct.PwrDiscnctClsdSts /end REF_MEASUREMENT /end GROUP
/begin GROUP PwrDiscnct.PwrDiscnctDeltaSwtClsThd.Val "MICROSAR RTE" /begin SUB_GROUP /end SUB_GROUP /begin FUNCTION_LIST /end FUNCTION_LIST /begin REF_CHARACTERISTIC PwrDiscnct.PwrDiscnctDeltaSwtClsThd.Val /end REF_CHARACTERISTIC /begin REF_MEASUREMENT /end REF_MEASUREMENT /end GROUP
/begin GROUP PwrDiscnct.PwrDiscnctDeltaVltgClsThd.Val "MICROSAR RTE" /begin SUB_GROUP /end SUB_GROUP /begin FUNCTION_LIST /end FUNCTION_LIST /begin REF_CHARACTERISTIC PwrDiscnct.PwrDiscnctDeltaVltgClsThd.Val /end REF_CHARACTERISTIC /begin REF_MEASUREMENT /end REF_MEASUREMENT /end GROUP
/begin GROUP PwrDiscnct.PwrDiscnctDeltaVltgOpenThd.Val "MICROSAR RTE" /begin SUB_GROUP /end SUB_GROUP /begin FUNCTION_LIST /end FUNCTION_LIST /begin REF_CHARACTERISTIC PwrDiscnct.PwrDiscnctDeltaVltgOpenThd.Val /end REF_CHARACTERISTIC /begin REF_MEASUREMENT /end REF_MEASUREMENT /end GROUP
/begin GROUP PwrDiscnct.PwrDiscnctFltAtInitErrAcc "MICROSAR RTE" /begin SUB_GROUP /end SUB_GROUP /begin FUNCTION_LIST /end FUNCTION_LIST /begin REF_CHARACTERISTIC /end REF_CHARACTERISTIC /begin REF_MEASUREMENT PwrDiscnct.PwrDiscnctFltAtInitErrAcc /end REF_MEASUREMENT /end GROUP
/begin GROUP PwrDiscnct.PwrDiscnctFltFailStep.Val "MICROSAR RTE" /begin SUB_GROUP /end SUB_GROUP /begin FUNCTION_LIST /end FUNCTION_LIST /begin REF_CHARACTERISTIC PwrDiscnct.PwrDiscnctFltFailStep.Val /end REF_CHARACTERISTIC /begin REF_MEASUREMENT /end REF_MEASUREMENT /end GROUP
/begin GROUP PwrDiscnct.PwrDiscnctFltPassStep.Val "MICROSAR RTE" /begin SUB_GROUP /end SUB_GROUP /begin FUNCTION_LIST /end FUNCTION_LIST /begin REF_CHARACTERISTIC PwrDiscnct.PwrDiscnctFltPassStep.Val /end REF_CHARACTERISTIC /begin REF_MEASUREMENT /end REF_MEASUREMENT /end GROUP
/begin GROUP PwrDiscnct.PwrDiscnctFltThd.Val "MICROSAR RTE" /begin SUB_GROUP /end SUB_GROUP /begin FUNCTION_LIST /end FUNCTION_LIST /begin REF_CHARACTERISTIC PwrDiscnct.PwrDiscnctFltThd.Val /end REF_CHARACTERISTIC /begin REF_MEASUREMENT /end REF_MEASUREMENT /end GROUP
/begin GROUP PwrDiscnct.PwrDiscnctMtrMtnThd.Val "MICROSAR RTE" /begin SUB_GROUP /end SUB_GROUP /begin FUNCTION_LIST /end FUNCTION_LIST /begin REF_CHARACTERISTIC PwrDiscnct.PwrDiscnctMtrMtnThd.Val /end REF_CHARACTERISTIC /begin REF_MEASUREMENT /end REF_MEASUREMENT /end GROUP
/begin GROUP PwrDiscnct.PwrDiscnctPwrDiscnctRtFltFailStep.Val "MICROSAR RTE" /begin SUB_GROUP /end SUB_GROUP /begin FUNCTION_LIST /end FUNCTION_LIST /begin REF_CHARACTERISTIC PwrDiscnct.PwrDiscnctPwrDiscnctRtFltFailStep.Val /end REF_CHARACTERISTIC /begin REF_MEASUREMENT /end REF_MEASUREMENT /end GROUP
/begin GROUP PwrDiscnct.PwrDiscnctPwrDiscnctRtFltPassStep.Val "MICROSAR RTE" /begin SUB_GROUP /end SUB_GROUP /begin FUNCTION_LIST /end FUNCTION_LIST /begin REF_CHARACTERISTIC PwrDiscnct.PwrDiscnctPwrDiscnctRtFltPassStep.Val /end REF_CHARACTERISTIC /begin REF_MEASUREMENT /end REF_MEASUREMENT /end GROUP
/begin GROUP PwrDiscnct.PwrDiscnctSt "MICROSAR RTE" /begin SUB_GROUP /end SUB_GROUP /begin FUNCTION_LIST /end FUNCTION_LIST /begin REF_CHARACTERISTIC /end REF_CHARACTERISTIC /begin REF_MEASUREMENT PwrDiscnct.PwrDiscnctSt /end REF_MEASUREMENT /end GROUP
/begin GROUP PwrDiscnct.PwrDiscnctSwtDiag.Val "MICROSAR RTE" /begin SUB_GROUP /end SUB_GROUP /begin FUNCTION_LIST /end FUNCTION_LIST /begin REF_CHARACTERISTIC /end REF_CHARACTERISTIC /begin REF_MEASUREMENT PwrDiscnct.PwrDiscnctSwtDiag.Val /end REF_MEASUREMENT /end GROUP
/begin GROUP PwrDiscnct.PwrDiscnctSwtDiagOpenThd.Val "MICROSAR RTE" /begin SUB_GROUP /end SUB_GROUP /begin FUNCTION_LIST /end FUNCTION_LIST /begin REF_CHARACTERISTIC PwrDiscnct.PwrDiscnctSwtDiagOpenThd.Val /end REF_CHARACTERISTIC /begin REF_MEASUREMENT /end REF_MEASUREMENT /end GROUP
/begin GROUP PwrDiscnct.PwrDiscnctTestACmpl "MICROSAR RTE" /begin SUB_GROUP /end SUB_GROUP /begin FUNCTION_LIST /end FUNCTION_LIST /begin REF_CHARACTERISTIC /end REF_CHARACTERISTIC /begin REF_MEASUREMENT PwrDiscnct.PwrDiscnctTestACmpl /end REF_MEASUREMENT /end GROUP
/begin GROUP PwrDiscnct.PwrDiscnctTestBCmpl "MICROSAR RTE" /begin SUB_GROUP /end SUB_GROUP /begin FUNCTION_LIST /end FUNCTION_LIST /begin REF_CHARACTERISTIC /end REF_CHARACTERISTIC /begin REF_MEASUREMENT PwrDiscnct.PwrDiscnctTestBCmpl /end REF_MEASUREMENT /end GROUP
/begin GROUP PwrDiscnct.ReceiverPorts "MICROSAR RTE"
 /begin SUB_GROUP PwrDiscnct.BattVltg.Val PwrDiscnct.BattVltgAdcFaild.Logl PwrDiscnct.BattVltgSwd1.Val PwrDiscnct.ChrgPmpDiag.Val PwrDiscnct.ChrgPmpDiagAdcFaild.Logl PwrDiscnct.MotVelMrf.Val PwrDiscnct.PwrDiscnctSwtDiag.Val PwrDiscnct.StrtUpSt.Val PwrDiscnct.SysSt.Val /end SUB_GROUP
 /begin FUNCTION_LIST /end FUNCTION_LIST
 /begin REF_CHARACTERISTIC /end REF_CHARACTERISTIC
 /begin REF_MEASUREMENT /end REF_MEASUREMENT
/end GROUP
/begin GROUP PwrDiscnct.SenderPorts "MICROSAR RTE"
 /begin SUB_GROUP PwrDiscnct.PwrDiscnctATestCmpl.Logl PwrDiscnct.PwrDiscnctBTestCmpl.Logl PwrDiscnct.PwrDiscnctClsd.Logl /end SUB_GROUP
 /begin FUNCTION_LIST /end FUNCTION_LIST
 /begin REF_CHARACTERISTIC /end REF_CHARACTERISTIC
 /begin REF_MEASUREMENT /end REF_MEASUREMENT
/end GROUP
/begin GROUP PwrDiscnct.StrtUpSt.Val "MICROSAR RTE" /begin SUB_GROUP /end SUB_GROUP /begin FUNCTION_LIST /end FUNCTION_LIST /begin REF_CHARACTERISTIC /end REF_CHARACTERISTIC /begin REF_MEASUREMENT PwrDiscnct.StrtUpSt.Val /end REF_MEASUREMENT /end GROUP
/begin GROUP PwrDiscnct.SysSt.Val "MICROSAR RTE" /begin SUB_GROUP /end SUB_GROUP /begin FUNCTION_LIST /end FUNCTION_LIST /begin REF_CHARACTERISTIC /end REF_CHARACTERISTIC /begin REF_MEASUREMENT PwrDiscnct.SysSt.Val /end REF_MEASUREMENT /end GROUP
/begin GROUP PwrLimr "MICROSAR RTE"
 /begin SUB_GROUP PwrLimr.CalibrationPorts PwrLimr.PerInstanceMemories PwrLimr.ReceiverPorts PwrLimr.SenderPorts /end SUB_GROUP
 /begin FUNCTION_LIST /end FUNCTION_LIST
 /begin REF_CHARACTERISTIC /end REF_CHARACTERISTIC
 /begin REF_MEASUREMENT /end REF_MEASUREMENT
/end GROUP
/begin GROUP PwrLimr.AltFltActv.Logl "MICROSAR RTE" /begin SUB_GROUP /end SUB_GROUP /begin FUNCTION_LIST /end FUNCTION_LIST /begin REF_CHARACTERISTIC /end REF_CHARACTERISTIC /begin REF_MEASUREMENT PwrLimr.AltFltActv.Logl /end REF_MEASUREMENT /end GROUP
/begin GROUP PwrLimr.BrdgVltg.Val "MICROSAR RTE" /begin SUB_GROUP /end SUB_GROUP /begin FUNCTION_LIST /end FUNCTION_LIST /begin REF_CHARACTERISTIC /end REF_CHARACTERISTIC /begin REF_MEASUREMENT PwrLimr.BrdgVltg.Val /end REF_MEASUREMENT /end GROUP
/begin GROUP PwrLimr.BrdgVltgRateLim "MICROSAR RTE" /begin SUB_GROUP /end SUB_GROUP /begin FUNCTION_LIST /end FUNCTION_LIST /begin REF_CHARACTERISTIC /end REF_CHARACTERISTIC /begin REF_MEASUREMENT PwrLimr.BrdgVltgRateLim /end REF_MEASUREMENT /end GROUP
/begin GROUP PwrLimr.CalibrationPorts "MICROSAR RTE"
 /begin SUB_GROUP PwrLimr.PwrLimrAssiRednLpFilFrq.Val PwrLimr.PwrLimrBackEmfConStdT.Val PwrLimr.PwrLimrBrdgVltgAdjSlew.Val PwrLimr.PwrLimrBrdgVltgAltFltAdj.Val PwrLimr.PwrLimrFilAssiRednThd.Val PwrLimr.PwrLimrLoVoltAssiRcvrThd.Val PwrLimr.PwrLimrLoVoltAssiRcvrTi.Val PwrLimr.PwrLimrMotEnvlpX.Ary1D PwrLimr.PwrLimrMotEnvlpY.Ary1D PwrLimr.PwrLimrMotVelLpFilFrq.Val PwrLimr.PwrLimrSpdAdjSlewDec.Val PwrLimr.PwrLimrSpdAdjSlewEna.Logl PwrLimr.PwrLimrSpdAdjSlewInc.Val PwrLimr.PwrLimrStdOperMotEnvlpX.Ary1D PwrLimr.PwrLimrStdOperMotEnvlpY.Ary1D PwrLimr.PwrLimrVltgDptMotVelOffsX.Ary1D PwrLimr.PwrLimrVltgDptMotVelOffsY.Ary1D /end SUB_GROUP
 /begin FUNCTION_LIST /end FUNCTION_LIST
 /begin REF_CHARACTERISTIC /end REF_CHARACTERISTIC
 /begin REF_MEASUREMENT /end REF_MEASUREMENT
/end GROUP
/begin GROUP PwrLimr.DualEcuFltMtgtnSca.Val "MICROSAR RTE" /begin SUB_GROUP /end SUB_GROUP /begin FUNCTION_LIST /end FUNCTION_LIST /begin REF_CHARACTERISTIC /end REF_CHARACTERISTIC /begin REF_MEASUREMENT PwrLimr.DualEcuFltMtgtnSca.Val /end REF_MEASUREMENT /end GROUP
/begin GROUP PwrLimr.LimdAssiLoVltgPrev "MICROSAR RTE" /begin SUB_GROUP /end SUB_GROUP /begin FUNCTION_LIST /end FUNCTION_LIST /begin REF_CHARACTERISTIC /end REF_CHARACTERISTIC /begin REF_MEASUREMENT PwrLimr.LimdAssiLoVltgPrev /end REF_MEASUREMENT /end GROUP
/begin GROUP PwrLimr.MotAndThermProtnLoaMod.Val "MICROSAR RTE" /begin SUB_GROUP /end SUB_GROUP /begin FUNCTION_LIST /end FUNCTION_LIST /begin REF_CHARACTERISTIC /end REF_CHARACTERISTIC /begin REF_MEASUREMENT PwrLimr.MotAndThermProtnLoaMod.Val /end REF_MEASUREMENT /end GROUP
/begin GROUP PwrLimr.MotBackEmfConEstimd.Val "MICROSAR RTE" /begin SUB_GROUP /end SUB_GROUP /begin FUNCTION_LIST /end FUNCTION_LIST /begin REF_CHARACTERISTIC /end REF_CHARACTERISTIC /begin REF_MEASUREMENT PwrLimr.MotBackEmfConEstimd.Val /end REF_MEASUREMENT /end GROUP
/begin GROUP PwrLimr.MotTqCmdMrf.Val "MICROSAR RTE" /begin SUB_GROUP /end SUB_GROUP /begin FUNCTION_LIST /end FUNCTION_LIST /begin REF_CHARACTERISTIC /end REF_CHARACTERISTIC /begin REF_MEASUREMENT PwrLimr.MotTqCmdMrf.Val /end REF_MEASUREMENT /end GROUP
/begin GROUP PwrLimr.MotTqCmdPwrLimd.Val "MICROSAR RTE" /begin SUB_GROUP /end SUB_GROUP /begin FUNCTION_LIST /end FUNCTION_LIST /begin REF_CHARACTERISTIC /end REF_CHARACTERISTIC /begin REF_MEASUREMENT PwrLimr.MotTqCmdPwrLimd.Val /end REF_MEASUREMENT /end GROUP
/begin GROUP PwrLimr.MotVelLpFil "MICROSAR RTE" /begin SUB_GROUP /end SUB_GROUP /begin FUNCTION_LIST /end FUNCTION_LIST /begin REF_CHARACTERISTIC /end REF_CHARACTERISTIC /begin REF_MEASUREMENT PwrLimr.MotVelLpFil.FilGain PwrLimr.MotVelLpFil.FilSt /end REF_MEASUREMENT /end GROUP
/begin GROUP PwrLimr.MotVelMrf.Val "MICROSAR RTE" /begin SUB_GROUP /end SUB_GROUP /begin FUNCTION_LIST /end FUNCTION_LIST /begin REF_CHARACTERISTIC /end REF_CHARACTERISTIC /begin REF_MEASUREMENT PwrLimr.MotVelMrf.Val /end REF_MEASUREMENT /end GROUP
/begin GROUP PwrLimr.OutpVelOffsRateLimd "MICROSAR RTE" /begin SUB_GROUP /end SUB_GROUP /begin FUNCTION_LIST /end FUNCTION_LIST /begin REF_CHARACTERISTIC /end REF_CHARACTERISTIC /begin REF_MEASUREMENT PwrLimr.OutpVelOffsRateLimd /end REF_MEASUREMENT /end GROUP
/begin GROUP PwrLimr.PerInstanceMemories "MICROSAR RTE"
 /begin SUB_GROUP PwrLimr.BrdgVltgRateLim PwrLimr.LimdAssiLoVltgPrev PwrLimr.MotVelLpFil PwrLimr.OutpVelOffsRateLimd PwrLimr.RefTmr PwrLimr.RefTmrPrev PwrLimr.TqLimLpFil PwrLimr.dPwrLimrFildMotVel PwrLimr.dPwrLimrLimDif PwrLimr.dPwrLimrMinStdOperLim PwrLimr.dPwrLimrMotEnvlpSpd PwrLimr.dPwrLimrMotTqCmdIvtrLoaSca PwrLimr.dPwrLimrOutpVelOffs PwrLimr.dPwrLimrSpdAdj PwrLimr.dPwrLimrTLimMaxCurr PwrLimr.dPwrLimrTqEnvlpLim1 PwrLimr.dPwrLimrTqEnvlpLim4 PwrLimr.dPwrLimrTqLim PwrLimr.dPwrLimrTqLim1 PwrLimr.dPwrLimrTqLim4 /end SUB_GROUP
 /begin FUNCTION_LIST /end FUNCTION_LIST
 /begin REF_CHARACTERISTIC /end REF_CHARACTERISTIC
 /begin REF_MEASUREMENT /end REF_MEASUREMENT
/end GROUP
/begin GROUP PwrLimr.PwrLimrAssiRednLpFilFrq.Val "MICROSAR RTE" /begin SUB_GROUP /end SUB_GROUP /begin FUNCTION_LIST /end FUNCTION_LIST /begin REF_CHARACTERISTIC PwrLimr.PwrLimrAssiRednLpFilFrq.Val /end REF_CHARACTERISTIC /begin REF_MEASUREMENT /end REF_MEASUREMENT /end GROUP
/begin GROUP PwrLimr.PwrLimrBackEmfConStdT.Val "MICROSAR RTE" /begin SUB_GROUP /end SUB_GROUP /begin FUNCTION_LIST /end FUNCTION_LIST /begin REF_CHARACTERISTIC PwrLimr.PwrLimrBackEmfConStdT.Val /end REF_CHARACTERISTIC /begin REF_MEASUREMENT /end REF_MEASUREMENT /end GROUP
/begin GROUP PwrLimr.PwrLimrBrdgVltgAdjSlew.Val "MICROSAR RTE" /begin SUB_GROUP /end SUB_GROUP /begin FUNCTION_LIST /end FUNCTION_LIST /begin REF_CHARACTERISTIC PwrLimr.PwrLimrBrdgVltgAdjSlew.Val /end REF_CHARACTERISTIC /begin REF_MEASUREMENT /end REF_MEASUREMENT /end GROUP
/begin GROUP PwrLimr.PwrLimrBrdgVltgAltFltAdj.Val "MICROSAR RTE" /begin SUB_GROUP /end SUB_GROUP /begin FUNCTION_LIST /end FUNCTION_LIST /begin REF_CHARACTERISTIC PwrLimr.PwrLimrBrdgVltgAltFltAdj.Val /end REF_CHARACTERISTIC /begin REF_MEASUREMENT /end REF_MEASUREMENT /end GROUP
/begin GROUP PwrLimr.PwrLimrFilAssiRednThd.Val "MICROSAR RTE" /begin SUB_GROUP /end SUB_GROUP /begin FUNCTION_LIST /end FUNCTION_LIST /begin REF_CHARACTERISTIC PwrLimr.PwrLimrFilAssiRednThd.Val /end REF_CHARACTERISTIC /begin REF_MEASUREMENT /end REF_MEASUREMENT /end GROUP
/begin GROUP PwrLimr.PwrLimrLoVoltAssiRcvrThd.Val "MICROSAR RTE" /begin SUB_GROUP /end SUB_GROUP /begin FUNCTION_LIST /end FUNCTION_LIST /begin REF_CHARACTERISTIC PwrLimr.PwrLimrLoVoltAssiRcvrThd.Val /end REF_CHARACTERISTIC /begin REF_MEASUREMENT /end REF_MEASUREMENT /end GROUP
/begin GROUP PwrLimr.PwrLimrLoVoltAssiRcvrTi.Val "MICROSAR RTE" /begin SUB_GROUP /end SUB_GROUP /begin FUNCTION_LIST /end FUNCTION_LIST /begin REF_CHARACTERISTIC PwrLimr.PwrLimrLoVoltAssiRcvrTi.Val /end REF_CHARACTERISTIC /begin REF_MEASUREMENT /end REF_MEASUREMENT /end GROUP
/begin GROUP PwrLimr.PwrLimrMotEnvlpX.Ary1D "MICROSAR RTE" /begin SUB_GROUP /end SUB_GROUP /begin FUNCTION_LIST /end FUNCTION_LIST /begin REF_CHARACTERISTIC PwrLimr.PwrLimrMotEnvlpX.Ary1D /end REF_CHARACTERISTIC /begin REF_MEASUREMENT /end REF_MEASUREMENT /end GROUP
/begin GROUP PwrLimr.PwrLimrMotEnvlpY.Ary1D "MICROSAR RTE" /begin SUB_GROUP /end SUB_GROUP /begin FUNCTION_LIST /end FUNCTION_LIST /begin REF_CHARACTERISTIC PwrLimr.PwrLimrMotEnvlpY.Ary1D /end REF_CHARACTERISTIC /begin REF_MEASUREMENT /end REF_MEASUREMENT /end GROUP
/begin GROUP PwrLimr.PwrLimrMotVelLpFilFrq.Val "MICROSAR RTE" /begin SUB_GROUP /end SUB_GROUP /begin FUNCTION_LIST /end FUNCTION_LIST /begin REF_CHARACTERISTIC PwrLimr.PwrLimrMotVelLpFilFrq.Val /end REF_CHARACTERISTIC /begin REF_MEASUREMENT /end REF_MEASUREMENT /end GROUP
/begin GROUP PwrLimr.PwrLimrRednFac.Val "MICROSAR RTE" /begin SUB_GROUP /end SUB_GROUP /begin FUNCTION_LIST /end FUNCTION_LIST /begin REF_CHARACTERISTIC /end REF_CHARACTERISTIC /begin REF_MEASUREMENT PwrLimr.PwrLimrRednFac.Val /end REF_MEASUREMENT /end GROUP
/begin GROUP PwrLimr.PwrLimrSpdAdjSlewDec.Val "MICROSAR RTE" /begin SUB_GROUP /end SUB_GROUP /begin FUNCTION_LIST /end FUNCTION_LIST /begin REF_CHARACTERISTIC PwrLimr.PwrLimrSpdAdjSlewDec.Val /end REF_CHARACTERISTIC /begin REF_MEASUREMENT /end REF_MEASUREMENT /end GROUP
/begin GROUP PwrLimr.PwrLimrSpdAdjSlewEna.Logl "MICROSAR RTE" /begin SUB_GROUP /end SUB_GROUP /begin FUNCTION_LIST /end FUNCTION_LIST /begin REF_CHARACTERISTIC PwrLimr.PwrLimrSpdAdjSlewEna.Logl /end REF_CHARACTERISTIC /begin REF_MEASUREMENT /end REF_MEASUREMENT /end GROUP
/begin GROUP PwrLimr.PwrLimrSpdAdjSlewInc.Val "MICROSAR RTE" /begin SUB_GROUP /end SUB_GROUP /begin FUNCTION_LIST /end FUNCTION_LIST /begin REF_CHARACTERISTIC PwrLimr.PwrLimrSpdAdjSlewInc.Val /end REF_CHARACTERISTIC /begin REF_MEASUREMENT /end REF_MEASUREMENT /end GROUP
/begin GROUP PwrLimr.PwrLimrStdOperMotEnvlpX.Ary1D "MICROSAR RTE" /begin SUB_GROUP /end SUB_GROUP /begin FUNCTION_LIST /end FUNCTION_LIST /begin REF_CHARACTERISTIC PwrLimr.PwrLimrStdOperMotEnvlpX.Ary1D /end REF_CHARACTERISTIC /begin REF_MEASUREMENT /end REF_MEASUREMENT /end GROUP
/begin GROUP PwrLimr.PwrLimrStdOperMotEnvlpY.Ary1D "MICROSAR RTE" /begin SUB_GROUP /end SUB_GROUP /begin FUNCTION_LIST /end FUNCTION_LIST /begin REF_CHARACTERISTIC PwrLimr.PwrLimrStdOperMotEnvlpY.Ary1D /end REF_CHARACTERISTIC /begin REF_MEASUREMENT /end REF_MEASUREMENT /end GROUP
/begin GROUP PwrLimr.PwrLimrVltgDptMotVelOffsX.Ary1D "MICROSAR RTE" /begin SUB_GROUP /end SUB_GROUP /begin FUNCTION_LIST /end FUNCTION_LIST /begin REF_CHARACTERISTIC PwrLimr.PwrLimrVltgDptMotVelOffsX.Ary1D /end REF_CHARACTERISTIC /begin REF_MEASUREMENT /end REF_MEASUREMENT /end GROUP
/begin GROUP PwrLimr.PwrLimrVltgDptMotVelOffsY.Ary1D "MICROSAR RTE" /begin SUB_GROUP /end SUB_GROUP /begin FUNCTION_LIST /end FUNCTION_LIST /begin REF_CHARACTERISTIC PwrLimr.PwrLimrVltgDptMotVelOffsY.Ary1D /end REF_CHARACTERISTIC /begin REF_MEASUREMENT /end REF_MEASUREMENT /end GROUP
/begin GROUP PwrLimr.ReceiverPorts "MICROSAR RTE"
 /begin SUB_GROUP PwrLimr.AltFltActv.Logl PwrLimr.BrdgVltg.Val PwrLimr.DualEcuFltMtgtnSca.Val PwrLimr.MotAndThermProtnLoaMod.Val PwrLimr.MotBackEmfConEstimd.Val PwrLimr.MotTqCmdMrf.Val PwrLimr.MotVelMrf.Val /end SUB_GROUP
 /begin FUNCTION_LIST /end FUNCTION_LIST
 /begin REF_CHARACTERISTIC /end REF_CHARACTERISTIC
 /begin REF_MEASUREMENT /end REF_MEASUREMENT
/end GROUP
/begin GROUP PwrLimr.RefTmr "MICROSAR RTE" /begin SUB_GROUP /end SUB_GROUP /begin FUNCTION_LIST /end FUNCTION_LIST /begin REF_CHARACTERISTIC /end REF_CHARACTERISTIC /begin REF_MEASUREMENT PwrLimr.RefTmr /end REF_MEASUREMENT /end GROUP
/begin GROUP PwrLimr.RefTmrPrev "MICROSAR RTE" /begin SUB_GROUP /end SUB_GROUP /begin FUNCTION_LIST /end FUNCTION_LIST /begin REF_CHARACTERISTIC /end REF_CHARACTERISTIC /begin REF_MEASUREMENT PwrLimr.RefTmrPrev /end REF_MEASUREMENT /end GROUP
/begin GROUP PwrLimr.SenderPorts "MICROSAR RTE" /begin SUB_GROUP PwrLimr.MotTqCmdPwrLimd.Val PwrLimr.PwrLimrRednFac.Val /end SUB_GROUP /begin FUNCTION_LIST /end FUNCTION_LIST /begin REF_CHARACTERISTIC /end REF_CHARACTERISTIC /begin REF_MEASUREMENT /end REF_MEASUREMENT /end GROUP
/begin GROUP PwrLimr.TqLimLpFil "MICROSAR RTE" /begin SUB_GROUP /end SUB_GROUP /begin FUNCTION_LIST /end FUNCTION_LIST /begin REF_CHARACTERISTIC /end REF_CHARACTERISTIC /begin REF_MEASUREMENT PwrLimr.TqLimLpFil.FilGain PwrLimr.TqLimLpFil.FilSt /end REF_MEASUREMENT /end GROUP
/begin GROUP PwrLimr.dPwrLimrFildMotVel "MICROSAR RTE" /begin SUB_GROUP /end SUB_GROUP /begin FUNCTION_LIST /end FUNCTION_LIST /begin REF_CHARACTERISTIC /end REF_CHARACTERISTIC /begin REF_MEASUREMENT PwrLimr.dPwrLimrFildMotVel /end REF_MEASUREMENT /end GROUP
/begin GROUP PwrLimr.dPwrLimrLimDif "MICROSAR RTE" /begin SUB_GROUP /end SUB_GROUP /begin FUNCTION_LIST /end FUNCTION_LIST /begin REF_CHARACTERISTIC /end REF_CHARACTERISTIC /begin REF_MEASUREMENT PwrLimr.dPwrLimrLimDif /end REF_MEASUREMENT /end GROUP
/begin GROUP PwrLimr.dPwrLimrMinStdOperLim "MICROSAR RTE" /begin SUB_GROUP /end SUB_GROUP /begin FUNCTION_LIST /end FUNCTION_LIST /begin REF_CHARACTERISTIC /end REF_CHARACTERISTIC /begin REF_MEASUREMENT PwrLimr.dPwrLimrMinStdOperLim /end REF_MEASUREMENT /end GROUP
/begin GROUP PwrLimr.dPwrLimrMotEnvlpSpd "MICROSAR RTE" /begin SUB_GROUP /end SUB_GROUP /begin FUNCTION_LIST /end FUNCTION_LIST /begin REF_CHARACTERISTIC /end REF_CHARACTERISTIC /begin REF_MEASUREMENT PwrLimr.dPwrLimrMotEnvlpSpd /end REF_MEASUREMENT /end GROUP
/begin GROUP PwrLimr.dPwrLimrMotTqCmdIvtrLoaSca "MICROSAR RTE" /begin SUB_GROUP /end SUB_GROUP /begin FUNCTION_LIST /end FUNCTION_LIST /begin REF_CHARACTERISTIC /end REF_CHARACTERISTIC /begin REF_MEASUREMENT PwrLimr.dPwrLimrMotTqCmdIvtrLoaSca /end REF_MEASUREMENT /end GROUP
/begin GROUP PwrLimr.dPwrLimrOutpVelOffs "MICROSAR RTE" /begin SUB_GROUP /end SUB_GROUP /begin FUNCTION_LIST /end FUNCTION_LIST /begin REF_CHARACTERISTIC /end REF_CHARACTERISTIC /begin REF_MEASUREMENT PwrLimr.dPwrLimrOutpVelOffs /end REF_MEASUREMENT /end GROUP
/**********************************************************************************************************************
* RECORD_LAYOUT
*********************************************************************************************************************/
/begin RECORD_LAYOUT RTE_RL_UBYTE FNC_VALUES 1 UBYTE ROW_DIR DIRECT /end RECORD_LAYOUT
/begin RECORD_LAYOUT RTE_RL_UWORD FNC_VALUES 1 UWORD ROW_DIR DIRECT /end RECORD_LAYOUT
/begin RECORD_LAYOUT RTE_RL_ULONG FNC_VALUES 1 ULONG ROW_DIR DIRECT /end RECORD_LAYOUT
/begin RECORD_LAYOUT RTE_RL_SWORD FNC_VALUES 1 SWORD ROW_DIR DIRECT /end RECORD_LAYOUT
/begin RECORD_LAYOUT RTE_RL_FLOAT32_IEEE FNC_VALUES 1 FLOAT32_IEEE ROW_DIR DIRECT /end RECORD_LAYOUT
/begin RECORD_LAYOUT RTE_RL_BOOLEAN FNC_VALUES 1 UBYTE ROW_DIR DIRECT /end RECORD_LAYOUT
/**********************************************************************************************************************
* COMPU_METHOD / COMPU_VTAB_RANGE
*********************************************************************************************************************/
/begin COMPU_METHOD RTE_CM_BOOLEAN "" TAB_VERB "%3.1" "" COMPU_TAB_REF RTE_CM_BOOLEAN /end COMPU_METHOD
/begin COMPU_VTAB_RANGE RTE_CM_BOOLEAN "" 2 0 0 "false" 1 255 "true" /end COMPU_VTAB_RANGE
/begin COMPU_METHOD RTE_CM_ENUM_SysSt1 "" TAB_VERB "%.1" "" COMPU_TAB_REF RTE_CM_ENUM_SysSt1 /end COMPU_METHOD
/begin COMPU_VTAB_RANGE RTE_CM_ENUM_SysSt1 "" 4 0 0 "SYSST_DI" 1 1 "SYSST_OFF" 2 2 "SYSST_ENA" 3 3 "SYSST_WRMININ" /end COMPU_VTAB_RANGE
/begin COMPU_METHOD RTE_CM_ENUM_LoaSt1 "" TAB_VERB "%.1" "" COMPU_TAB_REF RTE_CM_ENUM_LoaSt1 /end COMPU_METHOD
/begin COMPU_VTAB_RANGE RTE_CM_ENUM_LoaSt1 "" 6 0 0 "LOAST_NORM" 1 1 "LOAST_LIMD" 2 2 "LOAST_SWBASDMTGTN" 3 3 "LOAST_FADEOUT" 4 4 "LOAST_CTRLDSHTDWNREQD" 5 5 "LOAST_IMDTSHTDWNREQD" /end COMPU_VTAB_RANGE
/begin COMPU_METHOD RTE_CM_ENUM_PwrDiscnctSts1 "" TAB_VERB "%.1" "" COMPU_TAB_REF RTE_CM_ENUM_PwrDiscnctSts1 /end COMPU_METHOD
/begin COMPU_VTAB_RANGE RTE_CM_ENUM_PwrDiscnctSts1 "" 6 0 0 "PWRDISCNCTSTS_WAITFORSTRTA" 1 1 "PWRDISCNCTSTS_VRFYDISCNCTOPEN" 2 2 "PWRDISCNCTSTS_WAITFORSTRTB" 3 3 "PWRDISCNCTSTS_VRFYCLS" 4 4 "PWRDISCNCTSTS_SEQFAIL" 5 5 "PWRDISCNCTSTS_RTDIAGC" /end COMPU_VTAB_RANGE
