/begin CHARACTERISTIC HysCmp.HysCmpEffOffsY.Ary1D "MICROSAR RTE" VAL_BLK 0x0 RTE_RL_UWORD 0 NO_COMPU_METHOD 0 65535 MATRIX_DIM 12 1 1 SYMBOL_LINK "Rte_CalprmRom_CalRegn02Rt00GroupA_DEFAULT_RTE_CALPRM_GROUP.HysCmpEffOffsY_Ary1D" 0 DISPLAY_IDENTIFIER HysCmp.CalibrationPorts.HysCmpEffOffsY.Ary1D /end CHARACTERISTIC
/begin CHARACTERISTIC HysCmp.HysCmpFinalOutpLpFilFrq.Val "MICROSAR RTE" VALUE 0x0 RTE_RL_FLOAT32_IEEE 0 NO_COMPU_METHOD -3.402823466e+38 3.402823466e+38 SYMBOL_LINK "Rte_CalprmRom_CalRegn02Inin00GroupA_DEFAULT_RTE_CALPRM_GROUP.HysCmpFinalOutpLpFilFrq_Val" 0 DISPLAY_IDENTIFIER HysCmp.CalibrationPorts.HysCmpFinalOutpLpFilFrq.Val /end CHARACTERISTIC
/begin CHARACTERISTIC HysCmp.HysCmpFricTScaX.Ary1D "MICROSAR RTE" VAL_BLK 0x0 RTE_RL_SWORD 0 NO_COMPU_METHOD -32768 32767 MATRIX_DIM 8 1 1 SYMBOL_LINK "Rte_CalprmRom_CalRegn02Inin00GroupA_DEFAULT_RTE_CALPRM_GROUP.HysCmpFricTScaX_Ary1D" 0 DISPLAY_IDENTIFIER HysCmp.CalibrationPorts.HysCmpFricTScaX.Ary1D /end CHARACTERISTIC
/begin CHARACTERISTIC HysCmp.HysCmpFricTScaY.Ary1D "MICROSAR RTE" VAL_BLK 0x0 RTE_RL_UWORD 0 NO_COMPU_METHOD 0 65535 MATRIX_DIM 8 1 1 SYMBOL_LINK "Rte_CalprmRom_CalRegn02Inin00GroupA_DEFAULT_RTE_CALPRM_GROUP.HysCmpFricTScaY_Ary1D" 0 DISPLAY_IDENTIFIER HysCmp.CalibrationPorts.HysCmpFricTScaY.Ary1D /end CHARACTERISTIC
/begin CHARACTERISTIC HysCmp.HysCmpFricWhlImbRejctnBlndX.Ary1D "MICROSAR RTE" VAL_BLK 0x0 RTE_RL_UWORD 0 NO_COMPU_METHOD 0 65535 MATRIX_DIM 6 1 1 SYMBOL_LINK "Rte_CalprmRom_CalRegn02Rt00GroupA_DEFAULT_RTE_CALPRM_GROUP.HysCmpFricWhlImbRejctnBlndX_Ary1D" 0 DISPLAY_IDENTIFIER HysCmp.CalibrationPorts.HysCmpFricWhlImbRejctnBlndX.Ary1D /end CHARACTERISTIC
/begin CHARACTERISTIC HysCmp.HysCmpFricWhlImbRejctnBlndY.Ary1D "MICROSAR RTE" VAL_BLK 0x0 RTE_RL_UWORD 0 NO_COMPU_METHOD 0 65535 MATRIX_DIM 6 1 1 SYMBOL_LINK "Rte_CalprmRom_CalRegn02Rt00GroupA_DEFAULT_RTE_CALPRM_GROUP.HysCmpFricWhlImbRejctnBlndY_Ary1D" 0 DISPLAY_IDENTIFIER HysCmp.CalibrationPorts.HysCmpFricWhlImbRejctnBlndY.Ary1D /end CHARACTERISTIC
/begin CHARACTERISTIC HysCmp.HysCmpFricWhlImbRejctnOffY.Ary1D "MICROSAR RTE" VAL_BLK 0x0 RTE_RL_UWORD 0 NO_COMPU_METHOD 0 65535 MATRIX_DIM 12 1 1 SYMBOL_LINK "Rte_CalprmRom_CalRegn02Rt00GroupA_DEFAULT_RTE_CALPRM_GROUP.HysCmpFricWhlImbRejctnOffY_Ary1D" 0 DISPLAY_IDENTIFIER HysCmp.CalibrationPorts.HysCmpFricWhlImbRejctnOffY.Ary1D /end CHARACTERISTIC
/begin CHARACTERISTIC HysCmp.HysCmpFricWhlImbRejctnOnY.Ary1D "MICROSAR RTE" VAL_BLK 0x0 RTE_RL_UWORD 0 NO_COMPU_METHOD 0 65535 MATRIX_DIM 12 1 1 SYMBOL_LINK "Rte_CalprmRom_CalRegn02Rt00GroupA_DEFAULT_RTE_CALPRM_GROUP.HysCmpFricWhlImbRejctnOnY_Ary1D" 0 DISPLAY_IDENTIFIER HysCmp.CalibrationPorts.HysCmpFricWhlImbRejctnOnY.Ary1D /end CHARACTERISTIC
/begin CHARACTERISTIC HysCmp.HysCmpHwTqLpFilFrq.Val "MICROSAR RTE" VALUE 0x0 RTE_RL_FLOAT32_IEEE 0 NO_COMPU_METHOD -3.402823466e+38 3.402823466e+38 SYMBOL_LINK "Rte_CalprmRom_CalRegn02Inin00GroupA_DEFAULT_RTE_CALPRM_GROUP.HysCmpHwTqLpFilFrq_Val" 0 DISPLAY_IDENTIFIER HysCmp.CalibrationPorts.HysCmpHwTqLpFilFrq.Val /end CHARACTERISTIC
/begin CHARACTERISTIC HysCmp.HysCmpHwTqScaX.Ary2D "MICROSAR RTE" VAL_BLK 0x0 RTE_RL_UWORD 0 NO_COMPU_METHOD 0 65535 MATRIX_DIM 8 12 1 SYMBOL_LINK "Rte_CalprmRom_CalRegn02Rt00GroupA_DEFAULT_RTE_CALPRM_GROUP.HysCmpHwTqScaX_Ary2D" 0 DISPLAY_IDENTIFIER HysCmp.CalibrationPorts.HysCmpHwTqScaX.Ary2D /end CHARACTERISTIC
/begin CHARACTERISTIC HysCmp.HysCmpHwTqScaY.Ary2D "MICROSAR RTE" VAL_BLK 0x0 RTE_RL_UWORD 0 NO_COMPU_METHOD 0 65535 MATRIX_DIM 8 12 1 SYMBOL_LINK "Rte_CalprmRom_CalRegn02Rt00GroupA_DEFAULT_RTE_CALPRM_GROUP.HysCmpHwTqScaY_Ary2D" 0 DISPLAY_IDENTIFIER HysCmp.CalibrationPorts.HysCmpHwTqScaY.Ary2D /end CHARACTERISTIC
/begin CHARACTERISTIC HysCmp.HysCmpHysSatnY.Ary1D "MICROSAR RTE" VAL_BLK 0x0 RTE_RL_UWORD 0 NO_COMPU_METHOD 0 65535 MATRIX_DIM 12 1 1 SYMBOL_LINK "Rte_CalprmRom_CalRegn02Rt00GroupA_DEFAULT_RTE_CALPRM_GROUP.HysCmpHysSatnY_Ary1D" 0 DISPLAY_IDENTIFIER HysCmp.CalibrationPorts.HysCmpHysSatnY.Ary1D /end CHARACTERISTIC
/begin CHARACTERISTIC HysCmp.HysCmpNegHysCmpScaX.Ary1D "MICROSAR RTE" VAL_BLK 0x0 RTE_RL_UWORD 0 NO_COMPU_METHOD 0 65535 MATRIX_DIM 5 1 1 SYMBOL_LINK "Rte_CalprmRom_CalRegn02Rt00GroupA_DEFAULT_RTE_CALPRM_GROUP.HysCmpNegHysCmpScaX_Ary1D" 0 DISPLAY_IDENTIFIER HysCmp.CalibrationPorts.HysCmpNegHysCmpScaX.Ary1D /end CHARACTERISTIC
/begin CHARACTERISTIC HysCmp.HysCmpNegHysCmpScaY.Ary1D "MICROSAR RTE" VAL_BLK 0x0 RTE_RL_UWORD 0 NO_COMPU_METHOD 0 65535 MATRIX_DIM 5 1 1 SYMBOL_LINK "Rte_CalprmRom_CalRegn02Rt00GroupA_DEFAULT_RTE_CALPRM_GROUP.HysCmpNegHysCmpScaY_Ary1D" 0 DISPLAY_IDENTIFIER HysCmp.CalibrationPorts.HysCmpNegHysCmpScaY.Ary1D /end CHARACTERISTIC
/begin CHARACTERISTIC HysCmp.HysCmpNegHysCmpX.Ary1D "MICROSAR RTE" VAL_BLK 0x0 RTE_RL_UWORD 0 NO_COMPU_METHOD 0 65535 MATRIX_DIM 8 1 1 SYMBOL_LINK "Rte_CalprmRom_CalRegn02Rt00GroupA_DEFAULT_RTE_CALPRM_GROUP.HysCmpNegHysCmpX_Ary1D" 0 DISPLAY_IDENTIFIER HysCmp.CalibrationPorts.HysCmpNegHysCmpX.Ary1D /end CHARACTERISTIC
/begin CHARACTERISTIC HysCmp.HysCmpNegHysCmpY.Ary1D "MICROSAR RTE" VAL_BLK 0x0 RTE_RL_UWORD 0 NO_COMPU_METHOD 0 65535 MATRIX_DIM 8 1 1 SYMBOL_LINK "Rte_CalprmRom_CalRegn02Rt00GroupA_DEFAULT_RTE_CALPRM_GROUP.HysCmpNegHysCmpY_Ary1D" 0 DISPLAY_IDENTIFIER HysCmp.CalibrationPorts.HysCmpNegHysCmpY.Ary1D /end CHARACTERISTIC
/begin CHARACTERISTIC HysCmp.HysCmpOutpLim.Val "MICROSAR RTE" VALUE 0x0 RTE_RL_FLOAT32_IEEE 0 NO_COMPU_METHOD -3.402823466e+38 3.402823466e+38 SYMBOL_LINK "Rte_CalprmRom_CalRegn02Rt00GroupA_DEFAULT_RTE_CALPRM_GROUP.HysCmpOutpLim_Val" 0 DISPLAY_IDENTIFIER HysCmp.CalibrationPorts.HysCmpOutpLim.Val /end CHARACTERISTIC
/begin CHARACTERISTIC HysCmp.HysCmpRevGain.Val "MICROSAR RTE" VALUE 0x0 RTE_RL_FLOAT32_IEEE 0 NO_COMPU_METHOD -3.402823466e+38 3.402823466e+38 SYMBOL_LINK "Rte_CalprmRom_CalRegn02Rt00GroupA_DEFAULT_RTE_CALPRM_GROUP.HysCmpRevGain_Val" 0 DISPLAY_IDENTIFIER HysCmp.CalibrationPorts.HysCmpRevGain.Val /end CHARACTERISTIC
/begin CHARACTERISTIC HysCmp.HysCmpRiseX.Ary1D "MICROSAR RTE" VAL_BLK 0x0 RTE_RL_UWORD 0 NO_COMPU_METHOD 0 65535 MATRIX_DIM 6 1 1 SYMBOL_LINK "Rte_CalprmRom_CalRegn02Rt00GroupA_DEFAULT_RTE_CALPRM_GROUP.HysCmpRiseX_Ary1D" 0 DISPLAY_IDENTIFIER HysCmp.CalibrationPorts.HysCmpRiseX.Ary1D /end CHARACTERISTIC
/begin CHARACTERISTIC HysCmp.HysCmpRiseY.Ary1D "MICROSAR RTE" VAL_BLK 0x0 RTE_RL_UWORD 0 NO_COMPU_METHOD 0 65535 MATRIX_DIM 6 1 1 SYMBOL_LINK "Rte_CalprmRom_CalRegn02Rt00GroupA_DEFAULT_RTE_CALPRM_GROUP.HysCmpRiseY_Ary1D" 0 DISPLAY_IDENTIFIER HysCmp.CalibrationPorts.HysCmpRiseY.Ary1D /end CHARACTERISTIC
/begin CHARACTERISTIC HysCmp.SysGlbPrmSysTqRat.Val "MICROSAR RTE" VALUE 0x0 RTE_RL_FLOAT32_IEEE 0 NO_COMPU_METHOD -3.402823466e+38 3.402823466e+38 SYMBOL_LINK "Rte_CalprmRom_CalRegn01Inin00_DEFAULT_RTE_CALPRM_GROUP.SysGlbPrmSysTqRat_Val" 0 DISPLAY_IDENTIFIER HysCmp.CalibrationPorts.SysGlbPrmSysTqRat.Val /end CHARACTERISTIC
/begin CHARACTERISTIC HysCmp.SysGlbPrmVehSpdBilnrSeln.Ary1D "MICROSAR RTE" VAL_BLK 0x0 RTE_RL_UWORD 0 NO_COMPU_METHOD 0 65535 MATRIX_DIM 12 1 1 SYMBOL_LINK "Rte_CalprmRom_CalRegn01Inin00_DEFAULT_RTE_CALPRM_GROUP.SysGlbPrmVehSpdBilnrSeln_Ary1D" 0 DISPLAY_IDENTIFIER HysCmp.CalibrationPorts.SysGlbPrmVehSpdBilnrSeln.Ary1D /end CHARACTERISTIC
/begin CHARACTERISTIC ImcArbn.ImcArbnEcuIninTiOutThd.Val "MICROSAR RTE" VALUE 0x0 RTE_RL_ULONG 0 NO_COMPU_METHOD 0 4294967295 SYMBOL_LINK "Rte_CalprmRom_CalRegn01Cmn_DEFAULT_RTE_CALPRM_GROUP.ImcArbnEcuIninTiOutThd_Val" 0 DISPLAY_IDENTIFIER ImcArbn.CalibrationPorts.ImcArbnEcuIninTiOutThd.Val /end CHARACTERISTIC
/begin CHARACTERISTIC ImcArbn.ImcArbnFrmFltThd.Val "MICROSAR RTE" VALUE 0x0 RTE_RL_UBYTE 0 NO_COMPU_METHOD 0 255 SYMBOL_LINK "Rte_CalprmRom_CalRegn01Cmn_DEFAULT_RTE_CALPRM_GROUP.ImcArbnFrmFltThd_Val" 0 DISPLAY_IDENTIFIER ImcArbn.CalibrationPorts.ImcArbnFrmFltThd.Val /end CHARACTERISTIC
/begin CHARACTERISTIC ImcSigArbn.ImcSigArbnArbnFltTmr.Val "MICROSAR RTE" VALUE 0x0 RTE_RL_FLOAT32_IEEE 0 NO_COMPU_METHOD -3.402823466e+38 3.402823466e+38 SYMBOL_LINK "Rte_CalprmRom_CalRegn01Inin00_DEFAULT_RTE_CALPRM_GROUP.ImcSigArbnArbnFltTmr_Val" 0 DISPLAY_IDENTIFIER ImcSigArbn.CalibrationPorts.ImcSigArbnArbnFltTmr.Val /end CHARACTERISTIC
/begin CHARACTERISTIC ImcSigArbn.ImcSigArbnHwAgArbnEna.Logl "MICROSAR RTE" VALUE 0x0 RTE_RL_BOOLEAN 0 RTE_CM_BOOLEAN 0 255 SYMBOL_LINK "Rte_CalprmRom_CalRegn01Inin00_DEFAULT_RTE_CALPRM_GROUP.ImcSigArbnHwAgArbnEna_Logl" 0 DISPLAY_IDENTIFIER ImcSigArbn.CalibrationPorts.ImcSigArbnHwAgArbnEna.Logl /end CHARACTERISTIC
/begin CHARACTERISTIC ImcSigArbn.ImcSigArbnHwAgArbnLpFil.Val "MICROSAR RTE" VALUE 0x0 RTE_RL_FLOAT32_IEEE 0 NO_COMPU_METHOD -3.402823466e+38 3.402823466e+38 SYMBOL_LINK "Rte_CalprmRom_CalRegn01Inin00_DEFAULT_RTE_CALPRM_GROUP.ImcSigArbnHwAgArbnLpFil_Val" 0 DISPLAY_IDENTIFIER ImcSigArbn.CalibrationPorts.ImcSigArbnHwAgArbnLpFil.Val /end CHARACTERISTIC
/begin CHARACTERISTIC ImcSigArbn.ImcSigArbnHwAgArbnOffsLim.Val "MICROSAR RTE" VALUE 0x0 RTE_RL_FLOAT32_IEEE 0 NO_COMPU_METHOD -3.402823466e+38 3.402823466e+38 SYMBOL_LINK "Rte_CalprmRom_CalRegn01Inin00_DEFAULT_RTE_CALPRM_GROUP.ImcSigArbnHwAgArbnOffsLim_Val" 0 DISPLAY_IDENTIFIER ImcSigArbn.CalibrationPorts.ImcSigArbnHwAgArbnOffsLim.Val /end CHARACTERISTIC
/begin CHARACTERISTIC ImcSigArbn.ImcSigArbnHwAgTarArbnEna.Logl "MICROSAR RTE" VALUE 0x0 RTE_RL_BOOLEAN 0 RTE_CM_BOOLEAN 0 255 SYMBOL_LINK "Rte_CalprmRom_CalRegn01Inin00_DEFAULT_RTE_CALPRM_GROUP.ImcSigArbnHwAgTarArbnEna_Logl" 0 DISPLAY_IDENTIFIER ImcSigArbn.CalibrationPorts.ImcSigArbnHwAgTarArbnEna.Logl /end CHARACTERISTIC
/begin CHARACTERISTIC ImcSigArbn.ImcSigArbnHwAgTarArbnLpFil.Val "MICROSAR RTE" VALUE 0x0 RTE_RL_FLOAT32_IEEE 0 NO_COMPU_METHOD -3.402823466e+38 3.402823466e+38 SYMBOL_LINK "Rte_CalprmRom_CalRegn01Inin00_DEFAULT_RTE_CALPRM_GROUP.ImcSigArbnHwAgTarArbnLpFil_Val" 0 DISPLAY_IDENTIFIER ImcSigArbn.CalibrationPorts.ImcSigArbnHwAgTarArbnLpFil.Val /end CHARACTERISTIC
/begin CHARACTERISTIC ImcSigArbn.ImcSigArbnHwAgTarArbnOffsLim.Val "MICROSAR RTE" VALUE 0x0 RTE_RL_FLOAT32_IEEE 0 NO_COMPU_METHOD -3.402823466e+38 3.402823466e+38 SYMBOL_LINK "Rte_CalprmRom_CalRegn01Inin00_DEFAULT_RTE_CALPRM_GROUP.ImcSigArbnHwAgTarArbnOffsLim_Val" 0 DISPLAY_IDENTIFIER ImcSigArbn.CalibrationPorts.ImcSigArbnHwAgTarArbnOffsLim.Val /end CHARACTERISTIC
/begin CHARACTERISTIC ImcSigArbn.ImcSigArbnHwTqArbnEna.Logl "MICROSAR RTE" VALUE 0x0 RTE_RL_BOOLEAN 0 RTE_CM_BOOLEAN 0 255 SYMBOL_LINK "Rte_CalprmRom_CalRegn01Inin00_DEFAULT_RTE_CALPRM_GROUP.ImcSigArbnHwTqArbnEna_Logl" 0 DISPLAY_IDENTIFIER ImcSigArbn.CalibrationPorts.ImcSigArbnHwTqArbnEna.Logl /end CHARACTERISTIC
/begin CHARACTERISTIC ImcSigArbn.ImcSigArbnHwTqArbnLpFil.Val "MICROSAR RTE" VALUE 0x0 RTE_RL_FLOAT32_IEEE 0 NO_COMPU_METHOD -3.402823466e+38 3.402823466e+38 SYMBOL_LINK "Rte_CalprmRom_CalRegn01Inin00_DEFAULT_RTE_CALPRM_GROUP.ImcSigArbnHwTqArbnLpFil_Val" 0 DISPLAY_IDENTIFIER ImcSigArbn.CalibrationPorts.ImcSigArbnHwTqArbnLpFil.Val /end CHARACTERISTIC
/begin CHARACTERISTIC ImcSigArbn.ImcSigArbnHwTqArbnOffsLim.Val "MICROSAR RTE" VALUE 0x0 RTE_RL_FLOAT32_IEEE 0 NO_COMPU_METHOD -3.402823466e+38 3.402823466e+38 SYMBOL_LINK "Rte_CalprmRom_CalRegn01Inin00_DEFAULT_RTE_CALPRM_GROUP.ImcSigArbnHwTqArbnOffsLim_Val" 0 DISPLAY_IDENTIFIER ImcSigArbn.CalibrationPorts.ImcSigArbnHwTqArbnOffsLim.Val /end CHARACTERISTIC
/begin CHARACTERISTIC ImcSigArbn.ImcSigArbnMotVelArbnEna.Logl "MICROSAR RTE" VALUE 0x0 RTE_RL_BOOLEAN 0 RTE_CM_BOOLEAN 0 255 SYMBOL_LINK "Rte_CalprmRom_CalRegn01Inin00_DEFAULT_RTE_CALPRM_GROUP.ImcSigArbnMotVelArbnEna_Logl" 0 DISPLAY_IDENTIFIER ImcSigArbn.CalibrationPorts.ImcSigArbnMotVelArbnEna.Logl /end CHARACTERISTIC
/begin CHARACTERISTIC ImcSigArbn.ImcSigArbnMotVelArbnLpFil.Val "MICROSAR RTE" VALUE 0x0 RTE_RL_FLOAT32_IEEE 0 NO_COMPU_METHOD -3.402823466e+38 3.402823466e+38 SYMBOL_LINK "Rte_CalprmRom_CalRegn01Inin00_DEFAULT_RTE_CALPRM_GROUP.ImcSigArbnMotVelArbnLpFil_Val" 0 DISPLAY_IDENTIFIER ImcSigArbn.CalibrationPorts.ImcSigArbnMotVelArbnLpFil.Val /end CHARACTERISTIC
/begin CHARACTERISTIC ImcSigArbn.ImcSigArbnMotVelArbnOffsLim.Val "MICROSAR RTE" VALUE 0x0 RTE_RL_FLOAT32_IEEE 0 NO_COMPU_METHOD -3.402823466e+38 3.402823466e+38 SYMBOL_LINK "Rte_CalprmRom_CalRegn01Inin00_DEFAULT_RTE_CALPRM_GROUP.ImcSigArbnMotVelArbnOffsLim_Val" 0 DISPLAY_IDENTIFIER ImcSigArbn.CalibrationPorts.ImcSigArbnMotVelArbnOffsLim.Val /end CHARACTERISTIC
/begin CHARACTERISTIC ImcSigArbn.ImcSigArbnPosnServoArbnOffsLim.Val "MICROSAR RTE" VALUE 0x0 RTE_RL_FLOAT32_IEEE 0 NO_COMPU_METHOD -3.402823466e+38 3.402823466e+38 SYMBOL_LINK "Rte_CalprmRom_CalRegn01Inin00_DEFAULT_RTE_CALPRM_GROUP.ImcSigArbnPosnServoArbnOffsLim_Val" 0 DISPLAY_IDENTIFIER ImcSigArbn.CalibrationPorts.ImcSigArbnPosnServoArbnOffsLim.Val /end CHARACTERISTIC
/begin CHARACTERISTIC ImcSigArbn.ImcSigArbnPosnServoIntgtrStArbnEna.Logl "MICROSAR RTE" VALUE 0x0 RTE_RL_BOOLEAN 0 RTE_CM_BOOLEAN 0 255 SYMBOL_LINK "Rte_CalprmRom_CalRegn01Inin00_DEFAULT_RTE_CALPRM_GROUP.ImcSigArbnPosnServoIntgtrStArbnEna_Logl" 0 DISPLAY_IDENTIFIER ImcSigArbn.CalibrationPorts.ImcSigArbnPosnServoIntgtrStArbnEna.Logl /end CHARACTERISTIC
/begin CHARACTERISTIC ImcSigArbn.ImcSigArbnPosnServoIntgtrStArbnLpFil.Val "MICROSAR RTE" VALUE 0x0 RTE_RL_FLOAT32_IEEE 0 NO_COMPU_METHOD -3.402823466e+38 3.402823466e+38 SYMBOL_LINK "Rte_CalprmRom_CalRegn01Inin00_DEFAULT_RTE_CALPRM_GROUP.ImcSigArbnPosnServoIntgtrStArbnLpFil_Val" 0 DISPLAY_IDENTIFIER ImcSigArbn.CalibrationPorts.ImcSigArbnPosnServoIntgtrStArbnLpFil.Val /end CHARACTERISTIC
/begin CHARACTERISTIC ImcSigArbn.ImcSigArbnPosnTrakg1ArbnOffsLim.Val "MICROSAR RTE" VALUE 0x0 RTE_RL_FLOAT32_IEEE 0 NO_COMPU_METHOD -3.402823466e+38 3.402823466e+38 SYMBOL_LINK "Rte_CalprmRom_CalRegn01Inin00_DEFAULT_RTE_CALPRM_GROUP.ImcSigArbnPosnTrakg1ArbnOffsLim_Val" 0 DISPLAY_IDENTIFIER ImcSigArbn.CalibrationPorts.ImcSigArbnPosnTrakg1ArbnOffsLim.Val /end CHARACTERISTIC
/begin CHARACTERISTIC ImcSigArbn.ImcSigArbnPosnTrakg2ArbnOffsLim.Val "MICROSAR RTE" VALUE 0x0 RTE_RL_FLOAT32_IEEE 0 NO_COMPU_METHOD -3.402823466e+38 3.402823466e+38 SYMBOL_LINK "Rte_CalprmRom_CalRegn01Inin00_DEFAULT_RTE_CALPRM_GROUP.ImcSigArbnPosnTrakg2ArbnOffsLim_Val" 0 DISPLAY_IDENTIFIER ImcSigArbn.CalibrationPorts.ImcSigArbnPosnTrakg2ArbnOffsLim.Val /end CHARACTERISTIC
/begin CHARACTERISTIC ImcSigArbn.ImcSigArbnPullCmpLongTermArbnOffsLim.Val "MICROSAR RTE" VALUE 0x0 RTE_RL_FLOAT32_IEEE 0 NO_COMPU_METHOD -3.402823466e+38 3.402823466e+38 SYMBOL_LINK "Rte_CalprmRom_CalRegn01Inin00GroupA_DEFAULT_RTE_CALPRM_GROUP.ImcSigArbnPullCmpLongTermArbnOffsLim_Val" 0 DISPLAY_IDENTIFIER ImcSigArbn.CalibrationPorts.ImcSigArbnPullCmpLongTermArbnOffsLim.Val /end CHARACTERISTIC
/begin CHARACTERISTIC ImcSigArbn.ImcSigArbnPullCmpLongTermIntgtrStArbnEna.Logl "MICROSAR RTE" VALUE 0x0 RTE_RL_BOOLEAN 0 RTE_CM_BOOLEAN 0 255 SYMBOL_LINK "Rte_CalprmRom_CalRegn01Inin00_DEFAULT_RTE_CALPRM_GROUP.ImcSigArbnPullCmpLongTermIntgtrStArbnEna_Logl" 0 DISPLAY_IDENTIFIER ImcSigArbn.CalibrationPorts.ImcSigArbnPullCmpLongTermIntgtrStArbnEna.Logl /end CHARACTERISTIC
/begin CHARACTERISTIC ImcSigArbn.ImcSigArbnPullCmpLongTermIntgtrStArbnLpFil.Val "MICROSAR RTE" VALUE 0x0 RTE_RL_FLOAT32_IEEE 0 NO_COMPU_METHOD -3.402823466e+38 3.402823466e+38 SYMBOL_LINK "Rte_CalprmRom_CalRegn01Inin00_DEFAULT_RTE_CALPRM_GROUP.ImcSigArbnPullCmpLongTermIntgtrStArbnLpFil_Val" 0 DISPLAY_IDENTIFIER ImcSigArbn.CalibrationPorts.ImcSigArbnPullCmpLongTermIntgtrStArbnLpFil.Val /end CHARACTERISTIC
/begin CHARACTERISTIC ImcSigArbn.ImcSigArbnPullCmpShoTermArbnOffsLim.Val "MICROSAR RTE" VALUE 0x0 RTE_RL_FLOAT32_IEEE 0 NO_COMPU_METHOD -3.402823466e+38 3.402823466e+38 SYMBOL_LINK "Rte_CalprmRom_CalRegn01Inin00GroupA_DEFAULT_RTE_CALPRM_GROUP.ImcSigArbnPullCmpShoTermArbnOffsLim_Val" 0 DISPLAY_IDENTIFIER ImcSigArbn.CalibrationPorts.ImcSigArbnPullCmpShoTermArbnOffsLim.Val /end CHARACTERISTIC
/begin CHARACTERISTIC ImcSigArbn.ImcSigArbnPullCmpShoTermIntgtrStArbnEna.Logl "MICROSAR RTE" VALUE 0x0 RTE_RL_BOOLEAN 0 RTE_CM_BOOLEAN 0 255 SYMBOL_LINK "Rte_CalprmRom_CalRegn01Inin00_DEFAULT_RTE_CALPRM_GROUP.ImcSigArbnPullCmpShoTermIntgtrStArbnEna_Logl" 0 DISPLAY_IDENTIFIER ImcSigArbn.CalibrationPorts.ImcSigArbnPullCmpShoTermIntgtrStArbnEna.Logl /end CHARACTERISTIC
/begin CHARACTERISTIC ImcSigArbn.ImcSigArbnPullCmpShoTermIntgtrStArbnLpFil.Val "MICROSAR RTE" VALUE 0x0 RTE_RL_FLOAT32_IEEE 0 NO_COMPU_METHOD -3.402823466e+38 3.402823466e+38 SYMBOL_LINK "Rte_CalprmRom_CalRegn01Inin00_DEFAULT_RTE_CALPRM_GROUP.ImcSigArbnPullCmpShoTermIntgtrStArbnLpFil_Val" 0 DISPLAY_IDENTIFIER ImcSigArbn.CalibrationPorts.ImcSigArbnPullCmpShoTermIntgtrStArbnLpFil.Val /end CHARACTERISTIC
/begin CHARACTERISTIC ImcSigArbn.ImcSigArbnSysStTmr.Val "MICROSAR RTE" VALUE 0x0 RTE_RL_FLOAT32_IEEE 0 NO_COMPU_METHOD -3.402823466e+38 3.402823466e+38 SYMBOL_LINK "Rte_CalprmRom_CalRegn01Inin00_DEFAULT_RTE_CALPRM_GROUP.ImcSigArbnSysStTmr_Val" 0 DISPLAY_IDENTIFIER ImcSigArbn.CalibrationPorts.ImcSigArbnSysStTmr.Val /end CHARACTERISTIC
/begin CHARACTERISTIC ImcSigArbn.ImcSigArbnTrakgIntgtrSt1ArbnEna.Logl "MICROSAR RTE" VALUE 0x0 RTE_RL_BOOLEAN 0 RTE_CM_BOOLEAN 0 255 SYMBOL_LINK "Rte_CalprmRom_CalRegn01Inin00_DEFAULT_RTE_CALPRM_GROUP.ImcSigArbnTrakgIntgtrSt1ArbnEna_Logl" 0 DISPLAY_IDENTIFIER ImcSigArbn.CalibrationPorts.ImcSigArbnTrakgIntgtrSt1ArbnEna.Logl /end CHARACTERISTIC
/begin CHARACTERISTIC ImcSigArbn.ImcSigArbnTrakgIntgtrSt1ArbnLpFil.Val "MICROSAR RTE" VALUE 0x0 RTE_RL_FLOAT32_IEEE 0 NO_COMPU_METHOD -3.402823466e+38 3.402823466e+38 SYMBOL_LINK "Rte_CalprmRom_CalRegn01Inin00_DEFAULT_RTE_CALPRM_GROUP.ImcSigArbnTrakgIntgtrSt1ArbnLpFil_Val" 0 DISPLAY_IDENTIFIER ImcSigArbn.CalibrationPorts.ImcSigArbnTrakgIntgtrSt1ArbnLpFil.Val /end CHARACTERISTIC
/begin CHARACTERISTIC ImcSigArbn.ImcSigArbnTrakgIntgtrSt2ArbnEna.Logl "MICROSAR RTE" VALUE 0x0 RTE_RL_BOOLEAN 0 RTE_CM_BOOLEAN 0 255 SYMBOL_LINK "Rte_CalprmRom_CalRegn01Inin00_DEFAULT_RTE_CALPRM_GROUP.ImcSigArbnTrakgIntgtrSt2ArbnEna_Logl" 0 DISPLAY_IDENTIFIER ImcSigArbn.CalibrationPorts.ImcSigArbnTrakgIntgtrSt2ArbnEna.Logl /end CHARACTERISTIC
/begin CHARACTERISTIC ImcSigArbn.ImcSigArbnTrakgIntgtrSt2ArbnLpFil.Val "MICROSAR RTE" VALUE 0x0 RTE_RL_FLOAT32_IEEE 0 NO_COMPU_METHOD -3.402823466e+38 3.402823466e+38 SYMBOL_LINK "Rte_CalprmRom_CalRegn01Inin00_DEFAULT_RTE_CALPRM_GROUP.ImcSigArbnTrakgIntgtrSt2ArbnLpFil_Val" 0 DISPLAY_IDENTIFIER ImcSigArbn.CalibrationPorts.ImcSigArbnTrakgIntgtrSt2ArbnLpFil.Val /end CHARACTERISTIC
/begin CHARACTERISTIC ImcSigArbn.ImcSigArbnVehSpdArbnEna.Logl "MICROSAR RTE" VALUE 0x0 RTE_RL_BOOLEAN 0 RTE_CM_BOOLEAN 0 255 SYMBOL_LINK "Rte_CalprmRom_CalRegn01Inin00_DEFAULT_RTE_CALPRM_GROUP.ImcSigArbnVehSpdArbnEna_Logl" 0 DISPLAY_IDENTIFIER ImcSigArbn.CalibrationPorts.ImcSigArbnVehSpdArbnEna.Logl /end CHARACTERISTIC
/begin CHARACTERISTIC ImcSigArbn.ImcSigArbnVehSpdArbnLpFil.Val "MICROSAR RTE" VALUE 0x0 RTE_RL_FLOAT32_IEEE 0 NO_COMPU_METHOD -3.402823466e+38 3.402823466e+38 SYMBOL_LINK "Rte_CalprmRom_CalRegn01Inin00_DEFAULT_RTE_CALPRM_GROUP.ImcSigArbnVehSpdArbnLpFil_Val" 0 DISPLAY_IDENTIFIER ImcSigArbn.CalibrationPorts.ImcSigArbnVehSpdArbnLpFil.Val /end CHARACTERISTIC
/begin CHARACTERISTIC ImcSigArbn.ImcSigArbnVehSpdArbnOffsLim.Val "MICROSAR RTE" VALUE 0x0 RTE_RL_FLOAT32_IEEE 0 NO_COMPU_METHOD -3.402823466e+38 3.402823466e+38 SYMBOL_LINK "Rte_CalprmRom_CalRegn01Inin00_DEFAULT_RTE_CALPRM_GROUP.ImcSigArbnVehSpdArbnOffsLim_Val" 0 DISPLAY_IDENTIFIER ImcSigArbn.CalibrationPorts.ImcSigArbnVehSpdArbnOffsLim.Val /end CHARACTERISTIC
/begin CHARACTERISTIC InertiaCmpVel.InertiaCmpVelAssiBasdDampgCoeffX.Ary1D "MICROSAR RTE" VAL_BLK 0x0 RTE_RL_UWORD 0 NO_COMPU_METHOD 0 65535 MATRIX_DIM 10 1 1 SYMBOL_LINK "Rte_CalprmRom_CalRegn02Inin00GroupA_DEFAULT_RTE_CALPRM_GROUP.InertiaCmpVelAssiBasdDampgCoeffX_Ary1D" 0 DISPLAY_IDENTIFIER InertiaCmpVel.CalibrationPorts.InertiaCmpVelAssiBasdDampgCoeffX.Ary1D /end CHARACTERISTIC
/begin CHARACTERISTIC InertiaCmpVel.InertiaCmpVelAssiBasdDampgRollgWhlImbRejctnOnY.Ary1D "MICROSAR RTE" VAL_BLK 0x0 RTE_RL_UWORD 0 NO_COMPU_METHOD 0 65535 MATRIX_DIM 10 1 1 SYMBOL_LINK "Rte_CalprmRom_CalRegn02Inin00GroupA_DEFAULT_RTE_CALPRM_GROUP.InertiaCmpVelAssiBasdDampgRollgWhlImbRejctnOnY_Ary1D" 0 DISPLAY_IDENTIFIER InertiaCmpVel.CalibrationPorts.InertiaCmpVelAssiBasdDampgRollgWhlImbRejctnOnY.Ary1D /end CHARACTERISTIC
/begin CHARACTERISTIC InertiaCmpVel.InertiaCmpVelAssiBasdDampgRollgY.Ary1D "MICROSAR RTE" VAL_BLK 0x0 RTE_RL_UWORD 0 NO_COMPU_METHOD 0 65535 MATRIX_DIM 10 1 1 SYMBOL_LINK "Rte_CalprmRom_CalRegn02Inin00GroupA_DEFAULT_RTE_CALPRM_GROUP.InertiaCmpVelAssiBasdDampgRollgY_Ary1D" 0 DISPLAY_IDENTIFIER InertiaCmpVel.CalibrationPorts.InertiaCmpVelAssiBasdDampgRollgY.Ary1D /end CHARACTERISTIC
/begin CHARACTERISTIC InertiaCmpVel.InertiaCmpVelAssiBasdDampgStatWhlImbRejctnOnY.Ary1D "MICROSAR RTE" VAL_BLK 0x0 RTE_RL_UWORD 0 NO_COMPU_METHOD 0 65535 MATRIX_DIM 10 1 1 SYMBOL_LINK "Rte_CalprmRom_CalRegn02Inin00GroupA_DEFAULT_RTE_CALPRM_GROUP.InertiaCmpVelAssiBasdDampgStatWhlImbRejctnOnY_Ary1D" 0 DISPLAY_IDENTIFIER InertiaCmpVel.CalibrationPorts.InertiaCmpVelAssiBasdDampgStatWhlImbRejctnOnY.Ary1D /end CHARACTERISTIC
/begin CHARACTERISTIC InertiaCmpVel.InertiaCmpVelAssiBasdDampgStatY.Ary1D "MICROSAR RTE" VAL_BLK 0x0 RTE_RL_UWORD 0 NO_COMPU_METHOD 0 65535 MATRIX_DIM 10 1 1 SYMBOL_LINK "Rte_CalprmRom_CalRegn02Rt00GroupA_DEFAULT_RTE_CALPRM_GROUP.InertiaCmpVelAssiBasdDampgStatY_Ary1D" 0 DISPLAY_IDENTIFIER InertiaCmpVel.CalibrationPorts.InertiaCmpVelAssiBasdDampgStatY.Ary1D /end CHARACTERISTIC
/begin CHARACTERISTIC InertiaCmpVel.InertiaCmpVelCmdScaY.Ary1D "MICROSAR RTE" VAL_BLK 0x0 RTE_RL_UWORD 0 NO_COMPU_METHOD 0 65535 MATRIX_DIM 12 1 1 SYMBOL_LINK "Rte_CalprmRom_CalRegn02Inin00GroupA_DEFAULT_RTE_CALPRM_GROUP.InertiaCmpVelCmdScaY_Ary1D" 0 DISPLAY_IDENTIFIER InertiaCmpVel.CalibrationPorts.InertiaCmpVelCmdScaY.Ary1D /end CHARACTERISTIC
/begin CHARACTERISTIC InertiaCmpVel.InertiaCmpVelDampgDecelGain.Val "MICROSAR RTE" VALUE 0x0 RTE_RL_FLOAT32_IEEE 0 NO_COMPU_METHOD -3.402823466e+38 3.402823466e+38 SYMBOL_LINK "Rte_CalprmRom_CalRegn02Inin00GroupA_DEFAULT_RTE_CALPRM_GROUP.InertiaCmpVelDampgDecelGain_Val" 0 DISPLAY_IDENTIFIER InertiaCmpVel.CalibrationPorts.InertiaCmpVelDampgDecelGain.Val /end CHARACTERISTIC
/begin CHARACTERISTIC InertiaCmpVel.InertiaCmpVelDampgDecelGainFallSlew.Val "MICROSAR RTE" VALUE 0x0 RTE_RL_FLOAT32_IEEE 0 NO_COMPU_METHOD -3.402823466e+38 3.402823466e+38 SYMBOL_LINK "Rte_CalprmRom_CalRegn02Inin00GroupA_DEFAULT_RTE_CALPRM_GROUP.InertiaCmpVelDampgDecelGainFallSlew_Val" 0 DISPLAY_IDENTIFIER InertiaCmpVel.CalibrationPorts.InertiaCmpVelDampgDecelGainFallSlew.Val /end CHARACTERISTIC
/begin CHARACTERISTIC InertiaCmpVel.InertiaCmpVelDampgDecelGainRisngSlewX.Ary1D "MICROSAR RTE" VAL_BLK 0x0 RTE_RL_UWORD 0 NO_COMPU_METHOD 0 65535 MATRIX_DIM 6 1 1 SYMBOL_LINK "Rte_CalprmRom_CalRegn02Inin00GroupA_DEFAULT_RTE_CALPRM_GROUP.InertiaCmpVelDampgDecelGainRisngSlewX_Ary1D" 0 DISPLAY_IDENTIFIER InertiaCmpVel.CalibrationPorts.InertiaCmpVelDampgDecelGainRisngSlewX.Ary1D /end CHARACTERISTIC
/begin CHARACTERISTIC InertiaCmpVel.InertiaCmpVelDampgDecelGainRisngSlewY.Ary1D "MICROSAR RTE" VAL_BLK 0x0 RTE_RL_UWORD 0 NO_COMPU_METHOD 0 65535 MATRIX_DIM 6 1 1 SYMBOL_LINK "Rte_CalprmRom_CalRegn02Inin00GroupA_DEFAULT_RTE_CALPRM_GROUP.InertiaCmpVelDampgDecelGainRisngSlewY_Ary1D" 0 DISPLAY_IDENTIFIER InertiaCmpVel.CalibrationPorts.InertiaCmpVelDampgDecelGainRisngSlewY.Ary1D /end CHARACTERISTIC
/begin CHARACTERISTIC InertiaCmpVel.InertiaCmpVelDampgFilFrq.Ary1D "MICROSAR RTE" VAL_BLK 0x0 RTE_RL_UWORD 0 NO_COMPU_METHOD 0 65535 MATRIX_DIM 12 1 1 SYMBOL_LINK "Rte_CalprmRom_CalRegn02Rt00GroupA_DEFAULT_RTE_CALPRM_GROUP.InertiaCmpVelDampgFilFrq_Ary1D" 0 DISPLAY_IDENTIFIER InertiaCmpVel.CalibrationPorts.InertiaCmpVelDampgFilFrq.Ary1D /end CHARACTERISTIC
/begin CHARACTERISTIC InertiaCmpVel.InertiaCmpVelDampgFilFrqWhlImbRejctnOn.Ary1D "MICROSAR RTE" VAL_BLK 0x0 RTE_RL_UWORD 0 NO_COMPU_METHOD 0 65535 MATRIX_DIM 12 1 1 SYMBOL_LINK "Rte_CalprmRom_CalRegn02Rt00GroupA_DEFAULT_RTE_CALPRM_GROUP.InertiaCmpVelDampgFilFrqWhlImbRejctnOn_Ary1D" 0 DISPLAY_IDENTIFIER InertiaCmpVel.CalibrationPorts.InertiaCmpVelDampgFilFrqWhlImbRejctnOn.Ary1D /end CHARACTERISTIC
/begin CHARACTERISTIC InertiaCmpVel.InertiaCmpVelDampgGainOffThd.Val "MICROSAR RTE" VALUE 0x0 RTE_RL_FLOAT32_IEEE 0 NO_COMPU_METHOD -3.402823466e+38 3.402823466e+38 SYMBOL_LINK "Rte_CalprmRom_CalRegn02Inin00GroupA_DEFAULT_RTE_CALPRM_GROUP.InertiaCmpVelDampgGainOffThd_Val" 0 DISPLAY_IDENTIFIER InertiaCmpVel.CalibrationPorts.InertiaCmpVelDampgGainOffThd.Val /end CHARACTERISTIC
/begin CHARACTERISTIC InertiaCmpVel.InertiaCmpVelDampgGainOnThd.Val "MICROSAR RTE" VALUE 0x0 RTE_RL_FLOAT32_IEEE 0 NO_COMPU_METHOD -3.402823466e+38 3.402823466e+38 SYMBOL_LINK "Rte_CalprmRom_CalRegn02Inin00GroupA_DEFAULT_RTE_CALPRM_GROUP.InertiaCmpVelDampgGainOnThd_Val" 0 DISPLAY_IDENTIFIER InertiaCmpVel.CalibrationPorts.InertiaCmpVelDampgGainOnThd.Val /end CHARACTERISTIC
/begin CHARACTERISTIC InertiaCmpVel.InertiaCmpVelDampgSpdBlndY.Ary1D "MICROSAR RTE" VAL_BLK 0x0 RTE_RL_UWORD 0 NO_COMPU_METHOD 0 65535 MATRIX_DIM 12 1 1 SYMBOL_LINK "Rte_CalprmRom_CalRegn02Rt00GroupA_DEFAULT_RTE_CALPRM_GROUP.InertiaCmpVelDampgSpdBlndY_Ary1D" 0 DISPLAY_IDENTIFIER InertiaCmpVel.CalibrationPorts.InertiaCmpVelDampgSpdBlndY.Ary1D /end CHARACTERISTIC
/begin CHARACTERISTIC InertiaCmpVel.InertiaCmpVelDampgWhlImbRejctnBlndX.Ary1D "MICROSAR RTE" VAL_BLK 0x0 RTE_RL_UWORD 0 NO_COMPU_METHOD 0 65535 MATRIX_DIM 5 1 1 SYMBOL_LINK "Rte_CalprmRom_CalRegn02Rt00GroupA_DEFAULT_RTE_CALPRM_GROUP.InertiaCmpVelDampgWhlImbRejctnBlndX_Ary1D" 0 DISPLAY_IDENTIFIER InertiaCmpVel.CalibrationPorts.InertiaCmpVelDampgWhlImbRejctnBlndX.Ary1D /end CHARACTERISTIC
/begin CHARACTERISTIC InertiaCmpVel.InertiaCmpVelDampgWhlImbRejctnBlndY.Ary1D "MICROSAR RTE" VAL_BLK 0x0 RTE_RL_UWORD 0 NO_COMPU_METHOD 0 65535 MATRIX_DIM 5 1 1 SYMBOL_LINK "Rte_CalprmRom_CalRegn02Rt00GroupA_DEFAULT_RTE_CALPRM_GROUP.InertiaCmpVelDampgWhlImbRejctnBlndY_Ary1D" 0 DISPLAY_IDENTIFIER InertiaCmpVel.CalibrationPorts.InertiaCmpVelDampgWhlImbRejctnBlndY.Ary1D /end CHARACTERISTIC
/begin CHARACTERISTIC InertiaCmpVel.InertiaCmpVelDecelGainEnaCal.Logl "MICROSAR RTE" VALUE 0x0 RTE_RL_BOOLEAN 0 RTE_CM_BOOLEAN 0 255 SYMBOL_LINK "Rte_CalprmRom_CalRegn02Inin00GroupA_DEFAULT_RTE_CALPRM_GROUP.InertiaCmpVelDecelGainEnaCal_Logl" 0 DISPLAY_IDENTIFIER InertiaCmpVel.CalibrationPorts.InertiaCmpVelDecelGainEnaCal.Logl /end CHARACTERISTIC
/begin CHARACTERISTIC InertiaCmpVel.InertiaCmpVelModWhlImbRejctnBlndX.Ary1D "MICROSAR RTE" VAL_BLK 0x0 RTE_RL_UWORD 0 NO_COMPU_METHOD 0 65535 MATRIX_DIM 2 1 1 SYMBOL_LINK "Rte_CalprmRom_CalRegn02Inin00GroupA_DEFAULT_RTE_CALPRM_GROUP.InertiaCmpVelModWhlImbRejctnBlndX_Ary1D" 0 DISPLAY_IDENTIFIER InertiaCmpVel.CalibrationPorts.InertiaCmpVelModWhlImbRejctnBlndX.Ary1D /end CHARACTERISTIC
/begin CHARACTERISTIC InertiaCmpVel.InertiaCmpVelModWhlImbRejctnBlndY.Ary1D "MICROSAR RTE" VAL_BLK 0x0 RTE_RL_UWORD 0 NO_COMPU_METHOD 0 65535 MATRIX_DIM 2 1 1 SYMBOL_LINK "Rte_CalprmRom_CalRegn02Inin00GroupA_DEFAULT_RTE_CALPRM_GROUP.InertiaCmpVelModWhlImbRejctnBlndY_Ary1D" 0 DISPLAY_IDENTIFIER InertiaCmpVel.CalibrationPorts.InertiaCmpVelModWhlImbRejctnBlndY.Ary1D /end CHARACTERISTIC
/begin CHARACTERISTIC InertiaCmpVel.InertiaCmpVelMotInertia.Val "MICROSAR RTE" VALUE 0x0 RTE_RL_FLOAT32_IEEE 0 NO_COMPU_METHOD -3.402823466e+38 3.402823466e+38 SYMBOL_LINK "Rte_CalprmRom_CalRegn02Inin00GroupA_DEFAULT_RTE_CALPRM_GROUP.InertiaCmpVelMotInertia_Val" 0 DISPLAY_IDENTIFIER InertiaCmpVel.CalibrationPorts.InertiaCmpVelMotInertia.Val /end CHARACTERISTIC
/begin CHARACTERISTIC InertiaCmpVel.InertiaCmpVelMotVelBasdOutpScagX.Ary1D "MICROSAR RTE" VAL_BLK 0x0 RTE_RL_UWORD 0 NO_COMPU_METHOD 0 65535 MATRIX_DIM 2 1 1 SYMBOL_LINK "Rte_CalprmRom_CalRegn02Inin00GroupA_DEFAULT_RTE_CALPRM_GROUP.InertiaCmpVelMotVelBasdOutpScagX_Ary1D" 0 DISPLAY_IDENTIFIER InertiaCmpVel.CalibrationPorts.InertiaCmpVelMotVelBasdOutpScagX.Ary1D /end CHARACTERISTIC
/begin CHARACTERISTIC InertiaCmpVel.InertiaCmpVelMotVelBasdOutpScagY.Ary1D "MICROSAR RTE" VAL_BLK 0x0 RTE_RL_UWORD 0 NO_COMPU_METHOD 0 65535 MATRIX_DIM 2 1 1 SYMBOL_LINK "Rte_CalprmRom_CalRegn02Inin00GroupA_DEFAULT_RTE_CALPRM_GROUP.InertiaCmpVelMotVelBasdOutpScagY_Ary1D" 0 DISPLAY_IDENTIFIER InertiaCmpVel.CalibrationPorts.InertiaCmpVelMotVelBasdOutpScagY.Ary1D /end CHARACTERISTIC
/begin CHARACTERISTIC InertiaCmpVel.InertiaCmpVelNotchBlndY.Ary1D "MICROSAR RTE" VAL_BLK 0x0 RTE_RL_UWORD 0 NO_COMPU_METHOD 0 65535 MATRIX_DIM 12 1 1 SYMBOL_LINK "Rte_CalprmRom_CalRegn02Inin00GroupA_DEFAULT_RTE_CALPRM_GROUP.InertiaCmpVelNotchBlndY_Ary1D" 0 DISPLAY_IDENTIFIER InertiaCmpVel.CalibrationPorts.InertiaCmpVelNotchBlndY.Ary1D /end CHARACTERISTIC
/begin CHARACTERISTIC InertiaCmpVel.InertiaCmpVelNotchFilStruct.Rec.FilGainA1 "MICROSAR RTE" VALUE 0x0 RTE_RL_FLOAT32_IEEE 0 NO_COMPU_METHOD -3.402823466e+38 3.402823466e+38 SYMBOL_LINK "Rte_CalprmRom_CalRegn02Inin00GroupA_DEFAULT_RTE_CALPRM_GROUP.InertiaCmpVelNotchFilStruct_Rec.FilGainA1" 0 DISPLAY_IDENTIFIER InertiaCmpVel.CalibrationPorts.InertiaCmpVelNotchFilStruct.Rec.FilGainA1 /end CHARACTERISTIC
/begin CHARACTERISTIC InertiaCmpVel.InertiaCmpVelNotchFilStruct.Rec.FilGainA2 "MICROSAR RTE" VALUE 0x0 RTE_RL_FLOAT32_IEEE 0 NO_COMPU_METHOD -3.402823466e+38 3.402823466e+38 SYMBOL_LINK "Rte_CalprmRom_CalRegn02Inin00GroupA_DEFAULT_RTE_CALPRM_GROUP.InertiaCmpVelNotchFilStruct_Rec.FilGainA2" 0 DISPLAY_IDENTIFIER InertiaCmpVel.CalibrationPorts.InertiaCmpVelNotchFilStruct.Rec.FilGainA2 /end CHARACTERISTIC
/begin CHARACTERISTIC InertiaCmpVel.InertiaCmpVelNotchFilStruct.Rec.FilGainB0 "MICROSAR RTE" VALUE 0x0 RTE_RL_FLOAT32_IEEE 0 NO_COMPU_METHOD -3.402823466e+38 3.402823466e+38 SYMBOL_LINK "Rte_CalprmRom_CalRegn02Inin00GroupA_DEFAULT_RTE_CALPRM_GROUP.InertiaCmpVelNotchFilStruct_Rec.FilGainB0" 0 DISPLAY_IDENTIFIER InertiaCmpVel.CalibrationPorts.InertiaCmpVelNotchFilStruct.Rec.FilGainB0 /end CHARACTERISTIC
/begin CHARACTERISTIC InertiaCmpVel.InertiaCmpVelNotchFilStruct.Rec.FilGainB1 "MICROSAR RTE" VALUE 0x0 RTE_RL_FLOAT32_IEEE 0 NO_COMPU_METHOD -3.402823466e+38 3.402823466e+38 SYMBOL_LINK "Rte_CalprmRom_CalRegn02Inin00GroupA_DEFAULT_RTE_CALPRM_GROUP.InertiaCmpVelNotchFilStruct_Rec.FilGainB1" 0 DISPLAY_IDENTIFIER InertiaCmpVel.CalibrationPorts.InertiaCmpVelNotchFilStruct.Rec.FilGainB1 /end CHARACTERISTIC
/begin CHARACTERISTIC InertiaCmpVel.InertiaCmpVelNotchFilStruct.Rec.FilGainB2 "MICROSAR RTE" VALUE 0x0 RTE_RL_FLOAT32_IEEE 0 NO_COMPU_METHOD -3.402823466e+38 3.402823466e+38 SYMBOL_LINK "Rte_CalprmRom_CalRegn02Inin00GroupA_DEFAULT_RTE_CALPRM_GROUP.InertiaCmpVelNotchFilStruct_Rec.FilGainB2" 0 DISPLAY_IDENTIFIER InertiaCmpVel.CalibrationPorts.InertiaCmpVelNotchFilStruct.Rec.FilGainB2 /end CHARACTERISTIC
/begin CHARACTERISTIC InertiaCmpVel.InertiaCmpVelTqSnsrVelFilFrq.Val "MICROSAR RTE" VALUE 0x0 RTE_RL_FLOAT32_IEEE 0 NO_COMPU_METHOD -3.402823466e+38 3.402823466e+38 SYMBOL_LINK "Rte_CalprmRom_CalRegn02Inin00GroupA_DEFAULT_RTE_CALPRM_GROUP.InertiaCmpVelTqSnsrVelFilFrq_Val" 0 DISPLAY_IDENTIFIER InertiaCmpVel.CalibrationPorts.InertiaCmpVelTqSnsrVelFilFrq.Val /end CHARACTERISTIC
/begin CHARACTERISTIC InertiaCmpVel.InertiaCmpVelTqSnsrVelSca.Ary1D "MICROSAR RTE" VAL_BLK 0x0 RTE_RL_UWORD 0 NO_COMPU_METHOD 0 65535 MATRIX_DIM 12 1 1 SYMBOL_LINK "Rte_CalprmRom_CalRegn02Inin00GroupA_DEFAULT_RTE_CALPRM_GROUP.InertiaCmpVelTqSnsrVelSca_Ary1D" 0 DISPLAY_IDENTIFIER InertiaCmpVel.CalibrationPorts.InertiaCmpVelTqSnsrVelSca.Ary1D /end CHARACTERISTIC
/begin CHARACTERISTIC InertiaCmpVel.SysGlbPrmSysKineRat.Val "MICROSAR RTE" VALUE 0x0 RTE_RL_FLOAT32_IEEE 0 NO_COMPU_METHOD -3.402823466e+38 3.402823466e+38 SYMBOL_LINK "Rte_CalprmRom_CalRegn02Inin00_DEFAULT_RTE_CALPRM_GROUP.SysGlbPrmSysKineRat_Val" 0 DISPLAY_IDENTIFIER InertiaCmpVel.CalibrationPorts.SysGlbPrmSysKineRat.Val /end CHARACTERISTIC
/begin CHARACTERISTIC InertiaCmpVel.SysGlbPrmTorsBarStfn.Val "MICROSAR RTE" VALUE 0x0 RTE_RL_FLOAT32_IEEE 0 NO_COMPU_METHOD -3.402823466e+38 3.402823466e+38 SYMBOL_LINK "Rte_CalprmRom_CalRegn01Inin00_DEFAULT_RTE_CALPRM_GROUP.SysGlbPrmTorsBarStfn_Val" 0 DISPLAY_IDENTIFIER InertiaCmpVel.CalibrationPorts.SysGlbPrmTorsBarStfn.Val /end CHARACTERISTIC
/begin CHARACTERISTIC InertiaCmpVel.SysGlbPrmVehSpdBilnrSeln.Ary1D "MICROSAR RTE" VAL_BLK 0x0 RTE_RL_UWORD 0 NO_COMPU_METHOD 0 65535 MATRIX_DIM 12 1 1 SYMBOL_LINK "Rte_CalprmRom_CalRegn01Inin00_DEFAULT_RTE_CALPRM_GROUP.SysGlbPrmVehSpdBilnrSeln_Ary1D" 0 DISPLAY_IDENTIFIER InertiaCmpVel.CalibrationPorts.SysGlbPrmVehSpdBilnrSeln.Ary1D /end CHARACTERISTIC
/begin CHARACTERISTIC LimrCdng.LimrCdngGainDecSlew.Val "MICROSAR RTE" VALUE 0x0 RTE_RL_FLOAT32_IEEE 0 NO_COMPU_METHOD -3.402823466e+38 3.402823466e+38 SYMBOL_LINK "Rte_CalprmRom_CalRegn01Inin00_DEFAULT_RTE_CALPRM_GROUP.LimrCdngGainDecSlew_Val" 0 DISPLAY_IDENTIFIER LimrCdng.CalibrationPorts.LimrCdngGainDecSlew.Val /end CHARACTERISTIC
/begin CHARACTERISTIC LimrCdng.LimrCdngGainIncSlewX.Ary1D "MICROSAR RTE" VAL_BLK 0x0 RTE_RL_UWORD 0 NO_COMPU_METHOD 0 65535 MATRIX_DIM 2 1 1 SYMBOL_LINK "Rte_CalprmRom_CalRegn01Inin00_DEFAULT_RTE_CALPRM_GROUP.LimrCdngGainIncSlewX_Ary1D" 0 DISPLAY_IDENTIFIER LimrCdng.CalibrationPorts.LimrCdngGainIncSlewX.Ary1D /end CHARACTERISTIC
/begin CHARACTERISTIC LimrCdng.LimrCdngGainIncSlewY.Ary1D "MICROSAR RTE" VAL_BLK 0x0 RTE_RL_UWORD 0 NO_COMPU_METHOD 0 65535 MATRIX_DIM 2 1 1 SYMBOL_LINK "Rte_CalprmRom_CalRegn01Inin00_DEFAULT_RTE_CALPRM_GROUP.LimrCdngGainIncSlewY_Ary1D" 0 DISPLAY_IDENTIFIER LimrCdng.CalibrationPorts.LimrCdngGainIncSlewY.Ary1D /end CHARACTERISTIC
/begin CHARACTERISTIC LimrCdng.LimrCdngTqDecSlew.Val "MICROSAR RTE" VALUE 0x0 RTE_RL_FLOAT32_IEEE 0 NO_COMPU_METHOD -3.402823466e+38 3.402823466e+38 SYMBOL_LINK "Rte_CalprmRom_CalRegn01Inin00_DEFAULT_RTE_CALPRM_GROUP.LimrCdngTqDecSlew_Val" 0 DISPLAY_IDENTIFIER LimrCdng.CalibrationPorts.LimrCdngTqDecSlew.Val /end CHARACTERISTIC
/begin CHARACTERISTIC LimrCdng.LimrCdngTqIncSlewX.Ary1D "MICROSAR RTE" VAL_BLK 0x0 RTE_RL_UWORD 0 NO_COMPU_METHOD 0 65535 MATRIX_DIM 2 1 1 SYMBOL_LINK "Rte_CalprmRom_CalRegn01Inin00_DEFAULT_RTE_CALPRM_GROUP.LimrCdngTqIncSlewX_Ary1D" 0 DISPLAY_IDENTIFIER LimrCdng.CalibrationPorts.LimrCdngTqIncSlewX.Ary1D /end CHARACTERISTIC
/begin CHARACTERISTIC LimrCdng.LimrCdngTqIncSlewY.Ary1D "MICROSAR RTE" VAL_BLK 0x0 RTE_RL_UWORD 0 NO_COMPU_METHOD 0 65535 MATRIX_DIM 2 1 1 SYMBOL_LINK "Rte_CalprmRom_CalRegn01Inin00_DEFAULT_RTE_CALPRM_GROUP.LimrCdngTqIncSlewY_Ary1D" 0 DISPLAY_IDENTIFIER LimrCdng.CalibrationPorts.LimrCdngTqIncSlewY.Ary1D /end CHARACTERISTIC
/begin CHARACTERISTIC LoaMgr.LoaMgrCurrIvtrMtgtnRate.Val "MICROSAR RTE" VALUE 0x0 RTE_RL_FLOAT32_IEEE 0 NO_COMPU_METHOD -3.402823466e+38 3.402823466e+38 SYMBOL_LINK "Rte_CalprmRom_CalRegn02Cmn_DEFAULT_RTE_CALPRM_GROUP.LoaMgrCurrIvtrMtgtnRate_Val" 0 DISPLAY_IDENTIFIER LoaMgr.CalibrationPorts.LoaMgrCurrIvtrMtgtnRate.Val /end CHARACTERISTIC
/begin CHARACTERISTIC LoaMgr.LoaMgrCurrIvtrMtgtnSca.Val "MICROSAR RTE" VALUE 0x0 RTE_RL_FLOAT32_IEEE 0 NO_COMPU_METHOD -3.402823466e+38 3.402823466e+38 SYMBOL_LINK "Rte_CalprmRom_CalRegn02Cmn_DEFAULT_RTE_CALPRM_GROUP.LoaMgrCurrIvtrMtgtnSca_Val" 0 DISPLAY_IDENTIFIER LoaMgr.CalibrationPorts.LoaMgrCurrIvtrMtgtnSca.Val /end CHARACTERISTIC
/begin CHARACTERISTIC LoaMgr.LoaMgrCurrIvtrMtgtnScaZeroEna.Logl "MICROSAR RTE" VALUE 0x0 RTE_RL_BOOLEAN 0 RTE_CM_BOOLEAN 0 255 SYMBOL_LINK "Rte_CalprmRom_CalRegn01Cmn_DEFAULT_RTE_CALPRM_GROUP.LoaMgrCurrIvtrMtgtnScaZeroEna_Logl" 0 DISPLAY_IDENTIFIER LoaMgr.CalibrationPorts.LoaMgrCurrIvtrMtgtnScaZeroEna.Logl /end CHARACTERISTIC
/begin MEASUREMENT HysCmp.PrevAssiCmdFildVal "MICROSAR RTE" FLOAT32_IEEE NO_COMPU_METHOD 0 0 -3.402823466e+38 3.402823466e+38 ECU_ADDRESS 0 SYMBOL_LINK "Rte_HysCmp_PrevAssiCmdFildVal" 0 DISPLAY_IDENTIFIER HysCmp.PerInstanceMemories.PrevAssiCmdFildVal /end MEASUREMENT
/begin MEASUREMENT HysCmp.PrevHwTqFildVal "MICROSAR RTE" FLOAT32_IEEE NO_COMPU_METHOD 0 0 -3.402823466e+38 3.402823466e+38 ECU_ADDRESS 0 SYMBOL_LINK "Rte_HysCmp_PrevHwTqFildVal" 0 DISPLAY_IDENTIFIER HysCmp.PerInstanceMemories.PrevHwTqFildVal /end MEASUREMENT
/begin MEASUREMENT HysCmp.PrevRiseX "MICROSAR RTE" FLOAT32_IEEE NO_COMPU_METHOD 0 0 -3.402823466e+38 3.402823466e+38 ECU_ADDRESS 0 SYMBOL_LINK "Rte_HysCmp_PrevRiseX" 0 DISPLAY_IDENTIFIER HysCmp.PerInstanceMemories.PrevRiseX /end MEASUREMENT
/begin MEASUREMENT HysCmp.PrevRiseY "MICROSAR RTE" FLOAT32_IEEE NO_COMPU_METHOD 0 0 -3.402823466e+38 3.402823466e+38 ECU_ADDRESS 0 SYMBOL_LINK "Rte_HysCmp_PrevRiseY" 0 DISPLAY_IDENTIFIER HysCmp.PerInstanceMemories.PrevRiseY /end MEASUREMENT
/begin MEASUREMENT HysCmp.SysFricOffs.Val "MICROSAR RTE" FLOAT32_IEEE NO_COMPU_METHOD 0 0 -3.402823466e+38 3.402823466e+38 ECU_ADDRESS 0 SYMBOL_LINK "Rte_SysFricLrng_SysFricOffs_Val" 0 DISPLAY_IDENTIFIER HysCmp.ReceiverPorts.SysFricOffs.Val /end MEASUREMENT
/begin MEASUREMENT HysCmp.VehSpd.Val "MICROSAR RTE" FLOAT32_IEEE NO_COMPU_METHOD 0 0 -3.402823466e+38 3.402823466e+38 ECU_ADDRESS 0 SYMBOL_LINK "Rte_ImcSigArbn_VehSpdImcCorrd_Val" 0 DISPLAY_IDENTIFIER HysCmp.ReceiverPorts.VehSpd.Val /end MEASUREMENT
/begin MEASUREMENT HysCmp.WhlImbRejctnAmp.Val "MICROSAR RTE" FLOAT32_IEEE NO_COMPU_METHOD 0 0 -3.402823466e+38 3.402823466e+38 ECU_ADDRESS 0 SYMBOL_LINK "Rte_HysCmp_WhlImbRejctnAmp_Val" 0 DISPLAY_IDENTIFIER HysCmp.ReceiverPorts.WhlImbRejctnAmp.Val /end MEASUREMENT
/begin MEASUREMENT HysCmp.dHysCmpAssiCmdFild "MICROSAR RTE" FLOAT32_IEEE NO_COMPU_METHOD 0 0 -3.402823466e+38 3.402823466e+38 ECU_ADDRESS 0 SYMBOL_LINK "Rte_HysCmp_dHysCmpAssiCmdFild" 0 DISPLAY_IDENTIFIER HysCmp.PerInstanceMemories.dHysCmpAssiCmdFild /end MEASUREMENT
/begin MEASUREMENT HysCmp.dHysCmpAvl "MICROSAR RTE" FLOAT32_IEEE NO_COMPU_METHOD 0 0 -3.402823466e+38 3.402823466e+38 ECU_ADDRESS 0 SYMBOL_LINK "Rte_HysCmp_dHysCmpAvl" 0 DISPLAY_IDENTIFIER HysCmp.PerInstanceMemories.dHysCmpAvl /end MEASUREMENT
/begin MEASUREMENT HysCmp.dHysCmpEffCmpTq "MICROSAR RTE" FLOAT32_IEEE NO_COMPU_METHOD 0 0 -3.402823466e+38 3.402823466e+38 ECU_ADDRESS 0 SYMBOL_LINK "Rte_HysCmp_dHysCmpEffCmpTq" 0 DISPLAY_IDENTIFIER HysCmp.PerInstanceMemories.dHysCmpEffCmpTq /end MEASUREMENT
/begin MEASUREMENT HysCmp.dHysCmpFric "MICROSAR RTE" FLOAT32_IEEE NO_COMPU_METHOD 0 0 -3.402823466e+38 3.402823466e+38 ECU_ADDRESS 0 SYMBOL_LINK "Rte_HysCmp_dHysCmpFric" 0 DISPLAY_IDENTIFIER HysCmp.PerInstanceMemories.dHysCmpFric /end MEASUREMENT
/begin MEASUREMENT HysCmp.dHysCmpHwTqFild "MICROSAR RTE" FLOAT32_IEEE NO_COMPU_METHOD 0 0 -3.402823466e+38 3.402823466e+38 ECU_ADDRESS 0 SYMBOL_LINK "Rte_HysCmp_dHysCmpHwTqFild" 0 DISPLAY_IDENTIFIER HysCmp.PerInstanceMemories.dHysCmpHwTqFild /end MEASUREMENT
/begin MEASUREMENT HysCmp.dHysCmpNegAvl "MICROSAR RTE" FLOAT32_IEEE NO_COMPU_METHOD 0 0 -3.402823466e+38 3.402823466e+38 ECU_ADDRESS 0 SYMBOL_LINK "Rte_HysCmp_dHysCmpNegAvl" 0 DISPLAY_IDENTIFIER HysCmp.PerInstanceMemories.dHysCmpNegAvl /end MEASUREMENT
/begin MEASUREMENT HysCmp.dHysCmpPosAvl "MICROSAR RTE" FLOAT32_IEEE NO_COMPU_METHOD 0 0 -3.402823466e+38 3.402823466e+38 ECU_ADDRESS 0 SYMBOL_LINK "Rte_HysCmp_dHysCmpPosAvl" 0 DISPLAY_IDENTIFIER HysCmp.PerInstanceMemories.dHysCmpPosAvl /end MEASUREMENT
/begin MEASUREMENT HysCmp.dHysCmpRawVal "MICROSAR RTE" FLOAT32_IEEE NO_COMPU_METHOD 0 0 -3.402823466e+38 3.402823466e+38 ECU_ADDRESS 0 SYMBOL_LINK "Rte_HysCmp_dHysCmpRawVal" 0 DISPLAY_IDENTIFIER HysCmp.PerInstanceMemories.dHysCmpRawVal /end MEASUREMENT
/begin MEASUREMENT HysCmp.dHysCmpRiseYFac "MICROSAR RTE" FLOAT32_IEEE NO_COMPU_METHOD 0 0 -3.402823466e+38 3.402823466e+38 ECU_ADDRESS 0 SYMBOL_LINK "Rte_HysCmp_dHysCmpRiseYFac" 0 DISPLAY_IDENTIFIER HysCmp.PerInstanceMemories.dHysCmpRiseYFac /end MEASUREMENT
/begin MEASUREMENT ImcArbn.BattRtnCurr.Val "MICROSAR RTE" FLOAT32_IEEE NO_COMPU_METHOD 0 0 -3.402823466e+38 3.402823466e+38 ECU_ADDRESS 0 SYMBOL_LINK "Rte_ElecPwrCns_SplyCurrEstim_Val" 0 DISPLAY_IDENTIFIER ImcArbn.ReceiverPorts.BattRtnCurr.Val /end MEASUREMENT
/begin MEASUREMENT ImcArbn.BattVltg.Val "MICROSAR RTE" FLOAT32_IEEE NO_COMPU_METHOD 0 0 -3.402823466e+38 3.402823466e+38 ECU_ADDRESS 0 SYMBOL_LINK "Rte_BattVltg_BrdgVltg_Val" 0 DISPLAY_IDENTIFIER ImcArbn.ReceiverPorts.BattVltg.Val /end MEASUREMENT
/begin MEASUREMENT ImcArbn.ClrDiagcReq.Val "MICROSAR RTE" UBYTE NO_COMPU_METHOD 0 0 0 255 ECU_ADDRESS 0 SYMBOL_LINK "Rte_CustDiag_ClrDiagcReq_Val" 0 DISPLAY_IDENTIFIER ImcArbn.ReceiverPorts.ClrDiagcReq.Val /end MEASUREMENT
/begin MEASUREMENT ImcArbn.DiagcStsNonRcrvlReqDiFltPrsnt.Logl "MICROSAR RTE" UBYTE RTE_CM_BOOLEAN 0 0 0 255 ECU_ADDRESS 0 SYMBOL_LINK "Rte_DiagcMgr_DiagcStsNonRcvrlReqDiFltPrsnt_Logl" 0 DISPLAY_IDENTIFIER ImcArbn.ReceiverPorts.DiagcStsNonRcrvlReqDiFltPrsnt.Logl /end MEASUREMENT
/begin MEASUREMENT ImcArbn.DualEcuMotCtrlMtgtnEna.Logl "MICROSAR RTE" UBYTE RTE_CM_BOOLEAN 0 0 0 255 ECU_ADDRESS 0 SYMBOL_LINK "Rte_DualCtrlrOutpMgr_DualEcuMotCtrlMtgtnEna_Logl" 0 DISPLAY_IDENTIFIER ImcArbn.ReceiverPorts.DualEcuMotCtrlMtgtnEna.Logl /end MEASUREMENT
/begin MEASUREMENT ImcArbn.EcuId.Val "MICROSAR RTE" UBYTE NO_COMPU_METHOD 0 0 0 255 ECU_ADDRESS 0 SYMBOL_LINK "Rte_DualEcuIdn_EcuId_Val" 0 DISPLAY_IDENTIFIER ImcArbn.ReceiverPorts.EcuId.Val /end MEASUREMENT
/begin MEASUREMENT ImcArbn.FordAbsPrsnt.Logl "MICROSAR RTE" UBYTE RTE_CM_BOOLEAN 0 0 0 255 ECU_ADDRESS 0 SYMBOL_LINK "Rte_CustDiag_FordAbsPrsnt_Logl" 0 DISPLAY_IDENTIFIER ImcArbn.ReceiverPorts.FordAbsPrsnt.Logl /end MEASUREMENT
/begin MEASUREMENT ImcArbn.FordActvNiblCtrlArbnCmd.Val "MICROSAR RTE" UBYTE NO_COMPU_METHOD 0 0 0 255 ECU_ADDRESS 0 SYMBOL_LINK "Rte_FordCmdArbn_FordActvNiblCtrlArbnCmd_Val" 0 DISPLAY_IDENTIFIER ImcArbn.ReceiverPorts.FordActvNiblCtrlArbnCmd.Val /end MEASUREMENT
/begin MEASUREMENT ImcArbn.FordActvParkAssiEnad.Logl "MICROSAR RTE" UBYTE RTE_CM_BOOLEAN 0 0 0 255 ECU_ADDRESS 0 SYMBOL_LINK "Rte_CustDiag_FordActvParkAssiEnad_Logl" 0 DISPLAY_IDENTIFIER ImcArbn.ReceiverPorts.FordActvParkAssiEnad.Logl /end MEASUREMENT
/begin MEASUREMENT ImcArbn.FordActvRtnEnad.Logl "MICROSAR RTE" UBYTE RTE_CM_BOOLEAN 0 0 0 255 ECU_ADDRESS 0 SYMBOL_LINK "Rte_CustDiag_FordActvRtnEnad_Logl" 0 DISPLAY_IDENTIFIER ImcArbn.ReceiverPorts.FordActvRtnEnad.Logl /end MEASUREMENT
/begin MEASUREMENT ImcArbn.FordAfsEquid.Logl "MICROSAR RTE" UBYTE RTE_CM_BOOLEAN 0 0 0 255 ECU_ADDRESS 0 SYMBOL_LINK "Rte_CustDiag_FordAfsEquid_Logl" 0 DISPLAY_IDENTIFIER ImcArbn.ReceiverPorts.FordAfsEquid.Logl /end MEASUREMENT
/begin MEASUREMENT ImcArbn.FordColTqOvrl.Val "MICROSAR RTE" FLOAT32_IEEE NO_COMPU_METHOD 0 0 -3.402823466e+38 3.402823466e+38 ECU_ADDRESS 0 SYMBOL_LINK "Rte_FordHwTqCmdOvrlLimr_FordColTqOvrl_Val" 0 DISPLAY_IDENTIFIER ImcArbn.ReceiverPorts.FordColTqOvrl.Val /end MEASUREMENT
/begin MEASUREMENT ImcArbn.FordCtcIdx.Val "MICROSAR RTE" UBYTE NO_COMPU_METHOD 0 0 0 255 ECU_ADDRESS 0 SYMBOL_LINK "Rte_FordDualEcuFltDiagcCom_FordCtcIdx_Val" 0 DISPLAY_IDENTIFIER ImcArbn.ReceiverPorts.FordCtcIdx.Val /end MEASUREMENT
/begin MEASUREMENT ImcArbn.FordCtcSts.Val "MICROSAR RTE" UBYTE NO_COMPU_METHOD 0 0 0 255 ECU_ADDRESS 0 SYMBOL_LINK "Rte_FordDualEcuFltDiagcCom_FordCtcSts_Val" 0 DISPLAY_IDENTIFIER ImcArbn.ReceiverPorts.FordCtcSts.Val /end MEASUREMENT
/begin MEASUREMENT ImcArbn.FordDrvrSteerRcmdnArbnCmd.Val "MICROSAR RTE" UBYTE NO_COMPU_METHOD 0 0 0 255 ECU_ADDRESS 0 SYMBOL_LINK "Rte_FordCmdArbn_FordDrvrSteerRcmdnArbnCmd_Val" 0 DISPLAY_IDENTIFIER ImcArbn.ReceiverPorts.FordDrvrSteerRcmdnArbnCmd.Val /end MEASUREMENT
/begin MEASUREMENT ImcArbn.FordDrvrSteerRcmdnEnad.Logl "MICROSAR RTE" UBYTE RTE_CM_BOOLEAN 0 0 0 255 ECU_ADDRESS 0 SYMBOL_LINK "Rte_CustDiag_FordDrvrSteerRcmdnEnad_Logl" 0 DISPLAY_IDENTIFIER ImcArbn.ReceiverPorts.FordDrvrSteerRcmdnEnad.Logl /end MEASUREMENT
/begin MEASUREMENT ImcArbn.FordEngTqClass.Val "MICROSAR RTE" UBYTE NO_COMPU_METHOD 0 0 0 255 ECU_ADDRESS 0 SYMBOL_LINK "Rte_CustDiag_FordEngTqClass_Val" 0 DISPLAY_IDENTIFIER ImcArbn.ReceiverPorts.FordEngTqClass.Val /end MEASUREMENT
/begin MEASUREMENT ImcArbn.FordEscPrsnt.Logl "MICROSAR RTE" UBYTE RTE_CM_BOOLEAN 0 0 0 255 ECU_ADDRESS 0 SYMBOL_LINK "Rte_CustDiag_FordEscPrsnt_Logl" 0 DISPLAY_IDENTIFIER ImcArbn.ReceiverPorts.FordEscPrsnt.Logl /end MEASUREMENT
/begin MEASUREMENT ImcArbn.FordEvasSteerAssiArbnCmd.Val "MICROSAR RTE" UBYTE NO_COMPU_METHOD 0 0 0 255 ECU_ADDRESS 0 SYMBOL_LINK "Rte_FordCmdArbn_FordEvasSteerAssiArbnCmd_Val" 0 DISPLAY_IDENTIFIER ImcArbn.ReceiverPorts.FordEvasSteerAssiArbnCmd.Val /end MEASUREMENT
/begin MEASUREMENT ImcArbn.FordExtAgCtrlArbnCmd.Val "MICROSAR RTE" UBYTE NO_COMPU_METHOD 0 0 0 255 ECU_ADDRESS 0 SYMBOL_LINK "Rte_FordCmdArbn_FordExtAgCtrlArbnCmd_Val" 0 DISPLAY_IDENTIFIER ImcArbn.ReceiverPorts.FordExtAgCtrlArbnCmd.Val /end MEASUREMENT
/begin MEASUREMENT ImcArbn.FordLaneDprtrWarnArbnCmd.Val "MICROSAR RTE" UBYTE NO_COMPU_METHOD 0 0 0 255 ECU_ADDRESS 0 SYMBOL_LINK "Rte_FordCmdArbn_FordLaneDprtrWarnArbnCmd_Val" 0 DISPLAY_IDENTIFIER ImcArbn.ReceiverPorts.FordLaneDprtrWarnArbnCmd.Val /end MEASUREMENT
/begin MEASUREMENT ImcArbn.FordLaneKeepAssiArbnCmd.Val "MICROSAR RTE" UBYTE NO_COMPU_METHOD 0 0 0 255 ECU_ADDRESS 0 SYMBOL_LINK "Rte_FordCmdArbn_FordLaneKeepAssiArbnCmd_Val" 0 DISPLAY_IDENTIFIER ImcArbn.ReceiverPorts.FordLaneKeepAssiArbnCmd.Val /end MEASUREMENT
/begin MEASUREMENT ImcArbn.FordLatCtrlArbnCmd.Val "MICROSAR RTE" UBYTE NO_COMPU_METHOD 0 0 0 255 ECU_ADDRESS 0 SYMBOL_LINK "Rte_FordCmdArbn_FordLatCtrlArbnCmd_Val" 0 DISPLAY_IDENTIFIER ImcArbn.ReceiverPorts.FordLatCtrlArbnCmd.Val /end MEASUREMENT
/begin MEASUREMENT ImcArbn.FordMotTqCmdOvrl.Val "MICROSAR RTE" FLOAT32_IEEE NO_COMPU_METHOD 0 0 -3.402823466e+38 3.402823466e+38 ECU_ADDRESS 0 SYMBOL_LINK "Rte_FordMotTqCmdOvrlLimr_FordMotTqCmdOvrl_Val" 0 DISPLAY_IDENTIFIER ImcArbn.ReceiverPorts.FordMotTqCmdOvrl.Val /end MEASUREMENT
/begin MEASUREMENT ImcArbn.FordPullDriftCmpArbnCmd.Val "MICROSAR RTE" UBYTE NO_COMPU_METHOD 0 0 0 255 ECU_ADDRESS 0 SYMBOL_LINK "Rte_FordCmdArbn_FordPullDriftCmpArbnCmd_Val" 0 DISPLAY_IDENTIFIER ImcArbn.ReceiverPorts.FordPullDriftCmpArbnCmd.Val /end MEASUREMENT
/begin MEASUREMENT ImcArbn.FordPullDriftCmpLrngArbnCmd.Val "MICROSAR RTE" UBYTE NO_COMPU_METHOD 0 0 0 255 ECU_ADDRESS 0 SYMBOL_LINK "Rte_FordCmdArbn_FordPullDriftCmpLrngArbnCmd_Val" 0 DISPLAY_IDENTIFIER ImcArbn.ReceiverPorts.FordPullDriftCmpLrngArbnCmd.Val /end MEASUREMENT
/begin MEASUREMENT ImcArbn.FordSelDrvModEnad.Logl "MICROSAR RTE" UBYTE RTE_CM_BOOLEAN 0 0 0 255 ECU_ADDRESS 0 SYMBOL_LINK "Rte_CustDiag_FordSelDrvModEnad_Logl" 0 DISPLAY_IDENTIFIER ImcArbn.ReceiverPorts.FordSelDrvModEnad.Logl /end MEASUREMENT
/begin MEASUREMENT ImcArbn.FordSoftEndStopEnad.Logl "MICROSAR RTE" UBYTE RTE_CM_BOOLEAN 0 0 0 255 ECU_ADDRESS 0 SYMBOL_LINK "Rte_CustDiag_FordSoftEndStopEnad_Logl" 0 DISPLAY_IDENTIFIER ImcArbn.ReceiverPorts.FordSoftEndStopEnad.Logl /end MEASUREMENT
/begin MEASUREMENT ImcArbn.FordSpare1ArbnCmd.Val "MICROSAR RTE" UBYTE NO_COMPU_METHOD 0 0 0 255 ECU_ADDRESS 0 SYMBOL_LINK "Rte_FordCmdArbn_FordSpare1ArbnCmd_Val" 0 DISPLAY_IDENTIFIER ImcArbn.ReceiverPorts.FordSpare1ArbnCmd.Val /end MEASUREMENT
/begin MEASUREMENT ImcArbn.FordSpare2ArbnCmd.Val "MICROSAR RTE" UBYTE NO_COMPU_METHOD 0 0 0 255 ECU_ADDRESS 0 SYMBOL_LINK "Rte_FordCmdArbn_FordSpare2ArbnCmd_Val" 0 DISPLAY_IDENTIFIER ImcArbn.ReceiverPorts.FordSpare2ArbnCmd.Val /end MEASUREMENT
/begin MEASUREMENT ImcArbn.FordSpare3ArbnCmd.Val "MICROSAR RTE" UBYTE NO_COMPU_METHOD 0 0 0 255 ECU_ADDRESS 0 SYMBOL_LINK "Rte_FordCmdArbn_FordSpare3ArbnCmd_Val" 0 DISPLAY_IDENTIFIER ImcArbn.ReceiverPorts.FordSpare3ArbnCmd.Val /end MEASUREMENT
/begin MEASUREMENT ImcArbn.FordSteerTqDstbcRejctnArbnCmd.Val "MICROSAR RTE" UBYTE NO_COMPU_METHOD 0 0 0 255 ECU_ADDRESS 0 SYMBOL_LINK "Rte_FordCmdArbn_FordSteerTqDstbcRejctnArbnCmd_Val" 0 DISPLAY_IDENTIFIER ImcArbn.ReceiverPorts.FordSteerTqDstbcRejctnArbnCmd.Val /end MEASUREMENT
/begin MEASUREMENT ImcArbn.FordStrtStopSt.Val "MICROSAR RTE" UBYTE NO_COMPU_METHOD 0 0 0 255 ECU_ADDRESS 0 SYMBOL_LINK "Rte_CustDiag_FordStrtStopSt_Val" 0 DISPLAY_IDENTIFIER ImcArbn.ReceiverPorts.FordStrtStopSt.Val /end MEASUREMENT
/begin MEASUREMENT ImcArbn.FrmFltCntr100MilliSec "MICROSAR RTE" UBYTE NO_COMPU_METHOD 0 0 0 255 MATRIX_DIM 2 2 1 ECU_ADDRESS 0 SYMBOL_LINK "Rte_ImcArbn_FrmFltCntr100MilliSec" 0 DISPLAY_IDENTIFIER ImcArbn.PerInstanceMemories.FrmFltCntr100MilliSec /end MEASUREMENT
/begin MEASUREMENT ImcArbn.FrmFltCntr10MilliSec "MICROSAR RTE" UBYTE NO_COMPU_METHOD 0 0 0 255 MATRIX_DIM 2 2 1 ECU_ADDRESS 0 SYMBOL_LINK "Rte_ImcArbn_FrmFltCntr10MilliSec" 0 DISPLAY_IDENTIFIER ImcArbn.PerInstanceMemories.FrmFltCntr10MilliSec /end MEASUREMENT
/begin MEASUREMENT ImcArbn.FrmFltCntr2MilliSec "MICROSAR RTE" UBYTE NO_COMPU_METHOD 0 0 0 255 MATRIX_DIM 2 2 1 ECU_ADDRESS 0 SYMBOL_LINK "Rte_ImcArbn_FrmFltCntr2MilliSec" 0 DISPLAY_IDENTIFIER ImcArbn.PerInstanceMemories.FrmFltCntr2MilliSec /end MEASUREMENT
/begin MEASUREMENT ImcArbn.HwAg.Val "MICROSAR RTE" FLOAT32_IEEE NO_COMPU_METHOD 0 0 -3.402823466e+38 3.402823466e+38 ECU_ADDRESS 0 SYMBOL_LINK "Rte_HwAgSysArbn_HwAgFinal_Val" 0 DISPLAY_IDENTIFIER ImcArbn.ReceiverPorts.HwAg.Val /end MEASUREMENT
/begin MEASUREMENT ImcArbn.HwTq.Val "MICROSAR RTE" FLOAT32_IEEE NO_COMPU_METHOD 0 0 -3.402823466e+38 3.402823466e+38 ECU_ADDRESS 0 SYMBOL_LINK "Rte_Swp_HwTqSwp_Val" 0 DISPLAY_IDENTIFIER ImcArbn.ReceiverPorts.HwTq.Val /end MEASUREMENT
/begin MEASUREMENT ImcArbn.ImcEcuComStrtTiRef "MICROSAR RTE" ULONG NO_COMPU_METHOD 0 0 0 4294967295 ECU_ADDRESS 0 SYMBOL_LINK "Rte_ImcArbn_ImcEcuComStrtTiRef" 0 DISPLAY_IDENTIFIER ImcArbn.PerInstanceMemories.ImcEcuComStrtTiRef /end MEASUREMENT
/begin MEASUREMENT ImcArbn.MotVel.Val "MICROSAR RTE" FLOAT32_IEEE NO_COMPU_METHOD 0 0 -3.402823466e+38 3.402823466e+38 ECU_ADDRESS 0 SYMBOL_LINK "Rte_CDD_MotVel_MotVelCrf_Val" 0 DISPLAY_IDENTIFIER ImcArbn.ReceiverPorts.MotVel.Val /end MEASUREMENT
/begin MEASUREMENT ImcArbn.PinionAg.Val "MICROSAR RTE" FLOAT32_IEEE NO_COMPU_METHOD 0 0 -3.402823466e+38 3.402823466e+38 ECU_ADDRESS 0 SYMBOL_LINK "Rte_HwAgSysArbn_PinionAg_Val" 0 DISPLAY_IDENTIFIER ImcArbn.ReceiverPorts.PinionAg.Val /end MEASUREMENT
/begin MEASUREMENT ImcArbn.PinionAgConf.Val "MICROSAR RTE" FLOAT32_IEEE NO_COMPU_METHOD 0 0 -3.402823466e+38 3.402823466e+38 ECU_ADDRESS 0 SYMBOL_LINK "Rte_HwAgSysArbn_PinionAgConf_Val" 0 DISPLAY_IDENTIFIER ImcArbn.ReceiverPorts.PinionAgConf.Val /end MEASUREMENT
/begin MEASUREMENT ImcArbn.PosnServoIntgtrSt.Val "MICROSAR RTE" FLOAT32_IEEE NO_COMPU_METHOD 0 0 -3.402823466e+38 3.402823466e+38 ECU_ADDRESS 0 SYMBOL_LINK "Rte_PosnTrakgServo_PosnServoIntgtrSt_Val" 0 DISPLAY_IDENTIFIER ImcArbn.ReceiverPorts.PosnServoIntgtrSt.Val /end MEASUREMENT
/begin MEASUREMENT ImcArbn.PrevRollgCntrRxd "MICROSAR RTE" UBYTE NO_COMPU_METHOD 0 0 0 255 MATRIX_DIM 65535 1 1 ECU_ADDRESS 0 SYMBOL_LINK "Rte_ImcArbn_PrevRollgCntrRxd" 0 DISPLAY_IDENTIFIER ImcArbn.PerInstanceMemories.PrevRollgCntrRxd /end MEASUREMENT
/begin MEASUREMENT ImcArbn.PrimSrcResyncCntr "MICROSAR RTE" UBYTE NO_COMPU_METHOD 0 0 0 255 MATRIX_DIM 65535 1 1 ECU_ADDRESS 0 SYMBOL_LINK "Rte_ImcArbn_PrimSrcResyncCntr" 0 DISPLAY_IDENTIFIER ImcArbn.PerInstanceMemories.PrimSrcResyncCntr /end MEASUREMENT
/begin MEASUREMENT ImcArbn.PrimSrcRollgCntrResync "MICROSAR RTE" UBYTE NO_COMPU_METHOD 0 0 0 255 MATRIX_DIM 65535 1 1 ECU_ADDRESS 0 SYMBOL_LINK "Rte_ImcArbn_PrimSrcRollgCntrResync" 0 DISPLAY_IDENTIFIER ImcArbn.PerInstanceMemories.PrimSrcRollgCntrResync /end MEASUREMENT
/begin MEASUREMENT ImcArbn.PrimSrcRxBuf "MICROSAR RTE" UBYTE NO_COMPU_METHOD 0 0 0 255 MATRIX_DIM 8 65535 1 ECU_ADDRESS 0 SYMBOL_LINK "Rte_ImcArbn_PrimSrcRxBuf" 0 DISPLAY_IDENTIFIER ImcArbn.PerInstanceMemories.PrimSrcRxBuf /end MEASUREMENT
/begin MEASUREMENT ImcArbn.ResyncOnPrimActv "MICROSAR RTE" UBYTE RTE_CM_BOOLEAN 0 0 0 255 MATRIX_DIM 65535 1 1 ECU_ADDRESS 0 SYMBOL_LINK "Rte_ImcArbn_ResyncOnPrimActv" 0 DISPLAY_IDENTIFIER ImcArbn.PerInstanceMemories.ResyncOnPrimActv /end MEASUREMENT
/begin MEASUREMENT ImcArbn.ResyncOnSecdryActv "MICROSAR RTE" UBYTE RTE_CM_BOOLEAN 0 0 0 255 MATRIX_DIM 65535 1 1 ECU_ADDRESS 0 SYMBOL_LINK "Rte_ImcArbn_ResyncOnSecdryActv" 0 DISPLAY_IDENTIFIER ImcArbn.PerInstanceMemories.ResyncOnSecdryActv /end MEASUREMENT
/begin MEASUREMENT ImcArbn.RollgCntr "MICROSAR RTE" UBYTE NO_COMPU_METHOD 0 0 0 255 MATRIX_DIM 3 1 1 ECU_ADDRESS 0 SYMBOL_LINK "Rte_ImcArbn_RollgCntr" 0 DISPLAY_IDENTIFIER ImcArbn.PerInstanceMemories.RollgCntr /end MEASUREMENT
/begin MEASUREMENT ImcArbn.RstReq.Val "MICROSAR RTE" UBYTE NO_COMPU_METHOD 0 0 0 255 ECU_ADDRESS 0 SYMBOL_LINK "Rte_CustDiag_RstReq_Val" 0 DISPLAY_IDENTIFIER ImcArbn.ReceiverPorts.RstReq.Val /end MEASUREMENT
/begin MEASUREMENT ImcArbn.RtnDC00Req.Val "MICROSAR RTE" UBYTE NO_COMPU_METHOD 0 0 0 255 ECU_ADDRESS 0 SYMBOL_LINK "Rte_CustDiag_RtnDC00Req_Val" 0 DISPLAY_IDENTIFIER ImcArbn.ReceiverPorts.RtnDC00Req.Val /end MEASUREMENT
/begin MEASUREMENT ImcArbn.RxdSigData "MICROSAR RTE" ULONG NO_COMPU_METHOD 0 0 0 4294967295 MATRIX_DIM 65535 1 1 ECU_ADDRESS 0 SYMBOL_LINK "Rte_ImcArbn_RxdSigData" 0 DISPLAY_IDENTIFIER ImcArbn.PerInstanceMemories.RxdSigData /end MEASUREMENT
/begin MEASUREMENT ImcArbn.RxdSigDataExtdSts "MICROSAR RTE" UBYTE NO_COMPU_METHOD 0 0 0 255 MATRIX_DIM 65535 1 1 ECU_ADDRESS 0 SYMBOL_LINK "Rte_ImcArbn_RxdSigDataExtdSts" 0 DISPLAY_IDENTIFIER ImcArbn.PerInstanceMemories.RxdSigDataExtdSts /end MEASUREMENT
/begin MEASUREMENT ImcArbn.RxdSigDataSrc "MICROSAR RTE" UBYTE NO_COMPU_METHOD 0 0 0 255 MATRIX_DIM 65535 1 1 ECU_ADDRESS 0 SYMBOL_LINK "Rte_ImcArbn_RxdSigDataSrc" 0 DISPLAY_IDENTIFIER ImcArbn.PerInstanceMemories.RxdSigDataSrc /end MEASUREMENT
/begin MEASUREMENT ImcArbn.SecdrySrcResyncCntr "MICROSAR RTE" UBYTE NO_COMPU_METHOD 0 0 0 255 MATRIX_DIM 65535 1 1 ECU_ADDRESS 0 SYMBOL_LINK "Rte_ImcArbn_SecdrySrcResyncCntr" 0 DISPLAY_IDENTIFIER ImcArbn.PerInstanceMemories.SecdrySrcResyncCntr /end MEASUREMENT
/begin MEASUREMENT ImcArbn.SecdrySrcRollgCntrResync "MICROSAR RTE" UBYTE NO_COMPU_METHOD 0 0 0 255 MATRIX_DIM 65535 1 1 ECU_ADDRESS 0 SYMBOL_LINK "Rte_ImcArbn_SecdrySrcRollgCntrResync" 0 DISPLAY_IDENTIFIER ImcArbn.PerInstanceMemories.SecdrySrcRollgCntrResync /end MEASUREMENT
/begin MEASUREMENT ImcArbn.SecdrySrcRxBuf "MICROSAR RTE" UBYTE NO_COMPU_METHOD 0 0 0 255 MATRIX_DIM 8 65535 1 ECU_ADDRESS 0 SYMBOL_LINK "Rte_ImcArbn_SecdrySrcRxBuf" 0 DISPLAY_IDENTIFIER ImcArbn.PerInstanceMemories.SecdrySrcRxBuf /end MEASUREMENT
/begin MEASUREMENT ImcArbn.SigGroupDataSrc "MICROSAR RTE" UBYTE NO_COMPU_METHOD 0 0 0 255 MATRIX_DIM 65535 1 1 ECU_ADDRESS 0 SYMBOL_LINK "Rte_ImcArbn_SigGroupDataSrc" 0 DISPLAY_IDENTIFIER ImcArbn.PerInstanceMemories.SigGroupDataSrc /end MEASUREMENT
/begin MEASUREMENT ImcArbn.SigGroupMissCntr "MICROSAR RTE" UBYTE NO_COMPU_METHOD 0 0 0 255 MATRIX_DIM 65535 1 1 ECU_ADDRESS 0 SYMBOL_LINK "Rte_ImcArbn_SigGroupMissCntr" 0 DISPLAY_IDENTIFIER ImcArbn.PerInstanceMemories.SigGroupMissCntr /end MEASUREMENT
/begin MEASUREMENT ImcArbn.SigGroupNeverRxd "MICROSAR RTE" UBYTE RTE_CM_BOOLEAN 0 0 0 255 MATRIX_DIM 65535 1 1 ECU_ADDRESS 0 SYMBOL_LINK "Rte_ImcArbn_SigGroupNeverRxd" 0 DISPLAY_IDENTIFIER ImcArbn.PerInstanceMemories.SigGroupNeverRxd /end MEASUREMENT
/begin MEASUREMENT ImcArbn.SigGroupSkipCntr "MICROSAR RTE" UBYTE NO_COMPU_METHOD 0 0 0 255 MATRIX_DIM 65535 1 1 ECU_ADDRESS 0 SYMBOL_LINK "Rte_ImcArbn_SigGroupSkipCntr" 0 DISPLAY_IDENTIFIER ImcArbn.PerInstanceMemories.SigGroupSkipCntr /end MEASUREMENT
/begin MEASUREMENT ImcArbn.SysSt.Val "MICROSAR RTE" UBYTE RTE_CM_ENUM_SysSt1 0 0 0 255 ECU_ADDRESS 0 SYMBOL_LINK "Rte_SysStMod_SysSt_Val" 0 DISPLAY_IDENTIFIER ImcArbn.ReceiverPorts.SysSt.Val /end MEASUREMENT
/begin MEASUREMENT ImcArbn.TxBuf "MICROSAR RTE" UBYTE NO_COMPU_METHOD 0 0 0 255 MATRIX_DIM 8 65535 1 ECU_ADDRESS 0 SYMBOL_LINK "Rte_ImcArbn_TxBuf" 0 DISPLAY_IDENTIFIER ImcArbn.PerInstanceMemories.TxBuf /end MEASUREMENT
/begin MEASUREMENT ImcArbn.VehSpd.Val "MICROSAR RTE" FLOAT32_IEEE NO_COMPU_METHOD 0 0 -3.402823466e+38 3.402823466e+38 ECU_ADDRESS 0 SYMBOL_LINK "Rte_VehSigCdng_VehSpd_Val" 0 DISPLAY_IDENTIFIER ImcArbn.ReceiverPorts.VehSpd.Val /end MEASUREMENT
/begin MEASUREMENT ImcArbn.VehSpdVld.Logl "MICROSAR RTE" UBYTE RTE_CM_BOOLEAN 0 0 0 255 ECU_ADDRESS 0 SYMBOL_LINK "Rte_VehSigCdng_VehSpdVld_Logl" 0 DISPLAY_IDENTIFIER ImcArbn.ReceiverPorts.VehSpdVld.Logl /end MEASUREMENT
/begin MEASUREMENT ImcSigArbn.ArbnErrPrev "MICROSAR RTE" UBYTE RTE_CM_BOOLEAN 0 0 0 255 ECU_ADDRESS 0 SYMBOL_LINK "Rte_ImcSigArbn_ArbnErrPrev" 0 DISPLAY_IDENTIFIER ImcSigArbn.PerInstanceMemories.ArbnErrPrev /end MEASUREMENT
/begin MEASUREMENT ImcSigArbn.ArbnFltPrev "MICROSAR RTE" UBYTE RTE_CM_BOOLEAN 0 0 0 255 ECU_ADDRESS 0 SYMBOL_LINK "Rte_ImcSigArbn_ArbnFltPrev" 0 DISPLAY_IDENTIFIER ImcSigArbn.PerInstanceMemories.ArbnFltPrev /end MEASUREMENT
/begin MEASUREMENT ImcSigArbn.ArbnFltRefTiEnaLrng "MICROSAR RTE" ULONG NO_COMPU_METHOD 0 0 0 4294967295 ECU_ADDRESS 0 SYMBOL_LINK "Rte_ImcSigArbn_ArbnFltRefTiEnaLrng" 0 DISPLAY_IDENTIFIER ImcSigArbn.PerInstanceMemories.ArbnFltRefTiEnaLrng /end MEASUREMENT
/begin MEASUREMENT ImcSigArbn.EcuIdn.Val "MICROSAR RTE" UBYTE NO_COMPU_METHOD 0 0 0 255 ECU_ADDRESS 0 SYMBOL_LINK "Rte_DualEcuIdn_EcuId_Val" 0 DISPLAY_IDENTIFIER ImcSigArbn.ReceiverPorts.EcuIdn.Val /end MEASUREMENT
/begin MEASUREMENT ImcSigArbn.HwAg.Val "MICROSAR RTE" FLOAT32_IEEE NO_COMPU_METHOD 0 0 -3.402823466e+38 3.402823466e+38 ECU_ADDRESS 0 SYMBOL_LINK "Rte_HwAgSysArbn_HwAgFinal_Val" 0 DISPLAY_IDENTIFIER ImcSigArbn.ReceiverPorts.HwAg.Val /end MEASUREMENT
/begin MEASUREMENT ImcSigArbn.HwAgImcCorrd.Val "MICROSAR RTE" FLOAT32_IEEE NO_COMPU_METHOD 0 0 -3.402823466e+38 3.402823466e+38 ECU_ADDRESS 0 SYMBOL_LINK "Rte_ImcSigArbn_HwAgImcCorrd_Val" 0 DISPLAY_IDENTIFIER ImcSigArbn.SenderPorts.HwAgImcCorrd.Val /end MEASUREMENT
/begin MEASUREMENT ImcSigArbn.HwAgLpFil.FilGain "MICROSAR RTE" FLOAT32_IEEE NO_COMPU_METHOD 0 0 -3.402823466e+38 3.402823466e+38 ECU_ADDRESS 0 SYMBOL_LINK "Rte_ImcSigArbn_HwAgLpFil.FilGain" 0 DISPLAY_IDENTIFIER ImcSigArbn.PerInstanceMemories.HwAgLpFil.FilGain /end MEASUREMENT
/begin MEASUREMENT ImcSigArbn.HwAgLpFil.FilSt "MICROSAR RTE" FLOAT32_IEEE NO_COMPU_METHOD 0 0 -3.402823466e+38 3.402823466e+38 ECU_ADDRESS 0 SYMBOL_LINK "Rte_ImcSigArbn_HwAgLpFil.FilSt" 0 DISPLAY_IDENTIFIER ImcSigArbn.PerInstanceMemories.HwAgLpFil.FilSt /end MEASUREMENT
/begin MEASUREMENT ImcSigArbn.HwAgOffsPrev "MICROSAR RTE" FLOAT32_IEEE NO_COMPU_METHOD 0 0 -3.402823466e+38 3.402823466e+38 ECU_ADDRESS 0 SYMBOL_LINK "Rte_ImcSigArbn_HwAgOffsPrev" 0 DISPLAY_IDENTIFIER ImcSigArbn.PerInstanceMemories.HwAgOffsPrev /end MEASUREMENT
/begin MEASUREMENT ImcSigArbn.HwAgTarLpFil.FilGain "MICROSAR RTE" FLOAT32_IEEE NO_COMPU_METHOD 0 0 -3.402823466e+38 3.402823466e+38 ECU_ADDRESS 0 SYMBOL_LINK "Rte_ImcSigArbn_HwAgTarLpFil.FilGain" 0 DISPLAY_IDENTIFIER ImcSigArbn.PerInstanceMemories.HwAgTarLpFil.FilGain /end MEASUREMENT
/begin MEASUREMENT ImcSigArbn.HwAgTarLpFil.FilSt "MICROSAR RTE" FLOAT32_IEEE NO_COMPU_METHOD 0 0 -3.402823466e+38 3.402823466e+38 ECU_ADDRESS 0 SYMBOL_LINK "Rte_ImcSigArbn_HwAgTarLpFil.FilSt" 0 DISPLAY_IDENTIFIER ImcSigArbn.PerInstanceMemories.HwAgTarLpFil.FilSt /end MEASUREMENT
/begin MEASUREMENT ImcSigArbn.HwAgTarOffsPrev "MICROSAR RTE" FLOAT32_IEEE NO_COMPU_METHOD 0 0 -3.402823466e+38 3.402823466e+38 ECU_ADDRESS 0 SYMBOL_LINK "Rte_ImcSigArbn_HwAgTarOffsPrev" 0 DISPLAY_IDENTIFIER ImcSigArbn.PerInstanceMemories.HwAgTarOffsPrev /end MEASUREMENT
/begin MEASUREMENT ImcSigArbn.HwTq.Val "MICROSAR RTE" FLOAT32_IEEE NO_COMPU_METHOD 0 0 -3.402823466e+38 3.402823466e+38 ECU_ADDRESS 0 SYMBOL_LINK "Rte_Swp_HwTqSwp_Val" 0 DISPLAY_IDENTIFIER ImcSigArbn.ReceiverPorts.HwTq.Val /end MEASUREMENT
/begin MEASUREMENT ImcSigArbn.HwTqImcCorrd.Val "MICROSAR RTE" FLOAT32_IEEE NO_COMPU_METHOD 0 0 -3.402823466e+38 3.402823466e+38 ECU_ADDRESS 0 SYMBOL_LINK "Rte_ImcSigArbn_HwTqImcCorrd_Val" 0 DISPLAY_IDENTIFIER ImcSigArbn.SenderPorts.HwTqImcCorrd.Val /end MEASUREMENT
/begin MEASUREMENT ImcSigArbn.HwTqLpFil.FilGain "MICROSAR RTE" FLOAT32_IEEE NO_COMPU_METHOD 0 0 -3.402823466e+38 3.402823466e+38 ECU_ADDRESS 0 SYMBOL_LINK "Rte_ImcSigArbn_HwTqLpFil.FilGain" 0 DISPLAY_IDENTIFIER ImcSigArbn.PerInstanceMemories.HwTqLpFil.FilGain /end MEASUREMENT
/begin MEASUREMENT ImcSigArbn.HwTqLpFil.FilSt "MICROSAR RTE" FLOAT32_IEEE NO_COMPU_METHOD 0 0 -3.402823466e+38 3.402823466e+38 ECU_ADDRESS 0 SYMBOL_LINK "Rte_ImcSigArbn_HwTqLpFil.FilSt" 0 DISPLAY_IDENTIFIER ImcSigArbn.PerInstanceMemories.HwTqLpFil.FilSt /end MEASUREMENT
/begin MEASUREMENT ImcSigArbn.HwTqOffsPrev "MICROSAR RTE" FLOAT32_IEEE NO_COMPU_METHOD 0 0 -3.402823466e+38 3.402823466e+38 ECU_ADDRESS 0 SYMBOL_LINK "Rte_ImcSigArbn_HwTqOffsPrev" 0 DISPLAY_IDENTIFIER ImcSigArbn.PerInstanceMemories.HwTqOffsPrev /end MEASUREMENT
/begin MEASUREMENT ImcSigArbn.ImcSysSt.Val "MICROSAR RTE" UBYTE RTE_CM_ENUM_SysSt1 0 0 0 255 ECU_ADDRESS 0 SYMBOL_LINK "Rte_ImcSigArbn_ImcSysSt_Val" 0 DISPLAY_IDENTIFIER ImcSigArbn.SenderPorts.ImcSysSt.Val /end MEASUREMENT
/begin MEASUREMENT ImcSigArbn.ImcSysStVld.Logl "MICROSAR RTE" UBYTE RTE_CM_BOOLEAN 0 0 0 255 ECU_ADDRESS 0 SYMBOL_LINK "Rte_ImcSigArbn_ImcSysStVld_Logl" 0 DISPLAY_IDENTIFIER ImcSigArbn.SenderPorts.ImcSysStVld.Logl /end MEASUREMENT
/begin MEASUREMENT ImcSigArbn.MotVelCrf.Val "MICROSAR RTE" FLOAT32_IEEE NO_COMPU_METHOD 0 0 -3.402823466e+38 3.402823466e+38 ECU_ADDRESS 0 SYMBOL_LINK "Rte_CDD_MotVel_MotVelCrf_Val" 0 DISPLAY_IDENTIFIER ImcSigArbn.ReceiverPorts.MotVelCrf.Val /end MEASUREMENT
/begin MEASUREMENT ImcSigArbn.MotVelCrfImcCorrd.Val "MICROSAR RTE" FLOAT32_IEEE NO_COMPU_METHOD 0 0 -3.402823466e+38 3.402823466e+38 ECU_ADDRESS 0 SYMBOL_LINK "Rte_ImcSigArbn_MotVelCrfImcCorrd_Val" 0 DISPLAY_IDENTIFIER ImcSigArbn.SenderPorts.MotVelCrfImcCorrd.Val /end MEASUREMENT
/begin MEASUREMENT ImcSigArbn.MotVelCrfOffsPrev "MICROSAR RTE" FLOAT32_IEEE NO_COMPU_METHOD 0 0 -3.402823466e+38 3.402823466e+38 ECU_ADDRESS 0 SYMBOL_LINK "Rte_ImcSigArbn_MotVelCrfOffsPrev" 0 DISPLAY_IDENTIFIER ImcSigArbn.PerInstanceMemories.MotVelCrfOffsPrev /end MEASUREMENT
/begin MEASUREMENT ImcSigArbn.MotVelLpFil.FilGain "MICROSAR RTE" FLOAT32_IEEE NO_COMPU_METHOD 0 0 -3.402823466e+38 3.402823466e+38 ECU_ADDRESS 0 SYMBOL_LINK "Rte_ImcSigArbn_MotVelLpFil.FilGain" 0 DISPLAY_IDENTIFIER ImcSigArbn.PerInstanceMemories.MotVelLpFil.FilGain /end MEASUREMENT
/begin MEASUREMENT ImcSigArbn.MotVelLpFil.FilSt "MICROSAR RTE" FLOAT32_IEEE NO_COMPU_METHOD 0 0 -3.402823466e+38 3.402823466e+38 ECU_ADDRESS 0 SYMBOL_LINK "Rte_ImcSigArbn_MotVelLpFil.FilSt" 0 DISPLAY_IDENTIFIER ImcSigArbn.PerInstanceMemories.MotVelLpFil.FilSt /end MEASUREMENT
/begin MEASUREMENT ImcSigArbn.PosnServoHwAg.Val "MICROSAR RTE" FLOAT32_IEEE NO_COMPU_METHOD 0 0 -3.402823466e+38 3.402823466e+38 ECU_ADDRESS 0 SYMBOL_LINK "Rte_ImcSigArbn_PosnServoHwAg_Val" 0 DISPLAY_IDENTIFIER ImcSigArbn.ReceiverPorts.PosnServoHwAg.Val /end MEASUREMENT
/begin MEASUREMENT ImcSigArbn.PosnServoHwAgImcCorrd.Val "MICROSAR RTE" FLOAT32_IEEE NO_COMPU_METHOD 0 0 -3.402823466e+38 3.402823466e+38 ECU_ADDRESS 0 SYMBOL_LINK "Rte_ImcSigArbn_PosnServoHwAgImcCorrd_Val" 0 DISPLAY_IDENTIFIER ImcSigArbn.SenderPorts.PosnServoHwAgImcCorrd.Val /end MEASUREMENT
/begin MEASUREMENT ImcSigArbn.PosnServoIntgtrLpFil.FilGain "MICROSAR RTE" FLOAT32_IEEE NO_COMPU_METHOD 0 0 -3.402823466e+38 3.402823466e+38 ECU_ADDRESS 0 SYMBOL_LINK "Rte_ImcSigArbn_PosnServoIntgtrLpFil.FilGain" 0 DISPLAY_IDENTIFIER ImcSigArbn.PerInstanceMemories.PosnServoIntgtrLpFil.FilGain /end MEASUREMENT
/begin MEASUREMENT ImcSigArbn.PosnServoIntgtrLpFil.FilSt "MICROSAR RTE" FLOAT32_IEEE NO_COMPU_METHOD 0 0 -3.402823466e+38 3.402823466e+38 ECU_ADDRESS 0 SYMBOL_LINK "Rte_ImcSigArbn_PosnServoIntgtrLpFil.FilSt" 0 DISPLAY_IDENTIFIER ImcSigArbn.PerInstanceMemories.PosnServoIntgtrLpFil.FilSt /end MEASUREMENT
/begin MEASUREMENT ImcSigArbn.PosnServoIntgtrOffs.Val "MICROSAR RTE" FLOAT32_IEEE NO_COMPU_METHOD 0 0 -3.402823466e+38 3.402823466e+38 ECU_ADDRESS 0 SYMBOL_LINK "Rte_ImcSigArbn_PosnServoIntgtrOffs_Val" 0 DISPLAY_IDENTIFIER ImcSigArbn.SenderPorts.PosnServoIntgtrOffs.Val /end MEASUREMENT
/begin MEASUREMENT ImcSigArbn.PosnServoIntgtrOffsPrev "MICROSAR RTE" FLOAT32_IEEE NO_COMPU_METHOD 0 0 -3.402823466e+38 3.402823466e+38 ECU_ADDRESS 0 SYMBOL_LINK "Rte_ImcSigArbn_PosnServoIntgtrOffsPrev" 0 DISPLAY_IDENTIFIER ImcSigArbn.PerInstanceMemories.PosnServoIntgtrOffsPrev /end MEASUREMENT
/begin MEASUREMENT ImcSigArbn.PosnServoIntgtrSt.Val "MICROSAR RTE" FLOAT32_IEEE NO_COMPU_METHOD 0 0 -3.402823466e+38 3.402823466e+38 ECU_ADDRESS 0 SYMBOL_LINK "Rte_PosnTrakgServo_PosnServoIntgtrSt_Val" 0 DISPLAY_IDENTIFIER ImcSigArbn.ReceiverPorts.PosnServoIntgtrSt.Val /end MEASUREMENT
/begin MEASUREMENT ImcSigArbn.PosnTrakgArbnFltMtgtnEna.Logl "MICROSAR RTE" UBYTE RTE_CM_BOOLEAN 0 0 0 255 ECU_ADDRESS 0 SYMBOL_LINK "Rte_ImcSigArbn_PosnTrakgArbnFltMtgtnEna_Logl" 0 DISPLAY_IDENTIFIER ImcSigArbn.SenderPorts.PosnTrakgArbnFltMtgtnEna.Logl /end MEASUREMENT
/begin MEASUREMENT ImcSigArbn.PosnTrakgIntgtrSt1.Val "MICROSAR RTE" FLOAT32_IEEE NO_COMPU_METHOD 0 0 -3.402823466e+38 3.402823466e+38 ECU_ADDRESS 0 SYMBOL_LINK "Rte_ImcSigArbn_PosnTrakgIntgtrSt1_Val" 0 DISPLAY_IDENTIFIER ImcSigArbn.ReceiverPorts.PosnTrakgIntgtrSt1.Val /end MEASUREMENT
/begin MEASUREMENT ImcSigArbn.PosnTrakgIntgtrSt1Offs.Val "MICROSAR RTE" FLOAT32_IEEE NO_COMPU_METHOD 0 0 -3.402823466e+38 3.402823466e+38 ECU_ADDRESS 0 SYMBOL_LINK "Rte_ImcSigArbn_PosnTrakgIntgtrSt1Offs_Val" 0 DISPLAY_IDENTIFIER ImcSigArbn.SenderPorts.PosnTrakgIntgtrSt1Offs.Val /end MEASUREMENT
/begin MEASUREMENT ImcSigArbn.PosnTrakgIntgtrSt2.Val "MICROSAR RTE" FLOAT32_IEEE NO_COMPU_METHOD 0 0 -3.402823466e+38 3.402823466e+38 ECU_ADDRESS 0 SYMBOL_LINK "Rte_ImcSigArbn_PosnTrakgIntgtrSt2_Val" 0 DISPLAY_IDENTIFIER ImcSigArbn.ReceiverPorts.PosnTrakgIntgtrSt2.Val /end MEASUREMENT
/begin MEASUREMENT ImcSigArbn.PosnTrakgIntgtrSt2Offs.Val "MICROSAR RTE" FLOAT32_IEEE NO_COMPU_METHOD 0 0 -3.402823466e+38 3.402823466e+38 ECU_ADDRESS 0 SYMBOL_LINK "Rte_ImcSigArbn_PosnTrakgIntgtrSt2Offs_Val" 0 DISPLAY_IDENTIFIER ImcSigArbn.SenderPorts.PosnTrakgIntgtrSt2Offs.Val /end MEASUREMENT
/begin MEASUREMENT ImcSigArbn.PullCmpLongTermCmpLpFil.FilGain "MICROSAR RTE" FLOAT32_IEEE NO_COMPU_METHOD 0 0 -3.402823466e+38 3.402823466e+38 ECU_ADDRESS 0 SYMBOL_LINK "Rte_ImcSigArbn_PullCmpLongTermCmpLpFil.FilGain" 0 DISPLAY_IDENTIFIER ImcSigArbn.PerInstanceMemories.PullCmpLongTermCmpLpFil.FilGain /end MEASUREMENT
/begin MEASUREMENT ImcSigArbn.PullCmpLongTermCmpLpFil.FilSt "MICROSAR RTE" FLOAT32_IEEE NO_COMPU_METHOD 0 0 -3.402823466e+38 3.402823466e+38 ECU_ADDRESS 0 SYMBOL_LINK "Rte_ImcSigArbn_PullCmpLongTermCmpLpFil.FilSt" 0 DISPLAY_IDENTIFIER ImcSigArbn.PerInstanceMemories.PullCmpLongTermCmpLpFil.FilSt /end MEASUREMENT
/begin MEASUREMENT ImcSigArbn.PullCmpLongTermIntgtrSt.Val "MICROSAR RTE" FLOAT32_IEEE NO_COMPU_METHOD 0 0 -3.402823466e+38 3.402823466e+38 ECU_ADDRESS 0 SYMBOL_LINK "Rte_ImcSigArbn_PullCmpLongTermIntgtrSt_Val" 0 DISPLAY_IDENTIFIER ImcSigArbn.ReceiverPorts.PullCmpLongTermIntgtrSt.Val /end MEASUREMENT
/begin MEASUREMENT ImcSigArbn.PullCmpLongTermIntgtrStOffs.Val "MICROSAR RTE" FLOAT32_IEEE NO_COMPU_METHOD 0 0 -3.402823466e+38 3.402823466e+38 ECU_ADDRESS 0 SYMBOL_LINK "Rte_ImcSigArbn_PullCmpLongTermIntgtrStOffs_Val" 0 DISPLAY_IDENTIFIER ImcSigArbn.SenderPorts.PullCmpLongTermIntgtrStOffs.Val /end MEASUREMENT
/begin MEASUREMENT ImcSigArbn.PullCmpLongTermIntgtrStOffsPrev "MICROSAR RTE" FLOAT32_IEEE NO_COMPU_METHOD 0 0 -3.402823466e+38 3.402823466e+38 ECU_ADDRESS 0 SYMBOL_LINK "Rte_ImcSigArbn_PullCmpLongTermIntgtrStOffsPrev" 0 DISPLAY_IDENTIFIER ImcSigArbn.PerInstanceMemories.PullCmpLongTermIntgtrStOffsPrev /end MEASUREMENT
/begin MEASUREMENT ImcSigArbn.PullCmpShoTermCmpLpFil.FilGain "MICROSAR RTE" FLOAT32_IEEE NO_COMPU_METHOD 0 0 -3.402823466e+38 3.402823466e+38 ECU_ADDRESS 0 SYMBOL_LINK "Rte_ImcSigArbn_PullCmpShoTermCmpLpFil.FilGain" 0 DISPLAY_IDENTIFIER ImcSigArbn.PerInstanceMemories.PullCmpShoTermCmpLpFil.FilGain /end MEASUREMENT
/begin MEASUREMENT ImcSigArbn.PullCmpShoTermCmpLpFil.FilSt "MICROSAR RTE" FLOAT32_IEEE NO_COMPU_METHOD 0 0 -3.402823466e+38 3.402823466e+38 ECU_ADDRESS 0 SYMBOL_LINK "Rte_ImcSigArbn_PullCmpShoTermCmpLpFil.FilSt" 0 DISPLAY_IDENTIFIER ImcSigArbn.PerInstanceMemories.PullCmpShoTermCmpLpFil.FilSt /end MEASUREMENT
/begin MEASUREMENT ImcSigArbn.PullCmpShoTermIntgtrSt.Val "MICROSAR RTE" FLOAT32_IEEE NO_COMPU_METHOD 0 0 -3.402823466e+38 3.402823466e+38 ECU_ADDRESS 0 SYMBOL_LINK "Rte_ImcSigArbn_PullCmpShoTermIntgtrSt_Val" 0 DISPLAY_IDENTIFIER ImcSigArbn.ReceiverPorts.PullCmpShoTermIntgtrSt.Val /end MEASUREMENT
/begin MEASUREMENT ImcSigArbn.PullCmpShoTermIntgtrStOffs.Val "MICROSAR RTE" FLOAT32_IEEE NO_COMPU_METHOD 0 0 -3.402823466e+38 3.402823466e+38 ECU_ADDRESS 0 SYMBOL_LINK "Rte_ImcSigArbn_PullCmpShoTermIntgtrStOffs_Val" 0 DISPLAY_IDENTIFIER ImcSigArbn.SenderPorts.PullCmpShoTermIntgtrStOffs.Val /end MEASUREMENT
/begin MEASUREMENT ImcSigArbn.PullCmpShoTermIntgtrStOffsPrev "MICROSAR RTE" FLOAT32_IEEE NO_COMPU_METHOD 0 0 -3.402823466e+38 3.402823466e+38 ECU_ADDRESS 0 SYMBOL_LINK "Rte_ImcSigArbn_PullCmpShoTermIntgtrStOffsPrev" 0 DISPLAY_IDENTIFIER ImcSigArbn.PerInstanceMemories.PullCmpShoTermIntgtrStOffsPrev /end MEASUREMENT
/begin MEASUREMENT ImcSigArbn.SysStLrngEnaPrev "MICROSAR RTE" UBYTE RTE_CM_BOOLEAN 0 0 0 255 ECU_ADDRESS 0 SYMBOL_LINK "Rte_ImcSigArbn_SysStLrngEnaPrev" 0 DISPLAY_IDENTIFIER ImcSigArbn.PerInstanceMemories.SysStLrngEnaPrev /end MEASUREMENT
/begin MEASUREMENT ImcSigArbn.SysStRefTiEnaLrng "MICROSAR RTE" ULONG NO_COMPU_METHOD 0 0 0 4294967295 ECU_ADDRESS 0 SYMBOL_LINK "Rte_ImcSigArbn_SysStRefTiEnaLrng" 0 DISPLAY_IDENTIFIER ImcSigArbn.PerInstanceMemories.SysStRefTiEnaLrng /end MEASUREMENT
/begin MEASUREMENT ImcSigArbn.TrakgIntgtrSt1LpFil.FilGain "MICROSAR RTE" FLOAT32_IEEE NO_COMPU_METHOD 0 0 -3.402823466e+38 3.402823466e+38 ECU_ADDRESS 0 SYMBOL_LINK "Rte_ImcSigArbn_TrakgIntgtrSt1LpFil.FilGain" 0 DISPLAY_IDENTIFIER ImcSigArbn.PerInstanceMemories.TrakgIntgtrSt1LpFil.FilGain /end MEASUREMENT
/begin MEASUREMENT ImcSigArbn.TrakgIntgtrSt1LpFil.FilSt "MICROSAR RTE" FLOAT32_IEEE NO_COMPU_METHOD 0 0 -3.402823466e+38 3.402823466e+38 ECU_ADDRESS 0 SYMBOL_LINK "Rte_ImcSigArbn_TrakgIntgtrSt1LpFil.FilSt" 0 DISPLAY_IDENTIFIER ImcSigArbn.PerInstanceMemories.TrakgIntgtrSt1LpFil.FilSt /end MEASUREMENT
/begin MEASUREMENT ImcSigArbn.TrakgIntgtrSt1Offs "MICROSAR RTE" FLOAT32_IEEE NO_COMPU_METHOD 0 0 -3.402823466e+38 3.402823466e+38 ECU_ADDRESS 0 SYMBOL_LINK "Rte_ImcSigArbn_TrakgIntgtrSt1Offs" 0 DISPLAY_IDENTIFIER ImcSigArbn.PerInstanceMemories.TrakgIntgtrSt1Offs /end MEASUREMENT
/begin MEASUREMENT ImcSigArbn.TrakgIntgtrSt2LpFil.FilGain "MICROSAR RTE" FLOAT32_IEEE NO_COMPU_METHOD 0 0 -3.402823466e+38 3.402823466e+38 ECU_ADDRESS 0 SYMBOL_LINK "Rte_ImcSigArbn_TrakgIntgtrSt2LpFil.FilGain" 0 DISPLAY_IDENTIFIER ImcSigArbn.PerInstanceMemories.TrakgIntgtrSt2LpFil.FilGain /end MEASUREMENT
/begin MEASUREMENT ImcSigArbn.TrakgIntgtrSt2LpFil.FilSt "MICROSAR RTE" FLOAT32_IEEE NO_COMPU_METHOD 0 0 -3.402823466e+38 3.402823466e+38 ECU_ADDRESS 0 SYMBOL_LINK "Rte_ImcSigArbn_TrakgIntgtrSt2LpFil.FilSt" 0 DISPLAY_IDENTIFIER ImcSigArbn.PerInstanceMemories.TrakgIntgtrSt2LpFil.FilSt /end MEASUREMENT
/begin MEASUREMENT ImcSigArbn.TrakgIntgtrSt2Offs "MICROSAR RTE" FLOAT32_IEEE NO_COMPU_METHOD 0 0 -3.402823466e+38 3.402823466e+38 ECU_ADDRESS 0 SYMBOL_LINK "Rte_ImcSigArbn_TrakgIntgtrSt2Offs" 0 DISPLAY_IDENTIFIER ImcSigArbn.PerInstanceMemories.TrakgIntgtrSt2Offs /end MEASUREMENT
/begin MEASUREMENT ImcSigArbn.VehSpd.Val "MICROSAR RTE" FLOAT32_IEEE NO_COMPU_METHOD 0 0 -3.402823466e+38 3.402823466e+38 ECU_ADDRESS 0 SYMBOL_LINK "Rte_VehSigCdng_VehSpd_Val" 0 DISPLAY_IDENTIFIER ImcSigArbn.ReceiverPorts.VehSpd.Val /end MEASUREMENT
/begin MEASUREMENT ImcSigArbn.VehSpdImcCorrd.Val "MICROSAR RTE" FLOAT32_IEEE NO_COMPU_METHOD 0 0 -3.402823466e+38 3.402823466e+38 ECU_ADDRESS 0 SYMBOL_LINK "Rte_ImcSigArbn_VehSpdImcCorrd_Val" 0 DISPLAY_IDENTIFIER ImcSigArbn.SenderPorts.VehSpdImcCorrd.Val /end MEASUREMENT
/begin MEASUREMENT ImcSigArbn.VehSpdLpFil.FilGain "MICROSAR RTE" FLOAT32_IEEE NO_COMPU_METHOD 0 0 -3.402823466e+38 3.402823466e+38 ECU_ADDRESS 0 SYMBOL_LINK "Rte_ImcSigArbn_VehSpdLpFil.FilGain" 0 DISPLAY_IDENTIFIER ImcSigArbn.PerInstanceMemories.VehSpdLpFil.FilGain /end MEASUREMENT
/begin MEASUREMENT ImcSigArbn.VehSpdLpFil.FilSt "MICROSAR RTE" FLOAT32_IEEE NO_COMPU_METHOD 0 0 -3.402823466e+38 3.402823466e+38 ECU_ADDRESS 0 SYMBOL_LINK "Rte_ImcSigArbn_VehSpdLpFil.FilSt" 0 DISPLAY_IDENTIFIER ImcSigArbn.PerInstanceMemories.VehSpdLpFil.FilSt /end MEASUREMENT
/begin MEASUREMENT ImcSigArbn.VehSpdOffsPrev "MICROSAR RTE" FLOAT32_IEEE NO_COMPU_METHOD 0 0 -3.402823466e+38 3.402823466e+38 ECU_ADDRESS 0 SYMBOL_LINK "Rte_ImcSigArbn_VehSpdOffsPrev" 0 DISPLAY_IDENTIFIER ImcSigArbn.PerInstanceMemories.VehSpdOffsPrev /end MEASUREMENT
/begin MEASUREMENT InertiaCmpVel.AssiCmdBas.Val "MICROSAR RTE" FLOAT32_IEEE NO_COMPU_METHOD 0 0 -3.402823466e+38 3.402823466e+38 ECU_ADDRESS 0 SYMBOL_LINK "Rte_Assi_AssiCmdBas_Val" 0 DISPLAY_IDENTIFIER InertiaCmpVel.ReceiverPorts.AssiCmdBas.Val /end MEASUREMENT
/begin MEASUREMENT InertiaCmpVel.DecelGain "MICROSAR RTE" FLOAT32_IEEE NO_COMPU_METHOD 0 0 -3.402823466e+38 3.402823466e+38 ECU_ADDRESS 0 SYMBOL_LINK "Rte_InertiaCmpVel_DecelGain" 0 DISPLAY_IDENTIFIER InertiaCmpVel.PerInstanceMemories.DecelGain /end MEASUREMENT
/begin MEASUREMENT InertiaCmpVel.HwTq.Val "MICROSAR RTE" FLOAT32_IEEE NO_COMPU_METHOD 0 0 -3.402823466e+38 3.402823466e+38 ECU_ADDRESS 0 SYMBOL_LINK "Rte_ImcSigArbn_HwTqImcCorrd_Val" 0 DISPLAY_IDENTIFIER InertiaCmpVel.ReceiverPorts.HwTq.Val /end MEASUREMENT
/begin MEASUREMENT InertiaCmpVel.InertiaCmpDecelGainDi.Logl "MICROSAR RTE" UBYTE RTE_CM_BOOLEAN 0 0 0 255 ECU_ADDRESS 0 SYMBOL_LINK "Rte_InertiaCmpVel_InertiaCmpDecelGainDi_Logl" 0 DISPLAY_IDENTIFIER InertiaCmpVel.ReceiverPorts.InertiaCmpDecelGainDi.Logl /end MEASUREMENT
/begin MEASUREMENT InertiaCmpVel.InertiaCmpVelCmd.Val "MICROSAR RTE" FLOAT32_IEEE NO_COMPU_METHOD 0 0 -3.402823466e+38 3.402823466e+38 ECU_ADDRESS 0 SYMBOL_LINK "Rte_InertiaCmpVel_InertiaCmpVelCmd_Val" 0 DISPLAY_IDENTIFIER InertiaCmpVel.SenderPorts.InertiaCmpVelCmd.Val /end MEASUREMENT
/begin MEASUREMENT InertiaCmpVel.InertiaCmpVelCmdDi.Logl "MICROSAR RTE" UBYTE RTE_CM_BOOLEAN 0 0 0 255 ECU_ADDRESS 0 SYMBOL_LINK "Rte_CmnMfgSrv_InertiaCmpVelCmdDi_Logl" 0 DISPLAY_IDENTIFIER InertiaCmpVel.ReceiverPorts.InertiaCmpVelCmdDi.Logl /end MEASUREMENT
/begin MEASUREMENT InertiaCmpVel.MotVelCrf.Val "MICROSAR RTE" FLOAT32_IEEE NO_COMPU_METHOD 0 0 -3.402823466e+38 3.402823466e+38 ECU_ADDRESS 0 SYMBOL_LINK "Rte_ImcSigArbn_MotVelCrfImcCorrd_Val" 0 DISPLAY_IDENTIFIER InertiaCmpVel.ReceiverPorts.MotVelCrf.Val /end MEASUREMENT
/begin MEASUREMENT InertiaCmpVel.NotchFilChk "MICROSAR RTE" UBYTE RTE_CM_BOOLEAN 0 0 0 255 ECU_ADDRESS 0 SYMBOL_LINK "Rte_InertiaCmpVel_NotchFilChk" 0 DISPLAY_IDENTIFIER InertiaCmpVel.PerInstanceMemories.NotchFilChk /end MEASUREMENT
/begin MEASUREMENT InertiaCmpVel.PreScagCmpCmdPrev1 "MICROSAR RTE" FLOAT32_IEEE NO_COMPU_METHOD 0 0 -3.402823466e+38 3.402823466e+38 ECU_ADDRESS 0 SYMBOL_LINK "Rte_InertiaCmpVel_PreScagCmpCmdPrev1" 0 DISPLAY_IDENTIFIER InertiaCmpVel.PerInstanceMemories.PreScagCmpCmdPrev1 /end MEASUREMENT
/begin MEASUREMENT InertiaCmpVel.PreScagCmpCmdPrev2 "MICROSAR RTE" FLOAT32_IEEE NO_COMPU_METHOD 0 0 -3.402823466e+38 3.402823466e+38 ECU_ADDRESS 0 SYMBOL_LINK "Rte_InertiaCmpVel_PreScagCmpCmdPrev2" 0 DISPLAY_IDENTIFIER InertiaCmpVel.PerInstanceMemories.PreScagCmpCmdPrev2 /end MEASUREMENT
/begin MEASUREMENT InertiaCmpVel.ScaDrvrVelPrev1 "MICROSAR RTE" FLOAT32_IEEE NO_COMPU_METHOD 0 0 -3.402823466e+38 3.402823466e+38 ECU_ADDRESS 0 SYMBOL_LINK "Rte_InertiaCmpVel_ScaDrvrVelPrev1" 0 DISPLAY_IDENTIFIER InertiaCmpVel.PerInstanceMemories.ScaDrvrVelPrev1 /end MEASUREMENT
/begin MEASUREMENT InertiaCmpVel.ScaDrvrVelPrev2 "MICROSAR RTE" FLOAT32_IEEE NO_COMPU_METHOD 0 0 -3.402823466e+38 3.402823466e+38 ECU_ADDRESS 0 SYMBOL_LINK "Rte_InertiaCmpVel_ScaDrvrVelPrev2" 0 DISPLAY_IDENTIFIER InertiaCmpVel.PerInstanceMemories.ScaDrvrVelPrev2 /end MEASUREMENT
/begin MEASUREMENT InertiaCmpVel.TqSnsrAgPrev "MICROSAR RTE" FLOAT32_IEEE NO_COMPU_METHOD 0 0 -3.402823466e+38 3.402823466e+38 ECU_ADDRESS 0 SYMBOL_LINK "Rte_InertiaCmpVel_TqSnsrAgPrev" 0 DISPLAY_IDENTIFIER InertiaCmpVel.PerInstanceMemories.TqSnsrAgPrev /end MEASUREMENT
/begin MEASUREMENT InertiaCmpVel.TqSnsrVelFil.FilGain "MICROSAR RTE" FLOAT32_IEEE NO_COMPU_METHOD 0 0 -3.402823466e+38 3.402823466e+38 ECU_ADDRESS 0 SYMBOL_LINK "Rte_InertiaCmpVel_TqSnsrVelFil.FilGain" 0 DISPLAY_IDENTIFIER InertiaCmpVel.PerInstanceMemories.TqSnsrVelFil.FilGain /end MEASUREMENT
/begin MEASUREMENT InertiaCmpVel.TqSnsrVelFil.FilSt "MICROSAR RTE" FLOAT32_IEEE NO_COMPU_METHOD 0 0 -3.402823466e+38 3.402823466e+38 ECU_ADDRESS 0 SYMBOL_LINK "Rte_InertiaCmpVel_TqSnsrVelFil.FilSt" 0 DISPLAY_IDENTIFIER InertiaCmpVel.PerInstanceMemories.TqSnsrVelFil.FilSt /end MEASUREMENT
/begin MEASUREMENT InertiaCmpVel.TqSnsrVelFilNotchSt.FilSt1 "MICROSAR RTE" FLOAT32_IEEE NO_COMPU_METHOD 0 0 -3.402823466e+38 3.402823466e+38 ECU_ADDRESS 0 SYMBOL_LINK "Rte_InertiaCmpVel_TqSnsrVelFilNotchSt.FilSt1" 0 DISPLAY_IDENTIFIER InertiaCmpVel.PerInstanceMemories.TqSnsrVelFilNotchSt.FilSt1 /end MEASUREMENT
/begin MEASUREMENT InertiaCmpVel.TqSnsrVelFilNotchSt.FilSt2 "MICROSAR RTE" FLOAT32_IEEE NO_COMPU_METHOD 0 0 -3.402823466e+38 3.402823466e+38 ECU_ADDRESS 0 SYMBOL_LINK "Rte_InertiaCmpVel_TqSnsrVelFilNotchSt.FilSt2" 0 DISPLAY_IDENTIFIER InertiaCmpVel.PerInstanceMemories.TqSnsrVelFilNotchSt.FilSt2 /end MEASUREMENT
/begin MEASUREMENT InertiaCmpVel.VehLgtA.Val "MICROSAR RTE" FLOAT32_IEEE NO_COMPU_METHOD 0 0 -3.402823466e+38 3.402823466e+38 ECU_ADDRESS 0 SYMBOL_LINK "Rte_VehSigCdng_VehLgtA_Val" 0 DISPLAY_IDENTIFIER InertiaCmpVel.ReceiverPorts.VehLgtA.Val /end MEASUREMENT
/begin MEASUREMENT InertiaCmpVel.VehSpd.Val "MICROSAR RTE" FLOAT32_IEEE NO_COMPU_METHOD 0 0 -3.402823466e+38 3.402823466e+38 ECU_ADDRESS 0 SYMBOL_LINK "Rte_ImcSigArbn_VehSpdImcCorrd_Val" 0 DISPLAY_IDENTIFIER InertiaCmpVel.ReceiverPorts.VehSpd.Val /end MEASUREMENT
/begin MEASUREMENT InertiaCmpVel.WhlImbRejctnAmp.Val "MICROSAR RTE" FLOAT32_IEEE NO_COMPU_METHOD 0 0 -3.402823466e+38 3.402823466e+38 ECU_ADDRESS 0 SYMBOL_LINK "Rte_InertiaCmpVel_WhlImbRejctnAmp_Val" 0 DISPLAY_IDENTIFIER InertiaCmpVel.ReceiverPorts.WhlImbRejctnAmp.Val /end MEASUREMENT
/begin MEASUREMENT InertiaCmpVel.dInertiaCmpVelAssiBasdDampgCoeff "MICROSAR RTE" FLOAT32_IEEE NO_COMPU_METHOD 0 0 -3.402823466e+38 3.402823466e+38 ECU_ADDRESS 0 SYMBOL_LINK "Rte_InertiaCmpVel_dInertiaCmpVelAssiBasdDampgCoeff" 0 DISPLAY_IDENTIFIER InertiaCmpVel.PerInstanceMemories.dInertiaCmpVelAssiBasdDampgCoeff /end MEASUREMENT
/begin MEASUREMENT InertiaCmpVel.dInertiaCmpVelCalcdInertiaCmp "MICROSAR RTE" FLOAT32_IEEE NO_COMPU_METHOD 0 0 -3.402823466e+38 3.402823466e+38 ECU_ADDRESS 0 SYMBOL_LINK "Rte_InertiaCmpVel_dInertiaCmpVelCalcdInertiaCmp" 0 DISPLAY_IDENTIFIER InertiaCmpVel.PerInstanceMemories.dInertiaCmpVelCalcdInertiaCmp /end MEASUREMENT
/begin MEASUREMENT InertiaCmpVel.dInertiaCmpVelFilFrq "MICROSAR RTE" FLOAT32_IEEE NO_COMPU_METHOD 0 0 -3.402823466e+38 3.402823466e+38 ECU_ADDRESS 0 SYMBOL_LINK "Rte_InertiaCmpVel_dInertiaCmpVelFilFrq" 0 DISPLAY_IDENTIFIER InertiaCmpVel.PerInstanceMemories.dInertiaCmpVelFilFrq /end MEASUREMENT
/begin MEASUREMENT InertiaCmpVel.dInertiaCmpVelMotVelBasdOutpScag "MICROSAR RTE" FLOAT32_IEEE NO_COMPU_METHOD 0 0 -3.402823466e+38 3.402823466e+38 ECU_ADDRESS 0 SYMBOL_LINK "Rte_InertiaCmpVel_dInertiaCmpVelMotVelBasdOutpScag" 0 DISPLAY_IDENTIFIER InertiaCmpVel.PerInstanceMemories.dInertiaCmpVelMotVelBasdOutpScag /end MEASUREMENT
/begin MEASUREMENT InertiaCmpVel.dInertiaCmpVelNotScadDrvrVel "MICROSAR RTE" FLOAT32_IEEE NO_COMPU_METHOD 0 0 -3.402823466e+38 3.402823466e+38 ECU_ADDRESS 0 SYMBOL_LINK "Rte_InertiaCmpVel_dInertiaCmpVelNotScadDrvrVel" 0 DISPLAY_IDENTIFIER InertiaCmpVel.PerInstanceMemories.dInertiaCmpVelNotScadDrvrVel /end MEASUREMENT
/begin MEASUREMENT InertiaCmpVel.dInertiaCmpVelNotchBlndVal "MICROSAR RTE" FLOAT32_IEEE NO_COMPU_METHOD 0 0 -3.402823466e+38 3.402823466e+38 ECU_ADDRESS 0 SYMBOL_LINK "Rte_InertiaCmpVel_dInertiaCmpVelNotchBlndVal" 0 DISPLAY_IDENTIFIER InertiaCmpVel.PerInstanceMemories.dInertiaCmpVelNotchBlndVal /end MEASUREMENT
/begin MEASUREMENT InertiaCmpVel.dInertiaCmpVelNotchInpVal "MICROSAR RTE" FLOAT32_IEEE NO_COMPU_METHOD 0 0 -3.402823466e+38 3.402823466e+38 ECU_ADDRESS 0 SYMBOL_LINK "Rte_InertiaCmpVel_dInertiaCmpVelNotchInpVal" 0 DISPLAY_IDENTIFIER InertiaCmpVel.PerInstanceMemories.dInertiaCmpVelNotchInpVal /end MEASUREMENT
/begin MEASUREMENT InertiaCmpVel.dInertiaCmpVelNotchOutpVal "MICROSAR RTE" FLOAT32_IEEE NO_COMPU_METHOD 0 0 -3.402823466e+38 3.402823466e+38 ECU_ADDRESS 0 SYMBOL_LINK "Rte_InertiaCmpVel_dInertiaCmpVelNotchOutpVal" 0 DISPLAY_IDENTIFIER InertiaCmpVel.PerInstanceMemories.dInertiaCmpVelNotchOutpVal /end MEASUREMENT
/begin MEASUREMENT InertiaCmpVel.dInertiaCmpVelRawDecelGain "MICROSAR RTE" FLOAT32_IEEE NO_COMPU_METHOD 0 0 -3.402823466e+38 3.402823466e+38 ECU_ADDRESS 0 SYMBOL_LINK "Rte_InertiaCmpVel_dInertiaCmpVelRawDecelGain" 0 DISPLAY_IDENTIFIER InertiaCmpVel.PerInstanceMemories.dInertiaCmpVelRawDecelGain /end MEASUREMENT
/begin MEASUREMENT InertiaCmpVel.dInertiaCmpVelScadDrvrVel "MICROSAR RTE" FLOAT32_IEEE NO_COMPU_METHOD 0 0 -3.402823466e+38 3.402823466e+38 ECU_ADDRESS 0 SYMBOL_LINK "Rte_InertiaCmpVel_dInertiaCmpVelScadDrvrVel" 0 DISPLAY_IDENTIFIER InertiaCmpVel.PerInstanceMemories.dInertiaCmpVelScadDrvrVel /end MEASUREMENT
/begin MEASUREMENT InertiaCmpVel.dInertiaCmpVelTqSnsrVelFildVal "MICROSAR RTE" FLOAT32_IEEE NO_COMPU_METHOD 0 0 -3.402823466e+38 3.402823466e+38 ECU_ADDRESS 0 SYMBOL_LINK "Rte_InertiaCmpVel_dInertiaCmpVelTqSnsrVelFildVal" 0 DISPLAY_IDENTIFIER InertiaCmpVel.PerInstanceMemories.dInertiaCmpVelTqSnsrVelFildVal /end MEASUREMENT
/begin MEASUREMENT LimrCdng.EotAssiSca.Val "MICROSAR RTE" FLOAT32_IEEE NO_COMPU_METHOD 0 0 -3.402823466e+38 3.402823466e+38 ECU_ADDRESS 0 SYMBOL_LINK "Rte_EotProtn_EotAssiSca_Val" 0 DISPLAY_IDENTIFIER LimrCdng.ReceiverPorts.EotAssiSca.Val /end MEASUREMENT
/begin MEASUREMENT LimrCdng.EotAssiScaCdnd.Val "MICROSAR RTE" FLOAT32_IEEE NO_COMPU_METHOD 0 0 -3.402823466e+38 3.402823466e+38 ECU_ADDRESS 0 SYMBOL_LINK "Rte_LimrCdng_EotAssiScaCdnd_Val" 0 DISPLAY_IDENTIFIER LimrCdng.SenderPorts.EotAssiScaCdnd.Val /end MEASUREMENT
/begin MEASUREMENT LimrCdng.EotMotTqLim.Val "MICROSAR RTE" FLOAT32_IEEE NO_COMPU_METHOD 0 0 -3.402823466e+38 3.402823466e+38 ECU_ADDRESS 0 SYMBOL_LINK "Rte_EotProtn_EotMotTqLim_Val" 0 DISPLAY_IDENTIFIER LimrCdng.ReceiverPorts.EotMotTqLim.Val /end MEASUREMENT
/begin MEASUREMENT LimrCdng.EotMotTqLimCdnd.Val "MICROSAR RTE" FLOAT32_IEEE NO_COMPU_METHOD 0 0 -3.402823466e+38 3.402823466e+38 ECU_ADDRESS 0 SYMBOL_LINK "Rte_LimrCdng_EotMotTqLimCdnd_Val" 0 DISPLAY_IDENTIFIER LimrCdng.SenderPorts.EotMotTqLimCdnd.Val /end MEASUREMENT
/begin MEASUREMENT LimrCdng.PrevEotAssiScaCdnd "MICROSAR RTE" FLOAT32_IEEE NO_COMPU_METHOD 0 0 -3.402823466e+38 3.402823466e+38 ECU_ADDRESS 0 SYMBOL_LINK "Rte_LimrCdng_PrevEotAssiScaCdnd" 0 DISPLAY_IDENTIFIER LimrCdng.PerInstanceMemories.PrevEotAssiScaCdnd /end MEASUREMENT
/begin MEASUREMENT LimrCdng.PrevEotMotTqLimCdnd "MICROSAR RTE" FLOAT32_IEEE NO_COMPU_METHOD 0 0 -3.402823466e+38 3.402823466e+38 ECU_ADDRESS 0 SYMBOL_LINK "Rte_LimrCdng_PrevEotMotTqLimCdnd" 0 DISPLAY_IDENTIFIER LimrCdng.PerInstanceMemories.PrevEotMotTqLimCdnd /end MEASUREMENT
/begin MEASUREMENT LimrCdng.PrevStallMotTqLimCdnd "MICROSAR RTE" FLOAT32_IEEE NO_COMPU_METHOD 0 0 -3.402823466e+38 3.402823466e+38 ECU_ADDRESS 0 SYMBOL_LINK "Rte_LimrCdng_PrevStallMotTqLimCdnd" 0 DISPLAY_IDENTIFIER LimrCdng.PerInstanceMemories.PrevStallMotTqLimCdnd /end MEASUREMENT
/begin MEASUREMENT LimrCdng.PrevSysMotTqCmdScaCdnd "MICROSAR RTE" FLOAT32_IEEE NO_COMPU_METHOD 0 0 -3.402823466e+38 3.402823466e+38 ECU_ADDRESS 0 SYMBOL_LINK "Rte_LimrCdng_PrevSysMotTqCmdScaCdnd" 0 DISPLAY_IDENTIFIER LimrCdng.PerInstanceMemories.PrevSysMotTqCmdScaCdnd /end MEASUREMENT
/begin MEASUREMENT LimrCdng.PrevThermMotTqLimCdnd "MICROSAR RTE" FLOAT32_IEEE NO_COMPU_METHOD 0 0 -3.402823466e+38 3.402823466e+38 ECU_ADDRESS 0 SYMBOL_LINK "Rte_LimrCdng_PrevThermMotTqLimCdnd" 0 DISPLAY_IDENTIFIER LimrCdng.PerInstanceMemories.PrevThermMotTqLimCdnd /end MEASUREMENT
/begin MEASUREMENT LimrCdng.PrevVehSpdMotTqLimCdnd "MICROSAR RTE" FLOAT32_IEEE NO_COMPU_METHOD 0 0 -3.402823466e+38 3.402823466e+38 ECU_ADDRESS 0 SYMBOL_LINK "Rte_LimrCdng_PrevVehSpdMotTqLimCdnd" 0 DISPLAY_IDENTIFIER LimrCdng.PerInstanceMemories.PrevVehSpdMotTqLimCdnd /end MEASUREMENT
/begin MEASUREMENT LimrCdng.StallMotTqLim.Val "MICROSAR RTE" FLOAT32_IEEE NO_COMPU_METHOD 0 0 -3.402823466e+38 3.402823466e+38 ECU_ADDRESS 0 SYMBOL_LINK "Rte_HiLoadStallLimr_StallMotTqLim_Val" 0 DISPLAY_IDENTIFIER LimrCdng.ReceiverPorts.StallMotTqLim.Val /end MEASUREMENT
/begin MEASUREMENT LimrCdng.StallMotTqLimCdnd.Val "MICROSAR RTE" FLOAT32_IEEE NO_COMPU_METHOD 0 0 -3.402823466e+38 3.402823466e+38 ECU_ADDRESS 0 SYMBOL_LINK "Rte_LimrCdng_StallMotTqLimCdnd_Val" 0 DISPLAY_IDENTIFIER LimrCdng.SenderPorts.StallMotTqLimCdnd.Val /end MEASUREMENT
/begin MEASUREMENT LimrCdng.SysMotTqCmdSca.Val "MICROSAR RTE" FLOAT32_IEEE NO_COMPU_METHOD 0 0 -3.402823466e+38 3.402823466e+38 ECU_ADDRESS 0 SYMBOL_LINK "Rte_StOutpCtrl_SysMotTqCmdSca_Val" 0 DISPLAY_IDENTIFIER LimrCdng.ReceiverPorts.SysMotTqCmdSca.Val /end MEASUREMENT
/begin MEASUREMENT LimrCdng.SysMotTqCmdScaCdnd.Val "MICROSAR RTE" FLOAT32_IEEE NO_COMPU_METHOD 0 0 -3.402823466e+38 3.402823466e+38 ECU_ADDRESS 0 SYMBOL_LINK "Rte_LimrCdng_SysMotTqCmdScaCdnd_Val" 0 DISPLAY_IDENTIFIER LimrCdng.SenderPorts.SysMotTqCmdScaCdnd.Val /end MEASUREMENT
/begin MEASUREMENT LimrCdng.ThermMotTqLim.Val "MICROSAR RTE" FLOAT32_IEEE NO_COMPU_METHOD 0 0 -3.402823466e+38 3.402823466e+38 ECU_ADDRESS 0 SYMBOL_LINK "Rte_DutyCycThermProtn_ThermMotTqLim_Val" 0 DISPLAY_IDENTIFIER LimrCdng.ReceiverPorts.ThermMotTqLim.Val /end MEASUREMENT
/begin MEASUREMENT LimrCdng.ThermMotTqLimCdnd.Val "MICROSAR RTE" FLOAT32_IEEE NO_COMPU_METHOD 0 0 -3.402823466e+38 3.402823466e+38 ECU_ADDRESS 0 SYMBOL_LINK "Rte_LimrCdng_ThermMotTqLimCdnd_Val" 0 DISPLAY_IDENTIFIER LimrCdng.SenderPorts.ThermMotTqLimCdnd.Val /end MEASUREMENT
/begin MEASUREMENT LimrCdng.VehSpd.Val "MICROSAR RTE" FLOAT32_IEEE NO_COMPU_METHOD 0 0 -3.402823466e+38 3.402823466e+38 ECU_ADDRESS 0 SYMBOL_LINK "Rte_ImcSigArbn_VehSpdImcCorrd_Val" 0 DISPLAY_IDENTIFIER LimrCdng.ReceiverPorts.VehSpd.Val /end MEASUREMENT
/begin MEASUREMENT LimrCdng.VehSpdMotTqLim.Val "MICROSAR RTE" FLOAT32_IEEE NO_COMPU_METHOD 0 0 -3.402823466e+38 3.402823466e+38 ECU_ADDRESS 0 SYMBOL_LINK "Rte_VehSpdLimr_VehSpdMotTqLim_Val" 0 DISPLAY_IDENTIFIER LimrCdng.ReceiverPorts.VehSpdMotTqLim.Val /end MEASUREMENT
/begin MEASUREMENT LimrCdng.VehSpdMotTqLimCdnd.Val "MICROSAR RTE" FLOAT32_IEEE NO_COMPU_METHOD 0 0 -3.402823466e+38 3.402823466e+38 ECU_ADDRESS 0 SYMBOL_LINK "Rte_LimrCdng_VehSpdMotTqLimCdnd_Val" 0 DISPLAY_IDENTIFIER LimrCdng.SenderPorts.VehSpdMotTqLimCdnd.Val /end MEASUREMENT
/begin MEASUREMENT LoaMgr.CurrMeasIdptSig.Val "MICROSAR RTE" UBYTE NO_COMPU_METHOD 0 0 0 255 ECU_ADDRESS 0 SYMBOL_LINK "Rte_CurrMeasCorrln_CurrMeasIdptSig_Val" 0 DISPLAY_IDENTIFIER LoaMgr.ReceiverPorts.CurrMeasIdptSig.Val /end MEASUREMENT
/begin MEASUREMENT LoaMgr.DiagcStsIvtr1Inactv.Logl "MICROSAR RTE" UBYTE RTE_CM_BOOLEAN 0 0 0 255 ECU_ADDRESS 0 SYMBOL_LINK "Rte_GateDrv0Ctrl_DiagcStsIvtr1Inactv_Logl" 0 DISPLAY_IDENTIFIER LoaMgr.ReceiverPorts.DiagcStsIvtr1Inactv.Logl /end MEASUREMENT
/begin MEASUREMENT LoaMgr.DiagcStsIvtr2Inactv.Logl "MICROSAR RTE" UBYTE RTE_CM_BOOLEAN 0 0 0 255 ECU_ADDRESS 0 SYMBOL_LINK "Rte_LoaMgr_DiagcStsIvtr2Inactv_Logl" 0 DISPLAY_IDENTIFIER LoaMgr.ReceiverPorts.DiagcStsIvtr2Inactv.Logl /end MEASUREMENT
/begin MEASUREMENT LoaMgr.HwTqIdptSig.Val "MICROSAR RTE" UBYTE NO_COMPU_METHOD 0 0 0 255 ECU_ADDRESS 0 SYMBOL_LINK "Rte_HwTqCorrln_HwTqIdptSig_Val" 0 DISPLAY_IDENTIFIER LoaMgr.ReceiverPorts.HwTqIdptSig.Val /end MEASUREMENT
/begin MEASUREMENT LoaMgr.HwTqLoaMtgtnEna.Logl "MICROSAR RTE" UBYTE RTE_CM_BOOLEAN 0 0 0 255 ECU_ADDRESS 0 SYMBOL_LINK "Rte_LoaMgr_HwTqLoaMtgtnEna_Logl" 0 DISPLAY_IDENTIFIER LoaMgr.SenderPorts.HwTqLoaMtgtnEna.Logl /end MEASUREMENT
/begin MEASUREMENT LoaMgr.IvtrFetFltTyp.Val "MICROSAR RTE" UBYTE RTE_CM_ENUM_IvtrFetFltTyp1 0 0 0 255 ECU_ADDRESS 0 SYMBOL_LINK "Rte_GateDrv0Ctrl_IvtrFetFltTyp_Val" 0 DISPLAY_IDENTIFIER LoaMgr.ReceiverPorts.IvtrFetFltTyp.Val /end MEASUREMENT
/begin GROUP HysCmp.HysCmpEffOffsY.Ary1D "MICROSAR RTE" /begin SUB_GROUP /end SUB_GROUP /begin FUNCTION_LIST /end FUNCTION_LIST /begin REF_CHARACTERISTIC HysCmp.HysCmpEffOffsY.Ary1D /end REF_CHARACTERISTIC /begin REF_MEASUREMENT /end REF_MEASUREMENT /end GROUP
/begin GROUP HysCmp.HysCmpFinalOutpLpFilFrq.Val "MICROSAR RTE" /begin SUB_GROUP /end SUB_GROUP /begin FUNCTION_LIST /end FUNCTION_LIST /begin REF_CHARACTERISTIC HysCmp.HysCmpFinalOutpLpFilFrq.Val /end REF_CHARACTERISTIC /begin REF_MEASUREMENT /end REF_MEASUREMENT /end GROUP
/begin GROUP HysCmp.HysCmpFricTScaX.Ary1D "MICROSAR RTE" /begin SUB_GROUP /end SUB_GROUP /begin FUNCTION_LIST /end FUNCTION_LIST /begin REF_CHARACTERISTIC HysCmp.HysCmpFricTScaX.Ary1D /end REF_CHARACTERISTIC /begin REF_MEASUREMENT /end REF_MEASUREMENT /end GROUP
/begin GROUP HysCmp.HysCmpFricTScaY.Ary1D "MICROSAR RTE" /begin SUB_GROUP /end SUB_GROUP /begin FUNCTION_LIST /end FUNCTION_LIST /begin REF_CHARACTERISTIC HysCmp.HysCmpFricTScaY.Ary1D /end REF_CHARACTERISTIC /begin REF_MEASUREMENT /end REF_MEASUREMENT /end GROUP
/begin GROUP HysCmp.HysCmpFricWhlImbRejctnBlndX.Ary1D "MICROSAR RTE" /begin SUB_GROUP /end SUB_GROUP /begin FUNCTION_LIST /end FUNCTION_LIST /begin REF_CHARACTERISTIC HysCmp.HysCmpFricWhlImbRejctnBlndX.Ary1D /end REF_CHARACTERISTIC /begin REF_MEASUREMENT /end REF_MEASUREMENT /end GROUP
/begin GROUP HysCmp.HysCmpFricWhlImbRejctnBlndY.Ary1D "MICROSAR RTE" /begin SUB_GROUP /end SUB_GROUP /begin FUNCTION_LIST /end FUNCTION_LIST /begin REF_CHARACTERISTIC HysCmp.HysCmpFricWhlImbRejctnBlndY.Ary1D /end REF_CHARACTERISTIC /begin REF_MEASUREMENT /end REF_MEASUREMENT /end GROUP
/begin GROUP HysCmp.HysCmpFricWhlImbRejctnOffY.Ary1D "MICROSAR RTE" /begin SUB_GROUP /end SUB_GROUP /begin FUNCTION_LIST /end FUNCTION_LIST /begin REF_CHARACTERISTIC HysCmp.HysCmpFricWhlImbRejctnOffY.Ary1D /end REF_CHARACTERISTIC /begin REF_MEASUREMENT /end REF_MEASUREMENT /end GROUP
/begin GROUP HysCmp.HysCmpFricWhlImbRejctnOnY.Ary1D "MICROSAR RTE" /begin SUB_GROUP /end SUB_GROUP /begin FUNCTION_LIST /end FUNCTION_LIST /begin REF_CHARACTERISTIC HysCmp.HysCmpFricWhlImbRejctnOnY.Ary1D /end REF_CHARACTERISTIC /begin REF_MEASUREMENT /end REF_MEASUREMENT /end GROUP
/begin GROUP HysCmp.HysCmpHwTqLpFilFrq.Val "MICROSAR RTE" /begin SUB_GROUP /end SUB_GROUP /begin FUNCTION_LIST /end FUNCTION_LIST /begin REF_CHARACTERISTIC HysCmp.HysCmpHwTqLpFilFrq.Val /end REF_CHARACTERISTIC /begin REF_MEASUREMENT /end REF_MEASUREMENT /end GROUP
/begin GROUP HysCmp.HysCmpHwTqScaX.Ary2D "MICROSAR RTE" /begin SUB_GROUP /end SUB_GROUP /begin FUNCTION_LIST /end FUNCTION_LIST /begin REF_CHARACTERISTIC HysCmp.HysCmpHwTqScaX.Ary2D /end REF_CHARACTERISTIC /begin REF_MEASUREMENT /end REF_MEASUREMENT /end GROUP
/begin GROUP HysCmp.HysCmpHwTqScaY.Ary2D "MICROSAR RTE" /begin SUB_GROUP /end SUB_GROUP /begin FUNCTION_LIST /end FUNCTION_LIST /begin REF_CHARACTERISTIC HysCmp.HysCmpHwTqScaY.Ary2D /end REF_CHARACTERISTIC /begin REF_MEASUREMENT /end REF_MEASUREMENT /end GROUP
/begin GROUP HysCmp.HysCmpHysSatnY.Ary1D "MICROSAR RTE" /begin SUB_GROUP /end SUB_GROUP /begin FUNCTION_LIST /end FUNCTION_LIST /begin REF_CHARACTERISTIC HysCmp.HysCmpHysSatnY.Ary1D /end REF_CHARACTERISTIC /begin REF_MEASUREMENT /end REF_MEASUREMENT /end GROUP
/begin GROUP HysCmp.HysCmpNegHysCmpScaX.Ary1D "MICROSAR RTE" /begin SUB_GROUP /end SUB_GROUP /begin FUNCTION_LIST /end FUNCTION_LIST /begin REF_CHARACTERISTIC HysCmp.HysCmpNegHysCmpScaX.Ary1D /end REF_CHARACTERISTIC /begin REF_MEASUREMENT /end REF_MEASUREMENT /end GROUP
/begin GROUP HysCmp.HysCmpNegHysCmpScaY.Ary1D "MICROSAR RTE" /begin SUB_GROUP /end SUB_GROUP /begin FUNCTION_LIST /end FUNCTION_LIST /begin REF_CHARACTERISTIC HysCmp.HysCmpNegHysCmpScaY.Ary1D /end REF_CHARACTERISTIC /begin REF_MEASUREMENT /end REF_MEASUREMENT /end GROUP
/begin GROUP HysCmp.HysCmpNegHysCmpX.Ary1D "MICROSAR RTE" /begin SUB_GROUP /end SUB_GROUP /begin FUNCTION_LIST /end FUNCTION_LIST /begin REF_CHARACTERISTIC HysCmp.HysCmpNegHysCmpX.Ary1D /end REF_CHARACTERISTIC /begin REF_MEASUREMENT /end REF_MEASUREMENT /end GROUP
/begin GROUP HysCmp.HysCmpNegHysCmpY.Ary1D "MICROSAR RTE" /begin SUB_GROUP /end SUB_GROUP /begin FUNCTION_LIST /end FUNCTION_LIST /begin REF_CHARACTERISTIC HysCmp.HysCmpNegHysCmpY.Ary1D /end REF_CHARACTERISTIC /begin REF_MEASUREMENT /end REF_MEASUREMENT /end GROUP
/begin GROUP HysCmp.HysCmpOutpLim.Val "MICROSAR RTE" /begin SUB_GROUP /end SUB_GROUP /begin FUNCTION_LIST /end FUNCTION_LIST /begin REF_CHARACTERISTIC HysCmp.HysCmpOutpLim.Val /end REF_CHARACTERISTIC /begin REF_MEASUREMENT /end REF_MEASUREMENT /end GROUP
/begin GROUP HysCmp.HysCmpRevGain.Val "MICROSAR RTE" /begin SUB_GROUP /end SUB_GROUP /begin FUNCTION_LIST /end FUNCTION_LIST /begin REF_CHARACTERISTIC HysCmp.HysCmpRevGain.Val /end REF_CHARACTERISTIC /begin REF_MEASUREMENT /end REF_MEASUREMENT /end GROUP
/begin GROUP HysCmp.HysCmpRiseX.Ary1D "MICROSAR RTE" /begin SUB_GROUP /end SUB_GROUP /begin FUNCTION_LIST /end FUNCTION_LIST /begin REF_CHARACTERISTIC HysCmp.HysCmpRiseX.Ary1D /end REF_CHARACTERISTIC /begin REF_MEASUREMENT /end REF_MEASUREMENT /end GROUP
/begin GROUP HysCmp.HysCmpRiseY.Ary1D "MICROSAR RTE" /begin SUB_GROUP /end SUB_GROUP /begin FUNCTION_LIST /end FUNCTION_LIST /begin REF_CHARACTERISTIC HysCmp.HysCmpRiseY.Ary1D /end REF_CHARACTERISTIC /begin REF_MEASUREMENT /end REF_MEASUREMENT /end GROUP
/begin GROUP HysCmp.PerInstanceMemories "MICROSAR RTE"
 /begin SUB_GROUP HysCmp.AssiCmdLpFil HysCmp.FinalOutpLpFil HysCmp.HwTqLpFil HysCmp.PrevAssiCmdFildVal HysCmp.PrevHwTqFildVal HysCmp.PrevRiseX HysCmp.PrevRiseY HysCmp.dHysCmpAssiCmdFild HysCmp.dHysCmpAvl HysCmp.dHysCmpEffCmpTq HysCmp.dHysCmpFric HysCmp.dHysCmpHwTqFild HysCmp.dHysCmpNegAvl HysCmp.dHysCmpPosAvl HysCmp.dHysCmpRawVal HysCmp.dHysCmpRiseYFac /end SUB_GROUP
 /begin FUNCTION_LIST /end FUNCTION_LIST
 /begin REF_CHARACTERISTIC /end REF_CHARACTERISTIC
 /begin REF_MEASUREMENT /end REF_MEASUREMENT
/end GROUP
/begin GROUP HysCmp.PrevAssiCmdFildVal "MICROSAR RTE" /begin SUB_GROUP /end SUB_GROUP /begin FUNCTION_LIST /end FUNCTION_LIST /begin REF_CHARACTERISTIC /end REF_CHARACTERISTIC /begin REF_MEASUREMENT HysCmp.PrevAssiCmdFildVal /end REF_MEASUREMENT /end GROUP
/begin GROUP HysCmp.PrevHwTqFildVal "MICROSAR RTE" /begin SUB_GROUP /end SUB_GROUP /begin FUNCTION_LIST /end FUNCTION_LIST /begin REF_CHARACTERISTIC /end REF_CHARACTERISTIC /begin REF_MEASUREMENT HysCmp.PrevHwTqFildVal /end REF_MEASUREMENT /end GROUP
/begin GROUP HysCmp.PrevRiseX "MICROSAR RTE" /begin SUB_GROUP /end SUB_GROUP /begin FUNCTION_LIST /end FUNCTION_LIST /begin REF_CHARACTERISTIC /end REF_CHARACTERISTIC /begin REF_MEASUREMENT HysCmp.PrevRiseX /end REF_MEASUREMENT /end GROUP
/begin GROUP HysCmp.PrevRiseY "MICROSAR RTE" /begin SUB_GROUP /end SUB_GROUP /begin FUNCTION_LIST /end FUNCTION_LIST /begin REF_CHARACTERISTIC /end REF_CHARACTERISTIC /begin REF_MEASUREMENT HysCmp.PrevRiseY /end REF_MEASUREMENT /end GROUP
/begin GROUP HysCmp.ReceiverPorts "MICROSAR RTE"
 /begin SUB_GROUP HysCmp.AssiCmdBas.Val HysCmp.AssiMechT.Val HysCmp.HwTq.Val HysCmp.HwTqOvrl.Val HysCmp.HysCmpCmdDi.Logl HysCmp.SysFricOffs.Val HysCmp.VehSpd.Val HysCmp.WhlImbRejctnAmp.Val /end SUB_GROUP
 /begin FUNCTION_LIST /end FUNCTION_LIST
 /begin REF_CHARACTERISTIC /end REF_CHARACTERISTIC
 /begin REF_MEASUREMENT /end REF_MEASUREMENT
/end GROUP
/begin GROUP HysCmp.SenderPorts "MICROSAR RTE" /begin SUB_GROUP HysCmp.HysCmpCmd.Val /end SUB_GROUP /begin FUNCTION_LIST /end FUNCTION_LIST /begin REF_CHARACTERISTIC /end REF_CHARACTERISTIC /begin REF_MEASUREMENT /end REF_MEASUREMENT /end GROUP
/begin GROUP HysCmp.SysFricOffs.Val "MICROSAR RTE" /begin SUB_GROUP /end SUB_GROUP /begin FUNCTION_LIST /end FUNCTION_LIST /begin REF_CHARACTERISTIC /end REF_CHARACTERISTIC /begin REF_MEASUREMENT HysCmp.SysFricOffs.Val /end REF_MEASUREMENT /end GROUP
/begin GROUP HysCmp.SysGlbPrmSysTqRat.Val "MICROSAR RTE" /begin SUB_GROUP /end SUB_GROUP /begin FUNCTION_LIST /end FUNCTION_LIST /begin REF_CHARACTERISTIC HysCmp.SysGlbPrmSysTqRat.Val /end REF_CHARACTERISTIC /begin REF_MEASUREMENT /end REF_MEASUREMENT /end GROUP
/begin GROUP HysCmp.SysGlbPrmVehSpdBilnrSeln.Ary1D "MICROSAR RTE" /begin SUB_GROUP /end SUB_GROUP /begin FUNCTION_LIST /end FUNCTION_LIST /begin REF_CHARACTERISTIC HysCmp.SysGlbPrmVehSpdBilnrSeln.Ary1D /end REF_CHARACTERISTIC /begin REF_MEASUREMENT /end REF_MEASUREMENT /end GROUP
/begin GROUP HysCmp.VehSpd.Val "MICROSAR RTE" /begin SUB_GROUP /end SUB_GROUP /begin FUNCTION_LIST /end FUNCTION_LIST /begin REF_CHARACTERISTIC /end REF_CHARACTERISTIC /begin REF_MEASUREMENT HysCmp.VehSpd.Val /end REF_MEASUREMENT /end GROUP
/begin GROUP HysCmp.WhlImbRejctnAmp.Val "MICROSAR RTE" /begin SUB_GROUP /end SUB_GROUP /begin FUNCTION_LIST /end FUNCTION_LIST /begin REF_CHARACTERISTIC /end REF_CHARACTERISTIC /begin REF_MEASUREMENT HysCmp.WhlImbRejctnAmp.Val /end REF_MEASUREMENT /end GROUP
/begin GROUP HysCmp.dHysCmpAssiCmdFild "MICROSAR RTE" /begin SUB_GROUP /end SUB_GROUP /begin FUNCTION_LIST /end FUNCTION_LIST /begin REF_CHARACTERISTIC /end REF_CHARACTERISTIC /begin REF_MEASUREMENT HysCmp.dHysCmpAssiCmdFild /end REF_MEASUREMENT /end GROUP
/begin GROUP HysCmp.dHysCmpAvl "MICROSAR RTE" /begin SUB_GROUP /end SUB_GROUP /begin FUNCTION_LIST /end FUNCTION_LIST /begin REF_CHARACTERISTIC /end REF_CHARACTERISTIC /begin REF_MEASUREMENT HysCmp.dHysCmpAvl /end REF_MEASUREMENT /end GROUP
/begin GROUP HysCmp.dHysCmpEffCmpTq "MICROSAR RTE" /begin SUB_GROUP /end SUB_GROUP /begin FUNCTION_LIST /end FUNCTION_LIST /begin REF_CHARACTERISTIC /end REF_CHARACTERISTIC /begin REF_MEASUREMENT HysCmp.dHysCmpEffCmpTq /end REF_MEASUREMENT /end GROUP
/begin GROUP HysCmp.dHysCmpFric "MICROSAR RTE" /begin SUB_GROUP /end SUB_GROUP /begin FUNCTION_LIST /end FUNCTION_LIST /begin REF_CHARACTERISTIC /end REF_CHARACTERISTIC /begin REF_MEASUREMENT HysCmp.dHysCmpFric /end REF_MEASUREMENT /end GROUP
/begin GROUP HysCmp.dHysCmpHwTqFild "MICROSAR RTE" /begin SUB_GROUP /end SUB_GROUP /begin FUNCTION_LIST /end FUNCTION_LIST /begin REF_CHARACTERISTIC /end REF_CHARACTERISTIC /begin REF_MEASUREMENT HysCmp.dHysCmpHwTqFild /end REF_MEASUREMENT /end GROUP
/begin GROUP HysCmp.dHysCmpNegAvl "MICROSAR RTE" /begin SUB_GROUP /end SUB_GROUP /begin FUNCTION_LIST /end FUNCTION_LIST /begin REF_CHARACTERISTIC /end REF_CHARACTERISTIC /begin REF_MEASUREMENT HysCmp.dHysCmpNegAvl /end REF_MEASUREMENT /end GROUP
/begin GROUP HysCmp.dHysCmpPosAvl "MICROSAR RTE" /begin SUB_GROUP /end SUB_GROUP /begin FUNCTION_LIST /end FUNCTION_LIST /begin REF_CHARACTERISTIC /end REF_CHARACTERISTIC /begin REF_MEASUREMENT HysCmp.dHysCmpPosAvl /end REF_MEASUREMENT /end GROUP
/begin GROUP HysCmp.dHysCmpRawVal "MICROSAR RTE" /begin SUB_GROUP /end SUB_GROUP /begin FUNCTION_LIST /end FUNCTION_LIST /begin REF_CHARACTERISTIC /end REF_CHARACTERISTIC /begin REF_MEASUREMENT HysCmp.dHysCmpRawVal /end REF_MEASUREMENT /end GROUP
/begin GROUP HysCmp.dHysCmpRiseYFac "MICROSAR RTE" /begin SUB_GROUP /end SUB_GROUP /begin FUNCTION_LIST /end FUNCTION_LIST /begin REF_CHARACTERISTIC /end REF_CHARACTERISTIC /begin REF_MEASUREMENT HysCmp.dHysCmpRiseYFac /end REF_MEASUREMENT /end GROUP
/begin GROUP ImcArbn "MICROSAR RTE"
 /begin SUB_GROUP ImcArbn.CalibrationPorts ImcArbn.PerInstanceMemories ImcArbn.ReceiverPorts /end SUB_GROUP
 /begin FUNCTION_LIST /end FUNCTION_LIST
 /begin REF_CHARACTERISTIC /end REF_CHARACTERISTIC
 /begin REF_MEASUREMENT /end REF_MEASUREMENT
/end GROUP
/begin GROUP ImcArbn.BattRtnCurr.Val "MICROSAR RTE" /begin SUB_GROUP /end SUB_GROUP /begin FUNCTION_LIST /end FUNCTION_LIST /begin REF_CHARACTERISTIC /end REF_CHARACTERISTIC /begin REF_MEASUREMENT ImcArbn.BattRtnCurr.Val /end REF_MEASUREMENT /end GROUP
/begin GROUP ImcArbn.BattVltg.Val "MICROSAR RTE" /begin SUB_GROUP /end SUB_GROUP /begin FUNCTION_LIST /end FUNCTION_LIST /begin REF_CHARACTERISTIC /end REF_CHARACTERISTIC /begin REF_MEASUREMENT ImcArbn.BattVltg.Val /end REF_MEASUREMENT /end GROUP
/begin GROUP ImcArbn.CalibrationPorts "MICROSAR RTE"
 /begin SUB_GROUP ImcArbn.ImcArbnEcuIninTiOutThd.Val ImcArbn.ImcArbnFrmFltThd.Val /end SUB_GROUP
 /begin FUNCTION_LIST /end FUNCTION_LIST
 /begin REF_CHARACTERISTIC /end REF_CHARACTERISTIC
 /begin REF_MEASUREMENT /end REF_MEASUREMENT
/end GROUP
/begin GROUP ImcArbn.ClrDiagcReq.Val "MICROSAR RTE" /begin SUB_GROUP /end SUB_GROUP /begin FUNCTION_LIST /end FUNCTION_LIST /begin REF_CHARACTERISTIC /end REF_CHARACTERISTIC /begin REF_MEASUREMENT ImcArbn.ClrDiagcReq.Val /end REF_MEASUREMENT /end GROUP
/begin GROUP ImcArbn.DiagcStsNonRcrvlReqDiFltPrsnt.Logl "MICROSAR RTE" /begin SUB_GROUP /end SUB_GROUP /begin FUNCTION_LIST /end FUNCTION_LIST /begin REF_CHARACTERISTIC /end REF_CHARACTERISTIC /begin REF_MEASUREMENT ImcArbn.DiagcStsNonRcrvlReqDiFltPrsnt.Logl /end REF_MEASUREMENT /end GROUP
/begin GROUP ImcArbn.DualEcuMotCtrlMtgtnEna.Logl "MICROSAR RTE" /begin SUB_GROUP /end SUB_GROUP /begin FUNCTION_LIST /end FUNCTION_LIST /begin REF_CHARACTERISTIC /end REF_CHARACTERISTIC /begin REF_MEASUREMENT ImcArbn.DualEcuMotCtrlMtgtnEna.Logl /end REF_MEASUREMENT /end GROUP
/begin GROUP ImcArbn.EcuId.Val "MICROSAR RTE" /begin SUB_GROUP /end SUB_GROUP /begin FUNCTION_LIST /end FUNCTION_LIST /begin REF_CHARACTERISTIC /end REF_CHARACTERISTIC /begin REF_MEASUREMENT ImcArbn.EcuId.Val /end REF_MEASUREMENT /end GROUP
/begin GROUP ImcArbn.FordAbsPrsnt.Logl "MICROSAR RTE" /begin SUB_GROUP /end SUB_GROUP /begin FUNCTION_LIST /end FUNCTION_LIST /begin REF_CHARACTERISTIC /end REF_CHARACTERISTIC /begin REF_MEASUREMENT ImcArbn.FordAbsPrsnt.Logl /end REF_MEASUREMENT /end GROUP
/begin GROUP ImcArbn.FordActvNiblCtrlArbnCmd.Val "MICROSAR RTE" /begin SUB_GROUP /end SUB_GROUP /begin FUNCTION_LIST /end FUNCTION_LIST /begin REF_CHARACTERISTIC /end REF_CHARACTERISTIC /begin REF_MEASUREMENT ImcArbn.FordActvNiblCtrlArbnCmd.Val /end REF_MEASUREMENT /end GROUP
/begin GROUP ImcArbn.FordActvParkAssiEnad.Logl "MICROSAR RTE" /begin SUB_GROUP /end SUB_GROUP /begin FUNCTION_LIST /end FUNCTION_LIST /begin REF_CHARACTERISTIC /end REF_CHARACTERISTIC /begin REF_MEASUREMENT ImcArbn.FordActvParkAssiEnad.Logl /end REF_MEASUREMENT /end GROUP
/begin GROUP ImcArbn.FordActvRtnEnad.Logl "MICROSAR RTE" /begin SUB_GROUP /end SUB_GROUP /begin FUNCTION_LIST /end FUNCTION_LIST /begin REF_CHARACTERISTIC /end REF_CHARACTERISTIC /begin REF_MEASUREMENT ImcArbn.FordActvRtnEnad.Logl /end REF_MEASUREMENT /end GROUP
/begin GROUP ImcArbn.FordAfsEquid.Logl "MICROSAR RTE" /begin SUB_GROUP /end SUB_GROUP /begin FUNCTION_LIST /end FUNCTION_LIST /begin REF_CHARACTERISTIC /end REF_CHARACTERISTIC /begin REF_MEASUREMENT ImcArbn.FordAfsEquid.Logl /end REF_MEASUREMENT /end GROUP
/begin GROUP ImcArbn.FordColTqOvrl.Val "MICROSAR RTE" /begin SUB_GROUP /end SUB_GROUP /begin FUNCTION_LIST /end FUNCTION_LIST /begin REF_CHARACTERISTIC /end REF_CHARACTERISTIC /begin REF_MEASUREMENT ImcArbn.FordColTqOvrl.Val /end REF_MEASUREMENT /end GROUP
/begin GROUP ImcArbn.FordCtcIdx.Val "MICROSAR RTE" /begin SUB_GROUP /end SUB_GROUP /begin FUNCTION_LIST /end FUNCTION_LIST /begin REF_CHARACTERISTIC /end REF_CHARACTERISTIC /begin REF_MEASUREMENT ImcArbn.FordCtcIdx.Val /end REF_MEASUREMENT /end GROUP
/begin GROUP ImcArbn.FordCtcSts.Val "MICROSAR RTE" /begin SUB_GROUP /end SUB_GROUP /begin FUNCTION_LIST /end FUNCTION_LIST /begin REF_CHARACTERISTIC /end REF_CHARACTERISTIC /begin REF_MEASUREMENT ImcArbn.FordCtcSts.Val /end REF_MEASUREMENT /end GROUP
/begin GROUP ImcArbn.FordDrvrSteerRcmdnArbnCmd.Val "MICROSAR RTE" /begin SUB_GROUP /end SUB_GROUP /begin FUNCTION_LIST /end FUNCTION_LIST /begin REF_CHARACTERISTIC /end REF_CHARACTERISTIC /begin REF_MEASUREMENT ImcArbn.FordDrvrSteerRcmdnArbnCmd.Val /end REF_MEASUREMENT /end GROUP
/begin GROUP ImcArbn.FordDrvrSteerRcmdnEnad.Logl "MICROSAR RTE" /begin SUB_GROUP /end SUB_GROUP /begin FUNCTION_LIST /end FUNCTION_LIST /begin REF_CHARACTERISTIC /end REF_CHARACTERISTIC /begin REF_MEASUREMENT ImcArbn.FordDrvrSteerRcmdnEnad.Logl /end REF_MEASUREMENT /end GROUP
/begin GROUP ImcArbn.FordEngTqClass.Val "MICROSAR RTE" /begin SUB_GROUP /end SUB_GROUP /begin FUNCTION_LIST /end FUNCTION_LIST /begin REF_CHARACTERISTIC /end REF_CHARACTERISTIC /begin REF_MEASUREMENT ImcArbn.FordEngTqClass.Val /end REF_MEASUREMENT /end GROUP
/begin GROUP ImcArbn.FordEscPrsnt.Logl "MICROSAR RTE" /begin SUB_GROUP /end SUB_GROUP /begin FUNCTION_LIST /end FUNCTION_LIST /begin REF_CHARACTERISTIC /end REF_CHARACTERISTIC /begin REF_MEASUREMENT ImcArbn.FordEscPrsnt.Logl /end REF_MEASUREMENT /end GROUP
/begin GROUP ImcArbn.FordEvasSteerAssiArbnCmd.Val "MICROSAR RTE" /begin SUB_GROUP /end SUB_GROUP /begin FUNCTION_LIST /end FUNCTION_LIST /begin REF_CHARACTERISTIC /end REF_CHARACTERISTIC /begin REF_MEASUREMENT ImcArbn.FordEvasSteerAssiArbnCmd.Val /end REF_MEASUREMENT /end GROUP
/begin GROUP ImcArbn.FordExtAgCtrlArbnCmd.Val "MICROSAR RTE" /begin SUB_GROUP /end SUB_GROUP /begin FUNCTION_LIST /end FUNCTION_LIST /begin REF_CHARACTERISTIC /end REF_CHARACTERISTIC /begin REF_MEASUREMENT ImcArbn.FordExtAgCtrlArbnCmd.Val /end REF_MEASUREMENT /end GROUP
/begin GROUP ImcArbn.FordLaneDprtrWarnArbnCmd.Val "MICROSAR RTE" /begin SUB_GROUP /end SUB_GROUP /begin FUNCTION_LIST /end FUNCTION_LIST /begin REF_CHARACTERISTIC /end REF_CHARACTERISTIC /begin REF_MEASUREMENT ImcArbn.FordLaneDprtrWarnArbnCmd.Val /end REF_MEASUREMENT /end GROUP
/begin GROUP ImcArbn.FordLaneKeepAssiArbnCmd.Val "MICROSAR RTE" /begin SUB_GROUP /end SUB_GROUP /begin FUNCTION_LIST /end FUNCTION_LIST /begin REF_CHARACTERISTIC /end REF_CHARACTERISTIC /begin REF_MEASUREMENT ImcArbn.FordLaneKeepAssiArbnCmd.Val /end REF_MEASUREMENT /end GROUP
/begin GROUP ImcArbn.FordLatCtrlArbnCmd.Val "MICROSAR RTE" /begin SUB_GROUP /end SUB_GROUP /begin FUNCTION_LIST /end FUNCTION_LIST /begin REF_CHARACTERISTIC /end REF_CHARACTERISTIC /begin REF_MEASUREMENT ImcArbn.FordLatCtrlArbnCmd.Val /end REF_MEASUREMENT /end GROUP
/begin GROUP ImcArbn.FordMotTqCmdOvrl.Val "MICROSAR RTE" /begin SUB_GROUP /end SUB_GROUP /begin FUNCTION_LIST /end FUNCTION_LIST /begin REF_CHARACTERISTIC /end REF_CHARACTERISTIC /begin REF_MEASUREMENT ImcArbn.FordMotTqCmdOvrl.Val /end REF_MEASUREMENT /end GROUP
/begin GROUP ImcArbn.FordPullDriftCmpArbnCmd.Val "MICROSAR RTE" /begin SUB_GROUP /end SUB_GROUP /begin FUNCTION_LIST /end FUNCTION_LIST /begin REF_CHARACTERISTIC /end REF_CHARACTERISTIC /begin REF_MEASUREMENT ImcArbn.FordPullDriftCmpArbnCmd.Val /end REF_MEASUREMENT /end GROUP
/begin GROUP ImcArbn.FordPullDriftCmpLrngArbnCmd.Val "MICROSAR RTE" /begin SUB_GROUP /end SUB_GROUP /begin FUNCTION_LIST /end FUNCTION_LIST /begin REF_CHARACTERISTIC /end REF_CHARACTERISTIC /begin REF_MEASUREMENT ImcArbn.FordPullDriftCmpLrngArbnCmd.Val /end REF_MEASUREMENT /end GROUP
/begin GROUP ImcArbn.FordSelDrvModEnad.Logl "MICROSAR RTE" /begin SUB_GROUP /end SUB_GROUP /begin FUNCTION_LIST /end FUNCTION_LIST /begin REF_CHARACTERISTIC /end REF_CHARACTERISTIC /begin REF_MEASUREMENT ImcArbn.FordSelDrvModEnad.Logl /end REF_MEASUREMENT /end GROUP
/begin GROUP ImcArbn.FordSoftEndStopEnad.Logl "MICROSAR RTE" /begin SUB_GROUP /end SUB_GROUP /begin FUNCTION_LIST /end FUNCTION_LIST /begin REF_CHARACTERISTIC /end REF_CHARACTERISTIC /begin REF_MEASUREMENT ImcArbn.FordSoftEndStopEnad.Logl /end REF_MEASUREMENT /end GROUP
/begin GROUP ImcArbn.FordSpare1ArbnCmd.Val "MICROSAR RTE" /begin SUB_GROUP /end SUB_GROUP /begin FUNCTION_LIST /end FUNCTION_LIST /begin REF_CHARACTERISTIC /end REF_CHARACTERISTIC /begin REF_MEASUREMENT ImcArbn.FordSpare1ArbnCmd.Val /end REF_MEASUREMENT /end GROUP
/begin GROUP ImcArbn.FordSpare2ArbnCmd.Val "MICROSAR RTE" /begin SUB_GROUP /end SUB_GROUP /begin FUNCTION_LIST /end FUNCTION_LIST /begin REF_CHARACTERISTIC /end REF_CHARACTERISTIC /begin REF_MEASUREMENT ImcArbn.FordSpare2ArbnCmd.Val /end REF_MEASUREMENT /end GROUP
/begin GROUP ImcArbn.FordSpare3ArbnCmd.Val "MICROSAR RTE" /begin SUB_GROUP /end SUB_GROUP /begin FUNCTION_LIST /end FUNCTION_LIST /begin REF_CHARACTERISTIC /end REF_CHARACTERISTIC /begin REF_MEASUREMENT ImcArbn.FordSpare3ArbnCmd.Val /end REF_MEASUREMENT /end GROUP
/begin GROUP ImcArbn.FordSteerTqDstbcRejctnArbnCmd.Val "MICROSAR RTE" /begin SUB_GROUP /end SUB_GROUP /begin FUNCTION_LIST /end FUNCTION_LIST /begin REF_CHARACTERISTIC /end REF_CHARACTERISTIC /begin REF_MEASUREMENT ImcArbn.FordSteerTqDstbcRejctnArbnCmd.Val /end REF_MEASUREMENT /end GROUP
/begin GROUP ImcArbn.FordStrtStopSt.Val "MICROSAR RTE" /begin SUB_GROUP /end SUB_GROUP /begin FUNCTION_LIST /end FUNCTION_LIST /begin REF_CHARACTERISTIC /end REF_CHARACTERISTIC /begin REF_MEASUREMENT ImcArbn.FordStrtStopSt.Val /end REF_MEASUREMENT /end GROUP
/begin GROUP ImcArbn.FrmFltCntr100MilliSec "MICROSAR RTE" /begin SUB_GROUP /end SUB_GROUP /begin FUNCTION_LIST /end FUNCTION_LIST /begin REF_CHARACTERISTIC /end REF_CHARACTERISTIC /begin REF_MEASUREMENT ImcArbn.FrmFltCntr100MilliSec /end REF_MEASUREMENT /end GROUP
/begin GROUP ImcArbn.FrmFltCntr10MilliSec "MICROSAR RTE" /begin SUB_GROUP /end SUB_GROUP /begin FUNCTION_LIST /end FUNCTION_LIST /begin REF_CHARACTERISTIC /end REF_CHARACTERISTIC /begin REF_MEASUREMENT ImcArbn.FrmFltCntr10MilliSec /end REF_MEASUREMENT /end GROUP
/begin GROUP ImcArbn.FrmFltCntr2MilliSec "MICROSAR RTE" /begin SUB_GROUP /end SUB_GROUP /begin FUNCTION_LIST /end FUNCTION_LIST /begin REF_CHARACTERISTIC /end REF_CHARACTERISTIC /begin REF_MEASUREMENT ImcArbn.FrmFltCntr2MilliSec /end REF_MEASUREMENT /end GROUP
/begin GROUP ImcArbn.HwAg.Val "MICROSAR RTE" /begin SUB_GROUP /end SUB_GROUP /begin FUNCTION_LIST /end FUNCTION_LIST /begin REF_CHARACTERISTIC /end REF_CHARACTERISTIC /begin REF_MEASUREMENT ImcArbn.HwAg.Val /end REF_MEASUREMENT /end GROUP
/begin GROUP ImcArbn.HwTq.Val "MICROSAR RTE" /begin SUB_GROUP /end SUB_GROUP /begin FUNCTION_LIST /end FUNCTION_LIST /begin REF_CHARACTERISTIC /end REF_CHARACTERISTIC /begin REF_MEASUREMENT ImcArbn.HwTq.Val /end REF_MEASUREMENT /end GROUP
/begin GROUP ImcArbn.ImcArbnEcuIninTiOutThd.Val "MICROSAR RTE" /begin SUB_GROUP /end SUB_GROUP /begin FUNCTION_LIST /end FUNCTION_LIST /begin REF_CHARACTERISTIC ImcArbn.ImcArbnEcuIninTiOutThd.Val /end REF_CHARACTERISTIC /begin REF_MEASUREMENT /end REF_MEASUREMENT /end GROUP
/begin GROUP ImcArbn.ImcArbnFrmFltThd.Val "MICROSAR RTE" /begin SUB_GROUP /end SUB_GROUP /begin FUNCTION_LIST /end FUNCTION_LIST /begin REF_CHARACTERISTIC ImcArbn.ImcArbnFrmFltThd.Val /end REF_CHARACTERISTIC /begin REF_MEASUREMENT /end REF_MEASUREMENT /end GROUP
/begin GROUP ImcArbn.ImcEcuComStrtTiRef "MICROSAR RTE" /begin SUB_GROUP /end SUB_GROUP /begin FUNCTION_LIST /end FUNCTION_LIST /begin REF_CHARACTERISTIC /end REF_CHARACTERISTIC /begin REF_MEASUREMENT ImcArbn.ImcEcuComStrtTiRef /end REF_MEASUREMENT /end GROUP
/begin GROUP ImcArbn.MotVel.Val "MICROSAR RTE" /begin SUB_GROUP /end SUB_GROUP /begin FUNCTION_LIST /end FUNCTION_LIST /begin REF_CHARACTERISTIC /end REF_CHARACTERISTIC /begin REF_MEASUREMENT ImcArbn.MotVel.Val /end REF_MEASUREMENT /end GROUP
/begin GROUP ImcArbn.PerInstanceMemories "MICROSAR RTE"
 /begin SUB_GROUP ImcArbn.FrmFltCntr100MilliSec ImcArbn.FrmFltCntr10MilliSec ImcArbn.FrmFltCntr2MilliSec ImcArbn.ImcEcuComStrtTiRef ImcArbn.PrevRollgCntrRxd ImcArbn.PrimSrcResyncCntr ImcArbn.PrimSrcRollgCntrResync ImcArbn.PrimSrcRxBuf ImcArbn.ResyncOnPrimActv ImcArbn.ResyncOnSecdryActv ImcArbn.RollgCntr ImcArbn.RxdSigData ImcArbn.RxdSigDataExtdSts ImcArbn.RxdSigDataSrc ImcArbn.SecdrySrcResyncCntr ImcArbn.SecdrySrcRollgCntrResync ImcArbn.SecdrySrcRxBuf ImcArbn.SigGroupDataSrc ImcArbn.SigGroupMissCntr ImcArbn.SigGroupNeverRxd ImcArbn.SigGroupSkipCntr ImcArbn.TxBuf /end SUB_GROUP
 /begin FUNCTION_LIST /end FUNCTION_LIST
 /begin REF_CHARACTERISTIC /end REF_CHARACTERISTIC
 /begin REF_MEASUREMENT /end REF_MEASUREMENT
/end GROUP
/begin GROUP ImcArbn.PinionAg.Val "MICROSAR RTE" /begin SUB_GROUP /end SUB_GROUP /begin FUNCTION_LIST /end FUNCTION_LIST /begin REF_CHARACTERISTIC /end REF_CHARACTERISTIC /begin REF_MEASUREMENT ImcArbn.PinionAg.Val /end REF_MEASUREMENT /end GROUP
/begin GROUP ImcArbn.PinionAgConf.Val "MICROSAR RTE" /begin SUB_GROUP /end SUB_GROUP /begin FUNCTION_LIST /end FUNCTION_LIST /begin REF_CHARACTERISTIC /end REF_CHARACTERISTIC /begin REF_MEASUREMENT ImcArbn.PinionAgConf.Val /end REF_MEASUREMENT /end GROUP
/begin GROUP ImcArbn.PosnServoIntgtrSt.Val "MICROSAR RTE" /begin SUB_GROUP /end SUB_GROUP /begin FUNCTION_LIST /end FUNCTION_LIST /begin REF_CHARACTERISTIC /end REF_CHARACTERISTIC /begin REF_MEASUREMENT ImcArbn.PosnServoIntgtrSt.Val /end REF_MEASUREMENT /end GROUP
/begin GROUP ImcArbn.PrevRollgCntrRxd "MICROSAR RTE" /begin SUB_GROUP /end SUB_GROUP /begin FUNCTION_LIST /end FUNCTION_LIST /begin REF_CHARACTERISTIC /end REF_CHARACTERISTIC /begin REF_MEASUREMENT ImcArbn.PrevRollgCntrRxd /end REF_MEASUREMENT /end GROUP
/begin GROUP ImcArbn.PrimSrcResyncCntr "MICROSAR RTE" /begin SUB_GROUP /end SUB_GROUP /begin FUNCTION_LIST /end FUNCTION_LIST /begin REF_CHARACTERISTIC /end REF_CHARACTERISTIC /begin REF_MEASUREMENT ImcArbn.PrimSrcResyncCntr /end REF_MEASUREMENT /end GROUP
/begin GROUP ImcArbn.PrimSrcRollgCntrResync "MICROSAR RTE" /begin SUB_GROUP /end SUB_GROUP /begin FUNCTION_LIST /end FUNCTION_LIST /begin REF_CHARACTERISTIC /end REF_CHARACTERISTIC /begin REF_MEASUREMENT ImcArbn.PrimSrcRollgCntrResync /end REF_MEASUREMENT /end GROUP
/begin GROUP ImcArbn.PrimSrcRxBuf "MICROSAR RTE" /begin SUB_GROUP /end SUB_GROUP /begin FUNCTION_LIST /end FUNCTION_LIST /begin REF_CHARACTERISTIC /end REF_CHARACTERISTIC /begin REF_MEASUREMENT ImcArbn.PrimSrcRxBuf /end REF_MEASUREMENT /end GROUP
/begin GROUP ImcArbn.ReceiverPorts "MICROSAR RTE"
 /begin SUB_GROUP ImcArbn.BattRtnCurr.Val ImcArbn.BattVltg.Val ImcArbn.ClrDiagcReq.Val ImcArbn.DiagcStsNonRcrvlReqDiFltPrsnt.Logl ImcArbn.DualEcuMotCtrlMtgtnEna.Logl ImcArbn.EcuId.Val ImcArbn.FordAbsPrsnt.Logl ImcArbn.FordActvNiblCtrlArbnCmd.Val ImcArbn.FordActvParkAssiEnad.Logl ImcArbn.FordActvRtnEnad.Logl ImcArbn.FordAfsEquid.Logl ImcArbn.FordColTqOvrl.Val ImcArbn.FordCtcIdx.Val ImcArbn.FordCtcSts.Val ImcArbn.FordDrvrSteerRcmdnArbnCmd.Val ImcArbn.FordDrvrSteerRcmdnEnad.Logl ImcArbn.FordEngTqClass.Val ImcArbn.FordEscPrsnt.Logl ImcArbn.FordEvasSteerAssiArbnCmd.Val ImcArbn.FordExtAgCtrlArbnCmd.Val ImcArbn.FordLaneDprtrWarnArbnCmd.Val ImcArbn.FordLaneKeepAssiArbnCmd.Val ImcArbn.FordLatCtrlArbnCmd.Val ImcArbn.FordMotTqCmdOvrl.Val ImcArbn.FordPullDriftCmpArbnCmd.Val ImcArbn.FordPullDriftCmpLrngArbnCmd.Val ImcArbn.FordSelDrvModEnad.Logl ImcArbn.FordSoftEndStopEnad.Logl ImcArbn.FordSpare1ArbnCmd.Val ImcArbn.FordSpare2ArbnCmd.Val ImcArbn.FordSpare3ArbnCmd.Val ImcArbn.FordSteerTqDstbcRejctnArbnCmd.Val ImcArbn.FordStrtStopSt.Val ImcArbn.HwAg.Val ImcArbn.HwTq.Val ImcArbn.MotVel.Val ImcArbn.PinionAg.Val ImcArbn.PinionAgConf.Val ImcArbn.PosnServoIntgtrSt.Val ImcArbn.RstReq.Val ImcArbn.RtnDC00Req.Val ImcArbn.SysSt.Val ImcArbn.VehSpd.Val ImcArbn.VehSpdVld.Logl /end SUB_GROUP
 /begin FUNCTION_LIST /end FUNCTION_LIST
 /begin REF_CHARACTERISTIC /end REF_CHARACTERISTIC
 /begin REF_MEASUREMENT /end REF_MEASUREMENT
/end GROUP
/begin GROUP ImcArbn.ResyncOnPrimActv "MICROSAR RTE" /begin SUB_GROUP /end SUB_GROUP /begin FUNCTION_LIST /end FUNCTION_LIST /begin REF_CHARACTERISTIC /end REF_CHARACTERISTIC /begin REF_MEASUREMENT ImcArbn.ResyncOnPrimActv /end REF_MEASUREMENT /end GROUP
/begin GROUP ImcArbn.ResyncOnSecdryActv "MICROSAR RTE" /begin SUB_GROUP /end SUB_GROUP /begin FUNCTION_LIST /end FUNCTION_LIST /begin REF_CHARACTERISTIC /end REF_CHARACTERISTIC /begin REF_MEASUREMENT ImcArbn.ResyncOnSecdryActv /end REF_MEASUREMENT /end GROUP
/begin GROUP ImcArbn.RollgCntr "MICROSAR RTE" /begin SUB_GROUP /end SUB_GROUP /begin FUNCTION_LIST /end FUNCTION_LIST /begin REF_CHARACTERISTIC /end REF_CHARACTERISTIC /begin REF_MEASUREMENT ImcArbn.RollgCntr /end REF_MEASUREMENT /end GROUP
/begin GROUP ImcArbn.RstReq.Val "MICROSAR RTE" /begin SUB_GROUP /end SUB_GROUP /begin FUNCTION_LIST /end FUNCTION_LIST /begin REF_CHARACTERISTIC /end REF_CHARACTERISTIC /begin REF_MEASUREMENT ImcArbn.RstReq.Val /end REF_MEASUREMENT /end GROUP
/begin GROUP ImcArbn.RtnDC00Req.Val "MICROSAR RTE" /begin SUB_GROUP /end SUB_GROUP /begin FUNCTION_LIST /end FUNCTION_LIST /begin REF_CHARACTERISTIC /end REF_CHARACTERISTIC /begin REF_MEASUREMENT ImcArbn.RtnDC00Req.Val /end REF_MEASUREMENT /end GROUP
/begin GROUP ImcArbn.RxdSigData "MICROSAR RTE" /begin SUB_GROUP /end SUB_GROUP /begin FUNCTION_LIST /end FUNCTION_LIST /begin REF_CHARACTERISTIC /end REF_CHARACTERISTIC /begin REF_MEASUREMENT ImcArbn.RxdSigData /end REF_MEASUREMENT /end GROUP
/begin GROUP ImcArbn.RxdSigDataExtdSts "MICROSAR RTE" /begin SUB_GROUP /end SUB_GROUP /begin FUNCTION_LIST /end FUNCTION_LIST /begin REF_CHARACTERISTIC /end REF_CHARACTERISTIC /begin REF_MEASUREMENT ImcArbn.RxdSigDataExtdSts /end REF_MEASUREMENT /end GROUP
/begin GROUP ImcArbn.RxdSigDataSrc "MICROSAR RTE" /begin SUB_GROUP /end SUB_GROUP /begin FUNCTION_LIST /end FUNCTION_LIST /begin REF_CHARACTERISTIC /end REF_CHARACTERISTIC /begin REF_MEASUREMENT ImcArbn.RxdSigDataSrc /end REF_MEASUREMENT /end GROUP
/begin GROUP ImcArbn.SecdrySrcResyncCntr "MICROSAR RTE" /begin SUB_GROUP /end SUB_GROUP /begin FUNCTION_LIST /end FUNCTION_LIST /begin REF_CHARACTERISTIC /end REF_CHARACTERISTIC /begin REF_MEASUREMENT ImcArbn.SecdrySrcResyncCntr /end REF_MEASUREMENT /end GROUP
/begin GROUP ImcArbn.SecdrySrcRollgCntrResync "MICROSAR RTE" /begin SUB_GROUP /end SUB_GROUP /begin FUNCTION_LIST /end FUNCTION_LIST /begin REF_CHARACTERISTIC /end REF_CHARACTERISTIC /begin REF_MEASUREMENT ImcArbn.SecdrySrcRollgCntrResync /end REF_MEASUREMENT /end GROUP
/begin GROUP ImcArbn.SecdrySrcRxBuf "MICROSAR RTE" /begin SUB_GROUP /end SUB_GROUP /begin FUNCTION_LIST /end FUNCTION_LIST /begin REF_CHARACTERISTIC /end REF_CHARACTERISTIC /begin REF_MEASUREMENT ImcArbn.SecdrySrcRxBuf /end REF_MEASUREMENT /end GROUP
/begin GROUP ImcArbn.SigGroupDataSrc "MICROSAR RTE" /begin SUB_GROUP /end SUB_GROUP /begin FUNCTION_LIST /end FUNCTION_LIST /begin REF_CHARACTERISTIC /end REF_CHARACTERISTIC /begin REF_MEASUREMENT ImcArbn.SigGroupDataSrc /end REF_MEASUREMENT /end GROUP
/begin GROUP ImcArbn.SigGroupMissCntr "MICROSAR RTE" /begin SUB_GROUP /end SUB_GROUP /begin FUNCTION_LIST /end FUNCTION_LIST /begin REF_CHARACTERISTIC /end REF_CHARACTERISTIC /begin REF_MEASUREMENT ImcArbn.SigGroupMissCntr /end REF_MEASUREMENT /end GROUP
/begin GROUP ImcArbn.SigGroupNeverRxd "MICROSAR RTE" /begin SUB_GROUP /end SUB_GROUP /begin FUNCTION_LIST /end FUNCTION_LIST /begin REF_CHARACTERISTIC /end REF_CHARACTERISTIC /begin REF_MEASUREMENT ImcArbn.SigGroupNeverRxd /end REF_MEASUREMENT /end GROUP
/begin GROUP ImcArbn.SigGroupSkipCntr "MICROSAR RTE" /begin SUB_GROUP /end SUB_GROUP /begin FUNCTION_LIST /end FUNCTION_LIST /begin REF_CHARACTERISTIC /end REF_CHARACTERISTIC /begin REF_MEASUREMENT ImcArbn.SigGroupSkipCntr /end REF_MEASUREMENT /end GROUP
/begin GROUP ImcArbn.SysSt.Val "MICROSAR RTE" /begin SUB_GROUP /end SUB_GROUP /begin FUNCTION_LIST /end FUNCTION_LIST /begin REF_CHARACTERISTIC /end REF_CHARACTERISTIC /begin REF_MEASUREMENT ImcArbn.SysSt.Val /end REF_MEASUREMENT /end GROUP
/begin GROUP ImcArbn.TxBuf "MICROSAR RTE" /begin SUB_GROUP /end SUB_GROUP /begin FUNCTION_LIST /end FUNCTION_LIST /begin REF_CHARACTERISTIC /end REF_CHARACTERISTIC /begin REF_MEASUREMENT ImcArbn.TxBuf /end REF_MEASUREMENT /end GROUP
/begin GROUP ImcArbn.VehSpd.Val "MICROSAR RTE" /begin SUB_GROUP /end SUB_GROUP /begin FUNCTION_LIST /end FUNCTION_LIST /begin REF_CHARACTERISTIC /end REF_CHARACTERISTIC /begin REF_MEASUREMENT ImcArbn.VehSpd.Val /end REF_MEASUREMENT /end GROUP
/begin GROUP ImcArbn.VehSpdVld.Logl "MICROSAR RTE" /begin SUB_GROUP /end SUB_GROUP /begin FUNCTION_LIST /end FUNCTION_LIST /begin REF_CHARACTERISTIC /end REF_CHARACTERISTIC /begin REF_MEASUREMENT ImcArbn.VehSpdVld.Logl /end REF_MEASUREMENT /end GROUP
/begin GROUP ImcSigArbn "MICROSAR RTE"
 /begin SUB_GROUP ImcSigArbn.CalibrationPorts ImcSigArbn.PerInstanceMemories ImcSigArbn.ReceiverPorts ImcSigArbn.SenderPorts /end SUB_GROUP
 /begin FUNCTION_LIST /end FUNCTION_LIST
 /begin REF_CHARACTERISTIC /end REF_CHARACTERISTIC
 /begin REF_MEASUREMENT /end REF_MEASUREMENT
/end GROUP
/begin GROUP ImcSigArbn.ArbnErrPrev "MICROSAR RTE" /begin SUB_GROUP /end SUB_GROUP /begin FUNCTION_LIST /end FUNCTION_LIST /begin REF_CHARACTERISTIC /end REF_CHARACTERISTIC /begin REF_MEASUREMENT ImcSigArbn.ArbnErrPrev /end REF_MEASUREMENT /end GROUP
/begin GROUP ImcSigArbn.ArbnFltPrev "MICROSAR RTE" /begin SUB_GROUP /end SUB_GROUP /begin FUNCTION_LIST /end FUNCTION_LIST /begin REF_CHARACTERISTIC /end REF_CHARACTERISTIC /begin REF_MEASUREMENT ImcSigArbn.ArbnFltPrev /end REF_MEASUREMENT /end GROUP
/begin GROUP ImcSigArbn.ArbnFltRefTiEnaLrng "MICROSAR RTE" /begin SUB_GROUP /end SUB_GROUP /begin FUNCTION_LIST /end FUNCTION_LIST /begin REF_CHARACTERISTIC /end REF_CHARACTERISTIC /begin REF_MEASUREMENT ImcSigArbn.ArbnFltRefTiEnaLrng /end REF_MEASUREMENT /end GROUP
/begin GROUP ImcSigArbn.CalibrationPorts "MICROSAR RTE"
 /begin SUB_GROUP ImcSigArbn.ImcSigArbnArbnFltTmr.Val ImcSigArbn.ImcSigArbnHwAgArbnEna.Logl ImcSigArbn.ImcSigArbnHwAgArbnLpFil.Val ImcSigArbn.ImcSigArbnHwAgArbnOffsLim.Val ImcSigArbn.ImcSigArbnHwAgTarArbnEna.Logl ImcSigArbn.ImcSigArbnHwAgTarArbnLpFil.Val ImcSigArbn.ImcSigArbnHwAgTarArbnOffsLim.Val ImcSigArbn.ImcSigArbnHwTqArbnEna.Logl ImcSigArbn.ImcSigArbnHwTqArbnLpFil.Val ImcSigArbn.ImcSigArbnHwTqArbnOffsLim.Val ImcSigArbn.ImcSigArbnMotVelArbnEna.Logl ImcSigArbn.ImcSigArbnMotVelArbnLpFil.Val ImcSigArbn.ImcSigArbnMotVelArbnOffsLim.Val ImcSigArbn.ImcSigArbnPosnServoArbnOffsLim.Val ImcSigArbn.ImcSigArbnPosnServoIntgtrStArbnEna.Logl ImcSigArbn.ImcSigArbnPosnServoIntgtrStArbnLpFil.Val ImcSigArbn.ImcSigArbnPosnTrakg1ArbnOffsLim.Val ImcSigArbn.ImcSigArbnPosnTrakg2ArbnOffsLim.Val ImcSigArbn.ImcSigArbnPullCmpLongTermArbnOffsLim.Val ImcSigArbn.ImcSigArbnPullCmpLongTermIntgtrStArbnEna.Logl ImcSigArbn.ImcSigArbnPullCmpLongTermIntgtrStArbnLpFil.Val ImcSigArbn.ImcSigArbnPullCmpShoTermArbnOffsLim.Val ImcSigArbn.ImcSigArbnPullCmpShoTermIntgtrStArbnEna.Logl ImcSigArbn.ImcSigArbnPullCmpShoTermIntgtrStArbnLpFil.Val ImcSigArbn.ImcSigArbnSysStTmr.Val ImcSigArbn.ImcSigArbnTrakgIntgtrSt1ArbnEna.Logl ImcSigArbn.ImcSigArbnTrakgIntgtrSt1ArbnLpFil.Val ImcSigArbn.ImcSigArbnTrakgIntgtrSt2ArbnEna.Logl ImcSigArbn.ImcSigArbnTrakgIntgtrSt2ArbnLpFil.Val ImcSigArbn.ImcSigArbnVehSpdArbnEna.Logl ImcSigArbn.ImcSigArbnVehSpdArbnLpFil.Val ImcSigArbn.ImcSigArbnVehSpdArbnOffsLim.Val /end SUB_GROUP
 /begin FUNCTION_LIST /end FUNCTION_LIST
 /begin REF_CHARACTERISTIC /end REF_CHARACTERISTIC
 /begin REF_MEASUREMENT /end REF_MEASUREMENT
/end GROUP
/begin GROUP ImcSigArbn.EcuIdn.Val "MICROSAR RTE" /begin SUB_GROUP /end SUB_GROUP /begin FUNCTION_LIST /end FUNCTION_LIST /begin REF_CHARACTERISTIC /end REF_CHARACTERISTIC /begin REF_MEASUREMENT ImcSigArbn.EcuIdn.Val /end REF_MEASUREMENT /end GROUP
/begin GROUP ImcSigArbn.HwAg.Val "MICROSAR RTE" /begin SUB_GROUP /end SUB_GROUP /begin FUNCTION_LIST /end FUNCTION_LIST /begin REF_CHARACTERISTIC /end REF_CHARACTERISTIC /begin REF_MEASUREMENT ImcSigArbn.HwAg.Val /end REF_MEASUREMENT /end GROUP
/begin GROUP ImcSigArbn.HwAgImcCorrd.Val "MICROSAR RTE" /begin SUB_GROUP /end SUB_GROUP /begin FUNCTION_LIST /end FUNCTION_LIST /begin REF_CHARACTERISTIC /end REF_CHARACTERISTIC /begin REF_MEASUREMENT ImcSigArbn.HwAgImcCorrd.Val /end REF_MEASUREMENT /end GROUP
/begin GROUP ImcSigArbn.HwAgLpFil "MICROSAR RTE" /begin SUB_GROUP /end SUB_GROUP /begin FUNCTION_LIST /end FUNCTION_LIST /begin REF_CHARACTERISTIC /end REF_CHARACTERISTIC /begin REF_MEASUREMENT ImcSigArbn.HwAgLpFil.FilGain ImcSigArbn.HwAgLpFil.FilSt /end REF_MEASUREMENT /end GROUP
/begin GROUP ImcSigArbn.HwAgOffsPrev "MICROSAR RTE" /begin SUB_GROUP /end SUB_GROUP /begin FUNCTION_LIST /end FUNCTION_LIST /begin REF_CHARACTERISTIC /end REF_CHARACTERISTIC /begin REF_MEASUREMENT ImcSigArbn.HwAgOffsPrev /end REF_MEASUREMENT /end GROUP
/begin GROUP ImcSigArbn.HwAgTarLpFil "MICROSAR RTE" /begin SUB_GROUP /end SUB_GROUP /begin FUNCTION_LIST /end FUNCTION_LIST /begin REF_CHARACTERISTIC /end REF_CHARACTERISTIC
 /begin REF_MEASUREMENT ImcSigArbn.HwAgTarLpFil.FilGain ImcSigArbn.HwAgTarLpFil.FilSt /end REF_MEASUREMENT
/end GROUP
/begin GROUP ImcSigArbn.HwAgTarOffsPrev "MICROSAR RTE" /begin SUB_GROUP /end SUB_GROUP /begin FUNCTION_LIST /end FUNCTION_LIST /begin REF_CHARACTERISTIC /end REF_CHARACTERISTIC /begin REF_MEASUREMENT ImcSigArbn.HwAgTarOffsPrev /end REF_MEASUREMENT /end GROUP
/begin GROUP ImcSigArbn.HwTq.Val "MICROSAR RTE" /begin SUB_GROUP /end SUB_GROUP /begin FUNCTION_LIST /end FUNCTION_LIST /begin REF_CHARACTERISTIC /end REF_CHARACTERISTIC /begin REF_MEASUREMENT ImcSigArbn.HwTq.Val /end REF_MEASUREMENT /end GROUP
/begin GROUP ImcSigArbn.HwTqImcCorrd.Val "MICROSAR RTE" /begin SUB_GROUP /end SUB_GROUP /begin FUNCTION_LIST /end FUNCTION_LIST /begin REF_CHARACTERISTIC /end REF_CHARACTERISTIC /begin REF_MEASUREMENT ImcSigArbn.HwTqImcCorrd.Val /end REF_MEASUREMENT /end GROUP
/begin GROUP ImcSigArbn.HwTqLpFil "MICROSAR RTE" /begin SUB_GROUP /end SUB_GROUP /begin FUNCTION_LIST /end FUNCTION_LIST /begin REF_CHARACTERISTIC /end REF_CHARACTERISTIC /begin REF_MEASUREMENT ImcSigArbn.HwTqLpFil.FilGain ImcSigArbn.HwTqLpFil.FilSt /end REF_MEASUREMENT /end GROUP
/begin GROUP ImcSigArbn.HwTqOffsPrev "MICROSAR RTE" /begin SUB_GROUP /end SUB_GROUP /begin FUNCTION_LIST /end FUNCTION_LIST /begin REF_CHARACTERISTIC /end REF_CHARACTERISTIC /begin REF_MEASUREMENT ImcSigArbn.HwTqOffsPrev /end REF_MEASUREMENT /end GROUP
/begin GROUP ImcSigArbn.ImcSigArbnArbnFltTmr.Val "MICROSAR RTE" /begin SUB_GROUP /end SUB_GROUP /begin FUNCTION_LIST /end FUNCTION_LIST /begin REF_CHARACTERISTIC ImcSigArbn.ImcSigArbnArbnFltTmr.Val /end REF_CHARACTERISTIC /begin REF_MEASUREMENT /end REF_MEASUREMENT /end GROUP
/begin GROUP ImcSigArbn.ImcSigArbnHwAgArbnEna.Logl "MICROSAR RTE" /begin SUB_GROUP /end SUB_GROUP /begin FUNCTION_LIST /end FUNCTION_LIST /begin REF_CHARACTERISTIC ImcSigArbn.ImcSigArbnHwAgArbnEna.Logl /end REF_CHARACTERISTIC /begin REF_MEASUREMENT /end REF_MEASUREMENT /end GROUP
/begin GROUP ImcSigArbn.ImcSigArbnHwAgArbnLpFil.Val "MICROSAR RTE" /begin SUB_GROUP /end SUB_GROUP /begin FUNCTION_LIST /end FUNCTION_LIST /begin REF_CHARACTERISTIC ImcSigArbn.ImcSigArbnHwAgArbnLpFil.Val /end REF_CHARACTERISTIC /begin REF_MEASUREMENT /end REF_MEASUREMENT /end GROUP
/begin GROUP ImcSigArbn.ImcSigArbnHwAgArbnOffsLim.Val "MICROSAR RTE" /begin SUB_GROUP /end SUB_GROUP /begin FUNCTION_LIST /end FUNCTION_LIST /begin REF_CHARACTERISTIC ImcSigArbn.ImcSigArbnHwAgArbnOffsLim.Val /end REF_CHARACTERISTIC /begin REF_MEASUREMENT /end REF_MEASUREMENT /end GROUP
/begin GROUP ImcSigArbn.ImcSigArbnHwAgTarArbnEna.Logl "MICROSAR RTE" /begin SUB_GROUP /end SUB_GROUP /begin FUNCTION_LIST /end FUNCTION_LIST /begin REF_CHARACTERISTIC ImcSigArbn.ImcSigArbnHwAgTarArbnEna.Logl /end REF_CHARACTERISTIC /begin REF_MEASUREMENT /end REF_MEASUREMENT /end GROUP
/begin GROUP ImcSigArbn.ImcSigArbnHwAgTarArbnLpFil.Val "MICROSAR RTE" /begin SUB_GROUP /end SUB_GROUP /begin FUNCTION_LIST /end FUNCTION_LIST /begin REF_CHARACTERISTIC ImcSigArbn.ImcSigArbnHwAgTarArbnLpFil.Val /end REF_CHARACTERISTIC /begin REF_MEASUREMENT /end REF_MEASUREMENT /end GROUP
/begin GROUP ImcSigArbn.ImcSigArbnHwAgTarArbnOffsLim.Val "MICROSAR RTE" /begin SUB_GROUP /end SUB_GROUP /begin FUNCTION_LIST /end FUNCTION_LIST /begin REF_CHARACTERISTIC ImcSigArbn.ImcSigArbnHwAgTarArbnOffsLim.Val /end REF_CHARACTERISTIC /begin REF_MEASUREMENT /end REF_MEASUREMENT /end GROUP
/begin GROUP ImcSigArbn.ImcSigArbnHwTqArbnEna.Logl "MICROSAR RTE" /begin SUB_GROUP /end SUB_GROUP /begin FUNCTION_LIST /end FUNCTION_LIST /begin REF_CHARACTERISTIC ImcSigArbn.ImcSigArbnHwTqArbnEna.Logl /end REF_CHARACTERISTIC /begin REF_MEASUREMENT /end REF_MEASUREMENT /end GROUP
/begin GROUP ImcSigArbn.ImcSigArbnHwTqArbnLpFil.Val "MICROSAR RTE" /begin SUB_GROUP /end SUB_GROUP /begin FUNCTION_LIST /end FUNCTION_LIST /begin REF_CHARACTERISTIC ImcSigArbn.ImcSigArbnHwTqArbnLpFil.Val /end REF_CHARACTERISTIC /begin REF_MEASUREMENT /end REF_MEASUREMENT /end GROUP
/begin GROUP ImcSigArbn.ImcSigArbnHwTqArbnOffsLim.Val "MICROSAR RTE" /begin SUB_GROUP /end SUB_GROUP /begin FUNCTION_LIST /end FUNCTION_LIST /begin REF_CHARACTERISTIC ImcSigArbn.ImcSigArbnHwTqArbnOffsLim.Val /end REF_CHARACTERISTIC /begin REF_MEASUREMENT /end REF_MEASUREMENT /end GROUP
/begin GROUP ImcSigArbn.ImcSigArbnMotVelArbnEna.Logl "MICROSAR RTE" /begin SUB_GROUP /end SUB_GROUP /begin FUNCTION_LIST /end FUNCTION_LIST /begin REF_CHARACTERISTIC ImcSigArbn.ImcSigArbnMotVelArbnEna.Logl /end REF_CHARACTERISTIC /begin REF_MEASUREMENT /end REF_MEASUREMENT /end GROUP
/begin GROUP ImcSigArbn.ImcSigArbnMotVelArbnLpFil.Val "MICROSAR RTE" /begin SUB_GROUP /end SUB_GROUP /begin FUNCTION_LIST /end FUNCTION_LIST /begin REF_CHARACTERISTIC ImcSigArbn.ImcSigArbnMotVelArbnLpFil.Val /end REF_CHARACTERISTIC /begin REF_MEASUREMENT /end REF_MEASUREMENT /end GROUP
/begin GROUP ImcSigArbn.ImcSigArbnMotVelArbnOffsLim.Val "MICROSAR RTE" /begin SUB_GROUP /end SUB_GROUP /begin FUNCTION_LIST /end FUNCTION_LIST /begin REF_CHARACTERISTIC ImcSigArbn.ImcSigArbnMotVelArbnOffsLim.Val /end REF_CHARACTERISTIC /begin REF_MEASUREMENT /end REF_MEASUREMENT /end GROUP
/begin GROUP ImcSigArbn.ImcSigArbnPosnServoArbnOffsLim.Val "MICROSAR RTE" /begin SUB_GROUP /end SUB_GROUP /begin FUNCTION_LIST /end FUNCTION_LIST /begin REF_CHARACTERISTIC ImcSigArbn.ImcSigArbnPosnServoArbnOffsLim.Val /end REF_CHARACTERISTIC /begin REF_MEASUREMENT /end REF_MEASUREMENT /end GROUP
/begin GROUP ImcSigArbn.ImcSigArbnPosnServoIntgtrStArbnEna.Logl "MICROSAR RTE" /begin SUB_GROUP /end SUB_GROUP /begin FUNCTION_LIST /end FUNCTION_LIST /begin REF_CHARACTERISTIC ImcSigArbn.ImcSigArbnPosnServoIntgtrStArbnEna.Logl /end REF_CHARACTERISTIC /begin REF_MEASUREMENT /end REF_MEASUREMENT /end GROUP
/begin GROUP ImcSigArbn.ImcSigArbnPosnServoIntgtrStArbnLpFil.Val "MICROSAR RTE" /begin SUB_GROUP /end SUB_GROUP /begin FUNCTION_LIST /end FUNCTION_LIST /begin REF_CHARACTERISTIC ImcSigArbn.ImcSigArbnPosnServoIntgtrStArbnLpFil.Val /end REF_CHARACTERISTIC /begin REF_MEASUREMENT /end REF_MEASUREMENT /end GROUP
/begin GROUP ImcSigArbn.ImcSigArbnPosnTrakg1ArbnOffsLim.Val "MICROSAR RTE" /begin SUB_GROUP /end SUB_GROUP /begin FUNCTION_LIST /end FUNCTION_LIST /begin REF_CHARACTERISTIC ImcSigArbn.ImcSigArbnPosnTrakg1ArbnOffsLim.Val /end REF_CHARACTERISTIC /begin REF_MEASUREMENT /end REF_MEASUREMENT /end GROUP
/begin GROUP ImcSigArbn.ImcSigArbnPosnTrakg2ArbnOffsLim.Val "MICROSAR RTE" /begin SUB_GROUP /end SUB_GROUP /begin FUNCTION_LIST /end FUNCTION_LIST /begin REF_CHARACTERISTIC ImcSigArbn.ImcSigArbnPosnTrakg2ArbnOffsLim.Val /end REF_CHARACTERISTIC /begin REF_MEASUREMENT /end REF_MEASUREMENT /end GROUP
/begin GROUP ImcSigArbn.ImcSigArbnPullCmpLongTermArbnOffsLim.Val "MICROSAR RTE" /begin SUB_GROUP /end SUB_GROUP /begin FUNCTION_LIST /end FUNCTION_LIST /begin REF_CHARACTERISTIC ImcSigArbn.ImcSigArbnPullCmpLongTermArbnOffsLim.Val /end REF_CHARACTERISTIC /begin REF_MEASUREMENT /end REF_MEASUREMENT /end GROUP
/begin GROUP ImcSigArbn.ImcSigArbnPullCmpLongTermIntgtrStArbnEna.Logl "MICROSAR RTE" /begin SUB_GROUP /end SUB_GROUP /begin FUNCTION_LIST /end FUNCTION_LIST /begin REF_CHARACTERISTIC ImcSigArbn.ImcSigArbnPullCmpLongTermIntgtrStArbnEna.Logl /end REF_CHARACTERISTIC /begin REF_MEASUREMENT /end REF_MEASUREMENT /end GROUP
/begin GROUP ImcSigArbn.ImcSigArbnPullCmpLongTermIntgtrStArbnLpFil.Val "MICROSAR RTE" /begin SUB_GROUP /end SUB_GROUP /begin FUNCTION_LIST /end FUNCTION_LIST /begin REF_CHARACTERISTIC ImcSigArbn.ImcSigArbnPullCmpLongTermIntgtrStArbnLpFil.Val /end REF_CHARACTERISTIC /begin REF_MEASUREMENT /end REF_MEASUREMENT /end GROUP
/begin GROUP ImcSigArbn.ImcSigArbnPullCmpShoTermArbnOffsLim.Val "MICROSAR RTE" /begin SUB_GROUP /end SUB_GROUP /begin FUNCTION_LIST /end FUNCTION_LIST /begin REF_CHARACTERISTIC ImcSigArbn.ImcSigArbnPullCmpShoTermArbnOffsLim.Val /end REF_CHARACTERISTIC /begin REF_MEASUREMENT /end REF_MEASUREMENT /end GROUP
/begin GROUP ImcSigArbn.ImcSigArbnPullCmpShoTermIntgtrStArbnEna.Logl "MICROSAR RTE" /begin SUB_GROUP /end SUB_GROUP /begin FUNCTION_LIST /end FUNCTION_LIST /begin REF_CHARACTERISTIC ImcSigArbn.ImcSigArbnPullCmpShoTermIntgtrStArbnEna.Logl /end REF_CHARACTERISTIC /begin REF_MEASUREMENT /end REF_MEASUREMENT /end GROUP
/begin GROUP ImcSigArbn.ImcSigArbnPullCmpShoTermIntgtrStArbnLpFil.Val "MICROSAR RTE" /begin SUB_GROUP /end SUB_GROUP /begin FUNCTION_LIST /end FUNCTION_LIST /begin REF_CHARACTERISTIC ImcSigArbn.ImcSigArbnPullCmpShoTermIntgtrStArbnLpFil.Val /end REF_CHARACTERISTIC /begin REF_MEASUREMENT /end REF_MEASUREMENT /end GROUP
/begin GROUP ImcSigArbn.ImcSigArbnSysStTmr.Val "MICROSAR RTE" /begin SUB_GROUP /end SUB_GROUP /begin FUNCTION_LIST /end FUNCTION_LIST /begin REF_CHARACTERISTIC ImcSigArbn.ImcSigArbnSysStTmr.Val /end REF_CHARACTERISTIC /begin REF_MEASUREMENT /end REF_MEASUREMENT /end GROUP
/begin GROUP ImcSigArbn.ImcSigArbnTrakgIntgtrSt1ArbnEna.Logl "MICROSAR RTE" /begin SUB_GROUP /end SUB_GROUP /begin FUNCTION_LIST /end FUNCTION_LIST /begin REF_CHARACTERISTIC ImcSigArbn.ImcSigArbnTrakgIntgtrSt1ArbnEna.Logl /end REF_CHARACTERISTIC /begin REF_MEASUREMENT /end REF_MEASUREMENT /end GROUP
/begin GROUP ImcSigArbn.ImcSigArbnTrakgIntgtrSt1ArbnLpFil.Val "MICROSAR RTE" /begin SUB_GROUP /end SUB_GROUP /begin FUNCTION_LIST /end FUNCTION_LIST /begin REF_CHARACTERISTIC ImcSigArbn.ImcSigArbnTrakgIntgtrSt1ArbnLpFil.Val /end REF_CHARACTERISTIC /begin REF_MEASUREMENT /end REF_MEASUREMENT /end GROUP
/begin GROUP ImcSigArbn.ImcSigArbnTrakgIntgtrSt2ArbnEna.Logl "MICROSAR RTE" /begin SUB_GROUP /end SUB_GROUP /begin FUNCTION_LIST /end FUNCTION_LIST /begin REF_CHARACTERISTIC ImcSigArbn.ImcSigArbnTrakgIntgtrSt2ArbnEna.Logl /end REF_CHARACTERISTIC /begin REF_MEASUREMENT /end REF_MEASUREMENT /end GROUP
/begin GROUP ImcSigArbn.ImcSigArbnTrakgIntgtrSt2ArbnLpFil.Val "MICROSAR RTE" /begin SUB_GROUP /end SUB_GROUP /begin FUNCTION_LIST /end FUNCTION_LIST /begin REF_CHARACTERISTIC ImcSigArbn.ImcSigArbnTrakgIntgtrSt2ArbnLpFil.Val /end REF_CHARACTERISTIC /begin REF_MEASUREMENT /end REF_MEASUREMENT /end GROUP
/begin GROUP ImcSigArbn.ImcSigArbnVehSpdArbnEna.Logl "MICROSAR RTE" /begin SUB_GROUP /end SUB_GROUP /begin FUNCTION_LIST /end FUNCTION_LIST /begin REF_CHARACTERISTIC ImcSigArbn.ImcSigArbnVehSpdArbnEna.Logl /end REF_CHARACTERISTIC /begin REF_MEASUREMENT /end REF_MEASUREMENT /end GROUP
/begin GROUP ImcSigArbn.ImcSigArbnVehSpdArbnLpFil.Val "MICROSAR RTE" /begin SUB_GROUP /end SUB_GROUP /begin FUNCTION_LIST /end FUNCTION_LIST /begin REF_CHARACTERISTIC ImcSigArbn.ImcSigArbnVehSpdArbnLpFil.Val /end REF_CHARACTERISTIC /begin REF_MEASUREMENT /end REF_MEASUREMENT /end GROUP
/begin GROUP ImcSigArbn.ImcSigArbnVehSpdArbnOffsLim.Val "MICROSAR RTE" /begin SUB_GROUP /end SUB_GROUP /begin FUNCTION_LIST /end FUNCTION_LIST /begin REF_CHARACTERISTIC ImcSigArbn.ImcSigArbnVehSpdArbnOffsLim.Val /end REF_CHARACTERISTIC /begin REF_MEASUREMENT /end REF_MEASUREMENT /end GROUP
/begin GROUP ImcSigArbn.ImcSysSt.Val "MICROSAR RTE" /begin SUB_GROUP /end SUB_GROUP /begin FUNCTION_LIST /end FUNCTION_LIST /begin REF_CHARACTERISTIC /end REF_CHARACTERISTIC /begin REF_MEASUREMENT ImcSigArbn.ImcSysSt.Val /end REF_MEASUREMENT /end GROUP
/begin GROUP ImcSigArbn.ImcSysStVld.Logl "MICROSAR RTE" /begin SUB_GROUP /end SUB_GROUP /begin FUNCTION_LIST /end FUNCTION_LIST /begin REF_CHARACTERISTIC /end REF_CHARACTERISTIC /begin REF_MEASUREMENT ImcSigArbn.ImcSysStVld.Logl /end REF_MEASUREMENT /end GROUP
/begin GROUP ImcSigArbn.MotVelCrf.Val "MICROSAR RTE" /begin SUB_GROUP /end SUB_GROUP /begin FUNCTION_LIST /end FUNCTION_LIST /begin REF_CHARACTERISTIC /end REF_CHARACTERISTIC /begin REF_MEASUREMENT ImcSigArbn.MotVelCrf.Val /end REF_MEASUREMENT /end GROUP
/begin GROUP ImcSigArbn.MotVelCrfImcCorrd.Val "MICROSAR RTE" /begin SUB_GROUP /end SUB_GROUP /begin FUNCTION_LIST /end FUNCTION_LIST /begin REF_CHARACTERISTIC /end REF_CHARACTERISTIC /begin REF_MEASUREMENT ImcSigArbn.MotVelCrfImcCorrd.Val /end REF_MEASUREMENT /end GROUP
/begin GROUP ImcSigArbn.MotVelCrfOffsPrev "MICROSAR RTE" /begin SUB_GROUP /end SUB_GROUP /begin FUNCTION_LIST /end FUNCTION_LIST /begin REF_CHARACTERISTIC /end REF_CHARACTERISTIC /begin REF_MEASUREMENT ImcSigArbn.MotVelCrfOffsPrev /end REF_MEASUREMENT /end GROUP
/begin GROUP ImcSigArbn.MotVelLpFil "MICROSAR RTE" /begin SUB_GROUP /end SUB_GROUP /begin FUNCTION_LIST /end FUNCTION_LIST /begin REF_CHARACTERISTIC /end REF_CHARACTERISTIC
 /begin REF_MEASUREMENT ImcSigArbn.MotVelLpFil.FilGain ImcSigArbn.MotVelLpFil.FilSt /end REF_MEASUREMENT
/end GROUP
/begin GROUP ImcSigArbn.PerInstanceMemories "MICROSAR RTE"
 /begin SUB_GROUP ImcSigArbn.ArbnErrPrev ImcSigArbn.ArbnFltPrev ImcSigArbn.ArbnFltRefTiEnaLrng ImcSigArbn.HwAgLpFil ImcSigArbn.HwAgOffsPrev ImcSigArbn.HwAgTarLpFil ImcSigArbn.HwAgTarOffsPrev ImcSigArbn.HwTqLpFil ImcSigArbn.HwTqOffsPrev ImcSigArbn.MotVelCrfOffsPrev ImcSigArbn.MotVelLpFil ImcSigArbn.PosnServoIntgtrLpFil ImcSigArbn.PosnServoIntgtrOffsPrev ImcSigArbn.PullCmpLongTermCmpLpFil ImcSigArbn.PullCmpLongTermIntgtrStOffsPrev ImcSigArbn.PullCmpShoTermCmpLpFil ImcSigArbn.PullCmpShoTermIntgtrStOffsPrev ImcSigArbn.SysStLrngEnaPrev ImcSigArbn.SysStRefTiEnaLrng ImcSigArbn.TrakgIntgtrSt1LpFil ImcSigArbn.TrakgIntgtrSt1Offs ImcSigArbn.TrakgIntgtrSt2LpFil ImcSigArbn.TrakgIntgtrSt2Offs ImcSigArbn.VehSpdLpFil ImcSigArbn.VehSpdOffsPrev /end SUB_GROUP
 /begin FUNCTION_LIST /end FUNCTION_LIST
 /begin REF_CHARACTERISTIC /end REF_CHARACTERISTIC
 /begin REF_MEASUREMENT /end REF_MEASUREMENT
/end GROUP
/begin GROUP ImcSigArbn.PosnServoHwAg.Val "MICROSAR RTE" /begin SUB_GROUP /end SUB_GROUP /begin FUNCTION_LIST /end FUNCTION_LIST /begin REF_CHARACTERISTIC /end REF_CHARACTERISTIC /begin REF_MEASUREMENT ImcSigArbn.PosnServoHwAg.Val /end REF_MEASUREMENT /end GROUP
/begin GROUP ImcSigArbn.PosnServoHwAgImcCorrd.Val "MICROSAR RTE" /begin SUB_GROUP /end SUB_GROUP /begin FUNCTION_LIST /end FUNCTION_LIST /begin REF_CHARACTERISTIC /end REF_CHARACTERISTIC /begin REF_MEASUREMENT ImcSigArbn.PosnServoHwAgImcCorrd.Val /end REF_MEASUREMENT /end GROUP
/begin GROUP ImcSigArbn.PosnServoIntgtrLpFil "MICROSAR RTE" /begin SUB_GROUP /end SUB_GROUP /begin FUNCTION_LIST /end FUNCTION_LIST /begin REF_CHARACTERISTIC /end REF_CHARACTERISTIC
 /begin REF_MEASUREMENT ImcSigArbn.PosnServoIntgtrLpFil.FilGain ImcSigArbn.PosnServoIntgtrLpFil.FilSt /end REF_MEASUREMENT
/end GROUP
/begin GROUP ImcSigArbn.PosnServoIntgtrOffs.Val "MICROSAR RTE" /begin SUB_GROUP /end SUB_GROUP /begin FUNCTION_LIST /end FUNCTION_LIST /begin REF_CHARACTERISTIC /end REF_CHARACTERISTIC /begin REF_MEASUREMENT ImcSigArbn.PosnServoIntgtrOffs.Val /end REF_MEASUREMENT /end GROUP
/begin GROUP ImcSigArbn.PosnServoIntgtrOffsPrev "MICROSAR RTE" /begin SUB_GROUP /end SUB_GROUP /begin FUNCTION_LIST /end FUNCTION_LIST /begin REF_CHARACTERISTIC /end REF_CHARACTERISTIC /begin REF_MEASUREMENT ImcSigArbn.PosnServoIntgtrOffsPrev /end REF_MEASUREMENT /end GROUP
/begin GROUP ImcSigArbn.PosnServoIntgtrSt.Val "MICROSAR RTE" /begin SUB_GROUP /end SUB_GROUP /begin FUNCTION_LIST /end FUNCTION_LIST /begin REF_CHARACTERISTIC /end REF_CHARACTERISTIC /begin REF_MEASUREMENT ImcSigArbn.PosnServoIntgtrSt.Val /end REF_MEASUREMENT /end GROUP
/begin GROUP ImcSigArbn.PosnTrakgArbnFltMtgtnEna.Logl "MICROSAR RTE" /begin SUB_GROUP /end SUB_GROUP /begin FUNCTION_LIST /end FUNCTION_LIST /begin REF_CHARACTERISTIC /end REF_CHARACTERISTIC /begin REF_MEASUREMENT ImcSigArbn.PosnTrakgArbnFltMtgtnEna.Logl /end REF_MEASUREMENT /end GROUP
/begin GROUP ImcSigArbn.PosnTrakgIntgtrSt1.Val "MICROSAR RTE" /begin SUB_GROUP /end SUB_GROUP /begin FUNCTION_LIST /end FUNCTION_LIST /begin REF_CHARACTERISTIC /end REF_CHARACTERISTIC /begin REF_MEASUREMENT ImcSigArbn.PosnTrakgIntgtrSt1.Val /end REF_MEASUREMENT /end GROUP
/begin GROUP ImcSigArbn.PosnTrakgIntgtrSt1Offs.Val "MICROSAR RTE" /begin SUB_GROUP /end SUB_GROUP /begin FUNCTION_LIST /end FUNCTION_LIST /begin REF_CHARACTERISTIC /end REF_CHARACTERISTIC /begin REF_MEASUREMENT ImcSigArbn.PosnTrakgIntgtrSt1Offs.Val /end REF_MEASUREMENT /end GROUP
/begin GROUP ImcSigArbn.PosnTrakgIntgtrSt2.Val "MICROSAR RTE" /begin SUB_GROUP /end SUB_GROUP /begin FUNCTION_LIST /end FUNCTION_LIST /begin REF_CHARACTERISTIC /end REF_CHARACTERISTIC /begin REF_MEASUREMENT ImcSigArbn.PosnTrakgIntgtrSt2.Val /end REF_MEASUREMENT /end GROUP
/begin GROUP ImcSigArbn.PosnTrakgIntgtrSt2Offs.Val "MICROSAR RTE" /begin SUB_GROUP /end SUB_GROUP /begin FUNCTION_LIST /end FUNCTION_LIST /begin REF_CHARACTERISTIC /end REF_CHARACTERISTIC /begin REF_MEASUREMENT ImcSigArbn.PosnTrakgIntgtrSt2Offs.Val /end REF_MEASUREMENT /end GROUP
/begin GROUP ImcSigArbn.PullCmpLongTermCmpLpFil "MICROSAR RTE" /begin SUB_GROUP /end SUB_GROUP /begin FUNCTION_LIST /end FUNCTION_LIST /begin REF_CHARACTERISTIC /end REF_CHARACTERISTIC
 /begin REF_MEASUREMENT ImcSigArbn.PullCmpLongTermCmpLpFil.FilGain ImcSigArbn.PullCmpLongTermCmpLpFil.FilSt /end REF_MEASUREMENT
/end GROUP
/begin GROUP ImcSigArbn.PullCmpLongTermIntgtrSt.Val "MICROSAR RTE" /begin SUB_GROUP /end SUB_GROUP /begin FUNCTION_LIST /end FUNCTION_LIST /begin REF_CHARACTERISTIC /end REF_CHARACTERISTIC /begin REF_MEASUREMENT ImcSigArbn.PullCmpLongTermIntgtrSt.Val /end REF_MEASUREMENT /end GROUP
/begin GROUP ImcSigArbn.PullCmpLongTermIntgtrStOffs.Val "MICROSAR RTE" /begin SUB_GROUP /end SUB_GROUP /begin FUNCTION_LIST /end FUNCTION_LIST /begin REF_CHARACTERISTIC /end REF_CHARACTERISTIC /begin REF_MEASUREMENT ImcSigArbn.PullCmpLongTermIntgtrStOffs.Val /end REF_MEASUREMENT /end GROUP
/begin GROUP ImcSigArbn.PullCmpLongTermIntgtrStOffsPrev "MICROSAR RTE" /begin SUB_GROUP /end SUB_GROUP /begin FUNCTION_LIST /end FUNCTION_LIST /begin REF_CHARACTERISTIC /end REF_CHARACTERISTIC /begin REF_MEASUREMENT ImcSigArbn.PullCmpLongTermIntgtrStOffsPrev /end REF_MEASUREMENT /end GROUP
/begin GROUP ImcSigArbn.PullCmpShoTermCmpLpFil "MICROSAR RTE" /begin SUB_GROUP /end SUB_GROUP /begin FUNCTION_LIST /end FUNCTION_LIST /begin REF_CHARACTERISTIC /end REF_CHARACTERISTIC
 /begin REF_MEASUREMENT ImcSigArbn.PullCmpShoTermCmpLpFil.FilGain ImcSigArbn.PullCmpShoTermCmpLpFil.FilSt /end REF_MEASUREMENT
/end GROUP
/begin GROUP ImcSigArbn.PullCmpShoTermIntgtrSt.Val "MICROSAR RTE" /begin SUB_GROUP /end SUB_GROUP /begin FUNCTION_LIST /end FUNCTION_LIST /begin REF_CHARACTERISTIC /end REF_CHARACTERISTIC /begin REF_MEASUREMENT ImcSigArbn.PullCmpShoTermIntgtrSt.Val /end REF_MEASUREMENT /end GROUP
/begin GROUP ImcSigArbn.PullCmpShoTermIntgtrStOffs.Val "MICROSAR RTE" /begin SUB_GROUP /end SUB_GROUP /begin FUNCTION_LIST /end FUNCTION_LIST /begin REF_CHARACTERISTIC /end REF_CHARACTERISTIC /begin REF_MEASUREMENT ImcSigArbn.PullCmpShoTermIntgtrStOffs.Val /end REF_MEASUREMENT /end GROUP
/begin GROUP ImcSigArbn.PullCmpShoTermIntgtrStOffsPrev "MICROSAR RTE" /begin SUB_GROUP /end SUB_GROUP /begin FUNCTION_LIST /end FUNCTION_LIST /begin REF_CHARACTERISTIC /end REF_CHARACTERISTIC /begin REF_MEASUREMENT ImcSigArbn.PullCmpShoTermIntgtrStOffsPrev /end REF_MEASUREMENT /end GROUP
/begin GROUP ImcSigArbn.ReceiverPorts "MICROSAR RTE"
 /begin SUB_GROUP ImcSigArbn.EcuIdn.Val ImcSigArbn.HwAg.Val ImcSigArbn.HwTq.Val ImcSigArbn.MotVelCrf.Val ImcSigArbn.PosnServoHwAg.Val ImcSigArbn.PosnServoIntgtrSt.Val ImcSigArbn.PosnTrakgIntgtrSt1.Val ImcSigArbn.PosnTrakgIntgtrSt2.Val ImcSigArbn.PullCmpLongTermIntgtrSt.Val ImcSigArbn.PullCmpShoTermIntgtrSt.Val ImcSigArbn.VehSpd.Val /end SUB_GROUP
 /begin FUNCTION_LIST /end FUNCTION_LIST
 /begin REF_CHARACTERISTIC /end REF_CHARACTERISTIC
 /begin REF_MEASUREMENT /end REF_MEASUREMENT
/end GROUP
/begin GROUP ImcSigArbn.SenderPorts "MICROSAR RTE"
 /begin SUB_GROUP ImcSigArbn.HwAgImcCorrd.Val ImcSigArbn.HwTqImcCorrd.Val ImcSigArbn.ImcSysSt.Val ImcSigArbn.ImcSysStVld.Logl ImcSigArbn.MotVelCrfImcCorrd.Val ImcSigArbn.PosnServoHwAgImcCorrd.Val ImcSigArbn.PosnServoIntgtrOffs.Val ImcSigArbn.PosnTrakgArbnFltMtgtnEna.Logl ImcSigArbn.PosnTrakgIntgtrSt1Offs.Val ImcSigArbn.PosnTrakgIntgtrSt2Offs.Val ImcSigArbn.PullCmpLongTermIntgtrStOffs.Val ImcSigArbn.PullCmpShoTermIntgtrStOffs.Val ImcSigArbn.VehSpdImcCorrd.Val /end SUB_GROUP
 /begin FUNCTION_LIST /end FUNCTION_LIST
 /begin REF_CHARACTERISTIC /end REF_CHARACTERISTIC
 /begin REF_MEASUREMENT /end REF_MEASUREMENT
/end GROUP
/begin GROUP ImcSigArbn.SysStLrngEnaPrev "MICROSAR RTE" /begin SUB_GROUP /end SUB_GROUP /begin FUNCTION_LIST /end FUNCTION_LIST /begin REF_CHARACTERISTIC /end REF_CHARACTERISTIC /begin REF_MEASUREMENT ImcSigArbn.SysStLrngEnaPrev /end REF_MEASUREMENT /end GROUP
/begin GROUP ImcSigArbn.SysStRefTiEnaLrng "MICROSAR RTE" /begin SUB_GROUP /end SUB_GROUP /begin FUNCTION_LIST /end FUNCTION_LIST /begin REF_CHARACTERISTIC /end REF_CHARACTERISTIC /begin REF_MEASUREMENT ImcSigArbn.SysStRefTiEnaLrng /end REF_MEASUREMENT /end GROUP
/begin GROUP ImcSigArbn.TrakgIntgtrSt1LpFil "MICROSAR RTE" /begin SUB_GROUP /end SUB_GROUP /begin FUNCTION_LIST /end FUNCTION_LIST /begin REF_CHARACTERISTIC /end REF_CHARACTERISTIC
 /begin REF_MEASUREMENT ImcSigArbn.TrakgIntgtrSt1LpFil.FilGain ImcSigArbn.TrakgIntgtrSt1LpFil.FilSt /end REF_MEASUREMENT
/end GROUP
/begin GROUP ImcSigArbn.TrakgIntgtrSt1Offs "MICROSAR RTE" /begin SUB_GROUP /end SUB_GROUP /begin FUNCTION_LIST /end FUNCTION_LIST /begin REF_CHARACTERISTIC /end REF_CHARACTERISTIC /begin REF_MEASUREMENT ImcSigArbn.TrakgIntgtrSt1Offs /end REF_MEASUREMENT /end GROUP
/begin GROUP ImcSigArbn.TrakgIntgtrSt2LpFil "MICROSAR RTE" /begin SUB_GROUP /end SUB_GROUP /begin FUNCTION_LIST /end FUNCTION_LIST /begin REF_CHARACTERISTIC /end REF_CHARACTERISTIC
 /begin REF_MEASUREMENT ImcSigArbn.TrakgIntgtrSt2LpFil.FilGain ImcSigArbn.TrakgIntgtrSt2LpFil.FilSt /end REF_MEASUREMENT
/end GROUP
/begin GROUP ImcSigArbn.TrakgIntgtrSt2Offs "MICROSAR RTE" /begin SUB_GROUP /end SUB_GROUP /begin FUNCTION_LIST /end FUNCTION_LIST /begin REF_CHARACTERISTIC /end REF_CHARACTERISTIC /begin REF_MEASUREMENT ImcSigArbn.TrakgIntgtrSt2Offs /end REF_MEASUREMENT /end GROUP
/begin GROUP ImcSigArbn.VehSpd.Val "MICROSAR RTE" /begin SUB_GROUP /end SUB_GROUP /begin FUNCTION_LIST /end FUNCTION_LIST /begin REF_CHARACTERISTIC /end REF_CHARACTERISTIC /begin REF_MEASUREMENT ImcSigArbn.VehSpd.Val /end REF_MEASUREMENT /end GROUP
/begin GROUP ImcSigArbn.VehSpdImcCorrd.Val "MICROSAR RTE" /begin SUB_GROUP /end SUB_GROUP /begin FUNCTION_LIST /end FUNCTION_LIST /begin REF_CHARACTERISTIC /end REF_CHARACTERISTIC /begin REF_MEASUREMENT ImcSigArbn.VehSpdImcCorrd.Val /end REF_MEASUREMENT /end GROUP
/begin GROUP ImcSigArbn.VehSpdLpFil "MICROSAR RTE" /begin SUB_GROUP /end SUB_GROUP /begin FUNCTION_LIST /end FUNCTION_LIST /begin REF_CHARACTERISTIC /end REF_CHARACTERISTIC
 /begin REF_MEASUREMENT ImcSigArbn.VehSpdLpFil.FilGain ImcSigArbn.VehSpdLpFil.FilSt /end REF_MEASUREMENT
/end GROUP
/begin GROUP ImcSigArbn.VehSpdOffsPrev "MICROSAR RTE" /begin SUB_GROUP /end SUB_GROUP /begin FUNCTION_LIST /end FUNCTION_LIST /begin REF_CHARACTERISTIC /end REF_CHARACTERISTIC /begin REF_MEASUREMENT ImcSigArbn.VehSpdOffsPrev /end REF_MEASUREMENT /end GROUP
/begin GROUP InertiaCmpVel "MICROSAR RTE"
 /begin SUB_GROUP InertiaCmpVel.CalibrationPorts InertiaCmpVel.PerInstanceMemories InertiaCmpVel.ReceiverPorts InertiaCmpVel.SenderPorts /end SUB_GROUP
 /begin FUNCTION_LIST /end FUNCTION_LIST
 /begin REF_CHARACTERISTIC /end REF_CHARACTERISTIC
 /begin REF_MEASUREMENT /end REF_MEASUREMENT
/end GROUP
/begin GROUP InertiaCmpVel.AssiCmdBas.Val "MICROSAR RTE" /begin SUB_GROUP /end SUB_GROUP /begin FUNCTION_LIST /end FUNCTION_LIST /begin REF_CHARACTERISTIC /end REF_CHARACTERISTIC /begin REF_MEASUREMENT InertiaCmpVel.AssiCmdBas.Val /end REF_MEASUREMENT /end GROUP
/begin GROUP InertiaCmpVel.CalibrationPorts "MICROSAR RTE"
 /begin SUB_GROUP InertiaCmpVel.InertiaCmpVelAssiBasdDampgCoeffX.Ary1D InertiaCmpVel.InertiaCmpVelAssiBasdDampgRollgWhlImbRejctnOnY.Ary1D InertiaCmpVel.InertiaCmpVelAssiBasdDampgRollgY.Ary1D InertiaCmpVel.InertiaCmpVelAssiBasdDampgStatWhlImbRejctnOnY.Ary1D InertiaCmpVel.InertiaCmpVelAssiBasdDampgStatY.Ary1D InertiaCmpVel.InertiaCmpVelCmdScaY.Ary1D InertiaCmpVel.InertiaCmpVelDampgDecelGain.Val InertiaCmpVel.InertiaCmpVelDampgDecelGainFallSlew.Val InertiaCmpVel.InertiaCmpVelDampgDecelGainRisngSlewX.Ary1D InertiaCmpVel.InertiaCmpVelDampgDecelGainRisngSlewY.Ary1D InertiaCmpVel.InertiaCmpVelDampgFilFrq.Ary1D InertiaCmpVel.InertiaCmpVelDampgFilFrqWhlImbRejctnOn.Ary1D InertiaCmpVel.InertiaCmpVelDampgGainOffThd.Val InertiaCmpVel.InertiaCmpVelDampgGainOnThd.Val InertiaCmpVel.InertiaCmpVelDampgSpdBlndY.Ary1D InertiaCmpVel.InertiaCmpVelDampgWhlImbRejctnBlndX.Ary1D InertiaCmpVel.InertiaCmpVelDampgWhlImbRejctnBlndY.Ary1D InertiaCmpVel.InertiaCmpVelDecelGainEnaCal.Logl InertiaCmpVel.InertiaCmpVelModWhlImbRejctnBlndX.Ary1D InertiaCmpVel.InertiaCmpVelModWhlImbRejctnBlndY.Ary1D InertiaCmpVel.InertiaCmpVelMotInertia.Val InertiaCmpVel.InertiaCmpVelMotVelBasdOutpScagX.Ary1D InertiaCmpVel.InertiaCmpVelMotVelBasdOutpScagY.Ary1D InertiaCmpVel.InertiaCmpVelNotchBlndY.Ary1D InertiaCmpVel.InertiaCmpVelNotchFilStruct.Rec InertiaCmpVel.InertiaCmpVelTqSnsrVelFilFrq.Val InertiaCmpVel.InertiaCmpVelTqSnsrVelSca.Ary1D InertiaCmpVel.SysGlbPrmSysKineRat.Val InertiaCmpVel.SysGlbPrmTorsBarStfn.Val InertiaCmpVel.SysGlbPrmVehSpdBilnrSeln.Ary1D /end SUB_GROUP
 /begin FUNCTION_LIST /end FUNCTION_LIST
 /begin REF_CHARACTERISTIC /end REF_CHARACTERISTIC
 /begin REF_MEASUREMENT /end REF_MEASUREMENT
/end GROUP
/begin GROUP InertiaCmpVel.DecelGain "MICROSAR RTE" /begin SUB_GROUP /end SUB_GROUP /begin FUNCTION_LIST /end FUNCTION_LIST /begin REF_CHARACTERISTIC /end REF_CHARACTERISTIC /begin REF_MEASUREMENT InertiaCmpVel.DecelGain /end REF_MEASUREMENT /end GROUP
/begin GROUP InertiaCmpVel.HwTq.Val "MICROSAR RTE" /begin SUB_GROUP /end SUB_GROUP /begin FUNCTION_LIST /end FUNCTION_LIST /begin REF_CHARACTERISTIC /end REF_CHARACTERISTIC /begin REF_MEASUREMENT InertiaCmpVel.HwTq.Val /end REF_MEASUREMENT /end GROUP
/begin GROUP InertiaCmpVel.InertiaCmpDecelGainDi.Logl "MICROSAR RTE" /begin SUB_GROUP /end SUB_GROUP /begin FUNCTION_LIST /end FUNCTION_LIST /begin REF_CHARACTERISTIC /end REF_CHARACTERISTIC /begin REF_MEASUREMENT InertiaCmpVel.InertiaCmpDecelGainDi.Logl /end REF_MEASUREMENT /end GROUP
/begin GROUP InertiaCmpVel.InertiaCmpVelAssiBasdDampgCoeffX.Ary1D "MICROSAR RTE" /begin SUB_GROUP /end SUB_GROUP /begin FUNCTION_LIST /end FUNCTION_LIST /begin REF_CHARACTERISTIC InertiaCmpVel.InertiaCmpVelAssiBasdDampgCoeffX.Ary1D /end REF_CHARACTERISTIC /begin REF_MEASUREMENT /end REF_MEASUREMENT /end GROUP
/begin GROUP InertiaCmpVel.InertiaCmpVelAssiBasdDampgRollgWhlImbRejctnOnY.Ary1D "MICROSAR RTE" /begin SUB_GROUP /end SUB_GROUP /begin FUNCTION_LIST /end FUNCTION_LIST
 /begin REF_CHARACTERISTIC InertiaCmpVel.InertiaCmpVelAssiBasdDampgRollgWhlImbRejctnOnY.Ary1D /end REF_CHARACTERISTIC
 /begin REF_MEASUREMENT /end REF_MEASUREMENT
/end GROUP
/begin GROUP InertiaCmpVel.InertiaCmpVelAssiBasdDampgRollgY.Ary1D "MICROSAR RTE" /begin SUB_GROUP /end SUB_GROUP /begin FUNCTION_LIST /end FUNCTION_LIST /begin REF_CHARACTERISTIC InertiaCmpVel.InertiaCmpVelAssiBasdDampgRollgY.Ary1D /end REF_CHARACTERISTIC /begin REF_MEASUREMENT /end REF_MEASUREMENT /end GROUP
/begin GROUP InertiaCmpVel.InertiaCmpVelAssiBasdDampgStatWhlImbRejctnOnY.Ary1D "MICROSAR RTE" /begin SUB_GROUP /end SUB_GROUP /begin FUNCTION_LIST /end FUNCTION_LIST
 /begin REF_CHARACTERISTIC InertiaCmpVel.InertiaCmpVelAssiBasdDampgStatWhlImbRejctnOnY.Ary1D /end REF_CHARACTERISTIC
 /begin REF_MEASUREMENT /end REF_MEASUREMENT
/end GROUP
/begin GROUP InertiaCmpVel.InertiaCmpVelAssiBasdDampgStatY.Ary1D "MICROSAR RTE" /begin SUB_GROUP /end SUB_GROUP /begin FUNCTION_LIST /end FUNCTION_LIST /begin REF_CHARACTERISTIC InertiaCmpVel.InertiaCmpVelAssiBasdDampgStatY.Ary1D /end REF_CHARACTERISTIC /begin REF_MEASUREMENT /end REF_MEASUREMENT /end GROUP
/begin GROUP InertiaCmpVel.InertiaCmpVelCmd.Val "MICROSAR RTE" /begin SUB_GROUP /end SUB_GROUP /begin FUNCTION_LIST /end FUNCTION_LIST /begin REF_CHARACTERISTIC /end REF_CHARACTERISTIC /begin REF_MEASUREMENT InertiaCmpVel.InertiaCmpVelCmd.Val /end REF_MEASUREMENT /end GROUP
/begin GROUP InertiaCmpVel.InertiaCmpVelCmdDi.Logl "MICROSAR RTE" /begin SUB_GROUP /end SUB_GROUP /begin FUNCTION_LIST /end FUNCTION_LIST /begin REF_CHARACTERISTIC /end REF_CHARACTERISTIC /begin REF_MEASUREMENT InertiaCmpVel.InertiaCmpVelCmdDi.Logl /end REF_MEASUREMENT /end GROUP
/begin GROUP InertiaCmpVel.InertiaCmpVelCmdScaY.Ary1D "MICROSAR RTE" /begin SUB_GROUP /end SUB_GROUP /begin FUNCTION_LIST /end FUNCTION_LIST /begin REF_CHARACTERISTIC InertiaCmpVel.InertiaCmpVelCmdScaY.Ary1D /end REF_CHARACTERISTIC /begin REF_MEASUREMENT /end REF_MEASUREMENT /end GROUP
/begin GROUP InertiaCmpVel.InertiaCmpVelDampgDecelGain.Val "MICROSAR RTE" /begin SUB_GROUP /end SUB_GROUP /begin FUNCTION_LIST /end FUNCTION_LIST /begin REF_CHARACTERISTIC InertiaCmpVel.InertiaCmpVelDampgDecelGain.Val /end REF_CHARACTERISTIC /begin REF_MEASUREMENT /end REF_MEASUREMENT /end GROUP
/begin GROUP InertiaCmpVel.InertiaCmpVelDampgDecelGainFallSlew.Val "MICROSAR RTE" /begin SUB_GROUP /end SUB_GROUP /begin FUNCTION_LIST /end FUNCTION_LIST /begin REF_CHARACTERISTIC InertiaCmpVel.InertiaCmpVelDampgDecelGainFallSlew.Val /end REF_CHARACTERISTIC /begin REF_MEASUREMENT /end REF_MEASUREMENT /end GROUP
/begin GROUP InertiaCmpVel.InertiaCmpVelDampgDecelGainRisngSlewX.Ary1D "MICROSAR RTE" /begin SUB_GROUP /end SUB_GROUP /begin FUNCTION_LIST /end FUNCTION_LIST /begin REF_CHARACTERISTIC InertiaCmpVel.InertiaCmpVelDampgDecelGainRisngSlewX.Ary1D /end REF_CHARACTERISTIC /begin REF_MEASUREMENT /end REF_MEASUREMENT /end GROUP
/begin GROUP InertiaCmpVel.InertiaCmpVelDampgDecelGainRisngSlewY.Ary1D "MICROSAR RTE" /begin SUB_GROUP /end SUB_GROUP /begin FUNCTION_LIST /end FUNCTION_LIST /begin REF_CHARACTERISTIC InertiaCmpVel.InertiaCmpVelDampgDecelGainRisngSlewY.Ary1D /end REF_CHARACTERISTIC /begin REF_MEASUREMENT /end REF_MEASUREMENT /end GROUP
/begin GROUP InertiaCmpVel.InertiaCmpVelDampgFilFrq.Ary1D "MICROSAR RTE" /begin SUB_GROUP /end SUB_GROUP /begin FUNCTION_LIST /end FUNCTION_LIST /begin REF_CHARACTERISTIC InertiaCmpVel.InertiaCmpVelDampgFilFrq.Ary1D /end REF_CHARACTERISTIC /begin REF_MEASUREMENT /end REF_MEASUREMENT /end GROUP
/begin GROUP InertiaCmpVel.InertiaCmpVelDampgFilFrqWhlImbRejctnOn.Ary1D "MICROSAR RTE" /begin SUB_GROUP /end SUB_GROUP /begin FUNCTION_LIST /end FUNCTION_LIST /begin REF_CHARACTERISTIC InertiaCmpVel.InertiaCmpVelDampgFilFrqWhlImbRejctnOn.Ary1D /end REF_CHARACTERISTIC /begin REF_MEASUREMENT /end REF_MEASUREMENT /end GROUP
/begin GROUP InertiaCmpVel.InertiaCmpVelDampgGainOffThd.Val "MICROSAR RTE" /begin SUB_GROUP /end SUB_GROUP /begin FUNCTION_LIST /end FUNCTION_LIST /begin REF_CHARACTERISTIC InertiaCmpVel.InertiaCmpVelDampgGainOffThd.Val /end REF_CHARACTERISTIC /begin REF_MEASUREMENT /end REF_MEASUREMENT /end GROUP
/begin GROUP InertiaCmpVel.InertiaCmpVelDampgGainOnThd.Val "MICROSAR RTE" /begin SUB_GROUP /end SUB_GROUP /begin FUNCTION_LIST /end FUNCTION_LIST /begin REF_CHARACTERISTIC InertiaCmpVel.InertiaCmpVelDampgGainOnThd.Val /end REF_CHARACTERISTIC /begin REF_MEASUREMENT /end REF_MEASUREMENT /end GROUP
/begin GROUP InertiaCmpVel.InertiaCmpVelDampgSpdBlndY.Ary1D "MICROSAR RTE" /begin SUB_GROUP /end SUB_GROUP /begin FUNCTION_LIST /end FUNCTION_LIST /begin REF_CHARACTERISTIC InertiaCmpVel.InertiaCmpVelDampgSpdBlndY.Ary1D /end REF_CHARACTERISTIC /begin REF_MEASUREMENT /end REF_MEASUREMENT /end GROUP
/begin GROUP InertiaCmpVel.InertiaCmpVelDampgWhlImbRejctnBlndX.Ary1D "MICROSAR RTE" /begin SUB_GROUP /end SUB_GROUP /begin FUNCTION_LIST /end FUNCTION_LIST /begin REF_CHARACTERISTIC InertiaCmpVel.InertiaCmpVelDampgWhlImbRejctnBlndX.Ary1D /end REF_CHARACTERISTIC /begin REF_MEASUREMENT /end REF_MEASUREMENT /end GROUP
/begin GROUP InertiaCmpVel.InertiaCmpVelDampgWhlImbRejctnBlndY.Ary1D "MICROSAR RTE" /begin SUB_GROUP /end SUB_GROUP /begin FUNCTION_LIST /end FUNCTION_LIST /begin REF_CHARACTERISTIC InertiaCmpVel.InertiaCmpVelDampgWhlImbRejctnBlndY.Ary1D /end REF_CHARACTERISTIC /begin REF_MEASUREMENT /end REF_MEASUREMENT /end GROUP
/begin GROUP InertiaCmpVel.InertiaCmpVelDecelGainEnaCal.Logl "MICROSAR RTE" /begin SUB_GROUP /end SUB_GROUP /begin FUNCTION_LIST /end FUNCTION_LIST /begin REF_CHARACTERISTIC InertiaCmpVel.InertiaCmpVelDecelGainEnaCal.Logl /end REF_CHARACTERISTIC /begin REF_MEASUREMENT /end REF_MEASUREMENT /end GROUP
/begin GROUP InertiaCmpVel.InertiaCmpVelModWhlImbRejctnBlndX.Ary1D "MICROSAR RTE" /begin SUB_GROUP /end SUB_GROUP /begin FUNCTION_LIST /end FUNCTION_LIST /begin REF_CHARACTERISTIC InertiaCmpVel.InertiaCmpVelModWhlImbRejctnBlndX.Ary1D /end REF_CHARACTERISTIC /begin REF_MEASUREMENT /end REF_MEASUREMENT /end GROUP
/begin GROUP InertiaCmpVel.InertiaCmpVelModWhlImbRejctnBlndY.Ary1D "MICROSAR RTE" /begin SUB_GROUP /end SUB_GROUP /begin FUNCTION_LIST /end FUNCTION_LIST /begin REF_CHARACTERISTIC InertiaCmpVel.InertiaCmpVelModWhlImbRejctnBlndY.Ary1D /end REF_CHARACTERISTIC /begin REF_MEASUREMENT /end REF_MEASUREMENT /end GROUP
/begin GROUP InertiaCmpVel.InertiaCmpVelMotInertia.Val "MICROSAR RTE" /begin SUB_GROUP /end SUB_GROUP /begin FUNCTION_LIST /end FUNCTION_LIST /begin REF_CHARACTERISTIC InertiaCmpVel.InertiaCmpVelMotInertia.Val /end REF_CHARACTERISTIC /begin REF_MEASUREMENT /end REF_MEASUREMENT /end GROUP
/begin GROUP InertiaCmpVel.InertiaCmpVelMotVelBasdOutpScagX.Ary1D "MICROSAR RTE" /begin SUB_GROUP /end SUB_GROUP /begin FUNCTION_LIST /end FUNCTION_LIST /begin REF_CHARACTERISTIC InertiaCmpVel.InertiaCmpVelMotVelBasdOutpScagX.Ary1D /end REF_CHARACTERISTIC /begin REF_MEASUREMENT /end REF_MEASUREMENT /end GROUP
/begin GROUP InertiaCmpVel.InertiaCmpVelMotVelBasdOutpScagY.Ary1D "MICROSAR RTE" /begin SUB_GROUP /end SUB_GROUP /begin FUNCTION_LIST /end FUNCTION_LIST /begin REF_CHARACTERISTIC InertiaCmpVel.InertiaCmpVelMotVelBasdOutpScagY.Ary1D /end REF_CHARACTERISTIC /begin REF_MEASUREMENT /end REF_MEASUREMENT /end GROUP
/begin GROUP InertiaCmpVel.InertiaCmpVelNotchBlndY.Ary1D "MICROSAR RTE" /begin SUB_GROUP /end SUB_GROUP /begin FUNCTION_LIST /end FUNCTION_LIST /begin REF_CHARACTERISTIC InertiaCmpVel.InertiaCmpVelNotchBlndY.Ary1D /end REF_CHARACTERISTIC /begin REF_MEASUREMENT /end REF_MEASUREMENT /end GROUP
/begin GROUP InertiaCmpVel.InertiaCmpVelNotchFilStruct.Rec "MICROSAR RTE" /begin SUB_GROUP /end SUB_GROUP /begin FUNCTION_LIST /end FUNCTION_LIST
 /begin REF_CHARACTERISTIC InertiaCmpVel.InertiaCmpVelNotchFilStruct.Rec.FilGainA1 InertiaCmpVel.InertiaCmpVelNotchFilStruct.Rec.FilGainA2 InertiaCmpVel.InertiaCmpVelNotchFilStruct.Rec.FilGainB0 InertiaCmpVel.InertiaCmpVelNotchFilStruct.Rec.FilGainB1 InertiaCmpVel.InertiaCmpVelNotchFilStruct.Rec.FilGainB2 /end REF_CHARACTERISTIC
 /begin REF_MEASUREMENT /end REF_MEASUREMENT
/end GROUP
/begin GROUP InertiaCmpVel.InertiaCmpVelTqSnsrVelFilFrq.Val "MICROSAR RTE" /begin SUB_GROUP /end SUB_GROUP /begin FUNCTION_LIST /end FUNCTION_LIST /begin REF_CHARACTERISTIC InertiaCmpVel.InertiaCmpVelTqSnsrVelFilFrq.Val /end REF_CHARACTERISTIC /begin REF_MEASUREMENT /end REF_MEASUREMENT /end GROUP
/begin GROUP InertiaCmpVel.InertiaCmpVelTqSnsrVelSca.Ary1D "MICROSAR RTE" /begin SUB_GROUP /end SUB_GROUP /begin FUNCTION_LIST /end FUNCTION_LIST /begin REF_CHARACTERISTIC InertiaCmpVel.InertiaCmpVelTqSnsrVelSca.Ary1D /end REF_CHARACTERISTIC /begin REF_MEASUREMENT /end REF_MEASUREMENT /end GROUP
/begin GROUP InertiaCmpVel.MotVelCrf.Val "MICROSAR RTE" /begin SUB_GROUP /end SUB_GROUP /begin FUNCTION_LIST /end FUNCTION_LIST /begin REF_CHARACTERISTIC /end REF_CHARACTERISTIC /begin REF_MEASUREMENT InertiaCmpVel.MotVelCrf.Val /end REF_MEASUREMENT /end GROUP
/begin GROUP InertiaCmpVel.NotchFilChk "MICROSAR RTE" /begin SUB_GROUP /end SUB_GROUP /begin FUNCTION_LIST /end FUNCTION_LIST /begin REF_CHARACTERISTIC /end REF_CHARACTERISTIC /begin REF_MEASUREMENT InertiaCmpVel.NotchFilChk /end REF_MEASUREMENT /end GROUP
/begin GROUP InertiaCmpVel.PerInstanceMemories "MICROSAR RTE"
 /begin SUB_GROUP InertiaCmpVel.DecelGain InertiaCmpVel.NotchFilChk InertiaCmpVel.PreScagCmpCmdPrev1 InertiaCmpVel.PreScagCmpCmdPrev2 InertiaCmpVel.ScaDrvrVelPrev1 InertiaCmpVel.ScaDrvrVelPrev2 InertiaCmpVel.TqSnsrAgPrev InertiaCmpVel.TqSnsrVelFil InertiaCmpVel.TqSnsrVelFilNotchSt InertiaCmpVel.dInertiaCmpVelAssiBasdDampgCoeff InertiaCmpVel.dInertiaCmpVelCalcdInertiaCmp InertiaCmpVel.dInertiaCmpVelFilFrq InertiaCmpVel.dInertiaCmpVelMotVelBasdOutpScag InertiaCmpVel.dInertiaCmpVelNotScadDrvrVel InertiaCmpVel.dInertiaCmpVelNotchBlndVal InertiaCmpVel.dInertiaCmpVelNotchInpVal InertiaCmpVel.dInertiaCmpVelNotchOutpVal InertiaCmpVel.dInertiaCmpVelRawDecelGain InertiaCmpVel.dInertiaCmpVelScadDrvrVel InertiaCmpVel.dInertiaCmpVelTqSnsrVelFildVal /end SUB_GROUP
 /begin FUNCTION_LIST /end FUNCTION_LIST
 /begin REF_CHARACTERISTIC /end REF_CHARACTERISTIC
 /begin REF_MEASUREMENT /end REF_MEASUREMENT
/end GROUP
/begin GROUP InertiaCmpVel.PreScagCmpCmdPrev1 "MICROSAR RTE" /begin SUB_GROUP /end SUB_GROUP /begin FUNCTION_LIST /end FUNCTION_LIST /begin REF_CHARACTERISTIC /end REF_CHARACTERISTIC /begin REF_MEASUREMENT InertiaCmpVel.PreScagCmpCmdPrev1 /end REF_MEASUREMENT /end GROUP
/begin GROUP InertiaCmpVel.PreScagCmpCmdPrev2 "MICROSAR RTE" /begin SUB_GROUP /end SUB_GROUP /begin FUNCTION_LIST /end FUNCTION_LIST /begin REF_CHARACTERISTIC /end REF_CHARACTERISTIC /begin REF_MEASUREMENT InertiaCmpVel.PreScagCmpCmdPrev2 /end REF_MEASUREMENT /end GROUP
/begin GROUP InertiaCmpVel.ReceiverPorts "MICROSAR RTE"
 /begin SUB_GROUP InertiaCmpVel.AssiCmdBas.Val InertiaCmpVel.HwTq.Val InertiaCmpVel.InertiaCmpDecelGainDi.Logl InertiaCmpVel.InertiaCmpVelCmdDi.Logl InertiaCmpVel.MotVelCrf.Val InertiaCmpVel.VehLgtA.Val InertiaCmpVel.VehSpd.Val InertiaCmpVel.WhlImbRejctnAmp.Val /end SUB_GROUP
 /begin FUNCTION_LIST /end FUNCTION_LIST
 /begin REF_CHARACTERISTIC /end REF_CHARACTERISTIC
 /begin REF_MEASUREMENT /end REF_MEASUREMENT
/end GROUP
/begin GROUP InertiaCmpVel.ScaDrvrVelPrev1 "MICROSAR RTE" /begin SUB_GROUP /end SUB_GROUP /begin FUNCTION_LIST /end FUNCTION_LIST /begin REF_CHARACTERISTIC /end REF_CHARACTERISTIC /begin REF_MEASUREMENT InertiaCmpVel.ScaDrvrVelPrev1 /end REF_MEASUREMENT /end GROUP
/begin GROUP InertiaCmpVel.ScaDrvrVelPrev2 "MICROSAR RTE" /begin SUB_GROUP /end SUB_GROUP /begin FUNCTION_LIST /end FUNCTION_LIST /begin REF_CHARACTERISTIC /end REF_CHARACTERISTIC /begin REF_MEASUREMENT InertiaCmpVel.ScaDrvrVelPrev2 /end REF_MEASUREMENT /end GROUP
/begin GROUP InertiaCmpVel.SenderPorts "MICROSAR RTE" /begin SUB_GROUP InertiaCmpVel.InertiaCmpVelCmd.Val /end SUB_GROUP /begin FUNCTION_LIST /end FUNCTION_LIST /begin REF_CHARACTERISTIC /end REF_CHARACTERISTIC /begin REF_MEASUREMENT /end REF_MEASUREMENT /end GROUP
/begin GROUP InertiaCmpVel.SysGlbPrmSysKineRat.Val "MICROSAR RTE" /begin SUB_GROUP /end SUB_GROUP /begin FUNCTION_LIST /end FUNCTION_LIST /begin REF_CHARACTERISTIC InertiaCmpVel.SysGlbPrmSysKineRat.Val /end REF_CHARACTERISTIC /begin REF_MEASUREMENT /end REF_MEASUREMENT /end GROUP
/begin GROUP InertiaCmpVel.SysGlbPrmTorsBarStfn.Val "MICROSAR RTE" /begin SUB_GROUP /end SUB_GROUP /begin FUNCTION_LIST /end FUNCTION_LIST /begin REF_CHARACTERISTIC InertiaCmpVel.SysGlbPrmTorsBarStfn.Val /end REF_CHARACTERISTIC /begin REF_MEASUREMENT /end REF_MEASUREMENT /end GROUP
/begin GROUP InertiaCmpVel.SysGlbPrmVehSpdBilnrSeln.Ary1D "MICROSAR RTE" /begin SUB_GROUP /end SUB_GROUP /begin FUNCTION_LIST /end FUNCTION_LIST /begin REF_CHARACTERISTIC InertiaCmpVel.SysGlbPrmVehSpdBilnrSeln.Ary1D /end REF_CHARACTERISTIC /begin REF_MEASUREMENT /end REF_MEASUREMENT /end GROUP
/begin GROUP InertiaCmpVel.TqSnsrAgPrev "MICROSAR RTE" /begin SUB_GROUP /end SUB_GROUP /begin FUNCTION_LIST /end FUNCTION_LIST /begin REF_CHARACTERISTIC /end REF_CHARACTERISTIC /begin REF_MEASUREMENT InertiaCmpVel.TqSnsrAgPrev /end REF_MEASUREMENT /end GROUP
/begin GROUP InertiaCmpVel.TqSnsrVelFil "MICROSAR RTE" /begin SUB_GROUP /end SUB_GROUP /begin FUNCTION_LIST /end FUNCTION_LIST /begin REF_CHARACTERISTIC /end REF_CHARACTERISTIC
 /begin REF_MEASUREMENT InertiaCmpVel.TqSnsrVelFil.FilGain InertiaCmpVel.TqSnsrVelFil.FilSt /end REF_MEASUREMENT
/end GROUP
/begin GROUP InertiaCmpVel.TqSnsrVelFilNotchSt "MICROSAR RTE" /begin SUB_GROUP /end SUB_GROUP /begin FUNCTION_LIST /end FUNCTION_LIST /begin REF_CHARACTERISTIC /end REF_CHARACTERISTIC
 /begin REF_MEASUREMENT InertiaCmpVel.TqSnsrVelFilNotchSt.FilSt1 InertiaCmpVel.TqSnsrVelFilNotchSt.FilSt2 /end REF_MEASUREMENT
/end GROUP
/begin GROUP InertiaCmpVel.VehLgtA.Val "MICROSAR RTE" /begin SUB_GROUP /end SUB_GROUP /begin FUNCTION_LIST /end FUNCTION_LIST /begin REF_CHARACTERISTIC /end REF_CHARACTERISTIC /begin REF_MEASUREMENT InertiaCmpVel.VehLgtA.Val /end REF_MEASUREMENT /end GROUP
/begin GROUP InertiaCmpVel.VehSpd.Val "MICROSAR RTE" /begin SUB_GROUP /end SUB_GROUP /begin FUNCTION_LIST /end FUNCTION_LIST /begin REF_CHARACTERISTIC /end REF_CHARACTERISTIC /begin REF_MEASUREMENT InertiaCmpVel.VehSpd.Val /end REF_MEASUREMENT /end GROUP
/begin GROUP InertiaCmpVel.WhlImbRejctnAmp.Val "MICROSAR RTE" /begin SUB_GROUP /end SUB_GROUP /begin FUNCTION_LIST /end FUNCTION_LIST /begin REF_CHARACTERISTIC /end REF_CHARACTERISTIC /begin REF_MEASUREMENT InertiaCmpVel.WhlImbRejctnAmp.Val /end REF_MEASUREMENT /end GROUP
/begin GROUP InertiaCmpVel.dInertiaCmpVelAssiBasdDampgCoeff "MICROSAR RTE" /begin SUB_GROUP /end SUB_GROUP /begin FUNCTION_LIST /end FUNCTION_LIST /begin REF_CHARACTERISTIC /end REF_CHARACTERISTIC /begin REF_MEASUREMENT InertiaCmpVel.dInertiaCmpVelAssiBasdDampgCoeff /end REF_MEASUREMENT /end GROUP
/begin GROUP InertiaCmpVel.dInertiaCmpVelCalcdInertiaCmp "MICROSAR RTE" /begin SUB_GROUP /end SUB_GROUP /begin FUNCTION_LIST /end FUNCTION_LIST /begin REF_CHARACTERISTIC /end REF_CHARACTERISTIC /begin REF_MEASUREMENT InertiaCmpVel.dInertiaCmpVelCalcdInertiaCmp /end REF_MEASUREMENT /end GROUP
/begin GROUP InertiaCmpVel.dInertiaCmpVelFilFrq "MICROSAR RTE" /begin SUB_GROUP /end SUB_GROUP /begin FUNCTION_LIST /end FUNCTION_LIST /begin REF_CHARACTERISTIC /end REF_CHARACTERISTIC /begin REF_MEASUREMENT InertiaCmpVel.dInertiaCmpVelFilFrq /end REF_MEASUREMENT /end GROUP
/begin GROUP InertiaCmpVel.dInertiaCmpVelMotVelBasdOutpScag "MICROSAR RTE" /begin SUB_GROUP /end SUB_GROUP /begin FUNCTION_LIST /end FUNCTION_LIST /begin REF_CHARACTERISTIC /end REF_CHARACTERISTIC /begin REF_MEASUREMENT InertiaCmpVel.dInertiaCmpVelMotVelBasdOutpScag /end REF_MEASUREMENT /end GROUP
/begin GROUP InertiaCmpVel.dInertiaCmpVelNotScadDrvrVel "MICROSAR RTE" /begin SUB_GROUP /end SUB_GROUP /begin FUNCTION_LIST /end FUNCTION_LIST /begin REF_CHARACTERISTIC /end REF_CHARACTERISTIC /begin REF_MEASUREMENT InertiaCmpVel.dInertiaCmpVelNotScadDrvrVel /end REF_MEASUREMENT /end GROUP
/begin GROUP InertiaCmpVel.dInertiaCmpVelNotchBlndVal "MICROSAR RTE" /begin SUB_GROUP /end SUB_GROUP /begin FUNCTION_LIST /end FUNCTION_LIST /begin REF_CHARACTERISTIC /end REF_CHARACTERISTIC /begin REF_MEASUREMENT InertiaCmpVel.dInertiaCmpVelNotchBlndVal /end REF_MEASUREMENT /end GROUP
/begin GROUP InertiaCmpVel.dInertiaCmpVelNotchInpVal "MICROSAR RTE" /begin SUB_GROUP /end SUB_GROUP /begin FUNCTION_LIST /end FUNCTION_LIST /begin REF_CHARACTERISTIC /end REF_CHARACTERISTIC /begin REF_MEASUREMENT InertiaCmpVel.dInertiaCmpVelNotchInpVal /end REF_MEASUREMENT /end GROUP
/begin GROUP InertiaCmpVel.dInertiaCmpVelNotchOutpVal "MICROSAR RTE" /begin SUB_GROUP /end SUB_GROUP /begin FUNCTION_LIST /end FUNCTION_LIST /begin REF_CHARACTERISTIC /end REF_CHARACTERISTIC /begin REF_MEASUREMENT InertiaCmpVel.dInertiaCmpVelNotchOutpVal /end REF_MEASUREMENT /end GROUP
/begin GROUP InertiaCmpVel.dInertiaCmpVelRawDecelGain "MICROSAR RTE" /begin SUB_GROUP /end SUB_GROUP /begin FUNCTION_LIST /end FUNCTION_LIST /begin REF_CHARACTERISTIC /end REF_CHARACTERISTIC /begin REF_MEASUREMENT InertiaCmpVel.dInertiaCmpVelRawDecelGain /end REF_MEASUREMENT /end GROUP
/begin GROUP InertiaCmpVel.dInertiaCmpVelScadDrvrVel "MICROSAR RTE" /begin SUB_GROUP /end SUB_GROUP /begin FUNCTION_LIST /end FUNCTION_LIST /begin REF_CHARACTERISTIC /end REF_CHARACTERISTIC /begin REF_MEASUREMENT InertiaCmpVel.dInertiaCmpVelScadDrvrVel /end REF_MEASUREMENT /end GROUP
/begin GROUP InertiaCmpVel.dInertiaCmpVelTqSnsrVelFildVal "MICROSAR RTE" /begin SUB_GROUP /end SUB_GROUP /begin FUNCTION_LIST /end FUNCTION_LIST /begin REF_CHARACTERISTIC /end REF_CHARACTERISTIC /begin REF_MEASUREMENT InertiaCmpVel.dInertiaCmpVelTqSnsrVelFildVal /end REF_MEASUREMENT /end GROUP
/begin GROUP LimrCdng "MICROSAR RTE"
 /begin SUB_GROUP LimrCdng.CalibrationPorts LimrCdng.PerInstanceMemories LimrCdng.ReceiverPorts LimrCdng.SenderPorts /end SUB_GROUP
 /begin FUNCTION_LIST /end FUNCTION_LIST
 /begin REF_CHARACTERISTIC /end REF_CHARACTERISTIC
 /begin REF_MEASUREMENT /end REF_MEASUREMENT
/end GROUP
/begin GROUP LimrCdng.CalibrationPorts "MICROSAR RTE"
 /begin SUB_GROUP LimrCdng.LimrCdngGainDecSlew.Val LimrCdng.LimrCdngGainIncSlewX.Ary1D LimrCdng.LimrCdngGainIncSlewY.Ary1D LimrCdng.LimrCdngTqDecSlew.Val LimrCdng.LimrCdngTqIncSlewX.Ary1D LimrCdng.LimrCdngTqIncSlewY.Ary1D /end SUB_GROUP
 /begin FUNCTION_LIST /end FUNCTION_LIST
 /begin REF_CHARACTERISTIC /end REF_CHARACTERISTIC
 /begin REF_MEASUREMENT /end REF_MEASUREMENT
/end GROUP
/begin GROUP LimrCdng.EotAssiSca.Val "MICROSAR RTE" /begin SUB_GROUP /end SUB_GROUP /begin FUNCTION_LIST /end FUNCTION_LIST /begin REF_CHARACTERISTIC /end REF_CHARACTERISTIC /begin REF_MEASUREMENT LimrCdng.EotAssiSca.Val /end REF_MEASUREMENT /end GROUP
/begin GROUP LimrCdng.EotAssiScaCdnd.Val "MICROSAR RTE" /begin SUB_GROUP /end SUB_GROUP /begin FUNCTION_LIST /end FUNCTION_LIST /begin REF_CHARACTERISTIC /end REF_CHARACTERISTIC /begin REF_MEASUREMENT LimrCdng.EotAssiScaCdnd.Val /end REF_MEASUREMENT /end GROUP
/begin GROUP LimrCdng.EotMotTqLim.Val "MICROSAR RTE" /begin SUB_GROUP /end SUB_GROUP /begin FUNCTION_LIST /end FUNCTION_LIST /begin REF_CHARACTERISTIC /end REF_CHARACTERISTIC /begin REF_MEASUREMENT LimrCdng.EotMotTqLim.Val /end REF_MEASUREMENT /end GROUP
/begin GROUP LimrCdng.EotMotTqLimCdnd.Val "MICROSAR RTE" /begin SUB_GROUP /end SUB_GROUP /begin FUNCTION_LIST /end FUNCTION_LIST /begin REF_CHARACTERISTIC /end REF_CHARACTERISTIC /begin REF_MEASUREMENT LimrCdng.EotMotTqLimCdnd.Val /end REF_MEASUREMENT /end GROUP
/begin GROUP LimrCdng.LimrCdngGainDecSlew.Val "MICROSAR RTE" /begin SUB_GROUP /end SUB_GROUP /begin FUNCTION_LIST /end FUNCTION_LIST /begin REF_CHARACTERISTIC LimrCdng.LimrCdngGainDecSlew.Val /end REF_CHARACTERISTIC /begin REF_MEASUREMENT /end REF_MEASUREMENT /end GROUP
/begin GROUP LimrCdng.LimrCdngGainIncSlewX.Ary1D "MICROSAR RTE" /begin SUB_GROUP /end SUB_GROUP /begin FUNCTION_LIST /end FUNCTION_LIST /begin REF_CHARACTERISTIC LimrCdng.LimrCdngGainIncSlewX.Ary1D /end REF_CHARACTERISTIC /begin REF_MEASUREMENT /end REF_MEASUREMENT /end GROUP
/begin GROUP LimrCdng.LimrCdngGainIncSlewY.Ary1D "MICROSAR RTE" /begin SUB_GROUP /end SUB_GROUP /begin FUNCTION_LIST /end FUNCTION_LIST /begin REF_CHARACTERISTIC LimrCdng.LimrCdngGainIncSlewY.Ary1D /end REF_CHARACTERISTIC /begin REF_MEASUREMENT /end REF_MEASUREMENT /end GROUP
/begin GROUP LimrCdng.LimrCdngTqDecSlew.Val "MICROSAR RTE" /begin SUB_GROUP /end SUB_GROUP /begin FUNCTION_LIST /end FUNCTION_LIST /begin REF_CHARACTERISTIC LimrCdng.LimrCdngTqDecSlew.Val /end REF_CHARACTERISTIC /begin REF_MEASUREMENT /end REF_MEASUREMENT /end GROUP
/begin GROUP LimrCdng.LimrCdngTqIncSlewX.Ary1D "MICROSAR RTE" /begin SUB_GROUP /end SUB_GROUP /begin FUNCTION_LIST /end FUNCTION_LIST /begin REF_CHARACTERISTIC LimrCdng.LimrCdngTqIncSlewX.Ary1D /end REF_CHARACTERISTIC /begin REF_MEASUREMENT /end REF_MEASUREMENT /end GROUP
/begin GROUP LimrCdng.LimrCdngTqIncSlewY.Ary1D "MICROSAR RTE" /begin SUB_GROUP /end SUB_GROUP /begin FUNCTION_LIST /end FUNCTION_LIST /begin REF_CHARACTERISTIC LimrCdng.LimrCdngTqIncSlewY.Ary1D /end REF_CHARACTERISTIC /begin REF_MEASUREMENT /end REF_MEASUREMENT /end GROUP
/begin GROUP LimrCdng.PerInstanceMemories "MICROSAR RTE"
 /begin SUB_GROUP LimrCdng.PrevEotAssiScaCdnd LimrCdng.PrevEotMotTqLimCdnd LimrCdng.PrevStallMotTqLimCdnd LimrCdng.PrevSysMotTqCmdScaCdnd LimrCdng.PrevThermMotTqLimCdnd LimrCdng.PrevVehSpdMotTqLimCdnd /end SUB_GROUP
 /begin FUNCTION_LIST /end FUNCTION_LIST
 /begin REF_CHARACTERISTIC /end REF_CHARACTERISTIC
 /begin REF_MEASUREMENT /end REF_MEASUREMENT
/end GROUP
/begin GROUP LimrCdng.PrevEotAssiScaCdnd "MICROSAR RTE" /begin SUB_GROUP /end SUB_GROUP /begin FUNCTION_LIST /end FUNCTION_LIST /begin REF_CHARACTERISTIC /end REF_CHARACTERISTIC /begin REF_MEASUREMENT LimrCdng.PrevEotAssiScaCdnd /end REF_MEASUREMENT /end GROUP
/begin GROUP LimrCdng.PrevEotMotTqLimCdnd "MICROSAR RTE" /begin SUB_GROUP /end SUB_GROUP /begin FUNCTION_LIST /end FUNCTION_LIST /begin REF_CHARACTERISTIC /end REF_CHARACTERISTIC /begin REF_MEASUREMENT LimrCdng.PrevEotMotTqLimCdnd /end REF_MEASUREMENT /end GROUP
/begin GROUP LimrCdng.PrevStallMotTqLimCdnd "MICROSAR RTE" /begin SUB_GROUP /end SUB_GROUP /begin FUNCTION_LIST /end FUNCTION_LIST /begin REF_CHARACTERISTIC /end REF_CHARACTERISTIC /begin REF_MEASUREMENT LimrCdng.PrevStallMotTqLimCdnd /end REF_MEASUREMENT /end GROUP
/begin GROUP LimrCdng.PrevSysMotTqCmdScaCdnd "MICROSAR RTE" /begin SUB_GROUP /end SUB_GROUP /begin FUNCTION_LIST /end FUNCTION_LIST /begin REF_CHARACTERISTIC /end REF_CHARACTERISTIC /begin REF_MEASUREMENT LimrCdng.PrevSysMotTqCmdScaCdnd /end REF_MEASUREMENT /end GROUP
/begin GROUP LimrCdng.PrevThermMotTqLimCdnd "MICROSAR RTE" /begin SUB_GROUP /end SUB_GROUP /begin FUNCTION_LIST /end FUNCTION_LIST /begin REF_CHARACTERISTIC /end REF_CHARACTERISTIC /begin REF_MEASUREMENT LimrCdng.PrevThermMotTqLimCdnd /end REF_MEASUREMENT /end GROUP
/begin GROUP LimrCdng.PrevVehSpdMotTqLimCdnd "MICROSAR RTE" /begin SUB_GROUP /end SUB_GROUP /begin FUNCTION_LIST /end FUNCTION_LIST /begin REF_CHARACTERISTIC /end REF_CHARACTERISTIC /begin REF_MEASUREMENT LimrCdng.PrevVehSpdMotTqLimCdnd /end REF_MEASUREMENT /end GROUP
/begin GROUP LimrCdng.ReceiverPorts "MICROSAR RTE"
 /begin SUB_GROUP LimrCdng.EotAssiSca.Val LimrCdng.EotMotTqLim.Val LimrCdng.StallMotTqLim.Val LimrCdng.SysMotTqCmdSca.Val LimrCdng.ThermMotTqLim.Val LimrCdng.VehSpd.Val LimrCdng.VehSpdMotTqLim.Val /end SUB_GROUP
 /begin FUNCTION_LIST /end FUNCTION_LIST
 /begin REF_CHARACTERISTIC /end REF_CHARACTERISTIC
 /begin REF_MEASUREMENT /end REF_MEASUREMENT
/end GROUP
/begin GROUP LimrCdng.SenderPorts "MICROSAR RTE"
 /begin SUB_GROUP LimrCdng.EotAssiScaCdnd.Val LimrCdng.EotMotTqLimCdnd.Val LimrCdng.StallMotTqLimCdnd.Val LimrCdng.SysMotTqCmdScaCdnd.Val LimrCdng.ThermMotTqLimCdnd.Val LimrCdng.VehSpdMotTqLimCdnd.Val /end SUB_GROUP
 /begin FUNCTION_LIST /end FUNCTION_LIST
 /begin REF_CHARACTERISTIC /end REF_CHARACTERISTIC
 /begin REF_MEASUREMENT /end REF_MEASUREMENT
/end GROUP
/begin GROUP LimrCdng.StallMotTqLim.Val "MICROSAR RTE" /begin SUB_GROUP /end SUB_GROUP /begin FUNCTION_LIST /end FUNCTION_LIST /begin REF_CHARACTERISTIC /end REF_CHARACTERISTIC /begin REF_MEASUREMENT LimrCdng.StallMotTqLim.Val /end REF_MEASUREMENT /end GROUP
/begin GROUP LimrCdng.StallMotTqLimCdnd.Val "MICROSAR RTE" /begin SUB_GROUP /end SUB_GROUP /begin FUNCTION_LIST /end FUNCTION_LIST /begin REF_CHARACTERISTIC /end REF_CHARACTERISTIC /begin REF_MEASUREMENT LimrCdng.StallMotTqLimCdnd.Val /end REF_MEASUREMENT /end GROUP
/begin GROUP LimrCdng.SysMotTqCmdSca.Val "MICROSAR RTE" /begin SUB_GROUP /end SUB_GROUP /begin FUNCTION_LIST /end FUNCTION_LIST /begin REF_CHARACTERISTIC /end REF_CHARACTERISTIC /begin REF_MEASUREMENT LimrCdng.SysMotTqCmdSca.Val /end REF_MEASUREMENT /end GROUP
/begin GROUP LimrCdng.SysMotTqCmdScaCdnd.Val "MICROSAR RTE" /begin SUB_GROUP /end SUB_GROUP /begin FUNCTION_LIST /end FUNCTION_LIST /begin REF_CHARACTERISTIC /end REF_CHARACTERISTIC /begin REF_MEASUREMENT LimrCdng.SysMotTqCmdScaCdnd.Val /end REF_MEASUREMENT /end GROUP
/begin GROUP LimrCdng.ThermMotTqLim.Val "MICROSAR RTE" /begin SUB_GROUP /end SUB_GROUP /begin FUNCTION_LIST /end FUNCTION_LIST /begin REF_CHARACTERISTIC /end REF_CHARACTERISTIC /begin REF_MEASUREMENT LimrCdng.ThermMotTqLim.Val /end REF_MEASUREMENT /end GROUP
/begin GROUP LimrCdng.ThermMotTqLimCdnd.Val "MICROSAR RTE" /begin SUB_GROUP /end SUB_GROUP /begin FUNCTION_LIST /end FUNCTION_LIST /begin REF_CHARACTERISTIC /end REF_CHARACTERISTIC /begin REF_MEASUREMENT LimrCdng.ThermMotTqLimCdnd.Val /end REF_MEASUREMENT /end GROUP
/begin GROUP LimrCdng.VehSpd.Val "MICROSAR RTE" /begin SUB_GROUP /end SUB_GROUP /begin FUNCTION_LIST /end FUNCTION_LIST /begin REF_CHARACTERISTIC /end REF_CHARACTERISTIC /begin REF_MEASUREMENT LimrCdng.VehSpd.Val /end REF_MEASUREMENT /end GROUP
/begin GROUP LimrCdng.VehSpdMotTqLim.Val "MICROSAR RTE" /begin SUB_GROUP /end SUB_GROUP /begin FUNCTION_LIST /end FUNCTION_LIST /begin REF_CHARACTERISTIC /end REF_CHARACTERISTIC /begin REF_MEASUREMENT LimrCdng.VehSpdMotTqLim.Val /end REF_MEASUREMENT /end GROUP
/begin GROUP LimrCdng.VehSpdMotTqLimCdnd.Val "MICROSAR RTE" /begin SUB_GROUP /end SUB_GROUP /begin FUNCTION_LIST /end FUNCTION_LIST /begin REF_CHARACTERISTIC /end REF_CHARACTERISTIC /begin REF_MEASUREMENT LimrCdng.VehSpdMotTqLimCdnd.Val /end REF_MEASUREMENT /end GROUP
/begin GROUP LoaMgr "MICROSAR RTE"
 /begin SUB_GROUP LoaMgr.CalibrationPorts LoaMgr.PerInstanceMemories LoaMgr.ReceiverPorts LoaMgr.SenderPorts /end SUB_GROUP
 /begin FUNCTION_LIST /end FUNCTION_LIST
 /begin REF_CHARACTERISTIC /end REF_CHARACTERISTIC
 /begin REF_MEASUREMENT /end REF_MEASUREMENT
/end GROUP
/begin GROUP LoaMgr.CalibrationPorts "MICROSAR RTE"
 /begin SUB_GROUP LoaMgr.LoaMgrCurrIvtrMtgtnRate.Val LoaMgr.LoaMgrCurrIvtrMtgtnSca.Val LoaMgr.LoaMgrCurrIvtrMtgtnScaZeroEna.Logl LoaMgr.LoaMgrCurrMeasIdptSig0Resp.Val LoaMgr.LoaMgrCurrMeasIdptSig1Resp.Val LoaMgr.LoaMgrCurrMeasIdptSig2Resp.Val LoaMgr.LoaMgrCurrMeasIdptSigFltThd.Val LoaMgr.LoaMgrCurrMeasMtgtnRate.Val LoaMgr.LoaMgrCurrMeasMtgtnSca.Val LoaMgr.LoaMgrCurrMeasMtgtnScaZeroEna.Logl LoaMgr.LoaMgrFadeOutStRate.Val LoaMgr.LoaMgrHwTqIdptSig0NoTqLoaResp.Val LoaMgr.LoaMgrHwTqIdptSig1NoTqLoaResp.Val LoaMgr.LoaMgrHwTqIdptSig2Resp.Val LoaMgr.LoaMgrHwTqIdptSig3Resp.Val LoaMgr.LoaMgrHwTqIdptSig4Resp.Val LoaMgr.LoaMgrHwTqIdptSigFltThd.Val LoaMgr.LoaMgrHwTqLoaAvlResp.Val LoaMgr.LoaMgrIvtrIdptSig0Resp.Val LoaMgr.LoaMgrIvtrIdptSig1Resp.Val LoaMgr.LoaMgrIvtrIdptSig2Resp.Val LoaMgr.LoaMgrIvtrIdptSigFltThd.Val LoaMgr.LoaMgrIvtrMtgtnRate.Val LoaMgr.LoaMgrIvtrMtgtnSca.Val LoaMgr.LoaMgrIvtrMtgtnScaZeroEna.Logl LoaMgr.LoaMgrLimdStRate.Val LoaMgr.LoaMgrLimdStSca.Val LoaMgr.LoaMgrMotAgAvlSnsrlsResp.Val LoaMgr.LoaMgrMotAgIdptSig0NoSnsrlsResp.Val LoaMgr.LoaMgrMotAgIdptSig1NoSnsrlsResp.Val LoaMgr.LoaMgrMotAgIdptSig2Resp.Val LoaMgr.LoaMgrMotAgIdptSig3Resp.Val LoaMgr.LoaMgrMotAgIdptSigFltThd.Val LoaMgr.LoaMgrMotAgMtgtnRate.Val LoaMgr.LoaMgrMotAgMtgtnSca.Val LoaMgr.LoaMgrMotAgMtgtnScaZeroEna.Logl /end SUB_GROUP
 /begin FUNCTION_LIST /end FUNCTION_LIST
 /begin REF_CHARACTERISTIC /end REF_CHARACTERISTIC
 /begin REF_MEASUREMENT /end REF_MEASUREMENT
/end GROUP
/begin GROUP LoaMgr.CurrMeasIdptSig.Val "MICROSAR RTE" /begin SUB_GROUP /end SUB_GROUP /begin FUNCTION_LIST /end FUNCTION_LIST /begin REF_CHARACTERISTIC /end REF_CHARACTERISTIC /begin REF_MEASUREMENT LoaMgr.CurrMeasIdptSig.Val /end REF_MEASUREMENT /end GROUP
/begin GROUP LoaMgr.DiagcStsIvtr1Inactv.Logl "MICROSAR RTE" /begin SUB_GROUP /end SUB_GROUP /begin FUNCTION_LIST /end FUNCTION_LIST /begin REF_CHARACTERISTIC /end REF_CHARACTERISTIC /begin REF_MEASUREMENT LoaMgr.DiagcStsIvtr1Inactv.Logl /end REF_MEASUREMENT /end GROUP
/begin GROUP LoaMgr.DiagcStsIvtr2Inactv.Logl "MICROSAR RTE" /begin SUB_GROUP /end SUB_GROUP /begin FUNCTION_LIST /end FUNCTION_LIST /begin REF_CHARACTERISTIC /end REF_CHARACTERISTIC /begin REF_MEASUREMENT LoaMgr.DiagcStsIvtr2Inactv.Logl /end REF_MEASUREMENT /end GROUP
/begin GROUP LoaMgr.HwTqIdptSig.Val "MICROSAR RTE" /begin SUB_GROUP /end SUB_GROUP /begin FUNCTION_LIST /end FUNCTION_LIST /begin REF_CHARACTERISTIC /end REF_CHARACTERISTIC /begin REF_MEASUREMENT LoaMgr.HwTqIdptSig.Val /end REF_MEASUREMENT /end GROUP
/begin GROUP LoaMgr.HwTqLoaMtgtnEna.Logl "MICROSAR RTE" /begin SUB_GROUP /end SUB_GROUP /begin FUNCTION_LIST /end FUNCTION_LIST /begin REF_CHARACTERISTIC /end REF_CHARACTERISTIC /begin REF_MEASUREMENT LoaMgr.HwTqLoaMtgtnEna.Logl /end REF_MEASUREMENT /end GROUP
/begin GROUP LoaMgr.IvtrFetFltTyp.Val "MICROSAR RTE" /begin SUB_GROUP /end SUB_GROUP /begin FUNCTION_LIST /end FUNCTION_LIST /begin REF_CHARACTERISTIC /end REF_CHARACTERISTIC /begin REF_MEASUREMENT LoaMgr.IvtrFetFltTyp.Val /end REF_MEASUREMENT /end GROUP
/begin GROUP LoaMgr.LoaMgrCurrIvtrMtgtnRate.Val "MICROSAR RTE" /begin SUB_GROUP /end SUB_GROUP /begin FUNCTION_LIST /end FUNCTION_LIST /begin REF_CHARACTERISTIC LoaMgr.LoaMgrCurrIvtrMtgtnRate.Val /end REF_CHARACTERISTIC /begin REF_MEASUREMENT /end REF_MEASUREMENT /end GROUP
/begin GROUP LoaMgr.LoaMgrCurrIvtrMtgtnSca.Val "MICROSAR RTE" /begin SUB_GROUP /end SUB_GROUP /begin FUNCTION_LIST /end FUNCTION_LIST /begin REF_CHARACTERISTIC LoaMgr.LoaMgrCurrIvtrMtgtnSca.Val /end REF_CHARACTERISTIC /begin REF_MEASUREMENT /end REF_MEASUREMENT /end GROUP
/begin GROUP LoaMgr.LoaMgrCurrIvtrMtgtnScaZeroEna.Logl "MICROSAR RTE" /begin SUB_GROUP /end SUB_GROUP /begin FUNCTION_LIST /end FUNCTION_LIST /begin REF_CHARACTERISTIC LoaMgr.LoaMgrCurrIvtrMtgtnScaZeroEna.Logl /end REF_CHARACTERISTIC /begin REF_MEASUREMENT /end REF_MEASUREMENT /end GROUP
/**********************************************************************************************************************
* RECORD_LAYOUT
*********************************************************************************************************************/
/begin RECORD_LAYOUT RTE_RL_UBYTE FNC_VALUES 1 UBYTE ROW_DIR DIRECT /end RECORD_LAYOUT
/begin RECORD_LAYOUT RTE_RL_UWORD FNC_VALUES 1 UWORD ROW_DIR DIRECT /end RECORD_LAYOUT
/begin RECORD_LAYOUT RTE_RL_ULONG FNC_VALUES 1 ULONG ROW_DIR DIRECT /end RECORD_LAYOUT
/begin RECORD_LAYOUT RTE_RL_SWORD FNC_VALUES 1 SWORD ROW_DIR DIRECT /end RECORD_LAYOUT
/begin RECORD_LAYOUT RTE_RL_FLOAT32_IEEE FNC_VALUES 1 FLOAT32_IEEE ROW_DIR DIRECT /end RECORD_LAYOUT
/begin RECORD_LAYOUT RTE_RL_BOOLEAN FNC_VALUES 1 UBYTE ROW_DIR DIRECT /end RECORD_LAYOUT
/**********************************************************************************************************************
* COMPU_METHOD / COMPU_VTAB_RANGE
*********************************************************************************************************************/
/begin COMPU_METHOD RTE_CM_BOOLEAN "" TAB_VERB "%3.1" "" COMPU_TAB_REF RTE_CM_BOOLEAN /end COMPU_METHOD
/begin COMPU_VTAB_RANGE RTE_CM_BOOLEAN "" 2 0 0 "false" 1 255 "true" /end COMPU_VTAB_RANGE
/begin COMPU_METHOD RTE_CM_ENUM_SysSt1 "" TAB_VERB "%.1" "" COMPU_TAB_REF RTE_CM_ENUM_SysSt1 /end COMPU_METHOD
/begin COMPU_VTAB_RANGE RTE_CM_ENUM_SysSt1 "" 4 0 0 "SYSST_DI" 1 1 "SYSST_OFF" 2 2 "SYSST_ENA" 3 3 "SYSST_WRMININ" /end COMPU_VTAB_RANGE
/begin COMPU_METHOD RTE_CM_ENUM_IvtrFetFltTyp1 "" TAB_VERB "%.1" "" COMPU_TAB_REF RTE_CM_ENUM_IvtrFetFltTyp1 /end COMPU_METHOD
/begin COMPU_VTAB_RANGE RTE_CM_ENUM_IvtrFetFltTyp1 "" 4 0 0 "IVTRFETFLTTYP_NOFETFLT" 1 1 "IVTRFETFLTTYP_LOWRFETFLT" 2 2 "IVTRFETFLTTYP_UPPRFETFLT" 4 4 "IVTRFETFLTTYP_MPLFETFLT" /end COMPU_VTAB_RANGE
