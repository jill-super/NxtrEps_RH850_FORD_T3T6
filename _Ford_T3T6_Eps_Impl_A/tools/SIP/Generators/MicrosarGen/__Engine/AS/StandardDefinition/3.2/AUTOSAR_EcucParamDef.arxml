[part 3 of 3: package /AUTOSAR]
AUTOSAR XML (schema 3.2.3)
package /AUTOSAR  (continued)
  module definition FrSm [0..1]: variants link-time/post-build/pre-compile
    container FrSmCluster [1..*]: multiple-configuration-container=true
      boolean FrSmCheckWakeupReason: set at link in variant link-time / post-build in variant post-build / pre-compile in variant pre-compile  # If FrSMCheckWakeupReason is true, the FrSM will check the wakeup reason in order to skip the wakeup in case of wakeup by bus. If FrSMCheckWakeupReason is false, the FrSM will always try to perform a wakeup.
      boolean FrSmDelayStartupWithoutWakeup: set at link in variant link-time / post-build in variant post-build / pre-compile in variant pre-compile  # If true, timer t1 shall be started instead of immediately calling FrIf_AllowColdstart in case of a startup without wakeup.
      integer FrSmDurationT1: 0.., set at link in variant link-time / post-build in variant post-build / pre-compile in variant pre-compile  # The duration of timer t1 as multiples of the cycle time of the FrSm main function. A value of 0 shall imply that the timer is not used.
      integer FrSmDurationT2: 0.., set at link in variant link-time / post-build in variant post-build / pre-compile in variant pre-compile  # The duration of timer t2 as multiples of the cycle time of the FrSm main function. The value of this parameter shall be larger than the value of FrSMDurationT1 parameter. A value of 0 shall imply that the timer is not used.
      integer FrSmDurationT3: 0.., set at link in variant link-time / post-build in variant post-build / pre-compile in variant pre-compile  # The duration of timer t3 as multiples of the cycle time of the FrSm main function. The value of this parameter shall be larger than the value of FrSMDurationT1 parameter. A value of 0 shall imply that the timer is not used.
      boolean FrSmIsColdstartEcu: set at link in variant link-time / post-build in variant post-build / pre-compile in variant pre-compile  # True: The ECU is a coldstart node for this FlexRay cluster. False: The ECU is no coldstart node for this FlexRay cluster.
      boolean FrSmIsWakeupEcu: set at link in variant link-time / post-build in variant post-build / pre-compile in variant pre-compile  # True: FrSm shall perform a wakeup for this cluster. False: FrSm shall never perform a wakeup for this FlexRay cluster.
      float FrSmMainFunctionCycleTime: set at link in variant link-time+post-build / pre-compile in variant pre-compile  # This parameter defines the cycle time of the periodic calling of FrSm main function.
      integer FrSmNumWakeupPatterns: 0..65535, set at link in variant link-time / post-build in variant post-build / pre-compile in variant pre-compile  # Maximum number of Wakeup Patterns the node may send before going to FRSM_STARTUP.
      integer FrSmStartupRepetitions [0..1]: 0.., set at link in variant link-time / post-build in variant post-build / pre-compile in variant pre-compile  # The number of times an ECU may repeat the startup procedure for a FlexRay cluster.
      integer FrSmStartupRepetitionsWithWakeup [0..1]: 0.., set at link in variant link-time / post-build in variant post-build / pre-compile in variant pre-compile  # The number of times an ECU may repeat the startup procedure including a wakeup for a FlexRay cluster.
      float FrSmTrcvStdbyDelay [0..1]: 0.., set at link in variant link-time / post-build in variant post-build / pre-compile in variant pre-compile  # The duration of timer t_TrcvStdbyDelay in seconds. The granularity of this parameter shall be restricted to full FlexRay cycles (FrIfGdCycle). The transceiver status setting to STANDBY shall be delayed by this value. A value of 0 shall imply that the timer is not used.
      symbolic name reference FrSmFrIfClusterRef: destination=FrIfCluster  # References the cluster configuration in the FlexRay Interface configuration. Note that the assigned controllers and transceivers are defined in the FrIf configuration and can be accessed via this reference.
      symbolic name reference FrSmNetworkHandleRef: destination=ComMChannel  # Reference to the unique handle to identify one certain FlexRay network correspond to one of the network handles of the ComM configuration.
    container FrSmGeneral
      boolean FrSmDevErrorDetect: set at pre-compile, default-value=false  # Enables and disables the development error detection and notification mechanism.
      function name FrSmSyncLossErrorIndicationName [0..1]: set at link in variant link-time+post-build / pre-compile in variant pre-compile  # Name of <Cdd>_SyncLossErrorIndication function that shall be called on loss of synchronization. If this parameter is omitted no indication shall take place.
      boolean FrSmVersionInfoApi: set at pre-compile, default-value=false  # Enables and disables the version info API
  module definition FrTp [0..1]: variants post-build/pre-compile  # Configuration of the FrTp (FlexRay Transport Protocol) module.
    container FrTpGeneral  # This container contains the general configuration (parameters) of the FlexRay TP.
      integer FrTpChanNum [0..1]: 1..32, set at pre-compile  # This reference is deprecated and will be removed in a future release. Old description: Preprocessor switch for defining the number of concurrent channels the module supports. Up to 32 channels shall be definable here.
      boolean FrTpDevErrorDetect: set at pre-compile  # Preprocessor switch for enabling development error detection.
      boolean FrTpHaveAckRt: set at pre-compile  # Preprocessor switch for enabling the Acknowledgement and retry mechanisms.
      boolean FrTpHaveGrpSeg: set at pre-compile  # Preprocessor switch for enabling segmentation of 1:n messages.
      boolean FrTpHaveLm: set at pre-compile  # Preprocessor switch for enabling the mechanism for message longer than allowed by.
      boolean FrTpHaveTc: set at pre-compile  # Preprocessor switch for enabling Transmit Cancellation and Receive Cancellation.
      float FrTpMainFuncCycle: 0..1.024, set at post-build in variant post-build / pre-compile in variant pre-compile  # This parameter contains the calling period of the TPs Main Function. The parameter is specified in seconds.
      boolean FrTpVersionInfoApi: set at pre-compile  # Preprocessor switch for enabling the Version info API.
    container FrTpMultipleConfig: multiple-configuration-container=true  # This container holds one or several multiple configuration sets.
      container FrTpChannel [1..*]  # This container contains the configuration (parameters) of one FlexRay TP channel.
        enumeration FrTpAckType: {FRTP_ACK_WITHOUT_RT, FRTP_ACK_WITH_RT, FRTP_NO}, set at post-build in variant post-build / pre-compile in variant pre-compile  # This parameter defines the type of acknowledgement which is used for the specific channel.
        enumeration FrTpAdrType: {FRTP_OB, FRTP_TB}, set at post-build in variant post-build / pre-compile in variant pre-compile  # This parameter states the addressing type this connection has. The meanings of the values are one byte and two byte.
        integer FrTpChannelId [0..1]: 0.., set at post-build in variant post-build / pre-compile in variant pre-compile, symbolic-name-value=true  # Please note that this parameter is deprecated and will be removed in a future release. Old description: The Id of the channel.
        integer FrTpConNum [0..1]: set at post-build in variant post-build / pre-compile in variant pre-compile  # Please note that this parameter is deprecated and will be removed in a future release. Old description: This parameter states the number of connections used in this channel. At least 256 shall be configurable here.
        integer FrTpConcurrentConnections [0..1]: 0..255, set at post-build in variant post-build / pre-compile in variant pre-compile, default-value=0  # This parameter defines the number of connections that can be active at the same time. If set to 0, all configured connections can be active at the same time.
        boolean FrTpGrpSeg: set at post-build in variant post-build / pre-compile in variant pre-compile  # Here can be specified, whether segmentation within a 1:n connection is allowed or not.
        enumeration FrTpLm: {FRTP_ISO, FRTP_ISO6, FRTP_L4G}, set at post-build in variant post-build / pre-compile in variant pre-compile  # This specifies the maximum message length for the particular channel.
        integer FrTpMaxAr: 0..255, set at post-build in variant post-build / pre-compile in variant pre-compile  # This parameter defines the maximum number of trying to send a frame when a TIMEOUT AR occurs.
        integer FrTpMaxAs: 0..255, set at post-build in variant post-build / pre-compile in variant pre-compile  # This parameter defines the maximum number of trying t osend a frame when a TIMEOUT AS occurs.
        integer FrTpMaxBs: 0..255, set at post-build in variant post-build / pre-compile in variant pre-compile  # This parameter defines the number of consecutive CFs between two FCs (block size). Valid values are 1 .. 16 when retry is activated, and 0 .. 255 otherwise.
        integer FrTpMaxBufReq [0..1]: 0..255, set at post-build in variant post-build / pre-compile in variant pre-compile  # Please note that this parameter is deprecated and will be removed in a future release. FrTpMaxWft will be used instead to configure the maximum number of wait frames on receiver side. On the sender side, timeCs defines the maximum time for retries. Old description: This parameter defines the maximum number of trying to get a buffer (Transmit / Receive), depending of the return value of PduR_FrTpProvideTxBuffer / PduR_FrTpProvideRxBuffer and on whether retry is configured.
        integer FrTpMaxFrIf [0..1]: 0..255, set at post-build in variant post-build / pre-compile in variant pre-compile  # This parameter is deprecated and will be removed in future. Old description: This parameter defines the maximum number of trying to send a frame when the FrIf returns an error.
        integer FrTpMaxRn: 0..255, set at post-build in variant post-build / pre-compile in variant pre-compile  # This parameter defines the maximum number of retries (if retry is configured for the particular channel).
        integer FrTpMaxWft [0..1]: 0..255, set at post-build in variant post-build / pre-compile in variant pre-compile  # This parameter defines the maximal number of wait frames to be sent for a pending connection.
        float FrTpStMin: 0..0.127, set at post-build in variant post-build / pre-compile in variant pre-compile  # This parameter defines the minimum amount of time between two succeeding CFs of a 1:1 segmented transmission in seconds. Valid values are 0, 100µs, 200µs .. 900µs, 1ms, 2ms .. 127ms. The value can be changed at runtime using the FrTp_ChangeParameter interface. FrTpStMin must be an integer multiple of the cycle length multiplied with the multiplexing factor, i.e. FrTpStMin = n * FrIfGdCycle * m, where n is an integer >= 0 and m is the cycle multiplexor of those cycles where PDUs of the PDU pool are scheduled. Please note: Due to the scheduling strategies of FrTp, FrTpStMin can only be kept to a degree defined by the maximum temporal distance of the PDUs of a PDU pool within one FlexRay cycle.
        float FrTpStMinGrpSeg [0..1]: 0..0.127, set at post-build in variant post-build / pre-compile in variant pre-compile  # This parameter defines the minimum amount of time between two succeeding CFs of a 1:n segmented transmission in seconds. Valid values are 0, 100µs, 200µs ... 900µs, 1ms, 2ms .. 127ms. The value can be changed at runtime using the FrTp_ChangeParameter interface. FrTpStMinGrpSeg must be an integer multiple of the cycle length multiplied with the multiplexing factor, i.e. FrTpStMinGrpSeg = n * FrIfGdCycle * m, where n is an integer >= 0 and m is the cycle multiplexor of those cycles where PDUs of the PDU pool are scheduled. Please note: Due to the scheduling strategies of FrTp, FrTpStMinGrpSeg can only be kept to a degree defined by the maximum temporal distance of the PDUs of a PDU pool within one FlexRay cycle.
        boolean FrTpTc: set at post-build in variant post-build / pre-compile in variant pre-compile, default-value=false  # With this switch Transmit Cancellation and Receive Cancellation can be turned on or off for this channel.
        float FrTpTimeBr: 0..65.535, set at post-build in variant post-build / pre-compile in variant pre-compile  # This parameter defines the time in seconds between receiving the last CF of a block or an FF-x (or SF-x) and sending out an FC or AF. It is obvious that FRTP_TIME_BR + (FRTP_TIMEOUT_AR * FRTP_MAX_AR) < FRTP_TIMEOUT_BS must hold (because the transmission duration on the bus has also to be considered). This parameter is defined in ISO 15765-2. It is contained in the configuration as a performance requirement.
        float FrTpTimeCs: 0..65.535, set at post-build in variant post-build / pre-compile in variant pre-compile  # This parameter defines the time in seconds between the sending of two consecutive CFs or between reception of an FC or AF and sending of the next CF . It is obvious that FRTP_TIME_CS + (FRTP_TIMEOUT_AS * FRTP_MAX_AS) < FRTP_TIMEOUT_CR must hold (because the transmission duration on the bus has also to be considered). This parameter is defined in ISO 15765-2. It is contained in the configuration as a performance requirement.
        float FrTpTimeFrIf [0..1]: 0..0.255, set at post-build in variant post-build / pre-compile in variant pre-compile  # This parameter is deprecated and will be removed in future. Old description: This parameter defines the time in seconds of waiting for the next try to send via FrIf_Transmit.
        float FrTpTimeoutAr: 0..65.535, set at post-build in variant post-build / pre-compile in variant pre-compile  # This parameter states the timeout in seconds between the PDU transmit request of the Transport Layer to the FlexRay Interface and the corresponding confirmation of the FlexRay Interface on the receiver side (for FC or AF).
        float FrTpTimeoutAs: 0..65.535, set at post-build in variant post-build / pre-compile in variant pre-compile  # This parameter states the timeout in seconds between the PDU transmit request for the first PDU of the group used in the current connection of the Transport Layer to the FlexRay Interface and the corresponding confirmation of the FlexRay Interface (when having sent the last PDU of the group used in this connection) on the sender side (SF-x, FF-x, CF).
        float FrTpTimeoutBs: 0..65.535, set at post-build in variant post-build / pre-compile in variant pre-compile  # This parameter defines the timeout in seconds for waiting for an FC or AF on the sender side in a 1:1 connection.
        float FrTpTimeoutCr: 0..65.535, set at post-build in variant post-build / pre-compile in variant pre-compile  # This parameter defines the timeout value in seconds for waiting for a CF or FF-x (in case of retry) after receiving the last CF or after sending an FC or AF on the receiver side.
        boolean FrTpUsePduFc [0..1]: set at post-build in variant post-build / pre-compile in variant pre-compile  # Please note that this parameter is deprecated and will be removed in a future release. It has been rendered irrelevant by the introduction of PDU pools. Old description: This switch defines, whether within this channel the dedicated FC/ACK PDU (FrTpPduFc) shall be used or not. If this is not used FC / ACK frames are sent using the normal IDs, otherwise only FrTpPduFc shall be used for sending / receiving FC / ACK frames.
        container FrTpConnection [1..*]  # This container contains the configuration (parameters) of one FlexRay TP connection. A connection can only belong to one channel.
          integer FrTpConPrioPdus [0..1]: 0..255, set at post-build in variant post-build / pre-compile in variant pre-compile, default-value=0  # This parameter defines the number of TxNPdus to which this connection has prioritized access. It must be ensured that the number of prioritized PDUs of all connections is smaller than the total number of TxNPdus in the associated PDU pool.
          integer FrTpLa: 0..65535, set at post-build in variant post-build / pre-compile in variant pre-compile  # This parameter defines the Local Address for the respective connection. When the local instance is the sender, this is the Source Address within the TP frame. When the local instance is the receiver, this is the Target Address within the TP frame. Note that in case of 1 byte addressing only the values from 0x0000 - 0x00FF are valid.
          boolean FrTpMultRec: set at post-build in variant post-build / pre-compile in variant pre-compile  # This parameter defines, whether this connection is an 1:1 ('false') or an 1:n ('true') connection. Of course, if the channel to which the connection is configured has retry or acknowledgement enabled, no retry or acknowledgement will occur in case the connection is an 1:n connection.
          integer FrTpRa: 0..65535, set at post-build in variant post-build / pre-compile in variant pre-compile  # This parameter defines the Remote Address for the respective connection. When the local instance is the sender, this is the Target Address within the TP frame. When the local instance is the receiver, this is the Source Address within the TP frame. Note that in case of 1 byte addressing only the values from 0x0000 - 0x00FF are valid.
          reference FrTpConPduRef [0..*]: set at post-build in variant post-build / pre-compile in variant pre-compile, destination=FrTpPdu  # This reference is deprecated and will be removed in a future release. It has been rendered irrelevant by the introduction of PDU pools. Old description: Each value defines a PDU to be used for this connection. Thus each value is a PDU-ID given in FrTpPdu and this array cannot be longer than the array FrTpPdu. Please note: Only PDUs of the same size shall be used within a connection. Of course the PDU having the TxConfirmation configured has to be used by every connection.
          container FrTpRxSdu [0..1]  # Describes the Rx SDU
            integer FrTpSduRxId [0..1]: set at post-build in variant post-build / pre-compile in variant pre-compile, symbolic-name-value=true  # Please note that this parameter is deprecated and will be removed in a future release. Old description: This is a unique identifier for a received message. This Id is used in the CancelReceive API call. ImplementationType: PduIdType
            reference FrTpRxSduRef: set at post-build in variant post-build / pre-compile in variant pre-compile, destination=Pdu  # Reference to a PDU in the global PDU structure.
          container FrTpTxSdu [0..1]  # Describes the Tx SDU
            integer FrTpSduTxId: 0..65535, set at post-build in variant post-build / pre-compile in variant pre-compile, symbolic-name-value=true  # This is a unique identifier for a received or a to be transmitted message. With this (and by means of e.g. a lookup table) the PDU Router can route the message appropriately without dealing with the particularities of the Transport Layer. This parameter can also be seen as the identifier of a connection. ImplementationType: PduIdType
            reference FrTpTxSduRef: set at post-build in variant post-build / pre-compile in variant pre-compile, destination=Pdu  # Reference to a PDU in the global PDU structure.
        container FrTpPdu [1..*]  # Container to hold the PDU parameters. ImplementationType: FrTp_PduInfoType
          enumeration FrTpPduDirection: {FRTP_RX, FRTP_TX}, set at post-build in variant post-build / pre-compile in variant pre-compile  # This parameter defines the direction of the PDU.
          integer FrTpPduId: 0..65535, set at post-build in variant post-build / pre-compile in variant pre-compile, symbolic-name-value=true  # This is the identifier of the FlexRay Interface PDUs (Fr N-PDU, Fr L-SDU) in which the Transport Layer Frames of this channel should be transmitted. The FrTpPduId is only required for Rx N-PDUs (FrTpPduDirection == FRTP_RX), and should be omitted for Tx N-PDUs (FrTpPduDirection == FRTP_TX). ImplementationType: PduIdType
          reference FrTpPduRef: set at post-build in variant post-build / pre-compile in variant pre-compile, destination=Pdu
        container FrTpPduFc [0..2]  # Please note that this container with all references and parameters is deprecated and will be removed in a future release. It has been rendered irrelevant by the introduction of PDU pools. Old description: This is the identifier of the FlexRay Interface PDUs (Fr N-PDU, Fr L-SDU) in which the Transport Layer Flow Control and Acknowledgement Frames of this channel should be transmitted.
          enumeration FrTpPduFcDirection [0..1]: {FRTP_FC_RX, FRTP_FC_TX}, set at post-build in variant post-build / pre-compile in variant pre-compile  # This parameter is deprecated and will be removed in a future release. It has been rendered irrelevant by the introduction of PDU pools. Old description: This parameter defines the direction of the PDU.
          integer FrTpPduFcId [0..1]: set at post-build in variant post-build / pre-compile in variant pre-compile, symbolic-name-value=true  # This parameter is deprecated and will be removed in a future release. It has been rendered irrelevant by the introduction of PDU pools. Old description: This is the identifier of the FlexRay Interface PDUs (Fr N-PDU, Fr L-SDU) in which the Transport Layer Flow Control and Acknowledgement Frames of this channel should be transmitted.
          reference FrTpPduFcRef [0..1]: set at post-build in variant post-build / pre-compile in variant pre-compile, destination=Pdu  # This reference is deprecated and will be removed in a future release. It has been rendered irrelevant by the introduction of PDU pools.
  module definition FrTrcv [0..*]: variants pre-compile  # Configuration of the FrTrcv (FlexRay Transceiver driver) module.
    container FrTrcvGeneral  # Container gives FlexRay transceiver driver basic information.
      boolean FrTrcvDevErrorDetect: set at pre-compile  # Switches development error detection and notification on and off. If switched on, #define FRTRCV_DEV _ERROR_DETECT ON shall be generated. If switched off, #define FRTRCV_DEV_ERROR _DETECT OFF shall be generated. Define shall be part of file FrTrcv_Cfg.h.
      boolean FrTrcvGetVersionInfo: set at pre-compile  # Switches version information API on and off. If switched off, function need not be present in compiled code.
      integer FrTrcvIndex: set at pre-compile  # Specifies the InstanceId of this module instance. If only one instance is present it shall have the Id 0.
      float FrTrcvMainFunctionCycleTime: set at pre-compile  # Cyclic call time for function FrTrcvMainFunction in seconds. A call time of 0ms indicates no calls for this function. In this case function need not be present in compiled code.
      boolean FrTrcvReceiveonlySupport: set at pre-compile  # Information if the optional transceiver state RECEIVEONLY is supported by the driver and hardware.
      boolean FrTrcvSleepSupported: set at pre-compile  # Information if the optional transceiver state SLEEP is supported by the driver and hardware.
    container FrTrcvNode [1..*]  # Container gives FlexRay transceiver driver information about a single FlexRay transceiver node. Any FlexRay transceiver driver has such FlexRay transceiver nodes.
      boolean FrTrcvControlsPowerSupply: set at pre-compile  # Is ECU power supply controlled by this transceiver?
      enumeration FrTrcvInitState: {FRTRCV_TRCVMODE_NORMAL, FRTRCV_TRCVMODE_RECEIVEONLY, FRTRCV_TRCVMODE_SLEEP, FRTRCV_TRCVMODE_STANDBY}, set at pre-compile  # State of FlexRay transceiver after power on. ImplementationType: FrTrcv_TrcvModeType
      integer FrTrcvMaxBaudrate: set at pre-compile  # Max baudrate for transceiver hardware type. Only used for validation purposes. Value shall be configured by configuration tool based on FRTRCV_HARDWARE_NAME and internal information about ability of this hardware typel.
      integer FrTrcvNodeId: set at pre-compile, symbolic-name-value=true  # Unique node id. It is used by ComM by Icu and internally.
      boolean FrTrcvWakeupByNodeUsed: set at pre-compile  # Is wake up by node supported? If FlexRay transceiver hardware does not support wake up by node value is always FALSE. If FlexRay transceiver hardware supports wake up by node value is TRUE or FALSE depending whether it is used or not.
      boolean FrTrcvWakeupPolling: set at pre-compile  # Information of this entitiy is only relevant if parameter FrTrcvWakeup-ByTransceiverUsed is TRUE. Information whether wake up events will be performed in main function (TRUE) or by a callback function called by an interrupt service (FALSE).
      symbolic name reference FrTrcvIcuChannelRef [0..1]: destination=IcuChannel  # Reference to the IcuChannel to enable/disable the interrupts for wakeups.
      symbolic name reference FrTrcvWakeupSourceRef: destination=EcuMWakeupSource  # Reference to a wakeup source in the EcuM configuration. This reference is only needed if FrTrcvWakeupByNodeUsed is true. Implementation Type: reference to EcuM_WakeupSourceType
  module definition Gpt [0..1]: variants post-build/pre-compile  # Configuration of the Gpt (General Purpose Timer) module.
    container GptChannelConfigSet [1..*]: multiple-configuration-container=true  # This container is the base of an Configuration Set which contains the configured GPT channels. This way, different configuration sets can be defined for post-build process.
      container GptChannelConfiguration [1..*]  # This container contains the channel-wide configuration (parameters) of the GPT Driver
        integer GptChannelClkSrc [0..1]: set at post-build in variant post-build / pre-compile in variant pre-compile  # GPT187: The GPT module specific clock input for the timer unit can statically be configured and allows to select different clock sources (external clock, internal GPT specific clock) per channel
        integer GptChannelId: 0.., set at post-build in variant post-build / pre-compile in variant pre-compile, symbolic-name-value=true  # Channel Id of the GPT channel. This value will be assigned to the symbolic name derived of the GptChannelConfiguration container short name.
        enumeration GptChannelMode: {GPT_MODE_CONTINOUS, GPT_MODE_ONESHOT}, set at post-build in variant post-build / pre-compile in variant pre-compile  # Specifies the behaviour of the timerchannel after the timeout has expired
        integer GptChannelPrescale [0..1]: set at post-build in variant post-build / pre-compile in variant pre-compile  # GPT module specific prescaler factor per channel
        boolean GptEnableWakeup: set at post-build in variant post-build / pre-compile in variant pre-compile  # GPT188: Enables wakeup capability of CPU for a channel when timeout period expires. This might be different to enabling the notification depending on hardware capabilities
        function name GptNotification: set at post-build in variant post-build / pre-compile in variant pre-compile  # Function pointer to callback function
        container GptWakeupConfiguration [0..1]
          symbolic name reference GptWakeupSourceRef: destination=EcuMWakeupSource  # In case the wakeup-capability is true this value is transmitted to the Ecu State Manager. Implementation Type: reference to EcuM_WakeupSourceType
    container GptConfigurationOfOptApiServices  # This container contains all configuration switches for configuring optional API services of the GPT driver
      boolean GptDeinitApi: set at pre-compile  # Adds / removes the service Gpt_DeInit() from the code.
      boolean GptEnableDisableNotificationApi: set at pre-compile  # Adds / removes the services Gpt_EnableNotification() and Gpt_DisableNotification from the code.
      boolean GptTimeElapsedApi: set at pre-compile  # Adds / removes the service Gpt_GetTimeElapsed() from the code
      boolean GptTimeRemainingApi: set at pre-compile  # Adds / removes the service Gpt_GetTimeRemaining() from the code.
      boolean GptVersionInfoApi: set at pre-compile  # Adds / removes the service Gpt_GetVersionInfo() from the code.
      boolean GptWakeupFunctionalityApi: set at pre-compile  # Adds / removes the services Gpt_SetMode(), Gpt_EnableWakeup() Gpt_DisableWakeup() and Gpt_Cbk_CheckWakeup() from the code.
    container GptDriverConfiguration  # This container contains the module-wide configuration (parameters) of the GPT Driver
      boolean GptDevErrorDetect: set at pre-compile  # Enables/Disables development error detection
      boolean GptReportWakeupSource: set at pre-compile  # Enables/Disables wakeup source reporting
  module definition Icu [0..*]: variants post-build/pre-compile  # Configuration of the Icu (Input Capture Unit) module.
    container IcuConfigSet: multiple-configuration-container=true  # This container is the base for a multiple configuration set
      derived integer IcuMaxChannel: 0.., set at post-build in variant post-build / pre-compile in variant pre-compile, calculation-formula=number of configured icu channels, calculation-language=INFORMAL  # This parameter contains the number of Channels configured. It will be gathered by tools during the configuration stage. calculationFormula = Number of configured Icu Channels Implementation Type: Icu_ChannelType
      container IcuChannel [1..*]  # Configuration of an individual ICU channel.
        integer IcuChannelId: 0.., set at pre-compile, symbolic-name-value=true  # Channel Id of the ICU channel. This value will be assigned to the symbolic name derived of the IcuChannel container short name.
        enumeration IcuDefaultStartEdge: {ICU_BOTH_EDGES, ICU_FALLING_EDGE, ICU_RISING_EDGE}, set at post-build in variant post-build / pre-compile in variant pre-compile  # Configures the default-activation-edge which shall be used for this channel if there was no activation-edge configured by the call of service Icu_SetActivationCondition(). In case the Measurement Mode is "IcuSignalMeasurement" and the properties "DutyCycle" or "Period" are set, the edge configured here is used as Default Period Start Edge. Implementation Type: Icu_ActivationType
        enumeration IcuMeasurementMode: {ICU_MODE_EDGE_COUNTER, ICU_MODE_SIGNAL_EDGE_DETECT, ICU_MODE_SIGNAL_MEASUREMENT, ICU_MODE_TIMESTAMP}, set at post-build in variant post-build / pre-compile in variant pre-compile  # Configures the measurement mode of this channel. Implementation Type: Icu_MeasurementModeType
        boolean IcuWakeupCapability: set at post-build in variant post-build / pre-compile in variant pre-compile  # Information about the wakeup-capability of this channel. true: Channel is wakeup capable. false: Channel is not wakeup capable.
        container IcuEdgeCounterMeasurement [0..1]  # This container contains the configuration (parameters) in case the measurement mode is "IcuEdgeCounter"
        container IcuSignalEdgeDetection [0..1]  # This container contains the configuration (parameters) in case the measurement mode is "IcuSignalEdgeDetection"
          function name IcuSignalNotification: set at post-build in variant post-build / pre-compile in variant pre-compile  # Notification function for signal notification.
        container IcuSignalMeasurement [0..1]  # This container contains the configuration (parameters) in case the measurement mode is "IcuSignalMeasurement"
          enumeration IcuSignalMeasurementProperty: {ICU_DUTY_CYCLE, ICU_HIGH_TIME, ICU_LOW_TIME, ICU_PERIOD_TIME}, set at post-build in variant post-build / pre-compile in variant pre-compile  # Configures the property that could be measured in case the mode is "IcuSignalMeasurement". This property can not be changed during runtime. Implementation Type: Icu_SignalMeasurementPropertyType
        container IcuTimestampMeasurement [0..1]  # This container contains the configuration (parameters) in case the measurement mode is "IcuTimestamp"
          enumeration IcuTimestampMeasurementProperty: {ICU_CIRCULAR_BUFFER, ICU_LINEAR_BUFFER}, set at post-build in variant post-build / pre-compile in variant pre-compile  # Configures the handling of the buffer in case the mode is "Timestamp" Implementation Type: Icu_TimestampBufferType
          function name IcuTimestampNotification: set at post-build in variant post-build / pre-compile in variant pre-compile  # Notification function if the number of requested timestamps (Notification interval > 0) are acquired.
        container IcuWakeup [0..1]  # This container contains the configuration (parameters) needed to configure a wakeup capable channel
          symbolic name reference IcuChannelWakeupInfo: destination=EcuMWakeupSource  # If the wakeup-capability is true the wakeup source referenced is transmitted to the ECU State Manager (EcuM) . Implementation Type: reference to EcuM_WakeupSourceType
    container IcuGeneral  # Configuration of general ICU parameters.
      boolean IcuDevErrorDetect: set at pre-compile  # Switches the Development Error Detection and Notification on or off. true: Enabled. false: Disabled.
      integer IcuIndex: set at pre-compile  # Specifies the InstanceId of this module instance. If only one instance is present it shall have the Id 0.
      boolean IcuReportWakeupSource: set at pre-compile  # Switch for enabling Wakeup source reporting. true: Report Wakeup source. false: Do not report Wakeup source.
    container IcuOptionalApis  # This container contains all configuration switches for configuring optional API services of the ICU driver.
      boolean IcuDeInitApi: set at pre-compile  # Adds / removes the service Icu_DeInit() from the code. true: Icu_DeInit() can be used. false: Icu_DeInit() can not be used.
      boolean IcuDisableWakeupApi: set at pre-compile  # Adds / removes the service Icu_DisableWakeup() from the code. true: Icu_DisableWakeup() can be used. false: Icu_DisableWakeup() can not be used.
      boolean IcuEdgeCountApi: set at pre-compile  # Adds / removes all services related to the edge counting functionality as listed below, from the code: Icu_ResetEdgeCount(), Icu_EnableEdgeCount(), Icu_DisableEdgeCount(), Icu_GetEdgeNumbers(). true: The services listed above can be used. false: The services listed above can not be used.
      boolean IcuEnableWakeupApi: set at pre-compile  # Adds / removes the service Icu_EnableWakeup() from the code. true: Icu_EnableWakeup() can be used. false: Icu_EnableWakeup() can not be used.
      boolean IcuGetDutyCycleValuesApi: set at pre-compile  # Adds / removes the service Icu_GetDutyCycleValues() from the code. true: Icu_GetDutyCycleValues() can be used. false: Icu_GetDutyCycleValues() can not be used.
      boolean IcuGetInputStateApi: set at pre-compile  # Adds / removes the service Icu_GetInputState() from the code. true: Icu_GetInputState() can be used. false: Icu_GetInputState() can not be used.
      boolean IcuGetTimeElapsedApi: set at pre-compile  # Adds / removes the service Icu_GetTimeElapsed() from the code. true: Icu_GetTimeElapsed() can be used. false: Icu_GetTimeElapsed() can not be used.
      boolean IcuGetVersionInfoApi: set at pre-compile  # Adds / removes the service Icu_GetVersionInfo() from the code. true: Icu_GetVersionInfo() can be used. false: Icu_GetVersionInfo() can not be used.
      boolean IcuSetModeApi: set at pre-compile  # Adds / removes the service Icu_SetMode() from the code. true: Icu_SetMode() can be used. false: Icu_SetMode() can not be used.
      boolean IcuSignalMeasurementApi: set at pre-compile  # Adds / removes the services Icu_StartSignalMeasurement() and Icu_StopSignalMeasurement() from the code. true: Icu_StartSignalMeasurement() and Icu_StopSignalMeasurement() can be used. false: Icu_StartSignalMeasurement() and Icu_StopSignalMeasurement() can not be used.
      boolean IcuTimestampApi: set at pre-compile  # Adds / removes all services related to the timestamping functionality as listed below from the code: Icu_StartTimestamp(), Icu_StopTimestamp(), Icu_GetTimestampIndex(). true: The services listed above can be used. false: The services listed above can not be used.
  module definition IoHwAbstraction [0..1]  # Configuration of IO HW Abstraction.
    container IoHwAbEcuSignalGroup [0..*]  # This container contains the configuration (parameters) of all ECU signals groups implemented in the IO Hardware Abstraction Module
      container IoHwAbDiscSigGrpInput [0..*]  # This container contains the description of a discrete ECU signal group. The container IoHwAb_Discrete_SignalGroup contains several IoHwAb_Class_Discrete_Input sub-containers
        reference IoHwAbDiscSigGrpInMember [1..*]: destination=IoHwAbDiscreteInput  # Each member of the signal group is referenced by an instance of tthis element. In the IO HW Abstraction SWS, individual signals are aggregated by the signal group instead of referenced, but by using references it is still possible to have the same signal being par of several signal groups, as intended in the SWS.
      container IoHwAbDiscSigGrpOutput [0..*]  # This container contains the description of a discrete ECU signal group. The container IoHwAb_Discrete_SignalGroup contains several IoHwAb_Class_Discrete_Output sub-containers.
        reference IoHwAbDiscSigGrpOutMember [1..*]: destination=IoHwAbDiscreteOutput  # Each member of the signal group is referenced by an instance of tthis element. In the IO HW Abstraction SWS, individual signals are aggregated by the signal group instead of referenced, but by using references it is still possible to have the same signal being par of several signal groups, as intended in the SWS.
    container IoHwAbEcuSignals [0..*]  # This container contains the configuration (parameters) of all ECU signals implemented in the IO Hardware Abstraction Module. Remarks: - The IO Hardware Abstraction module is an ECU firmware module. That means that the implementation shall fit only to the ECU hardware. The implementer has to develop only the functionality needed (eg: if there is no pulse width ECU signal configurated, the pulse width abstraction will not be available. - At least one ECU signal shall be configurated to have the module.
      container IoHwAbAnalogInput [0..*]  # This container contains the description of an analog ECU signal used as input. The operation available through the Port is a OP_GET.
        boolean IoHwAbAnaInputFilter  # This parameter specifies if the ECU analog signal is filtered
        boolean IoHwAbAnaInputReport  # This parameter specifies if the report features is activated
        integer IoHwAbAnaInputSamplingRate  # This parameter specifies the sampling rate for an analog input
        container IoHwAbAnalog  # This container contains common description of a all ECU signals from class analog.
          integer IoHwAbAnalogBswRange: 0..  # This parameter gives the BSW Range used for an analog signal, according to the datatype
          string IoHwAbAnalogBswResolution  # This parameter gives the resolution used for an analog signal
          string IoHwAbAnalogDataType  # This parameter gives the DataType used for an analog signal
          integer IoHwAbAnalogMaxAge  # This parameter gives the maximum age of an ECU analog signal
          string IoHwAbAnalogUnit  # This parameter gives the unit used for an analog signal
      container IoHwAbAnalogOutput [0..*]  # This container contains the description of an analog ECU signal used as output. The operation available through the Port is a OP_SET.
        boolean IoHwAbAnaOutputFailureMoni  # This parameter specifies if the ECU analog Output is monitored, to detect failure
        boolean IoHwAbAnaOutputPulseTest  # This parameter specifies if an test pulse is used to detect failure on the ECU analog Output
        container IoHwAbAnalog  # This container contains common description of a all ECU signals from class analog.
          integer IoHwAbAnalogBswRange: 0..  # This parameter gives the BSW Range used for an analog signal, according to the datatype
          string IoHwAbAnalogBswResolution  # This parameter gives the resolution used for an analog signal
          string IoHwAbAnalogDataType  # This parameter gives the DataType used for an analog signal
          integer IoHwAbAnalogMaxAge  # This parameter gives the maximum age of an ECU analog signal
          string IoHwAbAnalogUnit  # This parameter gives the unit used for an analog signal
      container IoHwAbDiscreteDiagnosis [0..*]  # This container contains the description of a discrete ECU signal used as diagnosis.
        container IoHwAbDiscrete  # This container contains common description of a all ECU signals from class discrete
          boolean IoHwAbDiscreteBswRange  # This parameter gives all possible values of an ECU discrete signal
          boolean IoHwAbDiscreteDatatype  # This parameter gives the DataType used for a discrete signal
          integer IoHwAbDiscreteMaxAge  # This parameter gives the maximum age of an ECU discrete signal
      container IoHwAbDiscreteInput [0..*]  # This container contains the description of a discrete ECU signal used as input. The operation available through the Port is an OP_GET.
        integer IoHwAbDiscInputDebounce  # This parameter specifies if the ECU discrete signal is filtered / debounced 0 represents Debouncing deactivated N represents Debouncing activated, N values sampled before value is available
        boolean IoHwAbDiscInputReport  # This parameter specifies if the report features is activated FALSE represents no report if a significant change occurs TRUE represents repot if a significant change occurs
        boolean IoHwAbDiscInputWakeup  # This parameter specifies if the ECU pin is a wakeup input TRUE represents a wakeup Input. During sleep mode, a change is reported to the module. In case of a valid reason, the ECU state manager will be restarted to validate the wakeup. FALSE represents a simple discrete Input.
        container IoHwAbDiscrete  # This container contains common description of a all ECU signals from class discrete
          boolean IoHwAbDiscreteBswRange  # This parameter gives all possible values of an ECU discrete signal
          boolean IoHwAbDiscreteDatatype  # This parameter gives the DataType used for a discrete signal
          integer IoHwAbDiscreteMaxAge  # This parameter gives the maximum age of an ECU discrete signal
      container IoHwAbDiscreteOutput [0..*]  # This container contains the description of a discrete ECU signal used as Output. The operation available through the Port is a OP_SET.
        boolean IoHwAbDiscOutputFailureMoni  # This parameter specifies if the ECU discrete Output is monitored, to detect failure TRUE represents that the ECU Signal is a monitored Output. Failures on this Output are detected and managed by the module FALSE represents that the ECU Signal is a simple discrete Output.
        boolean IoHwAbDiscOutputPulseTest  # This parameter specifies if an test pulse is used to detect failure on the ECU discrete Output TRUE represents that a Test Pulse is used for failure monitoring FALSE represents that no Test Pulse is used for failure monitoring
        container IoHwAbDiscrete  # This container contains common description of a all ECU signals from class discrete
          boolean IoHwAbDiscreteBswRange  # This parameter gives all possible values of an ECU discrete signal
          boolean IoHwAbDiscreteDatatype  # This parameter gives the DataType used for a discrete signal
          integer IoHwAbDiscreteMaxAge  # This parameter gives the maximum age of an ECU discrete signal
      container IoHwAbPwDutyCycleInput [0..*]  # This container contains specific description for an input ECU signal from class pulse width, handling especially the characteristic DutyCycle The operation available through the Port is a OP_GET
        boolean IoHwAbPwdcInputWakeup  # This parameter specifies if the ECU pin is a wakeup input
        container IoHwAbPwDutyCycle  # This container contains common description of a all ECU signals from class pulse width, handling especially the characteristic duty cycle
          integer IoHwAbPwdcBswRange: 0..100  # This parameter gives the BSW Range for a pulse width signal
          string IoHwAbPwdcUnit  # This parameter gives the unit for an ECU signal, handling especially the characteristic period
          container IoHwAbPulseWidth  # This container contains common description of a all ECU signals from class pulse width
            integer IoHwAbPwBswResolution  # This parameter gives the resolution used for a pulse width ECU signal
            string IoHwAbPwDatatype  # This parameter gives the DataType used for a pulse width signal
            integer IoHwAbPwMaxAge  # This parameter gives the maximum age for a pulse width ECU signal
      container IoHwAbPwDutyCycleOutput [0..*]  # This container contains specific description for an output ECU signal from class pulse width, handling especially the characteristic DutyCycle. The operation available through the Port is a OP_SET.
        boolean IoHwAbPwdcOutputFailureMoni  # This parameter specifies if the ECU Output is monitored, to detect failure
        boolean IoHwAbPwdcOutputPulseTest  # This parameter specifies if an test pulse is used to detect failure on the ECU Output
        container IoHwAbPwDutyCycle  # This container contains common description of a all ECU signals from class pulse width, handling especially the characteristic duty cycle
          integer IoHwAbPwdcBswRange: 0..100  # This parameter gives the BSW Range for a pulse width signal
          string IoHwAbPwdcUnit  # This parameter gives the unit for an ECU signal, handling especially the characteristic period
          container IoHwAbPulseWidth  # This container contains common description of a all ECU signals from class pulse width
            integer IoHwAbPwBswResolution  # This parameter gives the resolution used for a pulse width ECU signal
            string IoHwAbPwDatatype  # This parameter gives the DataType used for a pulse width signal
            integer IoHwAbPwMaxAge  # This parameter gives the maximum age for a pulse width ECU signal
      container IoHwAbPwPeriodInput [0..*]  # This container contains specific description for an input ECU signal from class pulse width, handling especially the characteristic period
        boolean IoHwAbPwpInputWakeup  # This parameter specifies if the ECU pin is a wakeup input
        container IoHwAbPwPeriod  # This container contains common description of a all ECU signals from class pulse width, handling especially the characteristic period
          integer IoHwAbPwpBswRange: -100..100  # This parameter gives the BSW Range for a pulse width signal (in percent)
          string IoHwAbPwpUnit  # This parameter gives the unit for an ECU signal, handling especially the characteristic period
          container IoHwAbPulseWidth  # This container contains common description of a all ECU signals from class pulse width
            integer IoHwAbPwBswResolution  # This parameter gives the resolution used for a pulse width ECU signal
            string IoHwAbPwDatatype  # This parameter gives the DataType used for a pulse width signal
            integer IoHwAbPwMaxAge  # This parameter gives the maximum age for a pulse width ECU signal
      container IoHwAbPwPeriodOutput [0..*]  # This container contains specific description for an output ECU signal from class pulse width, handling especially the characteristic period The operation available through the Port is a OP_SET.
        boolean IoHwAbPwpOutputFailureMoni  # This parameter specifies if the ECU Output is monitored, to detect failure
        boolean IoHwAbPwpOutputPulseTest  # This parameter specifies if an test pulse is used to detect failure on the ECU Output
        container IoHwAbPwPeriod  # This container contains common description of a all ECU signals from class pulse width, handling especially the characteristic period
          integer IoHwAbPwpBswRange: -100..100  # This parameter gives the BSW Range for a pulse width signal (in percent)
          string IoHwAbPwpUnit  # This parameter gives the unit for an ECU signal, handling especially the characteristic period
          container IoHwAbPulseWidth  # This container contains common description of a all ECU signals from class pulse width
            integer IoHwAbPwBswResolution  # This parameter gives the resolution used for a pulse width ECU signal
            string IoHwAbPwDatatype  # This parameter gives the DataType used for a pulse width signal
            integer IoHwAbPwMaxAge  # This parameter gives the maximum age for a pulse width ECU signal
    container IoHwAbGeneral  # This container contains common description for the IO Hardware Abstraction module
      boolean IoHwAbDevErrorDetect  # Switches the Development Error Detection and Notification ON or OFF
      boolean IoHwAbVersionInfoApi  # Pre-processor switch to enable / disable the API to read out the modules version information.
  module definition IpduM [0..1]: variants link-time/post-build/pre-compile  # Configuration of the IpduM (Ipdu Multiplexer) module.
    container IpduMConfig: multiple-configuration-container=true  # This container contains the sub containers of the IpduM module. The IpduMTxPathway subcontainer includes information about sent I-PDUs. The IpduMRxPathway includes information about received I-PDUs. This container is a MultipleConfigurationContainer, i.e. this container and its sub-containers exist once per configuration set.
      container IpduMRxPathway [0..*]  # Contains the configuration parameters received I-PDUs by the IpduM module.
        container IpduMRxIndication  # Contains the configuration for incoming RxIndication calls.
          enumeration IpduMByteOrder: {BIG_ENDIAN, LITTLE_ENDIAN}, set at link in variant link-time / post-build in variant post-build / pre-compile in variant pre-compile  # This parameter defines the ByteOrder for all IpduMSegments (static and dynamic part) and for the selectorField within the MultiplexedPdu. The absolute position of a segment in the MultiplexedIPdu is determined by the definition of the ByteOrder parameter: If BIG_ENDIAN is specified, the SegmentPosition indicates the bit position of the most significant bit in an IPDU. If LITTLE_ENDIAN is specified, the SegmentPosition indicates the bit position of the least significant bit in an IPDU.
          integer IpduMRxHandleId: set at link in variant link-time / post-build in variant post-build / pre-compile in variant pre-compile, symbolic-name-value=true  # This is the I-PDU ID of the incoming I-PDU. If an incoming RxIndication's I-PDU ID matches this value then it is unpacked according to the specification in this container.
          reference IpduMRxIndicationPduRef: set at link in variant link-time / post-build in variant post-build / pre-compile in variant pre-compile, destination=Pdu  # Reference to the received Pdu representation in the ECU Configuration Description exchange file.
          container IpduMBitField  # This is used to specify a contiguous range of bits within an I-PDU. The range is inclusive.
            integer IpduMEndBit: 0..2031, set at link in variant link-time / post-build in variant post-build / pre-compile in variant pre-compile  # Position of the end bit in the I-PDU.
            integer IpduMStartBit: 0..2031, set at link in variant link-time / post-build in variant post-build / pre-compile in variant pre-compile  # Position of the start bit in the I-PDU.
          container IpduMRxDynamicPart [0..*]  # This container contains the configuration for the dynamic part of incoming RxIndication calls. When an incoming received I-PDU's selector field matches the IpduMRxSelectorValue, the new outgoing I-PDU for the dynamic part is constructed as defined by the segments of this container and sent out with the I-PDU ID referenced by IpduMOutgoingDynamicPduRef. In case no dynamic part shall be extracted from this received I-PDU this container does not exist. This use-case can occur in case a MultiplexedIPdu is received by an ECU which is only interested in the static part of the MultiplexedIPdu.
            integer IpduMRxSelectorValue: 0..255, set at link in variant link-time / post-build in variant post-build / pre-compile in variant pre-compile  # This is the selector value that this container refers to.
            reference IpduMOutgoingDynamicPduRef: set at link in variant link-time / post-build in variant post-build / pre-compile in variant pre-compile, destination=Pdu  # When the new I-PDU is sent out it is sent with this I-PDU ID. Reference to the sent PDU representation in the ECU Configuration Description exchange file.
            container IpduMCopyBitField [1..*]  # Specifies the source bit fields and the destination bit position, so that the bits in the source can be copied to the bits in the destination. Within one I-PDU multiple instances of this container are used to specify the bit fields in that I-PDU. Adjacent bit fields could be merged in order to reduce the number of instances of this container.
              integer IpduMDestinationBit: 0..2031, set at link in variant link-time / post-build in variant post-build / pre-compile in variant pre-compile  # Bit position in an I-PDU of the start of the destination bit field for the copy. The resulting destination field must fit inside the I-PDU.
              container IpduMBitField  # This is used to specify a contiguous range of bits within an I-PDU. The range is inclusive.
                integer IpduMEndBit: 0..2031, set at link in variant link-time / post-build in variant post-build / pre-compile in variant pre-compile  # Position of the end bit in the I-PDU.
                integer IpduMStartBit: 0..2031, set at link in variant link-time / post-build in variant post-build / pre-compile in variant pre-compile  # Position of the start bit in the I-PDU.
          container IpduMRxStaticPart [0..1]  # This container contains the information on how to unpack the static part of an incoming I-PDU.
            reference IpduMOutgoingStaticPduRef: set at link in variant link-time / post-build in variant post-build / pre-compile in variant pre-compile, destination=Pdu  # When the new I-PDU is sent out it is sent with this I-PDU ID. Reference to the sent Pdu representation in the ECU Configuration Description exchange file.
            container IpduMCopyBitField [1..*]  # Specifies the source bit fields and the destination bit position, so that the bits in the source can be copied to the bits in the destination. Within one I-PDU multiple instances of this container are used to specify the bit fields in that I-PDU. Adjacent bit fields could be merged in order to reduce the number of instances of this container.
              integer IpduMDestinationBit: 0..2031, set at link in variant link-time / post-build in variant post-build / pre-compile in variant pre-compile  # Bit position in an I-PDU of the start of the destination bit field for the copy. The resulting destination field must fit inside the I-PDU.
              container IpduMBitField  # This is used to specify a contiguous range of bits within an I-PDU. The range is inclusive.
                integer IpduMEndBit: 0..2031, set at link in variant link-time / post-build in variant post-build / pre-compile in variant pre-compile  # Position of the end bit in the I-PDU.
                integer IpduMStartBit: 0..2031, set at link in variant link-time / post-build in variant post-build / pre-compile in variant pre-compile  # Position of the start bit in the I-PDU.
      container IpduMTxPathway [0..*]  # Contains the configuration parameters transmitted I-PDUs by the IpduM module.
        container IpduMTxConfirmation [0..1]  # A transmit request can be confirmed by the lower layer. This container is used to generate the matching confirmations for the static and dynamic parts of a multiplexed I-PDU. When an I-PDU is transmitted by the IpduM, the selector field value in that PDU needs to be stored in the IpduM so that the confirmation for the correct dynamic part can be generated. This is state internal to the IpduM at run-time. For the purposes of this container and IpduMDynamicTxConfirmation this stored state is called Stored_Selector.
          reference IpduMStaticTxConfirmationIPduRef [0..1]: set at link in variant link-time / post-build in variant post-build / pre-compile in variant pre-compile, destination=Pdu  # This references the I-PDU to use in the TxConfirmation for the static part. This entity does not appear if there is no static part.
          container IpduMDynamicTxConfirmation [1..*]  # The dynamic part of an I-PDU can have more than one I-PDU IDs for confirmations. The correct I-PDU ID for the confirmation is found from the selector field value of a previously transmitted I-PDU. It is assumed that this selector field is stored in some internal value called Stored_Selector. When a transmit confirmation is received the Stored_Selector is used to select an instance of IpduMDynamicTxConfirmation by matching the Stored_Selector with the IpduMSelectorValue.
            integer IpduMSelectorValue: 0..255, set at link in variant link-time / post-build in variant post-build / pre-compile in variant pre-compile  # When the selector field of the confirmed I-PDU matches the value in here then generate a TxConfirmation for the I-PDU referenced by IpduMDynamicTxConfirmIPduRef.
            reference IpduMDynamicTxConfirmIPduRef: set at link in variant link-time / post-build in variant post-build / pre-compile in variant pre-compile, destination=Pdu  # This is the I-PDU ID to use in the outgoing confirmation (confirmation for the COM I-PDU) when an incoming confirmation (for an IpduM I-PDU) is received and matches the stored Stored_Selector.
        container IpduMTxRequest  # This is used to specify the configuration for Transmit requests. There will one instance of this container for each I-PDU that can be requested for transmission (the outgoing I-PDUs) by the IpduM.
          enumeration IpduMByteOrder: {BIG_ENDIAN, LITTLE_ENDIAN}, set at link in variant link-time / post-build in variant post-build / pre-compile in variant pre-compile  # This parameter defines the ByteOrder for all IpduMSegments (static and dynamic part) and for the selectorField within the MultiplexedPdu. The absolute position of a segment in the MultiplexedIPdu is determined by the definition of the ByteOrder parameter: If BIG_ENDIAN is specified, the SegmentPosition indicates the bit position of the most significant bit in an IPDU. If LITTLE_ENDIAN is specified, the SegmentPosition indicates the bit position of the least significant bit in an IPDU.
          integer IpduMIPduUnusedAreasDefault [0..1]: 0..255, set at link in variant link-time / post-build in variant post-build / pre-compile in variant pre-compile  # IpduM module fills not used areas of an I-PDU with this bit-pattern If this attribute is omitted the IpduM module does not fill the I-PDU.
          integer IpduMInitialSelectorValue: 0..255, set at link in variant link-time / post-build in variant post-build / pre-compile in variant pre-compile  # This value is used by the initialization function to set the initial value of the selector field.
          integer IpduMSize: 0..254, set at link in variant link-time / post-build in variant post-build / pre-compile in variant pre-compile  # The size of the I-PDU in bytes. The maximum size is limited by the underlying communication interface. 0-8 for CAN and LIN 0-254 for FlexRay
          float IpduMTxConfirmationTimeout [0..1]: set at link in variant link-time / post-build in variant post-build / pre-compile in variant pre-compile  # This timeout (in seconds) defines the timeout period for monitoring the reception of the TxConfirmation. It is not used when an I-PDU is requested using the trigger transmit API.
          enumeration IpduMTxTriggerMode: {DYNAMIC_PART_TRIGGER, NONE, STATIC_OR_DYNAMIC_PART_TRIGGER, STATIC_PART_TRIGGER}, set at link in variant link-time / post-build in variant post-build / pre-compile in variant pre-compile  # Selects whether to send the multiplexed I-PDU immediately or at some later date.
          reference IpduMOutgoingPduRef: set at link in variant link-time / post-build in variant post-build / pre-compile in variant pre-compile, destination=Pdu  # Reference to the PDU defining the outgoing I-PDU. When the outgoing I-PDU is sent this is the I-PDU ID to give it. It is the IpduM I-PDU ID of the assembled I-PDU.
          container IpduMBitField  # This is used to specify a contiguous range of bits within an I-PDU. The range is inclusive.
            integer IpduMEndBit: 0..2031, set at link in variant link-time / post-build in variant post-build / pre-compile in variant pre-compile  # Position of the end bit in the I-PDU.
            integer IpduMStartBit: 0..2031, set at link in variant link-time / post-build in variant post-build / pre-compile in variant pre-compile  # Position of the start bit in the I-PDU.
          container IpduMTxDynamicPart [1..*]  # Configuration parameters for an instance of a TxRequest call into the IpduM. When a Tx Request with the IpduMTxDynamicHandleId is received by the IpduM, the bit fields in the incoming I-PDU are packed into the outgoing I-PDU buffer and then the send mode honored. This container is used by the dynamic part of a TxRequest configuration. Therefore, for each outgoing I-PDU there will be one instance of this container for the dynamic part.
            boolean IpduMJitUpdate [0..1]: set at link in variant link-time / post-build in variant post-build / pre-compile in variant pre-compile, default-value=false  # If configured to true fetch the data of this part Just-In-Time via the triggerTransmit API of the PduR.
            integer IpduMTxDynamicHandleId: set at link in variant link-time / post-build in variant post-build / pre-compile in variant pre-compile, symbolic-name-value=true  # This is an incoming handle id. When the handle of an incoming Tx Request matches this, the bits fields (see IpduM_CopyBitField) are copied and the IpduMTxTriggerMode is honored.
            reference IpduMTxDynamicPduRef: set at link in variant link-time / post-build in variant post-build / pre-compile in variant pre-compile, destination=Pdu  # Reference to the Pdu representation in the ECU Configuration Description exchange file to be transmitted.
            container IpduMCopyBitField [1..*]  # Specifies the source bit fields and the destination bit position, so that the bits in the source can be copied to the bits in the destination. Within one I-PDU multiple instances of this container are used to specify the bit fields in that I-PDU. Adjacent bit fields could be merged in order to reduce the number of instances of this container.
              integer IpduMDestinationBit: 0..2031, set at link in variant link-time / post-build in variant post-build / pre-compile in variant pre-compile  # Bit position in an I-PDU of the start of the destination bit field for the copy. The resulting destination field must fit inside the I-PDU.
              container IpduMBitField  # This is used to specify a contiguous range of bits within an I-PDU. The range is inclusive.
                integer IpduMEndBit: 0..2031, set at link in variant link-time / post-build in variant post-build / pre-compile in variant pre-compile  # Position of the end bit in the I-PDU.
                integer IpduMStartBit: 0..2031, set at link in variant link-time / post-build in variant post-build / pre-compile in variant pre-compile  # Position of the start bit in the I-PDU.
          container IpduMTxStaticPart [0..1]  # Configuration parameters for an instance of a Tx_Request call into the IpduM. When a Tx Request with the IpduMTxStaticHandleId is received by the IpduM, the bit fields in the incoming I-PDU are packed into the outgoing I-PDU buffer and then the send mode honored. This container is used for the static part of a TxRequest configuration. Therefore, for each outgoing I-PDU there will be one instance of this container for the static part if it exists.
            boolean IpduMJitUpdate [0..1]: set at link in variant link-time / post-build in variant post-build / pre-compile in variant pre-compile, default-value=false  # If configured to true fetch the data of this part Just-In-Time via the triggerTransmit API of the PduR.
            integer IpduMTxStaticHandleId: set at link in variant link-time / post-build in variant post-build / pre-compile in variant pre-compile, symbolic-name-value=true  # This is an incoming handle id. When the handle of an incoming Tx Request matches this, the bits fields (see IpduMCopyBitField) are copied and the IpduMTxTriggerMode is honored.
            reference IpduMTxStaticPduRef: set at link in variant link-time / post-build in variant post-build / pre-compile in variant pre-compile, destination=Pdu  # Reference to the Pdu representation in the ECU Configuration Description exchange file to be transmitted.
            container IpduMCopyBitField [1..*]  # Specifies the source bit fields and the destination bit position, so that the bits in the source can be copied to the bits in the destination. Within one I-PDU multiple instances of this container are used to specify the bit fields in that I-PDU. Adjacent bit fields could be merged in order to reduce the number of instances of this container.
              integer IpduMDestinationBit: 0..2031, set at link in variant link-time / post-build in variant post-build / pre-compile in variant pre-compile  # Bit position in an I-PDU of the start of the destination bit field for the copy. The resulting destination field must fit inside the I-PDU.
              container IpduMBitField  # This is used to specify a contiguous range of bits within an I-PDU. The range is inclusive.
                integer IpduMEndBit: 0..2031, set at link in variant link-time / post-build in variant post-build / pre-compile in variant pre-compile  # Position of the end bit in the I-PDU.
                integer IpduMStartBit: 0..2031, set at link in variant link-time / post-build in variant post-build / pre-compile in variant pre-compile  # Position of the start bit in the I-PDU.
    container IpduMGeneral  # Contains the general configuration parameters of IpduM.
      float IpduMConfigurationTimeBase: set at pre-compile  # The period between successive ticks of AUTOSAR COM in seconds.
      boolean IpduMDevErrorDetect: set at pre-compile  # Active/Deactivate the detection of development errors, for production code this parameter has to be False. True: error detection activated False: error detection deactivated
      boolean IpduMStaticPartExists: set at pre-compile  # This is to allow optimizations in the case the IpduM will never be used with a static part. Note that this is a pre-compile option. If this is set to False then it will not be possible to add static parts after compilation. True: A static part may exist. False: A static part will never exist.
      boolean IpduMVersionInfoApi: set at pre-compile  # Active/Deactivate the version information API. true: version information activated false: version information deactivated
  module definition Lin [0..*]: variants post-build/pre-compile  # Configuration of the Lin (LIN driver) module.
    container LinGeneral
      boolean LinDevErrorDetect: set at pre-compile  # Switches the Development Error Detection and Notification ON or OFF.
      integer LinIndex: set at pre-compile  # Specifies the InstanceId of this module instance. If only one instance is present it shall have the Id 0.
      integer LinTimeoutDuration: set at pre-compile  # Specifies the maximum number of loops for blocking function until a timeout is raised in short term wait loops
      boolean LinVersionInfoApi: set at pre-compile  # Switches the Lin_GetVersionInfo function ON or OFF.
    container LinGlobalConfig: multiple-configuration-container=true  # This container contains the global configuration parameter of the Lin driver. This container is a MultipleConfigurationContainer, i.e. this container and its sub-containers exit once per configuration set.
      container LinChannel [1..*]  # This container contains the configuration (parameters) of the LIN Controller(s).
        integer LinChannelBaudRate: 1000..20000, set at post-build in variant post-build / pre-compile in variant pre-compile  # Specifies the baud rate of the LIN channel
        integer LinChannelId: set at pre-compile, symbolic-name-value=true  # Identifies the LIN channel. Replaces LIN_CHANNEL_INDEX_NAME from the LIN SWS.
        boolean LinChannelWakeUpSupport: set at pre-compile  # Specifies if the LIN hardware channel supports wake up functionality
        reference LinClockRef: set at post-build in variant post-build / pre-compile in variant pre-compile, destination=McuClockReferencePoint  # Reference to the LIN clock source configuration, which is set in the MCU driver configuration.
        symbolic name reference LinChannelEcuMWakeUpSource [0..1]: destination=EcuMWakeupSource  # This parameter contains a reference to the Wakeup Source for this controller as defined in the ECU State Manager. Implementation Type: reference to EcuM_WakeupSourceType
  module definition LinIf [0..1]: variants link-time/post-build/pre-compile  # Configuration of the LinIf (LIN Interface) module.
    container LinIfGeneral
      boolean LinIfDevErrorDetect: set at pre-compile  # Switches the Development Error Detection and Notification ON or OFF.
      boolean LinIfMultipleDriversSupported: set at pre-compile  # States if multiple drivers are included in the LIN Interface or not. The reason for this parameter is to reduce the size of LIN Interface if multiple drivers are not used.
      boolean LinIfNcOptionalRequestSupported: set at pre-compile  # States if the node configuration commands Assign NAD and Conditional Change NAD are supported.
      boolean LinIfTpSupported: set at pre-compile  # States if the TP is included in the LIN Interface or not. The reason for this parameter is to reduce the size of LIN Interface if the TP is not used.
      boolean LinIfVersionInfoApi: set at pre-compile  # Switches the LinIf_GetVersionInfo function ON or OFF.
    container LinIfGlobalConfig: multiple-configuration-container=true  # This container contains the global configuration parameter of the LinIf. It is a MultipleConfigurationContainer, i.e. this container and its sub-containers exit once per configuration set.
      float LinIfTimeBase: set at link in variant link-time / post-build in variant post-build / pre-compile in variant pre-compile  # Defines the interval of calls to main functions in seconds.
      container LinIfChannel [1..*]
        integer LinIfChannelId: set at link in variant link-time+post-build / pre-compile in variant pre-compile, symbolic-name-value=true  # Internal ID for the channel on LIN Interface level. This parameter shall map the NetworkHandleType to the physical LIN channel. Implementation Type: NetworkHandleType
        enumeration LinIfGotoSleepConfirmationUL: {CDD, LIN_SM}, set at link in variant link-time / post-build in variant post-build / pre-compile in variant pre-compile  # This parameter defines the upper layer (UL) module to which the confirmation of the goto-sleep command shall be sent.
        enumeration LinIfScheduleRequestConfirmationUL: {CDD, LIN_SM}, set at link in variant link-time / post-build in variant post-build / pre-compile in variant pre-compile  # This parameter defines the upper layer (UL) module to which the confirmation of the successfully performed schedule table change shall be sent.
        integer LinIfScheduleRequestQueueLength: 1..255, set at link in variant link-time / post-build in variant post-build / pre-compile in variant pre-compile  # Number of schedule requests the schedule table manager can handle for this channel.
        enumeration LinIfWakeupConfirmationUL: {CDD, LIN_SM}, set at link in variant link-time / post-build in variant post-build / pre-compile in variant pre-compile  # This parameter defines the upper layer (UL) module to which the confirmation of the wake-up shall be sent.
        foreign reference LinIfCddRef [0..1]: set at pre-compile, destination-type=MODULE-CONFIGURATION  # Reference to the CDD module description. This parameter is only required when LinIfWakeupConfirmationUL, LinIfScheduleRequestConfirmationUL, and/or LinIfGotoSleepConfirmationUL is set to CDD.
        symbolic name reference LinIfChannelRef: destination=LinChannel  # Reference to the used channel in Lin. Replaces LINIF_CHANNEL_INDEX
        container LinIfFrame [0..*]  # Generic container for all types of LIN frames.
          enumeration LinIfChecksumType: {CLASSIC, ENHANCED}, set at link in variant link-time / post-build in variant post-build / pre-compile in variant pre-compile  # Type of checksum that the frame is using.
          string LinIfFrameName [0..1]: set at link in variant link-time / post-build in variant post-build / pre-compile in variant pre-compile  # Optional frame name used to cross-reference with a LDF
          integer LinIfFramePriority: 0..255, set at link in variant link-time / post-build in variant post-build / pre-compile in variant pre-compile  # Priority of an unconditional frame if used as a sporadic frame or in case of collision resolving of event triggered frames
          enumeration LinIfFrameType: {ASSIGN, ASSIGN_NAD, CONDITIONAL, EVENT_TRIGGERED, FREE, MRF, SPORADIC, SRF, UNASSIGN, UNCONDITIONAL}, set at link in variant link-time / post-build in variant post-build / pre-compile in variant pre-compile  # Type of frame that is described (e.g. sporadic frame). The sporadic slot is not found among the frame types. A sporadic slot is a set of sporadic frames.
          integer LinIfLength: 1..8, set at link in variant link-time / post-build in variant post-build / pre-compile in variant pre-compile  # Length of the LIN SDU in bytes.
          integer LinIfPid: 0.., set at link in variant link-time / post-build in variant post-build / pre-compile in variant pre-compile  # Protected ID of the LIN frame. There is no reason to calculate the Parity in run-time.
          integer LinIfTxTargetPduId: set at link in variant link-time / post-build in variant post-build / pre-compile in variant pre-compile  # Identifier of the frame for the upper layer
          container LinIfFixedFrameSdu [0..1]  # In case this is a fixed frame this is the SDU (response). This value should represent an eight byte array. The Byte order shall be MSB first.
            container LinIfFixedFrameSduByte [8..8]  # This container represents a byte within the 8 byte array.
              integer LinIfFixedFrameSduBytePos: 0..7, set at link in variant link-time / post-build in variant post-build / pre-compile in variant pre-compile  # Index of the Byte in the SDU (response) 8 byte array.
              integer LinIfFixedFrameSduByteVal: 0..255, set at link in variant link-time / post-build in variant post-build / pre-compile in variant pre-compile  # Byte value in the SDU (response) 8-byte array.
          choice container LinIfPduDirection  # Direction of the frame
            container LinIfInternalPdu [0..1]  # Represents a Diagnostic or Configuration frame : no Message ID (no PduId).
            container LinIfRxPdu [0..1]  # represents a received PDU/frame
              function name LinIfRxIndicationUL [0..1]: set at link in variant link-time / post-build in variant post-build / pre-compile in variant pre-compile  # This parameter defines the name of the <User_RxIndication>. This parameter depends on the parameter LinIfUserRxIndicationUL. If LinIfUserRxIndicationUL equals PDUR, the name of the <User_RxIndication> is fixed. If LinIfUserRxIndicationUL equals CDD, the name of the <User_RxIndication> is selectable.
              integer LinIfRxPduId: set at link in variant link-time / post-build in variant post-build / pre-compile in variant pre-compile, symbolic-name-value=true  # Identifier of the frame for the LIN Interface
              enumeration LinIfUserRxIndicationUL: {CDD, PDUR}, set at link in variant link-time / post-build in variant post-build / pre-compile in variant pre-compile  # This parameter defines the upper layer (UL) module to which the indication of the successfully received LINRXPDUID has to be routed via <User_RxIndication>. This <User_RxIndication> has to be invoked when the indication of the configured LINRXPDUID will be received by a Rx indication event from the LIN Driver module.
              reference LinIfRxPduRef: set at link in variant link-time / post-build in variant post-build / pre-compile in variant pre-compile, destination=Pdu  # Reference to the PDU that is received in this frame.
            container LinIfSlaveToSlavePdu [0..1]  # represents a slave-to-slave PDU/frame. Master does only send the header but doesn't receive the response.
            container LinIfTxPdu [0..1]  # represents a transmitted PDU/frame
              function name LinIfTxConfirmationUL [0..1]: set at link in variant link-time / post-build in variant post-build / pre-compile in variant pre-compile  # This parameter defines the name of the <User_TxConfirmation>. This parameter depends on the parameter LinIfUserTxUL. If LinIfUserTxUL equals PDUR, the name of the <User_TxConfirmation> is fixed. If LinIfUserTxUL equals CDD, the name of the <User_TxConfirmation> is selectable.
              integer LinIfTxPduId: set at link in variant link-time / post-build in variant post-build / pre-compile in variant pre-compile, symbolic-name-value=true  # Identifier of the frame for the upper layer. This id is only relevant for sporadic frames.
              function name LinIfTxTriggerTransmitUL [0..1]: set at link in variant link-time / post-build in variant post-build / pre-compile in variant pre-compile  # This parameter defines the name of the <User_TriggerTransmit>. This parameter depends on the parameter LinIfUserTxUL. If LinIfUserTxUL equals PDUR, the name of the <User_TriggerTransmit> is fixed. If LinIfUserTxUL equals CDD, the name of the <User_TriggerTransmit> is selectable.
              enumeration LinIfUserTxUL: {CDD, PDUR}, set at link in variant link-time / post-build in variant post-build / pre-compile in variant pre-compile  # This parameter defines the upper layer (UL) module to which the trigger of the transmitted LinTxPdu (via the <User_TriggerTransmit>) or the confirmation of the successfully transmitted LinTxPdu has to be routed (via the <User_TxConfirmation>).
              reference LinIfTxPduRef: set at link in variant link-time / post-build in variant post-build / pre-compile in variant pre-compile, destination=Pdu  # Reference to the PDU that is transmitted in this frame.
          container LinIfSubstitutionFrames [0..*]  # List of unconditional Frames that can be sent in an event-triggered Frame or a sporadic Frame slot.
            reference LinIfSubstitutionFrameRef: set at link in variant link-time / post-build in variant post-build / pre-compile in variant pre-compile, destination=LinIfFrame  # Reference to an unconditional Frame that can be sent in an event-triggered Frame or a sporadic Frame slot.
        container LinIfMaster  # Each Master can only be connected to one physical channel. This could be compared to the Node parameter in a LDF file.
          float LinIfJitter: set at pre-compile  # The jitter specifies the differences between the maximum and minimum delay from time base tick to the header sending start point in seconds.
        container LinIfScheduleTable [1..*]  # Describes a schedule table. Each LinIfChannel may have several schedule tables. Each schedule table can only be connected to one channel.
          enumeration LinIfResumePosition: {CONTINUE_AT_IT_POINT, START_FROM_BEGINNING}, set at link in variant link-time / post-build in variant post-build / pre-compile in variant pre-compile  # Defines, where a schedule table shall be proceeded in case it has been interrupted by a RUN_ONCE table or MRF/SRF.
          enumeration LinIfRunMode: {RUN_CONTINUOUS, RUN_ONCE}, set at link in variant link-time / post-build in variant post-build / pre-compile in variant pre-compile  # The schedule table can be executed in two different modes.
          integer LinIfSchedulePriority: 0..255, set at link in variant link-time / post-build in variant post-build / pre-compile in variant pre-compile  # Priority of the schedule table. The priority is used in the schedule table manager. The RUN_ONCE run mode schedules shall not have equal priority. 0 Reserved for NULL_SCHEDULE 1..254 Only for RUN_ONCE 255 Only RUN_CONTINUOUS
          integer LinIfScheduleTableIndex: set at link in variant link-time / post-build in variant post-build / pre-compile in variant pre-compile, symbolic-name-value=true  # This is the unique index used by upper layers to identify a schedule. Note that the NULL_SCHEDULE for each channel has index 0.
          string LinIfScheduleTableName [0..1]: set at link in variant link-time / post-build in variant post-build / pre-compile in variant pre-compile  # Optional schedule name used to cross-reference with a LDF. This parameter shall always be accompanied by LINIF_SCHEDULE_INDEX
          container LinIfEntry [0..*]  # Describes an entry in the schedule table (also known as Frame Slot).
            float LinIfDelay: set at link in variant link-time / post-build in variant post-build / pre-compile in variant pre-compile  # Delay to next frame in schedule table in [s]
            integer LinIfEntryIndex: set at link in variant link-time / post-build in variant post-build / pre-compile in variant pre-compile  # Position of the Frame Entry in the Schedule Table.
            reference LinIfFrameRef [1..*]: set at link in variant link-time / post-build in variant post-build / pre-compile in variant pre-compile, destination=LinIfFrame  # Reference to the frames that belong to this schedule table entry.
        container LinIfSlave [0..*]  # The Node attributes of the Slaves are provided with these parameter.
          integer LinIfConfiguredNad: set at pre-compile  # Definition of the initial node address
          integer LinIfFunctionId: set at pre-compile  # LIN function ID
          string LinIfProtocolVersion: set at pre-compile  # Defines the LIN Protocol version which is used by the slave.
          integer LinIfSupplierId: set at pre-compile  # LIN Supplier ID
          integer LinIfVariant: set at pre-compile  # Specifies the Variant ID
          container LinIfNodeComposition  # Generic container that describes the node composition
            string LinIfNodeName: set at pre-compile
  module definition LinSM [0..1]: variants link-time/pre-compile  # Configuration of the Lin State Manager module.
    container LinSMChannel [1..*]: multiple-configuration-container=true  # Describes each LIN channel the LinSM is connected to.
      float LinSMConfirmationTimeout: set at link in variant link-time / pre-compile in variant pre-compile  # Timeout in seconds for the goto sleep and wakeup calls to LinIf. The timeout must be longer than a goto-sleep command on the bus (i.e. it is bit rate dependent).
      boolean LinSMSleepSupport: set at link in variant link-time / pre-compile in variant pre-compile  # Some LIN clusters does not need sleep, they will just shut off. This parameter will affect the behavior to achieve the no communication state. True - The LinSM will request the LinIf to send the goto sleep command before going to no communication state LINSM_NOCOM. False - The LinSM will directly go to no communication state LINSM_NOCOM.
      symbolic name reference LinSMChannelIndex: destination=LinIfChannel  # Index of the controller. To be able to interface to the correct hw.
      container LinSMSchedule [1..*]  # The schedule references to a schedule that is located in the LinIf configuration. Moreover, the PDU groups are located in the COM configuration. Note that there are two references to PDU groups. The simple reason is that a PDU group is only allowed to contain one direction (TX or RX).
        symbolic name reference LinSMScheduleIndexRef: destination=LinIfScheduleTable  # Reference to a schedule table in the LinIf configuration
    container LinSMGeneral  # The general parameters fo this module.
      boolean LinSMDevErrorDetect: set at pre-compile  # Switches the Development Error Detection and Notification ON or OFF.
      boolean LinSMVersionInfoApi: set at pre-compile  # Switches the LinSM_GetVersionInfo function ON or OFF.
  module definition LinTp [0..1]: variants link-time/post-build/pre-compile  # Singleton descriptor for the LIN Transport Protocol.
    container LinTpGeneral  # Container that holds all LIN transport protocol general parameters.
      boolean LinTpVersionInfoApi: set at pre-compile  # Switches the LinTp_GetVersionInfo function ON or OFF.
    container LinTpGlobalConfig: multiple-configuration-container=true  # This container contains the global configuration parameter of the LinTp. It is a MultipleConfigurationContainer, i.e. this container and its sub-containers exit once per configuration set.
      integer LinTpMaxNumberOfRespPendingFrames: set at link in variant link-time / post-build in variant post-build / pre-compile in variant pre-compile  # Configures the maximum number of allowed response pending frames.
      integer LinTpNumberOfRxNSdu [0..1]: set at link in variant link-time / post-build in variant post-build / pre-compile in variant pre-compile  # Number of transport protocol messages that can be received for all channels this node is connected to. Please note that this parameter is deprecated and will be removed in the next major version. The value of this parameter can be calculated from the multiplicity of the container LinTpRxNSdu.
      integer LinTpNumberOfTxNSdu [0..1]: set at link in variant link-time / post-build in variant post-build / pre-compile in variant pre-compile  # Number of transport protocol messages that can be transmitted for all channels this node is connected to. Please note that this parameter is deprecated and will be removed in the next major version. The value of this parameter can be calculated from the multiplicity of the container LinTpTxNSdu.
      float LinTpP2Max: 0..5, set at link in variant link-time / post-build in variant post-build / pre-compile in variant pre-compile  # P2 Timeout when a response pending frame is expected in seconds.
      float LinTpP2Timing: 0..5, set at link in variant link-time / post-build in variant post-build / pre-compile in variant pre-compile  # Definition of the P2 timeout observation parameter in seconds.
      container LinTpChannelConfig  # This container contains the channel specific configuration parameter of LinTp.
        boolean LinTpDropNotRequestedNad: set at link in variant link-time / post-build in variant post-build / pre-compile in variant pre-compile, default-value=true  # Configures if TP Frames of not requested LIN-Slaves are dropped or not. TRUE: Drop TP frames of not requested LIN-Slaves. FALSE: Keep TP frames of not requested LIN-Slaves.
        boolean LinTpScheduleChangeDiag: set at link in variant link-time / post-build in variant post-build / pre-compile in variant pre-compile, default-value=false  # Enables or disables the call of BswM_LinTp_RequestMode() to diagnostic request/response schedule.
        symbolic name reference LinTpChannelRef: destination=LinIfChannel  # Index of the channel this LinTp channel belongs to.
      container LinTpRxNSdu [0..*]  # For each received N-SDU on any channel the node is connected to.
        integer LinTpDl: set at link in variant link-time / post-build in variant post-build / pre-compile in variant pre-compile  # Data Length Code of this RxNsdu. In case of variable length message, this value indicates the minimum data length. Range of minimum length is 1 to 4095. Note that this is not relevant for Tx. The reason for this is to have identical structures for Tx and Rx.
        integer LinTpRxNSduId: set at link in variant link-time / post-build in variant post-build / pre-compile in variant pre-compile, symbolic-name-value=true  # The identifier of the Transport Protocol message. This ID will be the one that is communicated with upper layers.
        integer LinTpRxNSduNad: set at link in variant link-time / post-build in variant post-build / pre-compile in variant pre-compile  # A N-SDU transported on LIN is identified using the NAD for the specific slave.
        reference LinTpRxNSduPduRef: set at link in variant link-time / post-build in variant post-build / pre-compile in variant pre-compile, destination=Pdu  # Reference to the global PDU
        symbolic name reference LinTpRxNSduChannelRef: destination=LinIfChannel  # Index of the channel this N-SDU belongs to.
      container LinTpTxNSdu [0..*]  # For each transmitted N-SDU on any channel the node is connected to.
        integer LinTpTxNSduId: set at link in variant link-time / post-build in variant post-build / pre-compile in variant pre-compile, symbolic-name-value=true  # The identifier of the Transport Protocol message. This ID will be the one that is communicated with upper layers.
        integer LinTpTxNSduNad: set at link in variant link-time / post-build in variant post-build / pre-compile in variant pre-compile  # A N-SDU transported on LIN is identified using the NAD for the specific slave.
        reference LinTpTxNSduPduRef: set at link in variant link-time / post-build in variant post-build / pre-compile in variant pre-compile, destination=Pdu  # Reference to the global PDU
        symbolic name reference LinTpTxNSduChannelRef: destination=LinIfChannel  # Index of the channel this N-SDU belongs to.
  module definition Mcu [0..1]: variants post-build/pre-compile  # Configuration of the Mcu (Microcontroler Unit) module.
    container McuGeneralConfiguration  # This container contains the configuration (parameters) of the MCU driver.
      boolean McuDevErrorDetect: set at pre-compile  # Pre-processor switch for enabling the development error detection and reporting.
      boolean McuPerformResetApi: set at pre-compile  # Pre-processor switch to enable / disable the use of the function Mcu_PerformReset()
      boolean McuVersionInfoApi: set at pre-compile  # Pre-processor switch to enable / disable the API to read out the modules version information.
    container McuModuleConfiguration: multiple-configuration-container=true  # This container contains the configuration (parameters) of the MCU driver
      enumeration McuClockSrcFailureNotification: {DISABLED, ENABLED}, set at post-build in variant post-build / pre-compile in variant pre-compile  # Enables/Disables clock failure notification. In case this feature is not supported by HW the setting should be disabled.
      derived integer McuNumberOfMcuModes: calculation-formula=number of configured mcumodesettingconf, calculation-language=INFORMAL  # This parameter shall represent the number of Modes available for the MCU. calculationFormula = Number of configured McuModeSettingConf
      derived integer McuRamSectors: set at post-build in variant post-build / pre-compile in variant pre-compile, calculation-formula=number of configured mcuramsectorsettingconf, calculation-language=INFORMAL  # This parameter shall represent the number of RAM sectors available for the MCU. calculationFormula = Number of configured McuRamSectorSettingConf
      integer McuResetSetting [0..1]: set at pre-compile  # This parameter relates to the MCU specific reset configuration. This applies to the function Mcu_PerformReset, which performs a microcontroller reset using the hardware feature of the microcontroller.
      container McuClockSettingConfig [1..*]  # This container contains the configuration (parameters) for the Clock settings of the MCU. Please see MCU031 for more information on the MCU clock settings.
        container McuClockReferencePoint [1..*]  # This container defines a reference point in the Mcu Clock tree. It defines the frequency which then can be used by other modules as an input value. Lower multiplictiy is 1, as even in the simpliest case (only one frequency is used), there is one frequency to be defined.
          float McuClockReferencePointFrequency: set at post-build in variant post-build / pre-compile in variant pre-compile  # This is the frequency for the specific instance of the McuClockReferencePoint container. It shall be givn in Hz.
      container McuModeSettingConf [1..*]  # This container contains the configuration (parameters) for the Mode setting of the MCU. Please see MCU035 for more information on the MCU mode settings.
        integer McuMode: set at post-build in variant post-build / pre-compile in variant pre-compile, symbolic-name-value=true  # The parameter represents the MCU Mode settings.
      container McuRamSectorSettingConf [0..*]  # This container contains the configuration (parameters) for the RAM Sector setting. Please see MCU030 for more information on RAM sec-tor settings.
        integer McuRamDefaultValue: set at post-build in variant post-build / pre-compile in variant pre-compile  # This parameter shall represent the Data pre-setting to be initialized
        integer McuRamSectionBaseAddress: set at post-build in variant post-build / pre-compile in variant pre-compile  # This parameter shall represent the MCU RAM section base address
        integer McuRamSectionSize: set at post-build in variant post-build / pre-compile in variant pre-compile  # This parameter shall represent the MCU RAM Section size
  module definition MemIf [0..1]: variants pre-compile  # Configuration of the MemIf (Memory Abstraction Interface) module.
    container MemIfGeneral  # Configuration of the memory abstraction interface (Memif) module.
      boolean MemIfDevErrorDetect: set at pre-compile  # Pre-processor switch to enable and disable development error detection. true: Development error detection enabled. false: Development error detection disabled.
      derived integer MemIfNumberOfDevices: 1..255, set at pre-compile  # Concrete number of underlying memory abstraction modules.
      boolean MemIfVersionInfoApi: set at pre-compile  # Pre-processor switch to enable / disable the API to read out the modules version information. true: Version info API enabled. false: Version info API disabled.
  module definition Nm [0..1]: variants pre-compile  # The Generic Network Management Interface module
    container NmGlobalConfig  # This container contains all global configuration parameters of the Nm Interface.
      integer NmAutosarGatewayRounds: set at pre-compile  # Number of rounds the coordinator shall keep a bus which runs AUTOSAR NM awake after all nodes including itself are ready to sleep.
      boolean NmBusSynchronizationEnabled: set at pre-compile  # Pre-processor switch for enabling bus synchronization support. This feature is required for gateway nodes only. true: Enabled false:Disabled
      function name NmCarWakeUpCallback [0..1]: set at pre-compile  # Name of the callback function to be called if Nm_CarWakeUpIndication() is called.
      boolean NmCarWakeUpRxEnabled: set at pre-compile, default-value=false  # Enables or disables CWU detection. FALSE - CarWakeUp not supported TRUE - CarWakeUp supported
      boolean NmComControlEnabled: set at pre-compile  # Pre-processor switch for enabling the Communication Control support.
      boolean NmComUserDataSupport: set at pre-compile, default-value=false  # Enable/Disable setting of NMUserData via SW-C. If NmComUserDataSupport is enabled the API Nm_SetUserData shall not be available.
      boolean NmCoordinatorSupportEnabled: set at pre-compile, default-value=false  # Switch to inform if NM coordinator needs to be supported.
      integer NmCoordinatorSyncPrio [0..1]: 1..3, set at pre-compile  # Priority of the coordinator
      boolean NmCoordinatorSyncSupport: set at pre-compile  # Pre-processor switch for enabling the synchronisation of multiple coordinators.
      float NmCycletimeMainFunction [0..1]: set at pre-compile  # The period between successive calls to the Main Function of the NM Interface in seconds.
      boolean NmDevErrorDetect: set at pre-compile, default-value=false  # Pre-processor switch for enabling development error detection and notification.
      float NmGlobalCoordinatorTime [0..1]: 0.., set at pre-compile  # This parameter defines the maximum shutdown time of a connected and coordinated NM-Cluster. Note:This includes nested connections.
      boolean NmNodeDetectionEnabled: set at pre-compile  # Pre-processor switch for enabling the Request Repeat Message Request support.
      boolean NmNodeIdEnabled: set at pre-compile  # Pre-processor switch for enabling the source node identifier.
      integer NmNumberOfChannels: 1..255, set at pre-compile  # Number of NM channels allowed within one ECU.
      integer NmOsekGatewayRounds: set at pre-compile  # Number of rounds the coordinator shall keep a bus which runs OSEK NM awake after all nodes including itself are ready to sleep.
      boolean NmOsekSupportEnabled: set at pre-compile, default-value=false  # Switch to inform if NM coordinator needs to support direct OSEK NM.
      boolean NmPassiveModeEnabled: set at pre-compile  # Pre-processor switch for enabling support of the Passive Mode.
      boolean NmPduRxIndicationEnabled: set at pre-compile  # Pre-processor switch for enabling the PDU Rx Indication.
      boolean NmRemoteSleepIndEnabled: set at pre-compile  # Pre-processor switch for enabling remote sleep indication support. This feature is required for gateway nodes only.
      boolean NmStateChangeIndEnabled: set at pre-compile  # Pre-processor switch for enabling the CAN Network Management state change notification.
      boolean NmUserDataEnabled: set at pre-compile  # Pre-processor switch for enabling user data support.
      boolean NmVersionInfoApi: set at pre-compile  # Pre-processor switch for enabling version info API support.
      container NmChannelConfig [1..*]  # This container contains the configuration (parameters) of the bus channel(s). The channel parameter shall be harmonized within the whole communication stack.
        enumeration NmBusType: {NM_BUS_TYPE_CAN, NM_BUS_TYPE_FR, NM_BUS_TYPE_LIN}, set at pre-compile  # Identifies the bus type of the channel. LIN is not yet supported.
        integer NmChannelId: 0..255, set at pre-compile, symbolic-name-value=true  # Channel identification number of the corresponding channel.
        boolean NmSelectiveNmChannel: set at pre-compile, default-value=false  # If this value is set to FALSE the corresponding channel will be coordinated. If this value is set to TRUE the channel will be excluded from coordination.
        boolean NmStateReportEnabled: set at pre-compile  # Specifies if the NMS shall be set for the corresponding network. false: No NMS shall be set true: The NMS shall be set
        symbolic name reference NmComMChannelRef: destination=ComMChannel  # Reference to the corresponding ComM Channel.
        symbolic name reference NmStateReportSignalRef [0..1]: destination=ComSignal  # Reference to the signal for setting the NMS by calling Com_SendSignal for the respective channel.
  module definition NvM [0..1]: variants pre-compile  # Configuration of the NvM (NvRam Manager) module.
    container NvmBlockDescriptor [1..65536]  # Container for a management structure to configure the composition of a given NVRAM Block Management Type. Its multiplicity describes thenumber of configured NVRAM blocks, one block is required to be configured. The NVRAM block descriptors are condensed in the NVRAM block descriptor table.
      string NvMRamBlockHeaderInclude [0..1]: set at pre-compile  # Defines the header file where the owner of the NVRAM block has the declarations of the permanent RAM data block and/or ROM data block (if configured). If no permanent RAM block or ROM block is configured then this configuration parameter shall be ignored.
      enumeration NvmBlockCRCType: {NVM_CRC16, NVM_CRC32}, set at pre-compile  # Defines CRC data width for the NVRAM block. Default: NVM_CRC16, i.e. CRC16 will be used if NVM_BLOCK_USE_CRC==TRUE
      integer NvmBlockJobPriority: 0..255, set at pre-compile  # Defines the job priority for a NVRAM block (0 = Immediate priority).
      enumeration NvmBlockManagementType: {NVM_BLOCK_DATASET, NVM_BLOCK_NATIVE, NVM_BLOCK_REDUNDANT}, set at pre-compile  # Defines the block management type for the NVRAM block.[NVM137]
      boolean NvmBlockUseCrc: set at pre-compile  # Defines CRC usage for the NVRAM block, i.e. memory space for CRC is reserved in RAM and NV memory. true: CRC will be used for this NVRAM block. false: CRC will not be used for this NVRAM block.
      boolean NvmBlockUseSyncMechanism [0..1]: set at pre-compile, default-value=false  # Defines whether an explicit synchronization mechanism with a RAM mirror and callback routines for transferring data to and from NvM module's RAM mirror is used for NV block. true if synchronization mechanism is used, false otherwise.
      boolean NvmBlockWriteProt: set at pre-compile  # Defines an initial write protection of the NV block true: Initial block write protection is enabled. false: Initial block write protection is disabled.
      boolean NvmCalcRamBlockCrc: set at pre-compile  # Defines CRC (re)calculation for the permanent RAM block or blocks configured to support explicit synchronization. true: CRC will be (re)calculated for this permanent RAM block. false: CRC will not be (re)calculated for this permanent RAM block.
      function name NvmInitBlockCallback: set at pre-compile  # Entry address of a block specific callback routine which shall be called if no ROM data is available for initialization of the NVRAM block. If a NULL pointer is configured, no specific callback routine shall be called for initialization of the NVRAM block with default data.
      derived integer NvmNvBlockBaseNumber: set at pre-compile  # Configuration parameter to perform the link between the NVM_NVRAM_BLOCK_IDENTIFIER used by the SW-Cs and the FEE_BLOCK_NUMBER expected by the memory abstraction modules. The parameter relates directly to the FEE_BLOCK_NUMBER or EA_BLOCK_NUMBER with all configured NVM_DATASET_SELECTION_BITS set to zero (ref. to chapter 7.1.2.1). Calculation Formula: "value = TargetBlockReference.[Ea/Fee]BlockConfiguration.[Ea/Fee]BlockNumber"
      integer NvmNvBlockLength: 1..65535, set at pre-compile  # Defines the NV block data length in bytes
      integer NvmNvBlockNum: 1..255, set at pre-compile  # Defines the number of multiple NV blocks in a contiguous area according to the given block management type. 1-255 For NVRAM blocks to be configured of block management type NVM_BLOCK_DATASET. The actual range is limited according to NVM148. 1 For NVRAM blocks to be configured of block management type NVM_BLOCK_NATIVE 2 For NVRAM blocks to be configured of block management type NVM_BLOCK_REDUNDANT
      integer NvmNvramBlockIdentifier: 0.., set at pre-compile, symbolic-name-value=true  # Identification of a NVRAM block via a unique block identifier. Implementation Type: NvM_BlockIdType. min = 0 max = 2^(16- NVM_DATASET_SELECTION_BITS)-1 Reserved NVRAM block IDs: 0 -> to derive multi block request results via NvM_GetErrorStatus 1 -> redundant NVRAM block which holds the configuration ID
      derived integer NvmNvramDeviceId: set at pre-compile  # Defines the NVRAM device ID where the NVRAM block is located. Calculation Formula: "value = TargetBlockReference.[Ea/Fee]BlockConfiguration.[Ea/Fee]DeviceIndex"
      string NvmRamBlockDataAddress: set at pre-compile  # Defines the start address of the RAM block data. If a NULL pointer is configured, no permanent RAM data block is available for the selected block management type.
      function name NvmReadRamBlockFromNvCallback [0..1]: set at pre-compile  # Entry address of a block specific callback routine which shall be called in order to let the application copy data from the NvM module's mirror to RAM block. Implementation type: Std_ReturnType E_OK: copy was successful E_NOT_OK: copy was not successful, callback routine to be called again
      boolean NvmResistantToChangedSw: set at pre-compile  # Defines whether a NVRAM block shall be treated resistant to configuration changes or not. If there is no default data available at configuration time then the application shall be responsible for providing the default initialization data. In this case the application has to use NvM_GetErrorStatus()to be able to distinguish between first initialization and corrupted data. true: NVRAM block is resistant to changed software. false: NVRAM block is not resistant to changed software.
      string NvmRomBlockDataAddress: set at pre-compile  # Defines the start address of the ROM block data. If a NULL pointer is configured, no ROM block is available for the selected block management type.
      integer NvmRomBlockNum: set at pre-compile  # Defines the number of multiple ROM blocks in a contiguous area according to the given block management type. 0-255 For NVRAM blocks to be configured of block management type NVM_BLOCK_DATASET. The actual range is limited according to NVM148. 0-1 For NVRAM blocks to be configured of block management type NVM_BLOCK_NATIVE 0-1 For NVRAM blocks to be configured of block management type NVM_BLOCK_REDUNDANT
      boolean NvmSelectBlockForReadall: set at pre-compile  # NVM117: Defines whether a NVRAM block shall be processed during NvM_ReadAll or not. This configuration parameter has influence on those NVRAM blocks which are configured to have a permanent RAM block or NVRAM blocks which are configured to have explicit synchronization mechanism with a RAM mirror and callback routines. NVM245: Blocks of management type NVM_BLOCK_DATASET shall not be loaded automatically upon start-up. Thus the selection of blocks, which belong to block management type NVM_BLOCK_DATASET, shall not be possible for the service NvM_ReadAll. true: NVRAM block shall be processed by NvM_ReadAll false: NVRAM block shall not be processed by NvM_ReadAll
      function name NvmSingleBlockCallback: set at pre-compile  # Entry address of the block specific callback routine which shall be invoked on termination of each asynchronous single block request [NVM113].
      boolean NvmWriteBlockOnce: set at pre-compile  # Defines write protection after first write. The NVRAM manager sets the write protection bit after the NV block was written the first time. This means that some of the NV blocks in the NVRAM should never be erased nor be replaced with the default ROM data after first initialization. [NVM276]. true: Defines write protection after first write is enabled. false: Defines write protection after first write is disabled.
      function name NvmWriteRamBlockToNvCallback [0..1]: set at pre-compile  # Entry address of a block specific callback routine which shall be called in order to let the application copy data from RAM block to NvM module's mirror. Implementation type: Std_ReturnType E_OK: copy was successful E_NOT_OK: copy was not successful, callback routine to be called again
      choice container NvmTargetBlockReference
        container NvmEaRef [0..1]  # EEPROM Abstraction
          symbolic name reference NvmNameOfEaBlock: destination=EaBlockConfiguration  # reference to EaBlock
        container NvmFeeRef [0..1]  # Flash EEPROM Emulation
          symbolic name reference NvmNameOfFeeBlock: destination=FeeBlockConfiguration  # reference to FeeBlock
    container NvmCommon  # Container for common configuration options.
      float NvMMainFunctionPeriod: 1E-7.., set at pre-compile  # Allows to configure the period for the MainFunction (in seconds). Please note that the range shall be greater than 0.
      enumeration NvmApiConfigClass: {NVM_API_CONFIG_CLASS_1, NVM_API_CONFIG_CLASS_2, NVM_API_CONFIG_CLASS_3}, set at pre-compile  # Preprocessor switch to enable some API calls which are related to NVM API configuration classes.
      integer NvmCompiledConfigId: 0..65535, set at pre-compile  # Configuration ID regarding the NV memory layout. This configuration ID shall be published as e.g. a SW-C shall have the possibility to write it to NV memory.
      integer NvmCrcNumOfBytes: 1..65535, set at pre-compile  # If CRC is configured for at least one NVRAM block, this parameter defines the maximum number of bytes which shall be processed within one cycle of job processing.
      integer NvmDatasetSelectionBits: 0..8, set at pre-compile  # Defines the number of least significant bits which shall be used to address a certain dataset of a NVRAM block within the interface to the memory hardware abstraction. 0..8: Number of bits which are used for dataset or redundant block addressing. 0: No dataset or redundant NVRAM blocks are configured at all, no selection bits required. 1: In case of redundant NVRAM blocks are configured, but no dataset NVRAM blocks.
      boolean NvmDevErrorDetect: set at pre-compile  # Pre-processor switch to enable and disable development error detection. true: Development error detection enabled. false: Development error detection disabled.
      boolean NvmDrvModeSwitch: set at pre-compile  # Preprocessor switch to enable switching memory drivers to fast mode during performing NvM_ReadAll and NvM_WriteAll true: Fast mode enabled. false: Fast mode disabled.
      boolean NvmDynamicConfiguration: set at pre-compile  # Preprocessor switch to enable the dynamic configuration management handling by the NvM_ReadAll request. true: Dynamic configuration management handling enabled. false: Dynamic configuration management handling disabled.
      boolean NvmJobPrioritization: set at pre-compile  # Preprocessor switch to enable job prioritization handling true: Job prioritization handling enabled. false: Job prioritization handling disabled.
      integer NvmMaxNoOfWriteRetries: 0..7, set at pre-compile  # Defines the maximum number of write retries for a NVRAM block with [NVM061]. Regardless of configuration a consistency check (and maybe write retries) are always forced for each block which is processed by the request NvM_WriteAll and NvM_WriteBlock.
      function name NvmMultiBlockCallback: set at pre-compile  # Entry address of the common callback routine which shall be invoked on termination of each asynchronous multi block request
      boolean NvmPollingMode: set at pre-compile  # Preprocessor switch to enable/disable the polling mode in the NVRAM Manager and at the same time disable/enable the callback functions useable by lower layers true: Polling mode enabled, callback function usage disabled. false: Polling mode disabled, callback function usage enabled.
      integer NvmRepeatMirrorOperations [0..1]: 0..7, set at pre-compile  # Defines the number of retries to let the application copy data to or from the NvM module's mirror before postponing the current job.
      boolean NvmSetRamBlockStatusApi: set at pre-compile  # Preprocessor switch to enable the API NvM_SetRamBlockStatus. true: API NvM_SetRamBlockStatus enabled. false: API NvM_SetRamBlockStatus disabled.
      integer NvmSizeImmediateJobQueue: 1..65535, set at pre-compile  # Defines the number of queue entries for the immediate priority job queue. If NVM_JOB_PRIORITIZATION is switched OFF this parameter shall be out of scope.
      integer NvmSizeStandardJobQueue: 1..65535, set at pre-compile  # Defines the number of queue entries for the standard job queue.
      boolean NvmVersionInfoApi: set at pre-compile  # Pre-processor switch to enable / disable the API to read out the modules version information [NVM285], [NVM286]. true: Version info API enabled. false: Version info API disabled.
  module definition Os [0..1]: variants pre-compile  # Configuration of the Os (Operating System) module.
    container OsAlarm [0..*]  # An OsAlarm may be used to asynchronously inform or activate a specific task. It is possible to start alarms automatically at system start-up depending on the application mode.
      reference OsAlarmAccessingApplication [0..*]: set at pre-compile, destination=OsApplication  # Reference to applications which have an access to this object.
      reference OsAlarmCounterRef: set at pre-compile, destination=OsCounter  # Reference to the assigned counter for that alarm
      choice container OsAlarmAction  # This container defines which type of notification is used when the alarm expires.
        container OsAlarmActivateTask [0..1]  # This container specifies the parameters to activate a task.
          reference OsAlarmActivateTaskRef: set at pre-compile, destination=OsTask  # Reference to the task that will be activated by that alarm action
        container OsAlarmCallback [0..1]  # This container specifies the parameters to call a callback OS alarm action.
          function name OsAlarmCallbackName: set at pre-compile  # Name of the function that is called when this alarm callback is triggered.
        container OsAlarmIncrementCounter [0..1]  # This container specifies the parameters to increment a counter.
          reference OsAlarmIncrementCounterRef: set at pre-compile, destination=OsCounter  # Reference to the counter that will be incremented by that alarm action
        container OsAlarmSetEvent [0..1]  # This container specifies the parameters to set an event
          reference OsAlarmSetEventRef: set at pre-compile, destination=OsEvent  # Reference to the event that will be set by that alarm action
          reference OsAlarmSetEventTaskRef: set at pre-compile, destination=OsTask  # Reference to the task that will be activated by that event
      container OsAlarmAutostart [0..1]  # If present this container defines if an alarm is started automatically at system start-up depending on the application mode.
        integer OsAlarmAlarmTime: set at pre-compile  # The relative or absolute tick value when the alarm expires for the first time. Note that for an alarm which is RELATIVE the value must be at bigger than 0.
        enumeration OsAlarmAutostartType: {ABSOLUTE, RELATIVE}, set at pre-compile  # This specifies the type of autostart for the alarm..
        integer OsAlarmCycleTime: set at pre-compile  # Cycle time of a cyclic alarm in ticks. If the value is 0 than the alarm is not cyclic.
        reference OsAlarmAppModeRef [1..*]: set at pre-compile, destination=OsAppMode  # Reference to the application modes for which the AUTOSTART shall be performed
    container OsAppMode [1..*]  # OsAppMode is the object used to define OSEK OS properties for an OSEK OS application mode. No standard attributes are defined for AppMode. In a CPU, at least one AppMode object has to be defined. [source: OSEK OIL Spec. 2.5] An OsAppMode called OSDEFAULTAPPMODE must always be there for OSEK compatilbility.
      reference OsAlarmRef [0..*]: set at pre-compile, destination=OsAlarm  # Optional References to autostarted OSAlarms.
      reference OsScheduleTableRef [0..*]: set at pre-compile, destination=OsScheduleTable  # Optional References to autostarted OS Schedule Tables.
      reference OsTaskRef [0..*]: set at pre-compile, destination=OsTask  # Optional References to autosarted Os Tasks.
    container OsApplication [0..*]  # An AUTOSAR OS must be capable of supporting a collection of OS objects (tasks, interrupts, alarms, hooks etc.) that form a cohesive functional unit. This collection of objects is termed an OS-Application. All objects which belong to the same OS-Application have access to each other. Access means to allow to use these objects within API services. Access by other applications can be granted separately.
      boolean OsTrusted: set at pre-compile, default-value=false  # Parameter to specify if an OS-Application is trusted or not. true: OS-Application is trusted false: OS-Application is not trusted (default)
      reference OsAppAlarmRef [0..*]: set at pre-compile, destination=OsAlarm  # Specifies the OsAlarms that belong to the OsApplication.
      reference OsAppCounterRef [0..*]: set at pre-compile, destination=OsCounter  # References the OsCounters that belong to the OsApplication.
      reference OsAppIsrRef [0..*]: set at pre-compile, destination=OsIsr  # references which OsIsrs belong to the OsApplication
      reference OsAppResourceRef [0..*]: set at pre-compile, destination=OsResource  # References the OsResources that belong to the OsApplication.
      reference OsAppScheduleTableRef [0..*]: set at pre-compile, destination=OsScheduleTable  # References the OsScheduleTables that belong to the OsApplication.
      reference OsAppTaskRef [0..*]: set at pre-compile, destination=OsTask  # references which OsTasks belong to the OsApplication
      reference OsRestartTask [0..1]: set at pre-compile, destination=OsTask  # Optionally one task of an OS-Application may be defined as Restart Task. Multiplicity = 1: Restart Task is activated by the Operating System if the protection hook requests it. Multiplicity = 0: No task is automatically started after a protection error happened.
      container OsApplicationHooks  # Container to structure the OS-Application-specific hooks
        boolean OsAppErrorHook: set at pre-compile  # Select the OS-Application error hook. true: Hook is called false: Hook is not called
        boolean OsAppShutdownHook: set at pre-compile  # Select the OS-Application specific shutdown hook for the OS-Application. true: Hook is called false: Hook is not called
        boolean OsAppStartupHook: set at pre-compile  # Select the OS-Application specific startup hook for the OS-Application. true: Hook is called false: Hook is not called
      container OsApplicationTrustedFunction [0..*]  # Container to structure the configration parameters of trusted functions
        function name OsTrustedFunctionName: set at pre-compile  # Trusted function (as part of a trusted OS-Application) available to other OS-Applications. This also supersedes the OSEK OIL attribute TRUSTED in APPLICATION because the optionality of this parameter is describing that already.
    container OsCounter [0..*]  # Configuration information for the counters that belong to the OsApplication.
      integer OsCounterMaxAllowedValue: set at pre-compile  # Maximum possible allowed value of the system counter in ticks.
      integer OsCounterMinCycle: set at pre-compile  # The MINCYCLE attribute specifies the minimum allowed number of counter ticks for a cyclic alarm linked to the counter.
      integer OsCounterTicksPerBase: set at pre-compile  # The TICKSPERBASE attribute specifies the number of ticks required to reach a counterspecific unit. The interpretation is implementation-specific.
      enumeration OsCounterType: {HARDWARE, SOFTWARE}, set at pre-compile  # This parameter contains the natural type or unit of the counter.
      float OsSecondsPerTick [0..1]: set at pre-compile  # Time of one hardware tick in seconds.
      reference OsCounterAccessingApplication [0..*]: set at pre-compile, destination=OsApplication  # Reference to applications which have an access to this object.
      container OsDriver [0..1]  # This Container contains the information who will drive the counter. This configuration is only valid if the counter has OsCounterType set to HARDWARE. If the container does not exist (multiplicity=0) the timer is managed by the OS internally (OSINTERNAL). If the container exists the OS can use the GPT interface to manage the timer. The user have to supply the GPT channel. If the counter is driven by some other (external to the OS) source (like a TPU for example) this must be described as a vendor specific extension.
        reference OsGptChannelRef [0..1]: set at pre-compile, destination=GptChannelConfiguration  # Reference to the GPT channel.
      container OsTimeConstant [0..*]  # Allows the user to define constants which can be e.g. used to compare time values with timer tick values. A time value will be converted to a timer tick value during generation and can later on accessed via the OsConstName. The conversation is done by rounding time values to the nearest fitting tick value.
        string OsConstName: set at pre-compile  # The name which is accessed by the application to get the above OsTimeValue.
        float OsTimeValue: set at pre-compile  # This parameter contains the value of the constant in seconds.
    container OsEvent [0..*]  # Representation of OS events in the configuration context. Adopted from the OSEK OIL specification.
      integer OsEventMask [0..1]: set at pre-compile  # If event mask would be set to AUTO in OIL, this parameter should be omitted here.
    container OsIsr [0..*]  # The OsIsr container represents an OSEK interrupt service routine.
      enumeration OsIsrCategory: {CATEGORY_1, CATEGORY_2}, set at pre-compile  # This attribute specifies the category of this ISR.
      reference OsIsrResourceRef [0..*]: set at pre-compile, destination=OsResource  # This reference defines the resources accessed by this ISR.
      container OsIsrTimingProtection [0..1]  # This container contains all parameters which are related to timing protection If the container exists, the timing protection is used for this interrupt. If the container does not exist, the interrupt is not supervised regarding timing violations.
        float OsIsrAllInterruptLockBudget [0..1]: set at pre-compile  # This parameter contains the maximum time for which the ISR is allowed to lock all interrupts (via SuspendAllInterrupts() or DisableAllInterrupts()) (in seconds).
        float OsIsrExecutionBudget [0..1]: set at pre-compile  # The parameter contains the maximum allowed execution time of the interrupt (in seconds).
        float OsIsrOsInterruptLockBudget [0..1]: set at pre-compile  # This parameter contains the maximum time for which the ISR is allowed to lock all Category 2 interrupts (via SuspendOSInterrupts()) (in seconds).
        float OsIsrTimeFrame [0..1]: set at pre-compile  # This parameter contains the minimum inter-arrival time between successive interrupts (in seconds).
        container OsIsrResourceLock [0..*]  # This parameter contains a list of times the interrupt uses resources.
          float OsIsrResourceLockBudget: set at pre-compile  # This parameter contains the maximum time the interrupt is allowed to hold the given resource (in seconds).
          reference OsIsrResourceLockResourceRef: set at pre-compile, destination=OsResource  # Reference to the resource the locking time is depending on
    container OsOS  # OS is the object used to define OSEK OS properties for an OSEK application. Per CPU exactly one OS object has to be defined.
      enumeration OsScalabilityClass [0..1]: {SC1, SC2, SC3, SC4}, set at pre-compile  # A scalability class for each System Object "OS" has to be selected. In order to customize the operating system to the needs of the user and to take full advantage of the processor features the operating system can be scaled according to the scalability classes. If the scalability class is omitted this translates to the OIL AUTO mechanism.
      boolean OsStackMonitoring: set at pre-compile  # Select stack monitoring of Tasks/Category 2 ISRs true: Stacks are monitored false: Stacks are not monitored
      enumeration OsStatus: {EXTENDED, STANDARD}, set at pre-compile  # The Status attribute specifies whether a system with standard or extended status has to be used. Automatic assigment is not supported for this attribute.
      boolean OsUseGetServiceId: set at pre-compile  # As defined by OSEK
      boolean OsUseParameterAccess: set at pre-compile  # As defined by OSEK
      boolean OsUseResScheduler: set at pre-compile, default-value=true  # The OsUseResScheduler attribute defines whether the resource RES_SCHEDULER is used within the application.
      container OsHooks  # Container to structure all hooks belonging to the OS
        boolean OsErrorHook: set at pre-compile  # Error hook as defined by OSEK true: Hook is called false: Hook is not called
        boolean OsPostTaskHook: set at pre-compile  # Post-task hook as defined by OSEK true: Hook is called false: Hook is not called
        boolean OsPreTaskHook: set at pre-compile  # Pre-task hook as defined by OSEK true: Hook is called false: Hook is not called
        boolean OsProtectionHook [0..1]: set at pre-compile  # Switch to enable/disable the call to the (user supplied) protection hook. true: Protection hook is called on protection error false: Protection hook is not called
        boolean OsShutdownHook: set at pre-compile  # Shutdown hook as defined by OSEK true: Hook is called false: Hook is not called
        boolean OsStartupHook: set at pre-compile  # Startup hook as defined by OSEK true: Hook is called false: Hook is not called
    container OsResource [0..*]  # An OsResource object is used to co-ordinate the concurrent access by tasks and ISRs to a shared resource, e.g. the scheduler, any program sequence, memory or any hardware area.
      enumeration OsResourceProperty: {INTERNAL, LINKED, STANDARD}, set at pre-compile  # This specifies the type of the resource.
      reference OsResourceAccessingApplication [0..*]: set at pre-compile, destination=OsApplication  # Reference to applications which have an access to this object.
      reference OsResourceLinkedResourceRef [0..1]: set at pre-compile, destination=OsResource  # The link to the resource. Must be valid if OsResourceProperty is LINKED. If OsResourceProperty is not LINKED the value is ignored.
    container OsScheduleTable [0..*]  # An OsScheduleTable addresses the synchronization issue by providing an encapsulation of a statically defined set of alarms that cannot be modified at runtime.
      integer OsScheduleTableDuration  # This parameter defines the modulus of the schedule table (in ticks).
      boolean OsScheduleTableRepeating: set at pre-compile  # true: first expiry point on the schedule table shall be processed at final expiry point delay ticks after the final expiry point is processed. false: the schedule table processing stops when the final expiry point is processed.
      reference OsSchTblAccessingApplication [0..*]: set at pre-compile, destination=OsApplication  # Reference to applications which have an access to this object.
      reference OsScheduleTableCounterRef: set at pre-compile, destination=OsCounter  # This parameter contains a reference to the counter which drives the schedule table.
      container OsScheduleTableAutostart [0..1]  # This parameter specifies if and how the schedule table is started on startup of the Operating System. The options to start a schedule table correspond to the API calls to start schedule tables during runtime.
        integer OsScheduleTableAbsValue: set at pre-compile  # Absolute autostart tick value when the schedule table starts. Only used if the OsScheduleTableAutostartType is ABSOLUTE.
        enumeration OsScheduleTableAutostartType: {ABSOLUTE, RELATIVE, SYNCHRON}, set at pre-compile  # This specifies the type of the autostart for the schedule table.
        integer OsScheduleTableRelOffset: set at pre-compile  # Relative offset in ticks when the schedule table starts. Only used if the OsScheduleTableAutostartType is RELATIVE.
        reference OsScheduleTableAppModeRef [1..*]: set at pre-compile, destination=OsAppMode  # Reference in which application modes the schedule table should be started during startup
      container OsScheduleTableExpiryPoint [1..*]  # The point on a Schedule Table at which the OS activates tasks and/or sets events
        integer OsScheduleTblExpPointOffset: set at pre-compile  # The offset from zero (in ticks) at which the expiry point is to be processed.
        container OsScheduleTableEventSetting [0..*]  # Event that is triggered by that schedule table.
          reference OsScheduleTableSetEventRef: set at pre-compile, destination=OsEvent  # Reference to event that will be set by action
          reference OsScheduleTableSetEventTaskRef: set at pre-compile, destination=OsTask
        container OsScheduleTableTaskActivation [0..*]  # Task that is triggered by that schedule table.
          reference OsScheduleTableActivateTaskRef: set at pre-compile, destination=OsTask  # Reference to task that will be activated by action
        container OsScheduleTblAdjustableExpPoint [0..1]  # Adjustable expiry point
          integer OsScheduleTableMaxAdvance: set at pre-compile  # The maximum positive adjustment that can be made to the expiry point offset (in ticks).
          integer OsScheduleTableMaxRetard: set at pre-compile  # The maximum negative adjustment that can be made to the expiry point offset (in ticks).
      container OsScheduleTableSync [0..1]  # This parameter specifies the synchronization parameters of the schedule table.
        integer OsScheduleTblExplicitPrecision [0..1]: set at pre-compile  # This configuration is only valid if the explicit synchronisation is used.
        enumeration OsScheduleTblSyncStrategy: {EXPLICIT, IMPLICIT, NONE}, set at pre-compile, origin=AUTOSAR ECUC, default-value=NONE  # AUTOSAR OS provides support for synchronisation in two ways: explicit and implicit.
    container OsTask [0..*]  # This container represents an OSEK task.
      integer OsTaskActivation: set at pre-compile  # This attribute defines the maximum number of queued activation requests for the task. A value equal to "1" means that at any time only a single activation is permitted for this task. Note that the value must be a natural number starting at 1.
      integer OsTaskPriority: set at pre-compile  # The priority of a task is defined by the value of this attribute. This value has to be understood as a relative value, i.e. the values show only the relative ordering of the tasks. OSEK OS defines the lowest priority as zero (0); larger values correspond to higher priorities.
      enumeration OsTaskSchedule: {FULL, NON}, set at pre-compile  # The OsTaskSchedule attribute defines the preemptability of the task. If this attribute is set to NON, no internal resources may be assigned to this task.
      reference OsTaskAccessingApplication [0..*]: set at pre-compile, destination=OsApplication  # Reference to applications which have an access to this object.
      reference OsTaskEventRef [0..*]: set at pre-compile, destination=OsEvent  # This reference defines the list of events the extended task may react on.
      reference OsTaskResourceRef [0..*]: set at pre-compile, destination=OsResource  # This reference defines a list of resources accessed by this task.
      container OsTaskAutostart [0..1]  # This container determines whether the task is activated during the system start-up procedure or not for some specific application modes. If the task shall be activated during the system start-up, this container is present and holds the references to the application modes in which the task is auto-started.
        reference OsTaskAppModeRef [1..*]: set at pre-compile, destination=OsAppMode  # Reference to application modes in which that task is activated on startup of the OS
      container OsTaskTimingProtection [0..1]  # This parameter contains all parameters regarding timing protection of the task.
        float OsTaskAllInterruptLockBudget [0..1]: set at pre-compile  # This parameter contains the maximum time for which the task is allowed to lock all interrupts (via SuspendAllInterrupts() or DisableAllInterrupts()) (in seconds).
        float OsTaskExecutionBudget [0..1]: set at pre-compile  # This parameter contains the maximum allowed execution time of the task (in seconds).
        float OsTaskOsInterruptLockBudget [0..1]: set at pre-compile  # This parameter contains the maximum time for which the task is allowed to lock all Category 2 interrupts (via SuspendOSInterrupts()) (in seconds).
        float OsTaskTimeFrame [0..1]: set at pre-compile  # The minimum inter-arrival time between activations and/or releases of a task (in seconds).
        container OsTaskResourceLock [0..*]  # This parameter contains the worst case time between getting and releasing a given resource (in seconds).
          float OsTaskResourceLockBudget: set at pre-compile  # This parameter contains the maximum time the task is allowed to lock the resource (in seconds)
          reference OsTaskResourceLockResourceRef: set at pre-compile, destination=OsResource  # Reference to the resource used by the task
  module definition PduR [0..1]: variants post-build/pre-compile  # Configuration of the PduR (PDU Router) module.
    container PduRGeneral  # This container is a subcontainer of PduR and specifies the general configuration parameters of the PDU Router.
      boolean PduRCanIfSupport: set at pre-compile  # Configuration parameter to enable or disable PDU Router support for CAN interface.
      boolean PduRCanTpCancelReceive: set at pre-compile  # Specifies if the Can Transport protocol module supports the CancelReceive API or not. Value true the API is supported.
      boolean PduRCanTpChangeParameterRequestApi: set at pre-compile  # This parameter, if set to true, enables the PduR_CanTpChangeParameterRequest Api for CanTp.
      boolean PduRCanTpSupport: set at pre-compile  # Configuration parameter to enable or disable PDU Router support for CAN TP.
      boolean PduRComSupport: set at pre-compile  # Configuration parameter to enable or disable PDU Router support for COM.
      boolean PduRDcmSupport: set at pre-compile  # Configuration parameter to enable or disable PDU Router support for DCM.
      boolean PduRDevErrorDetect: set at pre-compile  # Switches the Development Error Detection and Notification ON or OFF.
      boolean PduRFifoTxBufferSupport: set at pre-compile  # Configuration parameter to enable or disable PDU Router support for FIFOs as PDU transmit buffers; if PDUR_GATEWAY_OPERATION is disabled, this parameter has to be disabled.
      boolean PduRFrIfSupport: set at pre-compile  # Configuration parameter to enable or disable PDU Router support for FlexRay interface.
      boolean PduRFrTpCancelReceive: set at pre-compile  # Specifies if the Flaxray Transport protocol module supports the CancelReceive API or not. Value true the API is supported.
      boolean PduRFrTpChangeParameterRequestApi: set at pre-compile  # This parameter, if set to true, enables the PduR_FrTpChangeParameterRequest Api for FrTp.
      boolean PduRFrTpSupport: set at pre-compile  # Configuration parameter to enable or disable PDU Router support for FlexRay TP.
      boolean PduRGatewayOperation: set at pre-compile  # Configuration parameter to enable or disable PDU Router gateway operation; if PDUR_ZERO_COST_OPERATION is enabled, this parameter has to be disabled.
      boolean PduRIPduMSupport: set at pre-compile  # Configuration parameter to enable or disable PDU Router support for IPDUM; if PDUR_ZERO_COST_OPERATION is enabled, this parameter has to be disabled.
      boolean PduRLinIfSupport: set at pre-compile  # Configuration parameter to enable or disable PDU Router support for LIN interface.
      boolean PduRLinTpChangeParameterRequestApi: set at pre-compile  # This parameter, if set to true, enables the PduR_LinTpChangeParameterRequest Api for LinTp.
      boolean PduRLinTpSupport: set at pre-compile  # Configuration parameter to enable or disable PDU Router support for LIN TP.
      integer PduRMemorySize: set at pre-compile  # Memory size reserved for PDU Router buffers. Only required for gateway operation.
      enumeration PduRMinimumRoutingLoModule [0..1]: {CAN_IF, CAN_TP, FR_IF, FR_TP, LIN_IF, LIN_TP}, set at link  # Please note that this parameter is deprecated and will be removed in a future release. Minimum routing has been removed from PduR. Old description: Lower layer module to be used for minimum routing; this parameter shall be used if PDUR_ZERO_COST_OPERATION is disabled; otherwise it shall not be used.
      integer PduRMinimumRoutingLoRxPduId [0..1]: 0..65535, set at link  # Please note that this parameter is deprecated and will be removed in a future release. Minimum routing has been removed from PduR. Old description: Receive PDU identifier of the lower layer module which shall be used at the PDU Router interface to the lower layer module specified by PDUR_MINIMUM_ROUTING_LO_MODULE for minimum routing; this parameter shall be used if PDUR_ZERO_COST_OPERATION is disabled; otherwise it shall not be used.
      integer PduRMinimumRoutingLoTxPduId [0..1]: 0..65535, set at link  # Please note that this parameter is deprecated and will be removed in a future release. Minimum routing has been removed from PduR. Old description: Transmit PDU identifier of the lower layer module which shall be used at the PDU Router interface to the lower layer module specified by PDUR_MINIMUM_ROUTING_LO_MODULE for minimum routing; this parameter shall be used if PDUR_ZERO_COST_OPERATION is disabled; otherwise it shall not be used.
      enumeration PduRMinimumRoutingUpModule [0..1]: {COM, DCM}, set at link  # Please note that this parameter is deprecated and will be removed in a future release. Minimum routing has been removed from PduR. Old description: Upper layer module to be used for minimum routing; this parameter shall be used if PDUR_ZERO_COST_OPERATION is disabled; otherwise it shall not be used.
      integer PduRMinimumRoutingUpRxPduId [0..1]: 0..65535, set at link  # Please note that this parameter is deprecated and will be removed in a future release. Minimum routing has been removed from PduR. Old description: Receive PDU identifier of the upper layer module which shall be used at the PDU Router interface to the upper layer module specified by PDUR_MINIMUM_ROUTING_UP_MODULE for minimum routing; this parameter shall be used if PDUR_ZERO_COST_OPERATION is disabled; otherwise it shall not be used.
      integer PduRMinimumRoutingUpTxPduId [0..1]: 0..65535, set at link  # Please note that this parameter is deprecated and will be removed in a future release. Minimum routing has been removed from PduR. Old description: Transmit PDU identifier of the upper layer module which shall be used at the PDU Router interface to the upper layer module specified by PDUR_MINIMUM_ROUTING_UP_MODULE for minimum routing; this parameter shall be used if PDUR_ZERO_COST_OPERATION is disabled; otherwise it shall not be used.
      boolean PduRMulticastFromIfSupport: set at pre-compile  # Configuration parameter to enable or disable PDU Router support for multicasts from an interface module to upper layer modules or lower layer interface modules; if PDUR_ZERO_COST_OPERATION is enabled, this parameter has to be disabled.
      boolean PduRMulticastFromTpSupport: set at pre-compile  # Configuration parameter to enable or disable PDU Router support for multicasts from a TP module to upper layer modules or lower layer TP modules; if PDUR_ZERO_COST_OPERATION is enabled, this parameter has to be disabled.
      boolean PduRMulticastToIfSupport: set at pre-compile  # Configuration parameter to enable or disable PDU Router support for multicasts from an upper layer module to interface modules; if PDUR_ZERO_COST_OPERATION is enabled, this parameter has to be disabled.
      boolean PduRMulticastToTpSupport: set at pre-compile  # Configuration parameter to enable or disable PDU Router support for multicasts from an upper layer module to TP modules; if PDUR_ZERO_COST_OPERATION is enabled, this parameter has to be disabled.
      boolean PduRSbTxBufferSupport: set at pre-compile  # Configuration parameter to enable or disable PDU Router support for single buffers as PDU transmit buffers; if PDUR_GATEWAY_OPERATION is disabled, this parameter has to be disabled.
      enumeration PduRSingleIf [0..1]: {CAN_IF, FR_IF, LIN_IF}, set at pre-compile  # Single interface module in case zero cost operation is enabled (PDUR_ZERO_COST_OPERATION).
      enumeration PduRSingleTp [0..1]: {CAN_TP, FR_TP, LIN_TP}, set at pre-compile  # Single transport protocol module in case zero cost operation is enabled (PDUR_ZERO_COST_OPERATION).
      boolean PduRVersionInfoApi: set at pre-compile  # Activates/Deactivates the Version Info API.
      boolean PduRZeroCostOperation: set at pre-compile  # All routing paths are implicitly defined and the communication modules directly above or below the PDU Router shall directly call each other without using PDU Router functions (zero cost operation). The configuration parameters PDUR_SINGLE_IF and PDUR_SINGLE_TP are used to specify the related lower layer module.
    container PduRGlobalConfig: multiple-configuration-container=true  # This container contains the global configuration parameter of the PduR. It is a MultipleConfigurationContainer, i.e. this container and its sub-containers exit once per configuration set.
      integer PduRConfigurationId [0..1]: set at post-build  # unique configuration identifier of post-build time configuration; this parameter shall be used if PDUR_ZERO_COST_OPERATION is disabled; otherwise it shall not be used.
      container PduRRoutingPathGroup [0..*]  # This container groups routing path destinations. Destinations are used instead of routing paths since a routing path can be 1:n. It is desirable to be able to enable/disable a specific bus (i.e. a destination) rather than a routing path. Of course it is possible to create groups that covers specific routing paths as well. Enabling and disabling of routing path groups are made using the PduR API.
        boolean PduRIsEnabledAtInit: set at pre-compile  # If set to true this routing path group will be enabled after initializing the PDU Router module (i.e. enabled in the PduR_Init function).
        integer PduRRoutingPathGroupId: 0..65535, set at post-build in variant post-build / pre-compile in variant pre-compile, symbolic-name-value=true  # Identification of the routing group. The identification will be used by the disable/enable API in the PDU Router module API.
        reference PduRDestPduRef [1..*]: set at post-build in variant post-build / pre-compile in variant pre-compile, destination=PduRDestPdu  # This reference selects one destination of the routing path.
      container PduRRoutingTable  # PDU Router routing table is a subcontainer ofPduR. This container shall only be considered by the PDU Router Configuration Generator if PduRGeneral/PDUR_ZERO_COST_OPERATION is disabled.
        container PduRRoutingPath [0..*]  # This container is a subcontainer of PduRRoutingTable and specifies the routing path of a PDU.
          integer PduRTpRxBlockSize [0..1]: 1..65535, set at post-build in variant post-build / pre-compile in variant pre-compile  # This parameter defines the block size to be used by the receiving TP module.
          integer SduLength [0..1]: 0..255, set at post-build  # Length of PDU data (SDU). Only required if a TX buffer is configured.
          integer TpChunkSize [0..1]: 1..65535, set at post-build  # Chunk size for routing on the fly. Defines the number of bytes which shall be received before transmission on the destination bus may start. Only required for TP gateway PDUs. The TpChunkSize shall not be larger than the length of the related TP Buffer.
          container PduRDefaultValue [0..1]  # This container is a subcontainer of PduRRoutingPath and specifies the default value of the I-PDU. Only required for gateway operation and if at least one PDU specified by PduRDestPdu uses TriggerTransmit Data provision. Represented as an array of IntegerParamDef.
            container PduRDefaultValueElement [0..*]  # Each value element is represented by the element and the position in an array.
              integer DefaultValueElement [1..*]: 0..255, set at post-build  # The default value consists of a number of elements. Each element is one byte long and the number of elements is specified by SduLength. The position of this parameter in the container is specified by the ElementBytePosition parameter.
              integer ElementBytePosition: set at post-build  # This parameter specifies the byte position of the element within the default value
          container PduRDestPdu [1..*]  # This container is a subcontainer of PduRRoutingPath and specifies one destination for the PDU to be routed.
            enumeration DataProvision [0..1]: {DIRECT, TRIGGER_TRANSMIT}, set at post-build  # Specifies how data are provided: direct (as part of the Transmit call) or via the TriggerTransmit callback function. Only required for non-TP gateway PDUs.
            reference DestPduRef: set at post-build in variant post-build / pre-compile in variant pre-compile, destination=Pdu  # Destination PDU reference; reference to unique PDU identifier which shall be used by the PDU Router instead of the source PDU ID when calling the related function of the destination module.
            reference TxBufferRef [0..1]: set at post-build, destination=PduRTxBuffer  # Reference to a buffer that is allocated in the PduRTxBufferTable. This buffer is required for communication interface gatewaying, and for transport protocol gatewaying for single frame routing.
          container PduRSrcPdu  # This container is a subcontainer of PduRRoutingPath and specifies the source of the PDU to be routed.
            integer HandleId: 0..65535, set at post-build in variant post-build / pre-compile in variant pre-compile, symbolic-name-value=true  # PDU identifier assigned by PDU Router.
            reference SrcPduRef: set at post-build in variant post-build / pre-compile in variant pre-compile, destination=Pdu  # Source PDU reference; reference to unique PDU identifier which shall be used for the requested PDU Router operation.
      container PduRTpBufferTable [0..1]  # This container is a subcontainer of PduR and contains the definition of all TP buffers (only required for PDU Router gateway operation). This container shall only be considered by the PDU Router Configuration Generator if PduRGeneral/PDUR_GATEWAY_OPERATION is enabled.
        integer PduRMaxTpBufferNumber: 0..65535, set at pre-compile  # maximum number of TP buffers.
        container PduRTpBuffer [0..*]  # This container is a subcontainer of PduRTpBufferTable and specifies a TP buffer.
          integer Length: 1..65535, set at post-build in variant post-build / pre-compile in variant pre-compile  # Length of the buffer.
      container PduRTxBufferTable [0..1]  # This container contains the buffers used for gatewaying via communication interfaces and for single frames of transport protocols.
        integer PduRMaxTxBufferNumber: 0..65535, set at pre-compile  # maximum number of transmit buffers
        container PduRTxBuffer [0..*]  # This container is a subcontainer of PduRTxBufferTable and specifies a transmit buffer for a non-TP PDU.
          integer Depth: 0..255, set at post-build in variant post-build / pre-compile in variant pre-compile  # Specifies the depth of the buffer. For TP single frames, the depth is always 1.
          integer Length: 1..255, set at post-build in variant post-build / pre-compile in variant pre-compile  # Length of the buffer. When this buffer is used for TP routing path the Length has to be large enough to contain the largest possible single frame of the source network.
  module definition Port [0..1]: variants post-build/pre-compile  # Configuration of the Port module.
    container PortConfigSet: multiple-configuration-container=true  # This container is the base of a multiple configuration set
      container PortContainer [1..*]  # Container collecting the PortPins.
        integer PortNumberOfPortPins: set at pre-compile  # The number of specified PortPins in this PortContainer.
        container PortPin [1..*]  # Configuration of the individual port pins.
          enumeration PortPinDirection: {PORT_PIN_IN, PORT_PIN_OUT}, set at post-build in variant post-build / pre-compile in variant pre-compile  # The initial direction of the pin (IN or OUT). If the direction is not changeable, the value configured here is fixed. The direction must match the pin mode. E.g. a pin used for an ADC must be configured to be an in port. Implementation Type: Port_PinDirectionType
          boolean PortPinDirectionChangeable: set at post-build in variant post-build / pre-compile in variant pre-compile  # Parameter to indicate if the direction is changeable on a port pin during runtime. true: Port Pin direction changeable enabled. false: Port Pin direction changeable disabled.
          integer PortPinId: 0.., set at pre-compile, symbolic-name-value=true  # Pin Id of the port pin. This value will be assigned to the symbolic name derived from the port pin container short name.
          enumeration PortPinInitialMode: {PORT_PIN_MODE_ADC, PORT_PIN_MODE_CAN, PORT_PIN_MODE_DIO, PORT_PIN_MODE_DIO_GPT, PORT_PIN_MODE_DIO_WDG, PORT_PIN_MODE_FLEXRAY, PORT_PIN_MODE_ICU, PORT_PIN_MODE_LIN, PORT_PIN_MODE_MEM, PORT_PIN_MODE_PWM, PORT_PIN_MODE_SPI}, set at post-build in variant post-build / pre-compile in variant pre-compile  # Port pin mode from mode list for use with Port_Init() function.
          enumeration PortPinLevelValue: {PORT_PIN_LEVEL_HIGH, PORT_PIN_LEVEL_LOW}, set at post-build in variant post-build / pre-compile in variant pre-compile  # Port Pin Level value from Port pin list.
          enumeration PortPinMode: {PORT_PIN_MODE_ADC, PORT_PIN_MODE_CAN, PORT_PIN_MODE_DIO, PORT_PIN_MODE_DIO_GPT, PORT_PIN_MODE_DIO_WDG, PORT_PIN_MODE_FLEXRAY, PORT_PIN_MODE_ICU, PORT_PIN_MODE_LIN, PORT_PIN_MODE_MEM, PORT_PIN_MODE_PWM, PORT_PIN_MODE_SPI}, set at post-build in variant post-build / pre-compile in variant pre-compile  # Port pin mode from mode list. Note that more than one mode is allowed by default. That way it is e.g. possible to combine DIO with another mode such as ICU.
    container PortGeneral  # Module wide configuration parameters of the PORT driver.
      boolean PortDevErrorDetect: set at pre-compile  # Switches the Development Error Detection and Notification on or off. true: Enabled. false: Disabled.
      boolean PortSetPinDirectionApi: set at pre-compile  # Pre-processor switch to enable / disable the use of the function Port_SetPinDirection(). TRUE: Enabled - Function Port_SetPinDirection() is available. FALSE: Disabled - Function Port_SetPinDirection() is not available.
      boolean PortSetPinModeApi: set at pre-compile  # Pre-processor switch to enable / disable the use of the function Port_SetPinMode(). true: Enabled - Function Port_SetPinMode() is available. false: Disabled - Function Port_SetPinMode() is not available.
      boolean PortVersionInfoApi: set at pre-compile  # Pre-processor switch to enable / disable the API to read out the modules version information. true: Version info API enabled. false: Version info API disabled.
  module definition Pwm [0..*]: variants post-build/pre-compile  # Configuration of Pwm (Pulse Width Modulation) module.
    container PwmChannelConfigSet: multiple-configuration-container=true  # Multiple Configuration Set Container
      container PwmChannel [1..*]  # Configuration of an individual PWM channel.
        enumeration PwmChannelClass: {PWM_FIXED_PERIOD, PWM_FIXED_PERIOD_SHIFTED, PWM_VARIABLE_PERIOD}, set at post-build in variant post-build / pre-compile in variant pre-compile  # Class of PWM Channel. ImplementationType: Pwm_ChannelClassType
        integer PwmChannelId: 0.., set at pre-compile, symbolic-name-value=true  # Channel Id of the PWM channel. This value will be assigned to the symbolic name derived of the PwmChannel container short name.
        integer PwmDutycycleDefault: 0..32768, set at post-build in variant post-build / pre-compile in variant pre-compile  # Value of duty cycle used for Initialization 0, represents 0% 0x8000 represents 100%
        enumeration PwmIdleState: {PWM_HIGH, PWM_LOW}, set at post-build in variant post-build / pre-compile in variant pre-compile  # The parameter PWM_IDLE_STATE represents the output state of the PWM after the signal is stopped (e.g. call of Pwm_SetOutputToIdle).
        function name PwmNotification: set at post-build in variant post-build / pre-compile in variant pre-compile, default-value="NULL"  # Definition of the Callback function.
        float PwmPeriodDefault: 0.., set at post-build in variant post-build / pre-compile in variant pre-compile  # Value of period used for Initialization.(in seconds).
        enumeration PwmPolarity: {PWM_HIGH, PWM_LOW}, set at post-build in variant post-build / pre-compile in variant pre-compile  # Defines the starting polarity of each PWM channel.
    container PwmConfigurationOfOptApiServices
      boolean PwmDeInitApi: set at pre-compile  # Adds / removes the service Pwm_DeInit() from the code.
      boolean PwmGetOutputState: set at pre-compile
      boolean PwmSetDutyCycle: set at pre-compile
      boolean PwmSetOutputToIdle: set at pre-compile
      boolean PwmSetPeriodAndDuty: set at pre-compile
      boolean PwmVersionInfoApi: set at pre-compile  # Switch to indicate that the Pwm_ GetVersionInfo is supported
    container PwmGeneral
      boolean PwmDevErorDetect: set at pre-compile  # Switch for enabling the development error detection.
      boolean PwmDutycycleUpdatedEndperiod: set at pre-compile  # Switch for enabling the update of the duty cycle parameter at the end of the current period. TRUE: update of duty cycle is done at the end of period of currently generated waveform (current waveform is finished). FALSE: update of duty cycle is done immediately (just after service call, current waveform is cut).
      integer PwmIndex: set at pre-compile  # Specifies the InstanceId of this module instance. If only one instance is present it shall have the Id 0.
      boolean PwmNotificationSupported: set at pre-compile  # Switch to indicate that the notifications are supported
      boolean PwmPeriodUpdatedEndperiod: set at pre-compile  # Switch for enabling the update of the period parameter at the end of the current period. TRUE: update of period/duty cycle is done at the end of period of currently generated waveform (current waveform is finished). FALSE: update of period/duty cycle is done immediately (just after service call, current waveform is cut).
  module definition RamTst [0..1]: variants link-time/pre-compile  # Configuration of the RamTst module.
    container RamTstCommon  # This container holds a list of all available functions in the RamTst module. Each function is turned ON or OFF before compiling so that only the desired functions and test algorithms are in the compiled code.
      boolean RamTstAllowApi: set at pre-compile  # Preprocessor switch to disable / enable the function "RamTst_Allow".
      boolean RamTstChangeNumOfTestedCellsApi: set at pre-compile  # Preprocessor switch to disable / enable the function "RamTst_ChangeNumberOfTestedCells".
      boolean RamTstDevErrorDetect: set at pre-compile  # Preprocessor switch to select the development error tracer (DET) ON or OFF
      boolean RamTstGetAlgParamsApi: set at pre-compile  # Preprocessor switch to disable / enable the function "RamTst_GetAlgParams".
      boolean RamTstGetExecutionStatusApi: set at pre-compile  # Preprocessor switch to disable / enable the function "RamTst_GetExecutionStatus"
      boolean RamTstGetNumberOfTestedCellsApi: set at pre-compile  # Preprocessor switch to disable / enable the function "RamTst_GetNumberOfTestedCells".
      boolean RamTstGetTestAlgorithmApi: set at pre-compile  # Preprocessor switch to disable / enable the function "RamTst_GetTestAlgorithm"
      boolean RamTstGetTestResultApi: set at pre-compile  # Preprocessor switch to disable / enable the function "RamTst_GetTestResult"
      boolean RamTstGetTestResultPerBlockApi: set at pre-compile  # Preprocessor switch to disable / enable the function "RamTst_GetTestResultPerBlock"
      boolean RamTstGetVersionInfoApi: set at pre-compile  # Preprocessor switch to disable / enable the function "RamTst_GetVersionInfo"
      boolean RamTstResumeApi: set at pre-compile  # Preprocessor switch to disable / enable the function "RamTst_Resume".
      boolean RamTstRunFullTestApi: set at pre-compile  # Preprocessor switch to disable / enable the function "RamTst_RunFullTest"
      boolean RamTstRunPartialTestApi: set at pre-compile  # Preprocessor switch to disable / enable the function "RamTst_RunPartialTest"
      boolean RamTstSelectAlgParamsApi: set at pre-compile  # Preprocessor switch to disable / enable the function "RamTst_SelectAlgParams".
      boolean RamTstStopApi: set at pre-compile  # Preprocessor switch to disable / enable the function "RamTst_Stop"
      boolean RamTstSuspendApi: set at pre-compile  # Preprocessor switch to disable / enable the function "RamTst_Suspend".
      container RamTstAlgorithms  # This container holds all of the available test algorithms for the specific microcontroller. Each test algorithm is selected ON or OFF before compiling so that only the desired test algorithms are in the compiled code.
        boolean RamTstHighCoverageTestSelected: set at pre-compile  # Preprocessor switch to select the test with high coverage ON or OFF
        boolean RamTstLowCoverageTestSelected: set at pre-compile  # Preprocessor switch to select the test with low coverage ON or OFF
        boolean RamTstMediumCoverageTestSelected: set at pre-compile  # Preprocessor switch to select the test with medium coverage ON or OFF
      container RamTstConfigParams  # This container specifies configuration parameters which are set at pre-compile or link time.
        integer RamTstDefaultAlgParamsId: 1..255, set at link in variant link-time / pre-compile in variant pre-compile  # This is the identifier for the default "RamTstAlgParams" valid after the "RamTst_Init(..)" function. It is the initial value for a RAM variable which could be changed by the function "RamTst_SelectAlgParams".
        integer RamTstMinNumberOfTestedCells: 1..4294967295, set at link in variant link-time / pre-compile in variant pre-compile  # Minimum number of tested cells for one cyle of a background test, as defined by implementer.
        integer RamTstNumberOfAlgParamSets: 1..255, set at link in variant link-time / pre-compile in variant pre-compile  # Number of configured parameter sets for the available test algorithms. count of the container RamTstAlgParams
        function name RamTstTestCompletedNotification: set at link in variant link-time / pre-compile in variant pre-compile  # This function will be called from abackground test after finishing the RAM test without an error.
        function name RamTstTestErrorNotification: set at link in variant link-time / pre-compile in variant pre-compile  # This function will be called from a background test if an error occurs during the RAM test.
        container RamTstAlgParams [1..255]  # This container holds parameters for configuring an algorithm. For each algorithm selected in the RamTst_Algorithms container there can be one or more RamTstAlgParams containers. The multiplicity of the included container RamTstBlockParams depends on the number of separate blocks of RAM which are defined for the particular test configuration.
          integer RamTstAlgParamsId: 1..255, set at link in variant link-time / pre-compile in variant pre-compile  # This is the identifier by which this RamTstAlgParams set can be selected.
          enumeration RamTstAlgorithmCoverage: {RAMTST_ALGORITHM_COVERAGE_HIGH, RAMTST_ALGORITHM_COVERAGE_LOW, RAMTST_ALGORITHM_COVERAGE_MEDIUM}, set at link in variant link-time / pre-compile in variant pre-compile  # This is the coverage of the defined RamTstAlgParams set. Note that the same algorithm can be used in more than one RamTstAlgParams. Constraint: Only the algorithms selected by RamTstCommon/ RamTstAlgorithms can be used.
          integer RamTstExtNumberOfTestedCells: 1..4294967295, set at link in variant link-time / pre-compile in variant pre-compile  # This is the absolute maximum value for the number of cells that NUMBER_OF_TESTED_CELLS and MAX_NUMBER_OF_TESTED_CELLS can be.
          integer RamTstMaxNumberOfTestedCells: 1..4294967295, set at link in variant link-time / pre-compile in variant pre-compile  # This is the maximum value for the number of cells that can be tested in one cycle of a background test.
          integer RamTstNumberOfBlocks: 1..65535, set at link in variant link-time / pre-compile in variant pre-compile  # Number of RAM blocks configured using the container "RamTst_BlockParams" Count of RamTstBlockParams contained in this RamTstAlgParams.
          integer RamTstNumberOfTestedCells: 1..4294967295, set at link in variant link-time / pre-compile in variant pre-compile  # This is the initial value for a RAM variable, which can be changed by the function "RamTst_ChangeNumberOfTestedCells"
          container RamTstBlockParams [1..65535]  # This container holds the description for one block of RAM. For each RAM block to be tested by a given algorithm, there is one container which describes the block. Multiple instances of this container are included in each container RamTst_AlgParams.
            integer RamTstBlockId: 1..65535, set at link in variant link-time / pre-compile in variant pre-compile  # ID of the RAM block
            integer RamTstEndAddress: 1..4294967295, set at link in variant link-time / pre-compile in variant pre-compile  # End Address of the RAM block. Constraint: It must be larger than the RamTstStartAddress.
            integer RamTstFillPattern: 0..4294967295, set at link in variant link-time / pre-compile in variant pre-compile  # Pattern to be filled into each memory cell after destructive test of this block.
            integer RamTstStartAddress: 0..4294967295, set at link in variant link-time / pre-compile in variant pre-compile  # Start Address of the RAM block. Constraint: It must be smaller than the RamTstEndAddress.
            enumeration RamTstTestPolicy: {RAMTEST_DESTRUCTIVE, RAMTEST_NON_DESTRUCTIVE}, set at link in variant link-time / pre-compile in variant pre-compile  # Policy regading destruction or non-destruction of memory content.
    container RamTstDemEventParameterRefs [0..1]  # Container for the references to DemEventParameter elements which shall be invoked using the API Dem_ReportErrorStatus in case the corresponding error occurs. The EventId is taken from the referenced DemEventParameter's DemEventId value. The standardized errors are provided in the container and can be extended by vendor-specific error references.
      symbolic name reference RAMTST_E_RAM_FAILURE [0..1]: destination=DemEventParameter  # Reference to the DemEventParameter which shall be issued when the error "RAM failure" has occurred.
    container RamTstPublishedInformation  # Container holding all RamTst specific published information parameter.
      integer RamTstCellSize: 1..64, set at published-information  # Size of RAM cells (in bits) which can be tested individually by the given implementation.
  module definition Rte [0..1]: variants pre-compile  # Configuration of the Rte (Runtime Environment) module.
    container ComponentTypeCalibration [0..*]  # Specifies for each CalprmComponentType or AtomicSoftwareComponentType whether calibration is enabled.
      boolean CalibrationSupportEnabled: set at pre-compile  # Enables calibration support for the specified CalprmComponentType or AtomicSoftwareComponentType.
      foreign reference ComponentTypeRef: set at pre-compile, destination-type=ComponentType  # Reference to the CalprmComponentType or AtomicSoftwareComponentType.
    container RteGeneration  # This container holds the parameters for the configuration of the RTE Generation.
      enumeration RteCalibrationSupport: {DOUBLE_POINTERED, INITIALIZED_RAM, NONE, SINGLE_POINTERED}, set at pre-compile  # The RTE generator shall have the option to switch off support for calibration for generated RTE code. This option shall influence complete RTE code at once.
      enumeration RteGenerationMode: {COMPATIBILITY_MODE, VENDOR_MODE}, set at pre-compile  # Switch between the two available generation modes of the RTE generator.
      boolean RteMeasurementSupport: set at pre-compile  # The RTE generator shall have the option to switch off support for measurement for generated RTE code. This option shall influence complete RTE code at once.
      enumeration RteOptimizationMode: {MEMORY, RUNTIME}, set at pre-compile  # Switch between the two available optimization modes of the RTE generator.
      integer RteVfbTrace: set at pre-compile  # The RTE generator shall globally enable VFB tracing when RTE_VFB_TRACE is defined in the RTE configuration header file as a non-zero integer. The RTE generator shall globally disable VFB tracing when RTE_VFB_TRACE is defined in the RTE configuration header file as 0.
      function name RteVfbTraceFunction [0..*]: set at pre-compile  # The RTE generator shall enable VFB tracing for a given hook function when there is a #define in the RTE configuration header file for the hook function name and tracing is globally enabled. Example: #define Rte_WriteHook_i1_p1_a_Start
    container SwComponentInstance [1..*]  # Representation of one SW-Component instance located on the to be configured ECU. All subcontainer configuration aspects are in relation to this SW-Component instance. The SwComponentInstance can be either an ApplicationSoftwareComponenInstance or a ServiceComponentInstance.
      foreign reference ImplementationRef [0..1]: set at pre-compile, destination-type=SwcImplementation  # The Implementation which is assiged to the ComponentPrototype.
      foreign reference ServiceComponentPrototypeRef [0..1]: destination-type=ServiceComponentPrototype  # Reference to the ServiceComponentPrototype representing an particular service on this ECU. If ServiceComponentPrototypeRef is specified there shall not be the SoftwareComponentInstanceRef specified.
      instance reference SoftwareComponentInstanceRef [0..1]: destination-context=SoftwareComposition* ComponentPrototype*, destination-type=ComponentPrototype  # Reference to a SW-Component ComponentPrototype. If SoftwareComponentInstanceRef is specified there shall not be the ServiceComponentPrototypeRef specified. Semantic Constraint: Only ComponentPrototypes which have an AtomicSoftwareComponentType as <<isOfType>> shall be referenced here. At most one SoftwareComposition shall be referenced (is optional).
      container ExclusiveAreaImplementation [0..*]  # Specifies the implementation to be used for the data consistency of this ExclusiveArea.
        enumeration ExclusiveAreaImplMechanism: {COOPERATIVE_RUNNABLE_PLACEMENT, INTERRUPT_BLOCKING, NON_PREEMPTIVE_TASK, OS_RESOURCE}, set at pre-compile  # To be used implementation mechanism for the specified ExclusiveArea.
        foreign reference ExclusiveAreaRef: set at pre-compile, destination-type=ExclusiveArea  # Reference to the ExclusiveArea.
      container NVRamAllocation [0..*]  # Specifies the relationship between the SW-Components NVRAMMapping / NVRAM needs and the NvM module configuration.
        linker symbol def RamBlockLocationSymbol: lower-multiplicity=0, upper-multiplicity=1, set at pre-compile  # This is the name of the linker object name where the NVRam Block will be mirrored by the Nvm. This symbol will be resolved into the parameter "NvmRamBlockDataAddress" from the "NvmBlockDescriptor".
        linker symbol def RomBlockLocationSymbol: lower-multiplicity=0, upper-multiplicity=1, set at pre-compile  # This is the name of the linker object name where the NVRom Block will be accessed by the Nvm. This symbol will be resolved into the parameter "NvmRomBlockDataAddress" from the "NvmBlockDescriptor".
        instance reference SwNvRamMappingReference: set at pre-compile, destination-context=ComponentPrototype*, destination-type=NVRAMMapping  # Reference to the NVRAMMapping instance to be configured.
        symbolic name reference NvmBlockRef: destination=NvmBlockDescriptor  # Reference to the used NvM block for storage of the NVRAMMapping information.
      container RunnableEntityMapping [0..*]  # Maps a RunnableEntity onto one OS Task based on the activating RTEEvent. Even if a RunnableEntity is executed in the caller's context this RunnableEntityMapping shall be specified, but no MappedToTask and PositionInTask elements given.
        float ActivationOffset [0..1]: set at pre-compile  # Activation offset in seconds.
        integer PositionInTask [0..1]: set at pre-compile  # Each RunnableEntities mapped to an OsTask has a specific position within the task execution. For periodic activation this is the order of execution. For event driver activation this is the order of evaluation which actual RunnableEntity has to be executed.
        foreign reference RTEEventRef: set at pre-compile, destination-type=RTEEvent  # Reference to the description of the RTEEvent which is pointing to the RunnableEntity being mapped. This allows a fine grained mapping of RunnableEntites based on the activating RTEEvent.
        reference MappedToTaskRef [0..1]: set at pre-compile, destination=OsTask  # Reference to the OsTask the RunnableEntity is mapped to. If no reference to the OsTask is specified the RunnableEntity is executed in the context of the caller.
        reference UsedOsEventRef [0..1]: set at pre-compile, destination=OsEvent  # If an OsEvent is used to activate the RunnableEntity it shall be referenced here.
  module definition SchM [0..1]: variants pre-compile  # Configuration of the SchM (BSW Scheduler) module.
    container SchMGeneral  # General configuration parameters of the SchM.
      boolean SchMDevErrorDetect: set at pre-compile  # Switches the Development Error Detection and Notification ON or OFF.
      boolean SchMVersionInfoApi: set at pre-compile  # Switches the service SchM_GetVersionInfo ON or OFF.
    container SchMMainFunctionMapping [1..*]  # Maps a MainFunction onto one OS Task.
      integer SchMPositionInTask: 0..255, set at pre-compile  # The parameter depicts the specific Position of the MainFunction within the OS Task. Note: The dependencies between the main processing functions mapped to the same task have been resolved by the configuration (process) beforehand. The result of this resolution is the order of the main processing functions within this task.
      foreign reference SchMMainFunctionRef: set at pre-compile, destination-type=BswSchedulableEntity  # The parameter depicts the reference to the MainFunction.
      reference SchMMappedToTask: set at pre-compile, destination=OsTask  # The parameter depicts the reference to the OS Task the MainFunction is mapped to. Note: The AUTOSAR OS Task has already been available and is configured. Therefore, the configuration attributes of the task do not need to mention again.
      container SchMScheduleTableMapping [0..*]  # Assigns a MainFunction to a OS Schedule Table
        reference SchMScheduletableRef: set at pre-compile, destination=OsScheduleTable  # The parameter depicts the reference to the OS SchedulaTable the MainFunction is mapped to.
    container SchMModuleConfiguration [0..*]  # Contains module specific configuration items.
      string SchMModuleLiteral: set at pre-compile  # The parameter depicts a symbolic name (a literal) for the unambigous identification of a BSW module; in fact it is the <ModulePrefix> specified for each BSW module in the Basic Software Module List.
      container InstanceConfiguration [1..*]  # Contains instance specific configuration items. One instance of this container for each instance of the module.
        integer SchMInstanceId: 0..255, set at pre-compile  # The parameter depicts a value for the unambigous identification of a BSW module instance.
        string SchMInstanceLiteral: set at pre-compile  # The parameter depicts a symbolic name for the unambigous identification of a BSW module instance.
        container ActivationPointConf [0..*]  # Contains configuration items of ActivationPoints in the context of a BSW module.
          integer SchMActivationId: 0..255, set at pre-compile  # The parameter depicts a value for the unambigous identification of an ActivationPoint.
          string SchMActivationLiteral: set at pre-compile  # The parameter depicts a symbolic name for the unambigous identification of an ActivationPoint.
        container CancelationPointConf [0..*]  # Contains configuration items of CancelationPoints in the context of a BSW module.
          integer SchMCancelationId: 0..255, set at pre-compile  # The parameter depicts a value for the unambigous identification of an CancelationPoint.
          string SchMCancelationLiteral: set at pre-compile  # The parameter depicts a symbolic name for the unambigous identification of a CancelationPoint.
        container ExclusiveAreaConf [0..*]  # Contains configuration items of critical sections (ExclusiveArea) in the context of a BSW module.
          integer SchMExclusiveAreaId: 0..255, set at pre-compile  # The parameter depicts a value for the unambigous identification of an ExclusiveArea.
          string SchMExclusiveAreaLiteral: set at pre-compile  # The parameter depicts a symbolic name for the unambigous identification of an ExclusiveArea.
        container SporadicEventConf [0..*]  # Contains configuration items of SporadicEvents.
          float DelayTime: set at pre-compile  # The parameter depicts the minimum delay time in seconds until a main processing functions shall be activated. This configuration parameter is an input for integration. It represents the base for the real, implementation specific values.
          string SchMSporadicLiteral: set at pre-compile  # The parameter depicts a symbolic name dfor the unambiguous identification of a sporadiv event.
  module definition Spi [0..1]: variants link-time/post-build/pre-compile  # Configuration of the Spi (Serial Peripheral Interface) module.
    container SpiDriver: multiple-configuration-container=true
      integer SpiMaxChannel [0..1]: set at link in variant link-time / post-build in variant post-build / pre-compile in variant pre-compile  # This parameter contains the number of Channels configured. It will be gathered by tools during the configuration stage.
      integer SpiMaxJob [0..1]: set at link in variant link-time / post-build in variant post-build / pre-compile in variant pre-compile
      integer SpiMaxSequence [0..1]: set at link in variant link-time / post-build in variant post-build / pre-compile in variant pre-compile
      container SpiChannel [1..*]  # All data needed to configure one SPI-channel
        integer SpiChannelId: set at pre-compile, symbolic-name-value=true
        enumeration SpiChannelType: {EB, IB}, set at link in variant link-time / post-build in variant post-build / pre-compile in variant pre-compile  # Buffer usage with EB/IB channel
        integer SpiDataWidth: 1..32, set at link in variant link-time / post-build in variant post-build / pre-compile in variant pre-compile  # This parameter is the width of a transmitted data unit.
        integer SpiDefaultData: set at link in variant link-time / post-build in variant post-build / pre-compile in variant pre-compile  # This parameter is the default value to transmit.
        integer SpiEbMaxLength: set at link in variant link-time / post-build in variant post-build / pre-compile in variant pre-compile  # This parameter contains the maximum size of data buffers in case of EB Channels and only.
        integer SpiIbNBuffers: set at link in variant link-time / post-build in variant post-build / pre-compile in variant pre-compile  # This parameter contains the maximum number of data buffers in case of IB Channels and only.
        enumeration SpiTransferStart: {LSB, MSB}, set at link in variant link-time / post-build in variant post-build / pre-compile in variant pre-compile  # This parameter defines the first starting bit for transmission.
      container SpiExternalDevice [1..*]  # The communication settings of an external device. Closely linked to SpiJob.
        float SpiBaudrate: set at link in variant link-time / post-build in variant post-build / pre-compile in variant pre-compile  # This parameter is the communication baudrate - This parameter allows using a range of values, from the point of view of configuration tools, from Hz up to MHz.
        string SpiCsIdentifier: set at link in variant link-time / post-build in variant post-build / pre-compile in variant pre-compile, symbolic-name-value=true  # This parameter is the symbolic name to identify the Chip Select (CS) allocated to this Job.
        enumeration SpiCsPolarity: {HIGH, LOW}, set at link in variant link-time / post-build in variant post-build / pre-compile in variant pre-compile  # This parameter defines the active polarity of Chip Select.
        enumeration SpiDataShiftEdge: {LEADING, TRAILING}, set at link in variant link-time / post-build in variant post-build / pre-compile in variant pre-compile  # This parameter defines the SPI data shift edge.
        boolean SpiEnableCs: set at link in variant link-time / post-build in variant post-build / pre-compile in variant pre-compile  # This parameter enables or not the Chip Select handling functions.
        enumeration SpiShiftClockIdleLevel: {HIGH, LOW}, set at link in variant link-time / post-build in variant post-build / pre-compile in variant pre-compile  # This parameter defines the SPI shift clock idle level.
        float SpiTimeClk2Cs: 0..100, set at link in variant link-time / post-build in variant post-build / pre-compile in variant pre-compile  # Timing between clock and chip select - This parameter allows to use a range of values from 0 up to 100 microSec. the real configuration-value used in software BSW-SPI is calculated out of this by the generator-tools
      container SpiJob [1..*]  # All data needed to configure one SPI-Job, amongst others the connection between the internal SPI unit and the special settings for an external device is done.
        enumeration SpiHwUnit: {CSIB0, CSIB1, CSIB2, CSIB3}, set at link in variant link-time / post-build in variant post-build / pre-compile in variant pre-compile  # This parameter is the symbolic name to identify the HW SPI Hardware microcontroller peripheral allocated to this Job.
        enumeration SpiHwUnitSynchronous [0..1]: {ASYNCHRONOUS, SYNCHRONOUS}, set at link in variant link-time / post-build in variant post-build / pre-compile in variant pre-compile, default-value=ASYNCHRONOUS  # If SpiHwUnitSynchronous is set to "SYNCHRONOUS", the SpiJob uses its containing SpiDriver in a synchronous manner. If it is set to "ASYNCHRONOUS", it uses the driver in an asynchronous way. If the parameter is not set, the SpiChannel uses the driver also in an asynchronous way.
        function name SpiJobEndNotification: set at link in variant link-time / post-build in variant post-build / pre-compile in variant pre-compile  # This parameter is a reference to a notification function.
        integer SpiJobId: set at pre-compile, symbolic-name-value=true
        integer SpiJobPriority: 0..3, set at link in variant link-time / post-build in variant post-build / pre-compile in variant pre-compile  # Priority of the Job
        reference ChannelAssignment [1..*]: set at link in variant link-time / post-build in variant post-build / pre-compile in variant pre-compile, destination=SpiChannel  # A job references several channels.
        reference DeviceAssignment: destination=SpiExternalDevice  # Reference to the external device used by this job
      container SpiSequence [1..*]  # All data needed to configure one SPI-sequence
        boolean SpiInterruptibleSequence: set at link in variant link-time / post-build in variant post-build / pre-compile in variant pre-compile  # This parameter allows or not this Sequence to be suspended by another one.
        function name SpiSeqEndNotification: set at link in variant link-time / post-build in variant post-build / pre-compile in variant pre-compile  # This parameter is a reference to a notification function.
        integer SpiSequenceId: set at pre-compile, symbolic-name-value=true
        reference JobAssignment [1..*]: set at link in variant link-time / post-build in variant post-build / pre-compile in variant pre-compile, destination=SpiJob  # A sequence references several jobs, which are executed during a communication sequence
    container SpiGeneral  # General configuration settings for SPI-Handler
      boolean SpiCancelApi: set at pre-compile  # Switches the Spi_Cancel function ON or OFF.
      integer SpiChannelBuffersAllowed: 0..2, set at pre-compile  # Selects the SPI Handler/Driver Channel Buffers usage allowed and delivered.
      boolean SpiDevErrorDetect: set at pre-compile  # Switches the Development Error Detection and Notification ON or OFF.
      boolean SpiHwStatusApi: set at pre-compile  # Switches the Spi_GetHWUnitStatus function ON or OFF.
      boolean SpiInterruptibleSeqAllowed: set at pre-compile  # Switches the Interruptible Sequences handling functionality ON or OFF.
      integer SpiLevelDelivered: 0..2, set at pre-compile  # Selects the SPI Handler/Driver level of scalable functionality that is available and delivered.
      boolean SpiSupportConcurrentSyncTransmit: set at pre-compile  # Specifies whether concurrent Spi_SyncTransmit() calls for different sequences shall be configurable.
      boolean SpiVersionInfoApi: set at pre-compile  # Switches the Spi_GetVersionInfo function ON or OFF.
  module definition Wdg [0..*]: variants link-time/post-build/pre-compile  # Configuration of the Wdg (Watchdog driver) module.
    container WdgExternalConfiguration [0..1]  # Configuration items for an external watchdog hardware
      choice reference WdgExternalContainerRef [0..1]: set at link in variant link-time / post-build in variant post-build / pre-compile in variant pre-compile, destination=[DioChannelGroup, SpiSequence]  # Reference to either - a DioChannelGroup container in case the hardware watchdog is connected via DIO pins - a SpiSequenceConfiguration container in case the watchdog hardware is accessed via SPI
    container WdgGeneral  # All general parameters of the watchdog driver are collected here.
      boolean WdgDevErrorDetect: set at pre-compile  # Compile switch to enable / disable development error detection for this module. True: Development error detection enabled False: Development error detection disabled
      boolean WdgDisableAllowed: set at pre-compile  # Compile switch to allow / forbid disabling the watchdog driver during runtime. True: Disabling the watchdog driver at runtime is allowed. False: Disabling the watchdog driver at runtime is not allowed.
      integer WdgIndex: set at pre-compile, symbolic-name-value=true  # Represents the watchdog driver's ID so that it can be referenced by the watchdog interface.
      function name WdgTriggerLocation: set at pre-compile  # Location (memory address) of the watchdog trigger routine.
      boolean WdgVersionInfoApi: set at pre-compile  # Compile switch to enable / disable the version information API True: API enabled False: API disables
    container WdgModeConfig: multiple-configuration-container=true  # Configuration items for the different watchdog modes
      enumeration WdgDefaultMode: {WDGIF_FAST_MODE, WDGIF_OFF_MODE, WDGIF_SLOW_MODE}, set at post-build in variant link-time+post-build / pre-compile in variant pre-compile  # Default mode for watchdog driver initialization. ImplementationType: WdgIf_ModeType
      container WdgSettingsFast  # Hardware dependent settings for the watchdog driver's "fast" mode.
      container WdgSettingsOff  # Hardware dependent settings for the watchdog driver's "off" mode.
      container WdgSettingsSlow  # Hardware dependent settings for the watchdog driver's "slow" mode.
    container WdgPublishedInformation  # Container holding all Wdg specific published information parameters
      float WdgMaxTimeout [0..1]: set at published-information  # Maximum timeout period in [s].
      float WdgMinTimeout [0..1]: set at published-information  # Minimum timeout period in [s].
      float WdgResolution [0..1]: set at published-information  # Resolution of watchdog timeout period in [s].
      enumeration WdgTriggerMode: {WDG_BOTH, WDG_TOGGLE, WDG_WINDOW}, set at published-information  # Watchdog trigger mode (toggle/window/both)
      container WdgTimeoutList [0..1]  # List of selectable timeout periods in [s].
        float WdgTimeoutPeriod [1..*]: set at published-information  # A single timeout period onto the Wdg can be configured.
  module definition WdgIf [0..1]: variants pre-compile  # Configuration of the WdgIf (Watchdog Interface) module.
    container WdgIfDevice [1..*]
      integer WdgIfDeviceIndex: symbolic-name-value=true  # Represents the watchdog interface ID so that it can be referenced by the watchdog manager.
      symbolic name reference WdgRef: destination=WdgGeneral  # Reference to the watchdog drivers that are controlled by the watchdog interface.
    container WdgIfGeneral  # This container collects all generic watchdog interface parameters.
      boolean WdgIfDevErrorDetect: set at pre-compile  # Pre-processor switch for enabling the development error detection and reporting. true: Development error detection enabled false: Development error detection disabled
      integer WdgIfNumberOfDevices: 1..255, set at pre-compile  # Constant specifying the number of controlled watchdog drivers. Minimum number of watchdog drivers shall be one, maximum number limited by type of device index parameter. Can be calculated by counting the no. of references to the watchdog drivers.
      boolean WdgIfVersionInfoApi: set at pre-compile  # Pre-processor switch to enable / disable the service returning the version information. true: Version information service enabled false: Version information service disabled
  module definition WdgM [0..1]: variants post-build/pre-compile  # Configuration of the WdgM (Watchdog Manager) module.
    container WdgMConfigSet: multiple-configuration-container=true  # This container describes one of multiple configuration sets of WdgM. This is a MultipleConfigurationContainer, i.e. this container and its sub-containers exist once per configuration set.
      symbolic name reference WdgMInitialMode: destination=WdgMMode  # The mode that the Watchdog Manager is in after it has been initialized.
      container WdgMMode [1..255]  # The container describes one of several modes of the Watchdog Manager.
        integer WdgMExpiredSupervisionCycleTol: 0.., set at post-build in variant post-build / pre-compile in variant pre-compile  # This parameter shall be used to define a value that fixes the amount of expired supervision cycles for how long the blocking of watchdog triggering shall be postponed.
        integer WdgMModeId: 0..255, set at post-build in variant post-build / pre-compile in variant pre-compile, symbolic-name-value=true  # This parameter fixes the identfier for the mode. This identifier is for instance passed as a parameter to the WdgM_SetMode service.
        choice container WdgMActivation  # This container allows to choose between Main Function activation and GPT activation.
          container WdgMActivationGpt [0..1]  # GPT activation.
            integer WdgMGptCycle: 1.., set at post-build in variant post-build / pre-compile in variant pre-compile  # This parameter defines the timeout value for GPT notifications to the Watchdog Manager.
            symbolic name reference WdgMGptChannelRef: destination=GptChannelConfiguration  # Reference to the GPT channel to be used for Watchdog Manager activation.
          container WdgMActivationSchM [0..1]  # Main Function activation.
            float WdgMSupervisionCycle: set at pre-compile  # This parameter defines the schedule period of the main function WdgM_MainFunction_AliveSupervision. Unit: [s]
            float WdgMTriggerCycle: set at pre-compile  # This parameter defines the schedule period of the main function WdgM_MainFunction_Trigger. Unit: [s]
        container WdgMAliveSupervision [0..65535]  # This container collects all configuration parameters of Alive-Supervision.
          boolean WdgMActivationActivated: set at post-build in variant post-build / pre-compile in variant pre-compile  # This parameter shall contain the activation status of the corresponding Supervised Entity.
          integer WdgMAliveSupervisionConfigId: 0..65535, set at post-build in variant post-build / pre-compile in variant pre-compile, symbolic-name-value=true  # This parameter shall contain the identifier of the alive-supervision configuration set.
          integer WdgMExpectedAliveIndications: 1.., set at post-build in variant post-build / pre-compile in variant pre-compile  # This parameter shall contain the amount of expected alive indications within the referenced amount of defined supervision cycles according to corresponding SE.
          integer WdgMFailedSupervisionRefCycleTol: 0.., set at post-build in variant post-build / pre-compile in variant pre-compile  # This parameter shall contain the acceptable amount of failed supervision reference cycles that shall be used by checkup of alive supervision according to corresponding SE.
          integer WdgMMaxMargin: 0.., set at post-build in variant post-build / pre-compile in variant pre-compile  # This parameter shall contain the amount of alive indications that are acceptable to be additional on the expected alive indications within the corresponding supervision reference cycle.
          integer WdgMMinMargin: 0.., set at post-build in variant post-build / pre-compile in variant pre-compile  # This parameter shall contain the amount of alive indications that are acceptable to be missed from the expected alive indications within the corresponding supervision reference cycle.
          integer WdgMSupervisionReferenceCycle: 1.., set at post-build in variant post-build / pre-compile in variant pre-compile  # This parameter shall contain the amount of supervision cycles to be used as reference by the alive-supervision mechanism to perform the checkup with counted alive indications according to corresponding SE.
          symbolic name reference WdgMSupervisedEntityRef: destination=WdgMSupervisedEntity
        container WdgMTrigger [0..255]  # This container collects all configuration parameters for the triggering of hardware watchdogs.
          integer WdgMTriggerReferenceCycle: 1.., set at post-build in variant post-build / pre-compile in variant pre-compile  # This parameter shall contain the amount of trigger cycles to be used as reference by the trigger service of the Watchdog Manager to perform the triggering of the corresponding watchdog.
          enumeration WdgMWatchdogMode: {WDGIF_FAST_MODE, WDGIF_OFF_MODE, WDGIF_SLOW_MODE}, set at post-build in variant post-build / pre-compile in variant pre-compile  # This parameter contains the watchdog mode that shall be used for the referenced watchdog in this Watchdog Manager mode. Implementation Type: WdgIf_ModeType
          symbolic name reference WdgMWatchdogRef: destination=WdgMWatchdog  # This parameter is a reference to the configured watchdog.
    container WdgMGeneral  # Container structures all general configuration parameters of the Watchdog Manager.
      boolean WdgMAliveSupervisionEnabled: set at pre-compile  # Parameter to enable/disable the alive-supervision mechanism. Use Case: no supervised entity assigned true: Alive-supervision mechanism is enabled false: Alive-supervision mechanism is disabled
      boolean WdgMDemAliveSupervisionReport: set at pre-compile  # Parameter to enable/disable alive-supervision error reporting to DEM. true: Alive-supervision error reporting is enabled false: Alive-supervision error reporting is disabled
      boolean WdgMDevErrorDetect: set at pre-compile  # Preprocessor switch to enable/disable development error detection and reporting. Shall be used to remove unneeded code segments regarding DET features true: Development error detection is enabled false: Development error detection is disabled
      boolean WdgMImmediateReset: set at pre-compile  # This parameter enables/disablse the immediate reset feature in case of alive-supervision failure. true: Immediate reset is enabled false: Immediate reset is disabled
      integer WdgMNumberOfModes: 1..255, set at pre-compile  # This parameter shall contain the number of configured modes of the Watchdog Manager.
      integer WdgMNumberOfSupervisedEntities: 0..65535, set at pre-compile  # This parameter shall contain the amount of supervised entities configured for the Watchodg Manager.
      integer WdgMNumberOfWatchdogs: 0..255, set at pre-compile  # This parameter shall contain the maximum amount of watchdogs to configured for Watchdog Manager.
      boolean WdgMOffModeEnabled: set at pre-compile  # This parameter enables/disables the selection of the "OffMode" of the watchdog driver. true: "OffMode" selection is allowed false: "OffMode" selection is disallowed
      boolean WdgMVersionInfoApi: set at pre-compile  # Preprocessor switch to enable/disable the existence of the API WdgM_GetVersionInfo. Shall be used to remove unneeded code segments. true: API is enabled false: API is disabled
      container WdgMSupervisedEntity [0..65535]  # This container collects all common (mode-independent) parameters of a Supervised Entity to be supervised by the Watchdog Manager.
        boolean WdgMDeactivationAccessEnabled: set at pre-compile  # This parameter shall be used to grant the access of the service WdgM_DeactivateAliveSupervision() for affecting the activation status of the corresponding Supervised Entity.
        integer WdgMSupervisedEntityId: 0..65535, set at pre-compile, symbolic-name-value=true  # This parameter shall contain the identifier of he supervised entity.
      container WdgMWatchdog [0..255]  # This container collects all common (mode-independent) parameters of a Watchdog to be triggered by the Watchdog Manager.
        string WdgMWatchdogName: set at pre-compile, symbolic-name-value=true  # This parameter shall contain the symbolic name of the watchdog instance.
        symbolic name reference WdgMDeviceRef: destination=WdgIfDevice  # Reference to one device container of Watchdog Interface. In the referenced container WdgIfDevice, the parameter WdgIfDeviceIndex contains the Index parameter that WdgM has to use for WdgIf_Trigger calls for that watchdog instance.
