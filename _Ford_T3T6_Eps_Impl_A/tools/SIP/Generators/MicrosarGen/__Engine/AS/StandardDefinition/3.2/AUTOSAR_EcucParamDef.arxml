[part 1 of 3: package /AUTOSAR]
AUTOSAR XML (schema 3.2.3)
# The material contained in this specification is protected by copyright and
# other types of Intellectual Property Rights. The commercial exploitation of
# the material contained in this specification requires a license to such
# Intellectual Property Rights.
# This specification may be utilized or reproduced without any modification, in
# any form or by any means, for informational purposes only.
# For any other purpose, no part of the specification may be utilized or
# reproduced, in any form or by any means, without permission in writing from
# the publisher.
# licensed under the same rules as applicable to the AUTOSAR Standard.
package /AUTOSAR
  ecu parameter definition AUTOSARParameterDefinition: module=[Adc, BswM, Can, CanIf, CanNm, CanSM, CanTp, CanTrcv, Cdd, Com, ComM, Crc, Dcm, Dem, Det, Dio, Ea, EcuC, EcuM, Eep, Fee, Fim, Fls, Fr, FrIf, FrIsoTp, FrNm, FrSm, FrTp, FrTrcv, Gpt, Icu, IoHwAbstraction, IpduM, Lin, LinIf, LinSM, LinTp, Mcu, MemIf, Nm, NvM, Os, PduR, Port, Pwm, RamTst, Rte, SchM, Spi, Wdg, WdgIf, WdgM]
  module definition Adc [0..1]: variants post-build/pre-compile  # Configuration of the Adc (Analog Digital Conversion) module.
    container AdcConfigSet: multiple-configuration-container=true  # This is the base container that contains the post-build selectable configuration parameters
      container AdcHwUnit [1..*]  # This container contains the Driver configuration (parameters) depending on grouping of channels This container could contain HW specific parameters which are not defined in the Standardized Module Definition. They must be added in the Vendor Specific Module Definition.
        integer AdcClockSource [0..1]: 0.., set at post-build in variant post-build / pre-compile in variant pre-compile  # The ADC module specific clock input for the conversion unit can statically be configured to select different clock sources if provided by hardware. ImplementationType: Adc_ClockSourceType
        integer AdcHwUnitId: set at post-build in variant post-build / pre-compile in variant pre-compile, symbolic-name-value=true  # Numeric ID of the HW Unit. This symbolic name allows accessing Hw Unit data. ImplementationType: Adc_HwUnitType
        integer AdcPrescale [0..1]: 0.., set at post-build in variant post-build / pre-compile in variant pre-compile  # Optional ADC module specific clock prescale factor, if supported by hardware. ImplementationType: Adc_PrescaleType
        container AdcChannel [1..*]  # This container contains the channel configuration (parameters) depending on the hardware capability. The organization of this data structure could contain dependencies to the microcontroller so this is left up to the implementer and its location is left up to the configuration. Note: Since a AdcChannel can be part of several AdcGroups, this container is not realized as a subcontainer of AdcGroup but instead as a subcontainer of AdcHwUnit.
          integer AdcChannelConvTime [0..1]: 0.., set at post-build in variant post-build / pre-compile in variant pre-compile  # Configuration of conversion time, i.e. the time during which the analogue value is converted into digital representation, (in clock cycles) for each channel, if supported by hardware. ImplementationType: Adc_ConversionTimeType
          integer AdcChannelId: 0.., set at post-build in variant post-build / pre-compile in variant pre-compile, symbolic-name-value=true  # Numeric ID of the channel. This parameter is the symbolic name to be used on the API. This symbolic name allows accessing Channel data. This value will be assigned to the symbolic name derived of the AdcChannel container shortName. ImplementationType: Adc_ChannelType
          integer AdcChannelRefVoltsrcHigh [0..1]: set at post-build in variant post-build / pre-compile in variant pre-compile  # Upper reference voltage source for each channel. ImplementationType: Adc_VoltageSourceType
          integer AdcChannelRefVoltsrcLow [0..1]: set at post-build in variant post-build / pre-compile in variant pre-compile  # Lower reference voltage source for each channel. ImplementationType: Adc_VoltageSourceType
          integer AdcChannelResolution [0..1]: 0.., set at post-build in variant post-build / pre-compile in variant pre-compile  # Channel resolution in bits. ImplementationType: Adc_ResolutionType
          integer AdcChannelSampTime [0..1]: 0.., set at post-build in variant post-build / pre-compile in variant pre-compile  # Configuration of sampling time, i.e. the time during which the value is sampled, (in clock cycles) for each channel, if supported by hardware. ImplementationType: Adc_SamplingTimeType
        container AdcGroup [1..*]  # This container contains the Group configuration (parameters).
          enumeration AdcGroupAccessMode: {ADC_ACCESS_MODE_SINGLE, ADC_ACCESS_MODE_STREAMING}, set at post-build in variant post-build / pre-compile in variant pre-compile  # Type of access mode to group conversion results. ImplementationType: Adc_GroupAccessModeType
          enumeration AdcGroupConversionMode: {ADC_CONV_MODE_CONTINUOUS, ADC_CONV_MODE_ONESHOT}, set at post-build in variant post-build / pre-compile in variant pre-compile  # Type of conversion mode supported by the driver. ImplementationType: Adc_GroupConvModeType
          integer AdcGroupId: 0.., set at post-build in variant post-build / pre-compile in variant pre-compile, symbolic-name-value=true  # Numeric ID of the group. This parameter is the symbolic name to be used on the API. This symbolic name allows accessing Channel Group data. This value will be assigned to the symbolic name derived of the AdcGroup container shortName. ImplementationType: Adc_GroupType
          integer AdcGroupPriority: 0..255, set at post-build in variant post-build / pre-compile in variant pre-compile  # Priority level of the AdcGroup. ImplementationType: Adc_GroupPriorityType
          enumeration AdcGroupReplacement: {ADC_GROUP_REPL_ABORT_RESTART, ADC_GROUP_REPL_SUSPEND_RESUME}, set at post-build in variant post-build / pre-compile in variant pre-compile  # Replacement mechanism, which is used on ADC group level, if a group conversion is interrupted by a group which has a higher priority. ImplementationType: Adc_GroupReplacementType
          enumeration AdcGroupTriggSrc: {ADC_TRIGG_SRC_HW, ADC_TRIGG_SRC_SW}, set at post-build in variant post-build / pre-compile in variant pre-compile  # Type of source event that starts a group conversion. ImplementationType: Adc_TriggerSourceType
          enumeration AdcHwTrigSignal: {ADC_HW_TRIG_BOTH_EDGES, ADC_HW_TRIG_FALLING_EDGE, ADC_HW_TRIG_RISING_EDGE}, set at post-build in variant post-build / pre-compile in variant pre-compile  # Configures on which edge of the hardware trigger signal the driver should react, i.e. start the conversion (only if supported by the ADC hardware). ImplementationType: Adc_HwTriggerSignalType
          integer AdcHwTrigTimer [0..1]: set at post-build in variant post-build / pre-compile in variant pre-compile  # Reload value of the ADC module embedded timer (only if supported by ADC hardware). ImplementationType: Adc_HwTriggerTimerType
          function name AdcNotification [0..1]: set at post-build in variant post-build / pre-compile in variant pre-compile  # Callback function for each group
          linker symbol def AdcResultBufferPointer: lower-multiplicity=0, upper-multiplicity=1, set at post-build in variant post-build / pre-compile in variant pre-compile  # Pointer to data buffer (destination for conversion results). One pointer for each ADC group is required. In streaming access mode the Adc_ValueGroupType buffer is made of m*n elements, where n is the number of channels belonging to the group and m the number of samples acquired per channel (i.e. ADC_STREAMING_NUM_SAMPLES). In single access mode (m=1) the Adc_ValueGroupType buffer is made of n elements, where n is the number of channels belonging to the group. User has to ensure that the AdcResultBufferPointer of the ADC groups point to the base addresses of the ADC result buffer. ImplementationType: Adc_ValueGroupType *
          enumeration AdcStreamingBufferMode: {ADC_STREAM_BUFFER_CIRCULAR, ADC_STREAM_BUFFER_LINEAR}, set at post-build in variant post-build / pre-compile in variant pre-compile  # Configure streaming buffer as "linear buffer" (i.e. the ADC Driver stops the conversion as soon as the stream buffer is full) or as "ring buffer" (wraps around if the end of the stream buffer is reached). ImplementationType: Adc_StreamBufferModeType
          integer AdcStreamingNumSamples: set at post-build in variant post-build / pre-compile in variant pre-compile, default-value=1  # Number of ADC values to be acquired per channel in streaming access mode. Note: in single access mode this parameter assumes value 1, since only one sample per channel is processed. ImplementationType: Adc_StreamNumSampleType
          reference AdcGroupDefinition [0..*]: set at post-build in variant post-build / pre-compile in variant pre-compile, destination=AdcChannel  # Assignment of AdcChannels to a AdcGroups. ImplementationType: Adc_GroupDefType
    container AdcGeneral  # General configuration (parameters) of the ADC Driver software module.
      boolean AdcDeInitApi: set at pre-compile  # Adds / removes the service Adc_DeInit() from the code. true: Adc_DeInit() can be used. false: Adc_DeInit() can not be used.
      boolean AdcDevErrorDetect: set at pre-compile  # Switches the Development Error Detection and Notification ON or OFF. true: Enabled. false: Disabled.
      boolean AdcEnableQueuing: set at pre-compile  # Determines, if the queuing mechanism is active in case of priority mechanism disabled. Note: If priority mechanism is enabled, queuing mechanism is always active and the parameter ADC_ENABLE_QUEUING is not evaluated. true: Enabled. false: Disabled.
      boolean AdcEnableStartStopGroupApi: set at pre-compile  # Adds / removes the services Adc_StartGroupConversion() and Adc_StopGroupConversion() from the code. true: Adc_StartGroupConversion() and Adc_StopGroupConversion() can be used. false: Adc_StartGroupConversion() and Adc_StopGroupConversion() can not be used.
      boolean AdcGrpNotifCapability: set at pre-compile  # Determines, if the group notification mechanism (the functions to enable and disable the notifications) is available at runtime. true: Enabled. false: Disabled.
      boolean AdcHwTriggerApi: set at pre-compile  # Adds / removes the services Adc_EnableHardwareTrigger() and Adc_DisableHardwareTrigger() from the code. true: Adc_EnableHardwareTrigger() and Adc_DisableHardwareTrigger() can be used. false: Adc_EnableHardwareTrigger() and Adc_DisableHardwareTrigger() can not be used.
      enumeration AdcPriorityImplementation: {ADC_PRIORITY_HW, ADC_PRIORITY_HW_SW, ADC_PRIORITY_NONE}, set at pre-compile  # Determines whether a priority mechanism is available for prioritization of the conversion requests and if available, the type of prioritization mechanism. The selection applies for groups with trigger source software and trigger source hardware. Two types of prioritization mechanism can be selected. The hardware prioritization mechanism (AdcPriorityHw) uses the ADC hardware features for prioritization of the software conversion requests and hardware trigger signals for groups with trigger source hardware. The mixed hardware and software prioritization mechanism (AdcPriorityHwSw) uses the ADC hardware features for prioritization of ADC hardware trigger for groups with trigger source hardware and a software implemented prioritization mechanism for groups with trigger source software. The group priorities for software triggered groups are typically configured with lower priority levels than the group priorities for hardware triggered groups. ImplementationType: Adc_PriorityImplementationType
      boolean AdcReadGroupApi: set at pre-compile  # Adds / removes the service Adc_ReadGroup() and from the code. true: Adc_ReadGroup() can be used. false: Adc_ReadGroup() can not be used.
      boolean AdcVersionInfoApi: set at pre-compile  # Adds / removes the service Adc_GetVersionInfo() from the code. true: Adc_GetVersionInfo() can be used. false: Adc_GetVersionInfor() can not be used.
    container AdcPublishedInformation  # Additional published parameters not covered by CommonPublishedInformation container. Note that these parameters do not have any configuration class setting, since they are published information.
      boolean AdcChannelValueSigned: set at published-information  # Information whether the result value of the ADC driver has sign information (true) or not (false). If the result shall be interpreted as signed value it shall apply to C-language rules.
      boolean AdcGroupFirstChannelFixed: set at published-information  # Information whether the first channel of an ADC Channel group can be configured (false) or is fixed (true) to a value determined by the ADC HW Unit.
      integer AdcMaxChannelResolution: set at published-information  # Maximum Channel resolution in bits (does not specify accuracy).
  module definition BswM [0..1]: variants link-time/pre-compile  # Configuration of the BswM (Basic SW Mode Manager) module.
    container BswMConfig  # This container contains the configuration parameters and sub containers of the AUTOSAR BswM module. This container is a MultipleConfigurationContainer, i.e. this container and its sub-containers exist once per configuration set.
      container BswMArbitration  # This container includes all configuration sub-containers and parameters related to the mode arbitration functionality of the BswM.
        container BswMLogicalExpression [0..*]  # This container describes the logical expressions that can be used for the mode arbitration. The logical expressions are built of a set of arguments and a logical operator. Each argument can either be a mode condition or a sub-expression to allow definition of more complex logical expressions. There may be an unlimited number of arguments in each logical expression. Note that the order of evaluation of the expressions is not defined. Note that for the NAND logical expression only two operands are supported.
          enumeration BswMLogicalOperator [0..1]: {BSWM_AND, BSWM_NAND, BSWM_OR, BSWM_XOR}, set at link in variant link-time / pre-compile in variant pre-compile  # This parameter specifies the logical operator to be used in the logical expression. If the expression only consists of a single condition this parameter shall not be used.
          choice reference BswMArgumentRef [1..*]: set at link in variant link-time / pre-compile in variant pre-compile, destination=[BswMLogicalExpression, BswMModeCondition]  # This is a choice reference either to a mode condition or a sub-expression.
        container BswMModeCondition [0..*]  # This container describes the BswM mode conditions that can be used either by itself to form a rule or as a part of a logical expression.
          enumeration BswMConditionType: {BSWM_EQUALS, BSWM_EQUALS_NOT}, set at link in variant link-time / pre-compile in variant pre-compile  # This parameter specifies what kind of comparison that is made for the evaluation of the mode condition.
          reference BswMConditionMode: set at link in variant link-time / pre-compile in variant pre-compile, destination=BswMModeRequestPort  # This parameter references the mode request port that is used for the condition.
          choice container BswMConditionValue  # This container holds the parameters and references necessary to identify the mode type and the value that the mode request is compared to.
            container BswMBswMode [0..1]  # This container defines the value and type of a mode in the BSW.
              enumeration BswMBswModeSourceType [0..1]: {BSWM_CANSM_INDICATION, BSWM_COMM_INDICATION, BSWM_COMM_PNC_REQUEST, BSWM_DCM_APPLICATION_UPDATED_INDICATION, BSWM_DCM_COMMUNICATION_CTRL_REQUEST, BSWM_DCM_RESET_REQUEST, BSWM_FRSM_INDICATION, BSWM_LINTP_MODE_REQUEST}, set at link in variant link-time / pre-compile in variant pre-compile  # This element is deprecated and will be removed in future. This parameter specifies the type of mode request.
              string BswMBswRequestedMode: set at link in variant link-time / pre-compile in variant pre-compile  # This parameter contains the symbolic name (as a string) of a certain mode/state that can be requested/indicated by the BSW modules.
            container BswMSwcMode [0..1]  # When the mode corresponds to a mode request or mode indication interface the mode is defined by a mode declaration. The mode declarations are defined in the SW-C Template and hence a foreign reference to the corresponding Mode Declaration is used.
              enumeration BswMSwcConditionType: {BSWM_SWC_MODE_NOTIFICATION, BSWM_SWC_MODE_REQUEST}, set at link in variant link-time / pre-compile in variant pre-compile  # This element is deprecated and will be removed in future. This parameter defines if the condition relates to a mode request or a mode indication.
              foreign reference BswMSwcModeDeclRef: set at link in variant link-time / pre-compile in variant pre-compile, destination-type=ModeDeclaration  # This is a foreign reference to the Mode Declaration used for the mode requests corresponding to this condition.
        container BswMModeRequestPort [0..*]  # Each instance of this container defines a mode request interface that is used to requests or indicate modes from/to the BswM. These interfaces are implemented as ports or as ordinary C-functions based upon if the request is made by an SW-C or a BSW module. There are different types of mode requests: 1. Mode requests from the SW-C:s 2. Mode Requests from other BSW modules such as the DCM. 3. State/mode indications from the RTE or other BSW modules such as the bus specific State Managers. Note that the BswM treats all request and indications in the exact same way.
          string BswMModeInitValue [0..1]: set at link in variant link-time / pre-compile in variant pre-compile  # This parameter defines the initial mode value that is used by BswM for the corresponding mode request after initialization. This parameter is optional and shall only be used for Mode Requests that does not already have an initial value. When this parameter is not present the requested mode is undefined after initialization of BswM. The requested mode will remain undefined until the requester performs a request. Mode arbitration rules shall not be evaluated as long as any of the used mode requests is undefined.
          enumeration BswMRequestProcessing: {BSWM_DEFERRED, BSWM_IMMEDIATE}, set at link in variant link-time / pre-compile in variant pre-compile  # This parameter defines if the processing of the mode arbitration shall be done immediately when a mode request is received or if it shall be deferred to the processing of the main function of BswM.
          choice container BswMModeRequestSource  # This choice container specifies the source of the mode request or state/mode indication. The requester of a mode can be both SW-C:s and other BSW Modules, such as the bus specific State Managers.
            container BswMCanSMIndication [0..1]  # This is an indication of the current state of the CAN State Manager.
              symbolic name reference BswMCanSMChannelRef: destination=ComMChannel  # This is a reference to the CAN channel handle that the mode request corresponds to.
            container BswMComMIndication [0..1]  # This is an indication of the current communication mode of a channel in the Communication Manager.
              symbolic name reference BswMComMChannelRef: destination=ComMChannel  # This is a reference to the Communication Manager channel handle that the indication corresponds to.
            container BswMComMPncRequest [0..1]  # This is a request of the current communication mode of a Partial Network Cluster in the Communication Manager.
              symbolic name reference BswMComMPncRef: destination=ComMPnc  # This is a reference to the Communication Manager PNC handle of the Partial Network Cluster that the request corresponds to.
            container BswMDcmApplicationUpdatedIndication [0..1]  # This is a request to update application data from the DCM. This container does not contain any parameters since there are no further configuration needed for this type of request.
            container BswMDcmCommunicationCtrlModeRequest [0..1]  # The source of the mode request is the Diagnostic Communication Manager.
              string BswMDcmComMNetwork: set at link in variant link-time / pre-compile in variant pre-compile  # This parameter specifies the network the request relates to.
            container BswMDcmResetModeRequest [0..1]  # This is a reset mode request from the DCM. This container does not contain any parameters since there are no further configuration needed for this type of request.
            container BswMFrSMIndication [0..1]  # This is an indication of the current state of the FlexRay State Manager.
              symbolic name reference BswMFrSMChannelRef: destination=ComMChannel  # This is a reference to the FlexRay Cluster handle that the mode request corresponds to.
            container BswMLinTpModeRequest [0..1]  # This is a LinTp mode request from the LinIf. This port corresponds to a call of the BswM_LinTp_RequestMode API.
              symbolic name reference BswMLinTpChannelRef: destination=LinIfChannel  # This is a reference to the LIN Interface Channel that the mode request corresponds to.
            container BswMSwcModeNotification [0..1]  # This is a mode switch notification associated with a RTE switch interface.
              instance reference BswMSwcModeNotificationIfcRef: set at link in variant link-time / pre-compile in variant pre-compile, destination-context=ComponentPrototype* PortPrototype, destination-type=ModeDeclarationGroupPrototype  # This is a instance reference to the ModeDeclarationGroupPrototype of the BswServiceComponent that the Mode Switch Notification corresponds to. The destinationContext element is deprecated and will be removed in future.
            container BswMSwcModeRequest [0..1]  # The source of the mode request is a SW Component.
              instance reference BswMSwcModeRequestPortRef: set at link in variant link-time / pre-compile in variant pre-compile, destination-context=ComponentPrototype* PortPrototype, destination-type=ModeDeclarationGroupPrototype  # This is a instance reference to the ModeDeclarationGroupPrototype of the BswServiceComponent. The ModeDeclarationGroupPrototype PortPrototype shall be connected to the requesting SoftwareComponentPrototype's PortPrototype. The destinationContext element is deprecated and will be removed in future.
        container BswMRule [0..*]  # Each instance of this container describes a BswM arbitration rule. The rule either consists of a simple mode condition or a more complex logical expression. This container also references the action lists that shall be invoked when the rule is evaluated to True or False.
          boolean BswMNestedExecutionOnly: set at link in variant link-time / pre-compile in variant pre-compile, default-value=false  # This parameter defines for its related Rule if the Rule is an Independent rule or a Subordinate rule; false: an Independent rule, i.e. to be evaluated each time applicable (both as standalone Rule driven by its own BswMModeRequestSource and when referenced by another Rule). true: a Subordinated rule, to be evaluated ONLY as a result of being referenced in one or more Action Lists.
          enumeration BswMRuleInitState: {BSWM_FALSE, BSWM_TRUE, BSWM_UNDEFINED}, set at link in variant link-time / pre-compile in variant pre-compile  # This parameter is a part of the reset/initialization behavior of BswM. Action lists are executed when the result of a rule evaluation have changed since the last evaluation. This parameter defines the "previous evaluation result" of a rule to be used after initialization of the BswM. If this parameter is set to BSWM_UNDEFINED, the evaluation result is always treated as changed at the first evaluation of the rule after initialization. If this parameter is set to BSWM_TRUE, the evaluation result is treated as changed if the rule is evaluated to false. If this parameter is set to BSWM_FALSE, the evaluation result is treated as changed if the rule is evaluated to true.
          reference BswMRuleExpressionRef: set at link in variant link-time / pre-compile in variant pre-compile, destination=BswMLogicalExpression  # This choice reference either references the mode condition or the logical expression that is evaluated for each rule.
          reference BswMRuleFalseActionList [0..1]: set at link in variant link-time / pre-compile in variant pre-compile, destination=BswMActionList  # This is a reference to the action list that shall be executed when the rule is evaluated to False
          reference BswMRuleTrueActionList [0..1]: set at link in variant link-time / pre-compile in variant pre-compile, destination=BswMActionList  # This is a reference to the action list that shall be executed when the rule is evaluated to True
      container BswMModeControl  # This container includes all configuration sub-containers and parameters related to the mode control functionality of the BswM.
        container BswMAction [0..*]  # Each container of this type defines an action. These actions can be part of one or several action lists.
          choice container BswMAvailableActions  # Choice container including the available actions to be used in the action lists.
            container BswMDeadlineMonitoringControl [0..1]  # This container includes all parameters related to enabling and disabling of deadline monitoring for one or several PDUs in COM.
              symbolic name reference BswMDisabledDMPduGroupRef [0..*]: destination=ComIPduGroup  # This is a reference to a PDU Group for which the Deadline Monitoring should be disabled. BswM shall call Com_DisableReceptionDM for each referenced IPduGroup.
              symbolic name reference BswMEnabledDMPduGroupRef [0..*]: destination=ComIPduGroup  # This is a reference to a PDU Group for which the Deadline Monitoring should be enabled. BswM shall call Com_EnableReceptionDM for each referenced IPduGroup.
            container BswMLinScheduleSwitch [0..1]  # This container includes all parameters related to a switch of LIN schedule table. LinSM_ScheduleRequest is called when this action is configured.
              symbolic name reference BswMLinScheduleRef: destination=LinIfScheduleTable  # This is a reference to the LIN schedule table that the LIN SM shall change to.
            container BswMNMControl [0..1]  # This container includes all parameters related to enabling and disabling of Network Management communication. Disabling of NM communication can be requested by DCM. Nm_EnableCommunication or Nm_DisableCommunication is called when this action is configured.
              enumeration BswMNMAction: {BSWM_NM_DISABLE, BSWM_NM_ENABLE}, set at link in variant link-time / pre-compile in variant pre-compile  # This parameter specifies if the communication of the corresponding NM channel should be enabled or disabled.
              symbolic name reference BswMComMNetworkHandleRef: destination=ComMChannel  # This reference points to the unique channel defined by the ComMChannel and provides access to the unique channel index value in ComMChannelId.
            container BswMPduGroupSwitch [0..1]  # This container includes references to the PDU groups that shall be enabled and disabled.
              boolean BswMPduGroupSwitchReinit: set at link in variant link-time / pre-compile in variant pre-compile, default-value=false  # This parameter defines if the the values for the parameters like periodical timer, minimum delay timer etc is retainer or reinitialized during a PDU Group Switch.
              symbolic name reference BswMDisabledPduGroupRef [0..*]: destination=ComIPduGroup  # This is a reference to a PDU Group that should be disabled. BswM shall call Com_IpduGroupStop for each referenced IPduGroup. BswMDisabledPduGroupRef and BswMEnabledPduGroupRef shall not reference the same IPduGroup in a single action.
              symbolic name reference BswMEnabledPduGroupRef [0..*]: destination=ComIPduGroup  # This is a reference to a PDU Group that should be enabled. BswM shall call Com_IpduGroupStart for each referenced IPduGroup. BswMDisabledPduGroupRef and BswMEnabledPduGroupRef shall not reference the same IPduGroup in a single action.
            container BswMPduRouterControl [0..1]  # This container includes all parameters related to enabling and disabling of routing of Routing Path Groups in the PDU Router. PduR_EnableRouting or PduR_DisableRouting is called when this action is configured.
              symbolic name reference BswMDisabledPduRoutingPathGroupRef [0..*]: destination=PduRRoutingPathGroup  # This is a reference to the PDU Routing Path Group for which the routing in the PDU Router should be disabled. BswM shall call PduR_DisableRouting for each referenced PduRRoutingPathGroup.
              symbolic name reference BswMEnabledPduRoutingPathGroupRef [0..*]: destination=PduRRoutingPathGroup  # This is a reference to the PDU Routing Path Group for which the routing in the PDU Router should be enabled. BswM shall call PduR_EnableRouting for each referenced PduRRoutingPathGroup.
            container BswMRteSwitch [0..1]  # This container defines a mode switch indication that the BswM provides to the SW-C that need to be notified about the mode switch. RTE_Switch is called when this action is configured. It is expected that the Software Component Description of the BswM contains a PPortPrototype for each instance of this container. The provided port shall be typed by the BswMRteSwitchInterfaceRef. The shortName of the PPortPrototype shall be equal to the shortName of this container.
              foreign reference BswMRteSwitchInterfaceRef: set at link in variant link-time / pre-compile in variant pre-compile, destination-type=SenderReceiverInterface  # This is a foreign reference to the SenderReceiverInterface which types the PPortPrototoype that is used for the indication.
              foreign reference BswMSwitchedMode: set at link in variant link-time / pre-compile in variant pre-compile, destination-type=ModeDeclaration  # This parameter contains the integer value that corresponds to a certain mode in a Mode Declaration Group.
            container BswMUserCallout [0..1]  # This container includes all details needed for a user defined function call.
              string BswMUserCalloutFunction: set at link in variant link-time / pre-compile in variant pre-compile  # This parameter specifies the complete function call including all parameters. The parameters are specified during configuration time, and cannot be changed during run time. Any return values passed by the callout will be ignored.
        container BswMActionList [0..*]  # Each instance of this container defines an action list that is invoked based on the BswM Rules. An action list contains a list of numbered action items to be processed. An action list can also include other action lists.
          enumeration BswMActionListExecution: {BSWM_CONDITION, BSWM_TRIGGER}, set at link in variant link-time / pre-compile in variant pre-compile  # This parameter controls if the corresponding action list shall be executed every time the rule is evaluated or only when the result of the evaluation changes.
          container BswMActionListItem [1..*]  # This container defines an item in an action list.
            boolean BswMAbortOnFail: set at link in variant link-time / pre-compile in variant pre-compile, default-value=false  # This parameter defines if the execution of the action list shall be aborted if this specific action returns E_NOT_OK. Note that this is only applicable for actions that have E_NOT_OK as a possible return value.
            integer BswMActionListItemIndex: 0..255, set at link in variant link-time / pre-compile in variant pre-compile  # This parameter defines the index of the action in the action list. It is used define in which order the actions shall be performed.
            boolean BswMReportFailToDem: set at link in variant link-time / pre-compile in variant pre-compile, default-value=false  # This parameter defines if a DEM event shall be reported if this specific action returns E_NOT_OK. Note that this is only applicable for actions that have E_NOT_OK as a possible return value.
            choice reference BswMActionListItemRef: set at link in variant link-time / pre-compile in variant pre-compile, destination=[BswMAction, BswMActionList, BswMRule]  # The action item can either be an atomic action or a reference to another action list or rule.
    container BswMGeneral  # General configuration parameters of the Basic SW Mode Manager.
      boolean BswMDevErrorDetect: set at pre-compile, default-value=false  # Switches the Development Error Detection and Notification ON or OFF. true: Enabled false: Disabled
      float BswMMainFunctionPeriod [0..1]: set at link in variant link-time / pre-compile in variant pre-compile  # The cycle time of the periodic main function of BswM. Defined in seconds .
      boolean BswMVersionInfoApi: set at pre-compile, default-value=true  # Switches the possibility to read the version information with the service BswM_GetVersionInfo(). true: Enabled false: Disabled
  module definition Can [0..*]: variants post-build/pre-compile  # This container holds the configuration of a single CAN Driver.
    container CanConfigSet: multiple-configuration-container=true  # This is the multiple configuration set container for CAN Driver
      container CanController [1..*]  # This container contains the configuration parameters of the CAN controller(s).
        enumeration CanBusoffProcessing: {INTERRUPT, POLLING}, set at pre-compile  # Enables / disables API Can_MainFunction_BusOff() for handling busoff events in polling mode.
        boolean CanControllerActivation: set at pre-compile  # Defines if a CAN controller is used in the configuration.
        integer CanControllerBaudRate: set at post-build in variant post-build / pre-compile in variant pre-compile  # Specifies the buadrate of the controller in kbps.
        integer CanControllerId: set at pre-compile, symbolic-name-value=true  # This parameter provides the controller ID which is unique in a given CAN Driver. The value for this parameter starts with 0 and continue without any gaps.
        integer CanControllerPropSeg: set at post-build in variant post-build / pre-compile in variant pre-compile  # Specifies propagation delay in time quantas.
        integer CanControllerSeg1: set at post-build in variant post-build / pre-compile in variant pre-compile  # Specifies phase segment 1 in time quantas.
        integer CanControllerSeg2: set at post-build in variant post-build / pre-compile in variant pre-compile  # Specifies phase segment 2 in time quantas.
        float CanControllerTimeQuanta: set at post-build in variant post-build / pre-compile in variant pre-compile  # Specifies the time quanta for the controller. The calculation of the resulting prescaler value depending on module clocking and time quanta shall be done offline Hardware specific.
        enumeration CanRxProcessing: {INTERRUPT, POLLING}, set at pre-compile  # Enables / disables API Can_MainFunction_Read() for handling PDU reception events in polling mode.
        enumeration CanTxProcessing: {INTERRUPT, POLLING}, set at pre-compile  # Enables / disables API Can_MainFunction_Write() for handling PDU transmission events in polling mode.
        enumeration CanWakeupProcessing: {INTERRUPT, POLLING}, set at pre-compile  # Enables / disables API Can_MainFunction_Wakeup() for handling wakeup events in polling mode.
        reference CanCpuClockRef: set at pre-compile, destination=McuClockReferencePoint  # Reference to the CPU clock configuration, which is set in the MCU driver configuration
        symbolic name reference CanWakeupSourceRef [0..1]: destination=EcuMWakeupSource  # This parameter contains a reference to the Wakeup Source for this controller as defined in the ECU State Manager. Implementation Type: reference to EcuM_WakeupSourceType
        container CanFilterMask [0..*]  # This container contains the configuration (parameters) of the CAN Filter Mask(s). This container is set to obsolete and will be removed in future. Use CanHwFilterMask instead.
          integer CanFilterMaskValue: set at post-build in variant post-build / pre-compile in variant pre-compile  # Describes a mask for hardware-based filtering of CAN identifiers It shall be distinguished between - Standard identifier mask - Extended identifier mask.
      container CanHardwareObject [1..*]  # This container contains the configuration (parameters) of CAN Hardware Objects.
        enumeration CanHandleType: {BASIC, FULL}, set at post-build in variant post-build / pre-compile in variant pre-compile  # Specifies the type (Full-CAN or Basic-CAN) of a hardware object.
        integer CanHwObjectCount [0..1]: set at post-build in variant post-build / pre-compile in variant pre-compile, default-value=1  # Number of hardware objects used to implement one HOH. In case of a HRH this parameter defines the number of elements in the hardware FIFO or the number of shadow buffers, in case of a HTH it defines the number of hardware objects used for multiplexed transmission or for a hardware FIFO used by a FullCAN HTH.
        enumeration CanIdType: {EXTENDED, MIXED, STANDARD}, set at post-build in variant post-build / pre-compile in variant pre-compile  # Specifies whether the IdValue is of type - standard identifier - extended identifier - mixed mode ImplementationType: Can_IdType
        integer CanIdValue [0..1]: set at post-build in variant post-build / pre-compile in variant pre-compile  # This parameter is deprecated and will be removed in the future. Old description: Specifies (together with the filter mask) the identifiers range that passes the hardware filter.
        integer CanObjectId: set at post-build in variant post-build / pre-compile in variant pre-compile, symbolic-name-value=true  # Holds the handle ID of HRH or HTH. The value of this parameter is unique in a given CAN Driver, and it should start with 0 and continue without any gaps. The HRH and HTH Ids share a common ID range. Example: HRH0-0, HRH1-1, HTH0-2, HTH1-3
        enumeration CanObjectType: {RECEIVE, TRANSMIT}, set at post-build in variant post-build / pre-compile in variant pre-compile  # Specifies if the HardwareObject is used as Transmit or as Receive object
        reference CanControllerRef: set at post-build in variant post-build / pre-compile in variant pre-compile, destination=CanController  # Reference to CAN Controller to which the HOH is associated to.
        reference CanFilterMaskRef [0..1]: set at post-build in variant post-build / pre-compile in variant pre-compile, destination=CanFilterMask  # Reference to the filter mask that is used for hardware filtering togerther with the CAN_ID_VALUE Different CanHardwareObjects with different CanIdTypes (STANDARD, MIXED, EXTENDED) can share the same CanFilterMask (i.e., the CanFilterMaskRef parameters of these CanHardwareObjects reference the very same CanFilterMask container). This shall be allowed and must be supported by the configuration generators. This container is set to obsolete and will be removed in future. Use CanHwFilterMask instead.
        container CanHwFilter [0..*]  # This container is only valid for HRHs and contains the configuration (parameters) of one hardware filter.
          integer CanHwFilterCode: 0..4294967295, set at post-build in variant post-build / pre-compile in variant pre-compile  # Specifies (together with the filter mask) the identifiers range that passes the hardware filter.
          integer CanHwFilterMask: 0..4294967295, set at post-build in variant post-build / pre-compile in variant pre-compile  # Describes a mask for hardware-based filtering of CAN identifiers It shall be distinguished between - Standard identifier mask - Extended identifier mask.
    container CanGeneral  # This container contains the parameters related each CAN Driver Unit.
      boolean CanDevErrorDetection: set at pre-compile  # Switches the Development Error Detection and Notification ON or OFF.
      boolean CanHardwareCancellation: set at pre-compile  # Specifies if hardware cancellation shall be supported.ON or OFF
      integer CanIndex: set at pre-compile  # Specifies the InstanceId of this module instance. If only one instance is present it shall have the Id 0.
      function name CanLPduReceiveCalloutFunction [0..1]: set at pre-compile  # This parameter defines the existence and the name of a callout function that is called after a successful reception of a received CAN Rx L-PDU. If this parameter is omitted no callout shall take place.
      float CanMainFunctionBusoffPeriod: set at pre-compile  # This parameter describes the period for cyclic call to Can_MainFunction_Busoff. Unit is seconds.
      float CanMainFunctionReadPeriod [0..*]: set at pre-compile  # This parameter describes the period for cyclic call to Can_MainFunction_Read. Unit is seconds. Different poll-cycles will be configurable if more than one CanMainFunctionReadPeriod is configured. In this case multiple Can_MainFunction_Read() will be provided by the CAN Driver module.
      float CanMainFunctionWakeupPeriod: set at pre-compile  # This parameter describes the period for cyclic call to Can_MainFunction_Wakeup. Unit is seconds.
      float CanMainFunctionWritePeriod [0..*]: set at pre-compile  # This parameter describes the period for cyclic call to Can_MainFunction_Write. Unit is seconds. Different poll-cycles will be configurable if more than one CanMainFunctionWritePeriod is configured. In this case multiple Can_MainFunction_Write() will be provided by the CAN Driver module.
      boolean CanMultiplexedTransmission: set at pre-compile  # Specifies if multiplexed transmission shall be supported.ON or OFF
      integer CanTimeoutDurationFactor: set at pre-compile  # Specifies the maximum number of loops for blocking function until a timeout is raised in short term wait loops.
      boolean CanVersionInfoApi: set at pre-compile  # Switches the Can_GetVersionInfo() API ON or OFF.
      boolean CanWakeupSupport: set at pre-compile  # CAN driver support for wakeup over CAN Bus.
      reference CanMainFunctionReadPeriodRef [0..1]: set at pre-compile, destination=CanHardwareObject  # Reference to CAN Hardware Object which shall be polled with the configured CanMainFunctionReadPeriod. This reference shall only be configurable if more than one period is configured via CanMainFunctionReadPeriod.
      reference CanMainFunctionWritePeriodRef [0..1]: set at pre-compile, destination=CanHardwareObject  # Reference to CAN Hardware Object which shall be polled with the configured CanMainFunctionWritePeriod. This reference shall only be configurable if more than one period is configured via CanMainFunctionWritePeriod.
  module definition CanIf [0..1]: variants link-time/post-build/pre-compile  # This container includes all necessary configuration sub-containers according the CAN Interface configuration structure.
    container CanIfControllerConfig [1..*]  # This container contains the configuration (parameters) of all addressed CAN controllers by each underlying CAN driver.
      integer CanIfCtrlId: 0..255, set at link in variant link-time / pre-compile in variant pre-compile, symbolic-name-value=true  # This parameter abstracts from the CAN Driver specific parameter Controller. Each controller of all connected CAN Driver modules shall be assigned to one specific ControllerId of the CanIf. Range: 0..number of configured controllers of all CAN Driver modules
      boolean CanIfCtrlWakeupSupport: set at link in variant link-time+post-build / pre-compile in variant pre-compile, default-value=false  # This parameter defines if a respective controller of the referenced CAN Driver modules is queriable for wake up events. True: Enabled False: Disabled
      reference CanIfDriverNameRef: set at link in variant link-time+post-build / pre-compile in variant pre-compile, destination=CanIfDriverConfig  # Refers to the CAN Driver Name to which the controller belongs to. This parameter refers to CanIfDriverConfig container.
      symbolic name reference CanIfCtrlCanCtrlRef [0..*]: destination=CanController  # This parameter references to the logical handle of the underlying CAN controller from the CAN Driver module to be served by the CAN Interface module. The following parameters of CanController config container shall be referenced by this link: CanControllerId, CanWakeupSourceRef Range: 0..max. number of underlying supported CAN controllers
    container CanIfDispatchConfig [0..1]  # Callout functions with respect to the upper layers. This callout functions defined in this container are common to all configured underlying CAN Drivers / CAN Transceiver Drivers.
      function name CanIfDispatchUserCheckTrcvWakeFlagIndicationName [0..1]: set at link in variant link-time+post-build / pre-compile in variant pre-compile  # This parameter defines the name of <User_CheckTrcvWakeFlagIndication>. This parameter depends on the parameter CANIF_DISPATCH_USERCHECKTRCVWAKEFLAGINDICATION_UL. If CANIF_DISPATCH_USERCHECKTRCVWAKEFLAGINDICATION_UL equals CAN_SM the name of <User_CheckTrcvWakeFlagIndication> is fixed. If CANIF_DISPATCH_USERCHECKTRCVWAKEFLAGINDICATION_UL equals CDD, the name of <User_CheckTrcvWakeFlagIndication> is selectable. minLength: 1 maxLength: 32
      enumeration CanIfDispatchUserCheckTrcvWakeFlagIndicationUL [0..1]: {CAN_SM, CDD}, set at link in variant link-time+post-build / pre-compile in variant pre-compile  # This parameter defines the upper layer (UL) module to which the CanIf_CheckTrcvWakeFlagIndication has to be routed via <User_CheckTrcvWakeFlagIndication>. If no UL module is configured, no upper layer callback function will be called.
      function name CanIfDispatchUserClearTrcvWufFlagIndicationName [0..1]: set at link in variant link-time+post-build / pre-compile in variant pre-compile  # This parameter defines the name of <User_ClearTrcvWufFlagIndication>. This parameter depends on the parameter CANIF_DISPATCH_USERCLEARTRCVWUFFLAGINDICATION_UL. If CANIF_DISPATCH_USERCLEARTRCVWUFFLAGINDICATION_UL equals CAN_SM the name of <User_ClearTrcvWufFlagIndication> is fixed. If CANIF_DISPATCH_USERCLEARTRCVWUFFLAGINDICATION_UL equals CDD, the name of <User_ClearTrcvWufFlagIndication> is selectable. minLength: 1 maxLength: 32
      enumeration CanIfDispatchUserClearTrcvWufFlagIndicationUL [0..1]: {CAN_SM, CDD}, set at link in variant link-time+post-build / pre-compile in variant pre-compile  # This parameter defines the upper layer (UL) module to which the CanIf_ClearTrcvWufFlagIndication has to be routed via <User_ClearTrcvWufFlagIndication>. If no UL module is configured, no upper layer callback function will be called.
      function name CanIfDispatchUserConfirmPnAvailabilityName [0..1]: set at link in variant link-time+post-build / pre-compile in variant pre-compile  # This parameter defines the name of <User_ConfirmPnAvailability>. This parameter depends on the parameter CANIF_DISPATCH_USERCONFIRMPNAVAILABILITY_UL. If CANIF_DISPATCH_USERCONFIRMPNAVAILABILITY_UL equals CAN_SM the name of <User_ConfirmPnAvailability> is fixed. If CANIF_DISPATCH_USERCONFIRMPNAVAILABILITY_UL equals CDD, the name of <User_ConfirmPnAvailability> is selectable. minLength: 1 maxLength: 32
      enumeration CanIfDispatchUserConfirmPnAvailabilityUL [0..1]: {CAN_SM, CDD}, set at link in variant link-time+post-build / pre-compile in variant pre-compile  # This parameter defines the upper layer (UL) module to which the CanIf_ConfirmPnAvailability has to be routed via <User_ConfirmPnAvailability>. If no UL module is configured, no upper layer callback function will be called.
      function name CanIfDispatchUserCtrlBusOffName: set at link in variant link-time+post-build / pre-compile in variant pre-compile  # This parameter defines the name of <User_ControllerBusOff>. This parameter depends on the parameter CANIF_USERCTRLBUSOFF_UL. If CANIF_USERCTRLBUSOFF_UL equals CAN_SM the name of <User_ControllerBusOff> is fixed. If CANIF_USERCTRLBUSOFF_UL equals CDD, the name of <User_ControllerBusOff> is selectable.
      enumeration CanIfDispatchUserCtrlBusOffUL: {CAN_SM, CDD}, set at link in variant link-time+post-build / pre-compile in variant pre-compile  # This parameter defines the upper layer (UL) module to which the notifications of all ControllerBusOff events from the CAN Driver modules have to be routed via <User_ControllerBusOff>. There is no possibility to configure no upper layer (UL) module as the provider of <User_ControllerBusOff>.
      function name CanIfDispatchUserTrcvModeIndicationName [0..1]: set at link in variant link-time+post-build / pre-compile in variant pre-compile  # This parameter defines the name of <User_TrcvModeIndication>. This parameter depends on the parameter CANIF_USERTRCVMODEINDICATION_UL. If CANIF_USERTRCVMODEINDICATION_UL equals CAN_SM the name of <User_TrcvModeIndication> is fixed. If CANIF_USERTRCVMODEINDICATION_UL equals CDD, the name of <User_TrcvModeIndication> is selectable. minLength: 1 maxLength: 32
      enumeration CanIfDispatchUserTrcvModeIndicationUL [0..1]: {CAN_SM, CDD}, set at link in variant link-time+post-build / pre-compile in variant pre-compile  # This parameter defines the upper layer (UL) module to which the notifications of all TransceiverTransition events from the CAN Transceiver Driver modules have to be routed via <User_TrcvModeIndication>. If no UL module is configured, no upper layer callback function will be called.
      function name CanIfDispatchUserValidateWakeupEventName: set at link in variant link-time+post-build / pre-compile in variant pre-compile  # This parameter defines the name of <User_ValidateWakeupEvent>. This parameter depends on the parameter CANIF_USERVALIDATEWAKEUPEVENT_UL. CANIF_USERVALIDATEWAKEUPEVENT_UL equals ECUM the name of <User_ValidateWakeupEvent> is fixed. CANIF_USERVALIDATEWAKEUPEVENT_UL equals CDD, the name of <User_ValidateWakeupEvent> is selectable. If parameter CANIF_WAKEUP_CHECK_VALIDATION_API is disabled, no <User_ValidateWakeupEvent> API can be configured.
      enumeration CanIfDispatchUserValidateWakeupEventUL: {CDD, ECUM}, set at link in variant link-time+post-build / pre-compile in variant pre-compile  # This parameter defines the upper layer (UL) module to which the notifications about positive former requested wake up sources have to be routed via <User_ValidateWakeupEvent>. If parameter CANIF_WAKEUP_CHECK_VALIDATION_API is disabled, this parameter cannot be configured.
    container CanIfDriverConfig [1..*]  # Configuration parameters for all the underlying CAN drivers are aggregated under this container.
      boolean CanIfBusoffNotification: set at link in variant link-time+post-build / pre-compile in variant pre-compile  # Selects whether BusOff indication notification is supported. True: Enabled False: Disabled
      boolean CanIfReceiveIndication: set at link in variant link-time+post-build / pre-compile in variant pre-compile  # Selects whether receive indication notification is supported. True: Enabled False: Disabled
      boolean CanIfTransmitCancellation: set at pre-compile  # Selects whether transmit cancellation is supported. True: Enabled False: Disabled
      boolean CanIfTxConfirmation: set at link in variant link-time+post-build / pre-compile in variant pre-compile  # Selects whether transmit confirmation notification is supported.
      boolean CanIfWakeupNotification: set at link in variant link-time+post-build / pre-compile in variant pre-compile  # Selects whether wakeup indication notification is supported. True: Enabled False: Disabled
      reference CanIfDriverNameRef: set at pre-compile, destination=CanGeneral  # CAN Interface Driver Reference. This reference can be used to get any information (Ex. Driver Name, Vendor ID) from the CAN driver. The CAN Driver name can be derived from the ShortName of the CAN driver module.
      reference CanIfInitHohConfigRef: set at link in variant link-time+post-build / pre-compile in variant pre-compile, destination=CanIfInitHohConfig  # Reference to the Init Hoh Configuration
    container CanIfInitConfiguration [1..*]: multiple-configuration-container=true  # This container contains the init parameters of the CAN Interface.
      string CanIfConfigSet: set at link in variant link-time / post-build in variant post-build / pre-compile in variant pre-compile  # Selects the CAN Interface specific configuration setup. This type of the external data structure shall contain the post build initialization data for the CAN Interface for all underlying CAN Dirvers. constant to CanIf_ConfigType
      integer CanIfNumberOfCanRxPduIds: set at link in variant link-time / post-build in variant post-build / pre-compile in variant pre-compile  # Total number of CanRxPduIds to be handled. Range: 0..max number of defined CanRxPduIds
      integer CanIfNumberOfCanTXPduIds: set at link in variant link-time / post-build in variant post-build / pre-compile in variant pre-compile  # Total number of CanTxPduIds to be handled. Range: 0..max number of defined CanTxPduIds
      integer CanIfNumberOfDynamicCanTXPduIds: set at link in variant link-time / post-build in variant post-build / pre-compile in variant pre-compile  # Total number of dynamic CanTxPduIds to be handled. Range: 0..max. nember of defined CanTxPduIds
      reference CanIfInitControllerRef [1..*]: set at link in variant link-time / post-build in variant post-build / pre-compile in variant pre-compile, destination=CanIfInitControllerConfig  # Reference to the Init Controller Configuration.
      container CanIfInitControllerConfig [0..*]  # This container contains the references to the configuration setup of each underlying CAN driver.
        symbolic name reference CanIfControllerRefConfigSet: destination=CanController  # References the corresponding CAN Controller configuration setup of the corresponding CAN Driver.
      container CanIfInitHohConfig [0..*]  # This container contains the references to the configuration setup of each underlying CAN Driver.
        reference CanIfRefConfigSet: set at link in variant link-time / post-build in variant post-build / pre-compile in variant pre-compile, destination=CanConfigSet  # Selects the CAN Interface specific configuration setup. This type of external data structure shall contain the post build initialization data for the CAN Interface for all underlying CAN Drivers.
        container CanIfHrhConfig [0..*]  # This container contains configuration parameters for each hardware receive object (HRH).
          enumeration CanIfHrhType: {BASIC_CAN, FULL_CAN}, set at link in variant link-time+post-build / pre-compile in variant pre-compile  # Defines the HRH type i.e, whether its a BasicCan or FullCan. If BasicCan is configured, software filtering is enabled.
          boolean CanIfSoftwareFilterHrh: set at link in variant link-time+post-build / pre-compile in variant pre-compile, default-value=true  # Selects the hardware receive objects by using the HRH range/list from CAN Driver configuration to define, for which HRH a software filtering has to be performed at during receive processing. True: Software filtering is enabled False: Software filtering is enabled
          reference CanIfCanControllerHrhIdRef: set at link in variant link-time+post-build / pre-compile in variant pre-compile, destination=CanIfControllerConfig  # Reference to controller Id to which the HRH belongs to. A controller can contain one or more HRHs.
          symbolic name reference CanIfHrhIdSymRef: destination=CanHardwareObject  # The parameter refers to a particular HRH object in the CAN Driver Module configuration. The HRH id is unique in a given CAN Driver. The HRH Ids are defined in the CAN Driver Module and hence it is derived from CAN Driver Configuration.
          container CanIfHrhRangeConfig [0..*]  # Defines the parameters required for configuraing multiple CANID ranges for a given same HRH.
            integer CanIfRxPduLowerCanId [0..1]: 0..8589934591, set at link in variant link-time / post-build in variant post-build / pre-compile in variant pre-compile  # Lower CAN Identifier of a receive CAN L-PDU for identifier range definition, in which all CAN Ids shall pass the software filtering.
            enumeration CanIfRxPduRangeCanIdType: {EXTENDED, STANDARD}, set at link in variant link-time / post-build in variant post-build / pre-compile in variant pre-compile  # Specifies whether a configured Range of CAN Ids shall only consider standard CAN Ids or extended CAN Ids.
            integer CanIfRxPduUpperCanId: 0..8589934591, set at link in variant link-time / post-build in variant post-build / pre-compile in variant pre-compile  # Upper CAN Identifier of a receive CAN L-PDU for identifier range definition, in which all CAN Ids shall pass the software filtering.
        container CanIfHthConfig [0..*]  # This container contains parameters related to each HTH.
          enumeration CanIfHthType: {BASIC_CAN, FULL_CAN}, set at link in variant link-time+post-build / pre-compile in variant pre-compile  # Transmission method of the corresponding HTH.
          reference CanIfCanControllerIdRef: set at link in variant link-time+post-build / pre-compile in variant pre-compile, destination=CanIfControllerConfig  # Reference to controller Id to which the HTH belongs to. A controller can contain one or more HTHs.
          symbolic name reference CanIfHthIdSymRef: destination=CanHardwareObject  # The parameter refers to a particular HTH object in the CAN Driver Module configuration. The HTH id is unique in a given CAN Driver. The HTH Ids are defined in the CAN Driver Module and hence it is derived from CAN Driver Configuration.
      container CanIfRxPduConfig [0..*]  # This container contains the configuration (parameters) of each receive CAN L-PDU. The SHORT-NAME of "CanIfRxPduConfig" container itself represents the symolic name of Receive L-PDU.
        integer CanIfCanRxPduCanId [0..1]: set at link in variant link-time / post-build in variant post-build / pre-compile in variant pre-compile  # CAN Identifier of Receive CAN L-PDUs used by the CAN Interface. Exa: Software Filtering. This parameter is used if exactly one Can Identifier is assigned to the Pdu. If a range is assigned then the CanIfRxPduCanIdRange parameter shall be used. Range: 11 Bit For Standard CAN Identifier ... 29 Bit For Extended CAN identifier
        integer CanIfCanRxPduDlc: 0..8, set at link in variant link-time / post-build in variant post-build / pre-compile in variant pre-compile  # Data Length code of received CAN L-PDUs used by the CAN Interface. Exa: DLC check. The data area size of a CAN L-PDU can have a range from 0 to 8 bytes.
        integer CanIfCanRxPduId: set at link in variant link-time / post-build in variant post-build / pre-compile in variant pre-compile, symbolic-name-value=true  # ECU wide unique, symbolic handle for receive CAN L-PDU. The CanRxPduId is configurable at pre-compile and post-built time. It shall fulfill ANSI/AUTOSAR definitions for constant defines. Range: 0..max. number of defined CanRxPduIds
        boolean CanIfReadRxPduData: set at link in variant link-time / post-build in variant post-build / pre-compile in variant pre-compile, default-value=false  # Enables and disables the Rx buffering for reading of received L-PDU data. True: Enabled False: Disabled
        boolean CanIfReadRxPduNotifyStatus: set at link in variant link-time / post-build in variant post-build / pre-compile in variant pre-compile, default-value=false  # Enables and disables receive indication for each receive CAN L-PDU for reading its' notification status. True: Enabled False: Disabled
        enumeration CanIfRxPduIdCanIdType: {EXTENDED_CAN, STANDARD_CAN}, set at link in variant link-time / post-build in variant post-build / pre-compile in variant pre-compile  # CAN Identtifier of receive CAN L-PDUs used by the CAN Driver for CAN L-PDU reception.
        enumeration CanIfRxUserType: {CAN_NM, CAN_TP, CDD, PDUR}, set at link in variant link-time / post-build in variant post-build / pre-compile in variant pre-compile  # This parameter defines the type of the receive indication call-outs called to the corresponding upper layer the used TargetRxPduId belongs to.
        function name CanIfUserRxIndication [0..1]: set at link in variant link-time+post-build / pre-compile in variant pre-compile  # Name of target indication services to target upper layers (PduRouter, CanNm, CanTp and ComplexDeviceDrivers). If parameter is not present no call-out function is configured.
        reference CanIfCanRxPduHrhRef: set at link in variant link-time / post-build in variant post-build / pre-compile in variant pre-compile, destination=CanIfHrhConfig  # The HRH to which Rx L-PDU belongs to, is referred through this parameter.
        reference PduIdRef: set at pre-compile, destination=Pdu  # Reference to the "global" Pdu structure to allow harmonization of handle IDs in the COM-Stack.
        container CanIfRxPduCanIdRange [0..1]  # Optional container that allows to map a range of CAN Ids to one PduId.
          integer CanIfRxPduCanIdRangeLowerCanId: 0..536870911, set at link in variant link-time / post-build in variant post-build / pre-compile in variant pre-compile  # Lower CAN Identifier of a receive CAN L-PDU for identifier range definition, in which all CAN Ids are mapped to one PduId.
          integer CanIfRxPduCanIdRangeUpperCanId: 0..536870911, set at link in variant link-time / post-build in variant post-build / pre-compile in variant pre-compile  # Upper CAN Identifier of a receive CAN L-PDU for identifier range definition, in which all CAN Ids are mapped to one PduId.
      container CanIfTxPduConfig [0..*]  # This container contains the configuration (parameters) of each transmit CAN L-PDU. The SHORT-NAME of "CanIfTxPduConfig" container represents the symolic name of Transmit L-PDU.
        integer CanIfCanTxPduId: set at link in variant link-time / post-build in variant post-build / pre-compile in variant pre-compile, symbolic-name-value=true  # ECU wide unique, symbolic handle for transmit CAN L-PDU. The CanIfCanTxPduId is configurable at pre-compile and post-built time. Range: 0..max. number of CantTxPduIds
        integer CanIfCanTxPduIdCanId: set at link in variant link-time / post-build in variant post-build / pre-compile in variant pre-compile  # CAN Identifier of transmit CAN L-PDUs used by the CAN Driver for CAN L-PDU transmission. Range: 11 Bit For Standard CAN Identifier ... 29 Bit For Extended CAN identifier
        integer CanIfCanTxPduIdDlc: 0..8, set at link in variant link-time / post-build in variant post-build / pre-compile in variant pre-compile  # Data length code (in bytes) of transmit CAN L-PDUs used by the CAN Driver for CAN L-PDU transmission. The data area size of a CAN L-Pdu can have a range from 0 to 8 bytes.
        enumeration CanIfCanTxPduType: {DYNAMIC, STATIC}, set at link in variant link-time / post-build in variant post-build / pre-compile in variant pre-compile  # Defines the type of each transmit CAN L-PDU.
        boolean CanIfReadTxPduNotifyStatus: set at link in variant link-time / post-build in variant post-build / pre-compile in variant pre-compile, default-value=false  # Enables and disables transmit confirmation for each transmit CAN L-PDU for reading its notification status. True: Enabled False: Disabled
        enumeration CanIfTxPduIdCanIdType: {EXTENDED_CAN, STANDARD_CAN}, set at link in variant link-time / post-build in variant post-build / pre-compile in variant pre-compile  # CAN Identifier of transmit CAN L-PDUs used by the CAN Driver for CAN L-PDU transmission.
        boolean CanIfTxPduPnFilterPdu [0..1]: set at link in variant link-time / post-build in variant post-build / pre-compile in variant pre-compile  # If CanIfPublicPnFilterSupport is enabled, by this parameter PDUs could be configured which will pass the CanIfPnFilter. If there is no CanIfTxPduPnFilterPdu configured per controller, the corresponding controller applies no CanIfPnFilter.
        enumeration CanIfTxUserType: {CAN_NM, CAN_TP, CDD, PDUR}, set at link in variant link-time / post-build in variant post-build / pre-compile in variant pre-compile  # This parameter defines the type of the transmit confirmation call-out called to the corresponding upper layer the used TargetTxPduId belongs to.
        function name CanIfUserTxConfirmation [0..1]: set at link in variant link-time+post-build / pre-compile in variant pre-compile  # Name of target confirmation services to target upper layers (PduR, CanNm, CanTp, Complex Device Driver). If parameter is not configured then no call-out function is provided by the upper layer for this Tx L-PDU.
        reference CanIfCanTxPduHthRef: set at link in variant link-time / post-build in variant post-build / pre-compile in variant pre-compile, destination=CanIfHthConfig  # Handle, that defines the hardware object or the pool of hardware objects configured for transmission. The parameter refers HTH Id, to which the L-PDU belongs to.
        reference PduIdRef: set at pre-compile, destination=Pdu  # Reference to the "global" Pdu structure to allow harmonization of handle IDs in the COM-Stack.
    container CanIfPrivateConfiguration  # This container contains the private configuration (parameters) of the CAN Interface.
      boolean CanIfDlcCheck: set at pre-compile, default-value=true  # Selects whether the DLC check is supported. True: Enabled False: Disabled
      integer CanIfNumberOfTxBuffers: set at pre-compile  # Defined the number of L-PDU elements for the transmit buffering. The Tx L-PDU buffers shall be used to store an L-PDU once for each different L-PDU handle. Range: 0..max. number of Tx L-PDUs to be used. Default Value: NUMBER_OF_TX_PDUS
      enumeration CanIfSoftwareFilterType: {BINARY, INDEX, LINEAR, TABLE}, set at pre-compile  # Selects the desired software filter mechanism for reception only. Each implemented software filtering method is identified by this enumeration number. Range: Types implemented software filtering methods
    container CanIfPublicConfiguration  # This container contains the public configuration (parameters) of the CAN Interface.
      boolean CanIfDevErrorDetect: set at pre-compile, default-value=true  # Enables and disables the development error detection and notification mechanism. True: Enabled False: Disabled
      boolean CanIfMultipleDriverSupport: set at pre-compile, default-value=true  # Selects support for multiple CAN Drivers. True: Enabled False: Disabled
      integer CanIfNumberOfCanHwUnits: set at link in variant link-time+post-build / pre-compile in variant pre-compile, default-value=1  # Number of served CAN hardware units. Range: 1..max. number of underlying supported CAN Hardware units
      string CanIfPublicCddHeaderFile [0..*]: set at pre-compile  # Defines header files for callback functions which shall be included in case of CDDs. Range of characters is 1.. 32.
      enumeration CanIfPublicHandleTypeEnum: {UINT16, UINT8}, set at pre-compile  # This parameter is used to configure the Can_HwHandleType. The Can_HwHandleType represents the hardware object handles of a CAN hardware unit. For CAN hardware units with more than 255 HW objects the extended range shall be used (UINT16).
      boolean CanIfPublicPnSupport: set at pre-compile, default-value=false  # Selects support of Partial Networking features in CanIf. True: Enabled False: Disabled
      boolean CanIfPublicTxConfirmPollingSupport: set at pre-compile  # Configuration parameter to enable/disable the API to poll for Tx Confirmation state.
      boolean CanIfPublicWakeupCheckValidSupport: set at pre-compile, default-value=false  # Selects support for wake up validation True: Enabled False: Disabled
      boolean CanIfReadRxPduDataApi: set at pre-compile, default-value=false  # Enables / Disables the API CanIf_ReadRxPduData() for reading received L-PDU data. True: Enabled False: Disabled
      boolean CanIfReadRxPduNotifyStatusApi: set at pre-compile, default-value=false  # Enables and disables the API for reading the received L-PDU data. True: Enabled False: Disabled
      boolean CanIfReadTxPduNotifyStatusApi: set at pre-compile, default-value=false  # Enables and disables the API for reading the notification status of transmit and receive L-PDUs. True: Enabled False: Disabled
      boolean CanIfSetDynamicTxIdApi: set at pre-compile, default-value=false  # Enables and disables the API for reconfiguration of the CAN Identifier for each Transmit L-PDU. True: Enabled False: Disabled
      boolean CanIfVersionInfoApi: set at pre-compile, default-value=true  # Enables and disables the API for reading the version information about the CAN Interface. True: Enabled False: Disabled
    container CanIfTransceiverDrvConfig [0..*]  # This container contains the configuration (parameters) of all addressed CAN transceivers by each underlying CAN Transceiver Driver.
      integer CanIfTrcvId: 0..255, set at link in variant link-time / pre-compile in variant pre-compile, symbolic-name-value=true  # This parameter abstracts from the CAN Transceiver Driver specific parameter Transceiver. Each transceiver of all connected CAN Transceiver Driver modules shall be assigned to one specific TransceiverId of the CanIf. Range: 0..number of configured transceivers of all CAN Transceiver Driver modules
      boolean CanIfTrcvWakeupSupport: set at link in variant link-time+post-build / pre-compile in variant pre-compile, default-value=false  # This parameter defines if a respective transceiver of the referenced CAN Transceiver Driver modules is queriable for wake up events. True: Enabled False: Disabled
      symbolic name reference CanIfTrcvIdRef [1..*]: destination=CanTrcvChannel  # Logical handle of the underlying CAN transceiver to be served by the CAN Interface.
  module definition CanNm [0..1]: variants link-time/post-build/pre-compile  # Configuration Parameters for the Can Nm module.
    container CanNmGlobalConfig: multiple-configuration-container=true  # This container contains the global configuration parameter of the CanNm. The parameters and the parameters of the sub containers shall be mapped to the C data type CanNm_ConfigType (for parameters where it is possible) which is passed to the CanNm_Init function. This container is a MultipleConfigurationContainer (only for variant 3), i.e. this container and its sub-containers exit once per configuration set.
      boolean CanNmActiveWakeupBitEnabled [0..1]: set at pre-compile  # Please note that this parameter is obsolete and replaced by the CanNmActiveWakeupBitEnabled parameter in the CanNmChannelConfig container. Enables/Disables the handling of the Active Wakeup Bit in the CanNm module.
      boolean CanNmBusLoadReductionEnabled: set at pre-compile  # Pre-processor switch for enabling busload reduction support.
      derived boolean CanNmBusSynchronizationEnabled: set at pre-compile  # Pre-processor switch for enabling bus synchronization support.
      derived boolean CanNmComControlEnabled: set at pre-compile  # Pre-processor switch for enabling the Communication Control support.
      boolean CanNmComUserDataSupport: set at pre-compile  # Enable/disable the user data support.
      integer CanNmConfigPtr [0..1]: set at link in variant link-time / post-build in variant post-build / pre-compile in variant pre-compile  # Pointer to configuration of CanNm. This parameter is set to obsolete and will be removed in future.
      boolean CanNmCoordinatorSyncSupport: set at pre-compile  # Enables/disables the coordinator synchronisation support.
      boolean CanNmDevErrorDetect: set at pre-compile  # Pre-processor switch for enabling development error detection support.
      boolean CanNmImmediateRestartEnabled: set at pre-compile  # Pre-processor switch for enabling the asynchronous transmission of a NM PDU upon bus-communication request in Prepare-Bus-Sleep mode.
      boolean CanNmImmediateTxconfEnabled: set at pre-compile  # Enable/disable the immediate tx confirmation.
      derived boolean CanNmNodeDetectionEnabled: set at pre-compile  # Pre-processor switch for enabling the node detection support.
      derived boolean CanNmNodeIdEnabled: set at pre-compile  # Pre-processor switch for enabling the source node identifier.
      integer CanNmNumberOfChannels [0..1]: 1..255, set at pre-compile  # Number of Can NM channels allowed within one ECU. Please note that this parameter is deprecated and will be removed in future.
      derived boolean CanNmPassiveModeEnabled: set at pre-compile  # Pre-processor switch for enabling support of the Passive Mode.
      derived boolean CanNmPduRxIndicationEnabled: set at pre-compile  # Pre-processor switch for enabling the PDU Rx Indication.
      boolean CanNmPnEiraCalcEnabled [0..1]: set at pre-compile, default-value=false  # Specifies if CanNm calculates the PN request information for internal an external requests. (EIRA) true: PN request are calculated false: PN request are not calculated
      float CanNmPnResetTime [0..1]: 0.001..65.535, set at link in variant link-time+post-build / pre-compile in variant pre-compile  # Specifies the runtime of the reset timer in seconds. This reset time is valid for the reset of PN requests in the EIRA and in the ERA. The value shall be the same for every channel. Thus it is a global config parameter.
      derived boolean CanNmRemoteSleepIndEnabled: set at pre-compile  # Pre-processor switch for enabling remote sleep indication support.
      derived boolean CanNmRepeatMsgIndEnabled: set at pre-compile  # Enable/disable the notification that a RepeatMessageRequest bit has been received.
      derived boolean CanNmStateChangeIndEnabled: set at pre-compile  # Pre-processor switch for enabling the CAN NM state change notification.
      derived boolean CanNmUserDataEnabled: set at pre-compile  # Pre-processor switch for enabling user data support.
      boolean CanNmVersionInfoApi: set at pre-compile  # Pre-processor switch for enabling version info API support.
      reference CanNmPnEiraRxNSduRef [0..1]: set at link in variant link-time+post-build / pre-compile in variant pre-compile, destination=Pdu  # Reference to a Pdu in the COM-Stack. Only one SduRef is required for CanNm because the EIRA is the aggregation over all Can Channels.
      container CanNmChannelConfig [1..*]  # This container contains the channel specific configuration parameter of the CanNm.
        boolean CanNmActiveWakeupBitEnabled [0..1]: set at link in variant link-time+post-build / pre-compile in variant pre-compile, default-value=false  # Enables/Disables the handling of the Active Wakeup Bit in the CanNm module.
        boolean CanNmAllNmMessagesKeepAwake [0..1]: set at link in variant link-time+post-build / pre-compile in variant pre-compile, default-value=false  # Specifies if CanNm drops irrelevant NM PDUs. false: Only NM PDUs with an with PNI bit = true and containing an PN request for this ECU triggers the standard RX indication handling true: Every NM PDU triggers the standard RX indication handling
        boolean CanNmBusLoadReductionActive: set at link in variant link-time+post-build / pre-compile in variant pre-compile  # This parameter defines if bus load reduction for the respective NM channel is active or not.
        integer CanNmCarWakeUpBitPosition: 0..7, set at link in variant link-time+post-build / pre-compile in variant pre-compile  # Specifies the Bit position of the CWU within the NM PDU.
        integer CanNmCarWakeUpBytePosition: 2..7, set at link in variant link-time+post-build / pre-compile in variant pre-compile  # Specifies the Byte position of the CWU within the NM PDU.
        boolean CanNmCarWakeUpFilterEnabled: set at link in variant link-time+post-build / pre-compile in variant pre-compile, default-value=false  # If CWU filtering is supported, only the CWU bit within the NM PDU with source node identifier CanNmCarWakeUpFilterNodeId is considered as CWU request. FALSE - CWU filtering is not supported TRUE - CWU filtering is supported
        integer CanNmCarWakeUpFilterNodeId: 0..255, set at link in variant link-time+post-build / pre-compile in variant pre-compile  # Source node identifier for CWU filtering. If CWU filtering is supported, only the CWU bit within the NM PDU with source node identifier CanNmCarWakeUpFilterNodeId is considered as CWU request.
        boolean CanNmCarWakeUpRxEnabled: set at link in variant link-time+post-build / pre-compile in variant pre-compile, default-value=false  # Enables or disables support of CarWakeUp bit evaluation in received NM PDUs. FALSE - CarWakeUp not supported TRUE - CarWakeUp supported
        boolean CanNmChannelActive: set at link in variant link-time+post-build / pre-compile in variant pre-compile  # Please note that this parameter is obsolete and will be removed in future revisions. It determines if the respective NM channel is active or not. Indicates whether a particular NM-channel shall be initialized (TRUE) or not (FALSE). If this parameter is set to FALSE the respective CanNm channel shall not be used during runtime.
        float CanNmImmediateNmCycleTime [0..1]: 0.001..65.535, set at link in variant link-time+post-build / pre-compile in variant pre-compile  # Defines the immediate NM PDU cycle time in seconds which is used for CanNmImmediateNmTransmissions NM PDU transmissions.
        integer CanNmImmediateNmTransmissions: 0..255, set at link in variant link-time+post-build / pre-compile in variant pre-compile  # Defines the number of immediate NM PDUs which shall be transmitted. If the value is zero no immediate NM PDUs are transmitted. The cycle time of immeditate NM PDUs is defined by CanNmImmediateNmCycleTime.
        float CanNmMainFunctionPeriod: 0.001..0.255, set at link in variant link-time+post-build / pre-compile in variant pre-compile  # Call cycle in seconds of CanNm_MainFunction_x for the respective CanNm channel.
        float CanNmMsgCycleOffset: 0..65.535, set at link in variant link-time+post-build / pre-compile in variant pre-compile  # Time offset in the periodic transmission node. It determines the start delay of the transmission. Specified in seconds.
        float CanNmMsgCycleTime: 0.001..65.535, set at link in variant link-time+post-build / pre-compile in variant pre-compile  # Period of a NM PDU in seconds. It determines the periodic rate in the "periodic transmission mode with bus load reduction" and is the basis for transmit scheduling in the "periodic transmission mode without bus load reduction".
        float CanNmMsgReducedtime: 0.001..65.535, set at link in variant link-time / pre-compile in variant pre-compile  # Node specific bus cycle time in the periodic transmission mode with bus load reduction. Specified in seconds.
        float CanNmMsgTimeoutTime: 1..65.535, set at link in variant link-time+post-build / pre-compile in variant pre-compile  # Transmission Timeout of NM PDU.
        integer CanNmNodeId: 0..255, set at link in variant link-time+post-build / pre-compile in variant pre-compile  # Node identifier of local node
        enumeration CanNmPduCbvPosition: {CANNM_PDU_BYTE_0, CANNM_PDU_BYTE_1, CANNM_PDU_OFF}, set at link in variant link-time+post-build / pre-compile in variant pre-compile  # Defines the position of the control bit vector within the NM PDU. The value of the parameter represents the location of the control bit vector in the NM PDU (CanNmPduByte0 means byte 0, CanNmPduByte1 means byte 1, CanNmPduOff means source node identifier is not part of the NM PDU). ImplementationType: CanNm_PduPositionType
        integer CanNmPduLength: 0..8, set at link in variant link-time+post-build / pre-compile in variant pre-compile  # Defines the length of the NM PDU.
        enumeration CanNmPduNidPosition: {CANNM_PDU_BYTE_0, CANNM_PDU_BYTE_1, CANNM_PDU_OFF}, set at link in variant link-time+post-build / pre-compile in variant pre-compile  # Defines the position of the source node identifier within the NM PDU. The value of the parameter represents the location of the source node identifier in the NM PDU (CanNMPduByte0 means byte 0, CanNmPduByte1 means byte 1, CanNmPduOff means source node identifier is not part of the NM PDU) ImplementationType: CanNm_PduPositionType
        boolean CanNmPnEnabled [0..1]: set at link in variant link-time / post-build in variant post-build / pre-compile in variant pre-compile, default-value=false  # Enables or disables support of partial networking. false: Partial networking Range not supported true: Partial networking supported
        boolean CanNmPnEraCalcEnabled [0..1]: set at link in variant link-time+post-build / pre-compile in variant pre-compile, default-value=false  # Specifies if CanNm calculates the PN request information for external requests. (ERA) false: PN request are not calculated true: PN request are calculated
        boolean CanNmPnHandleMultipleNetworkRequests [0..1]: set at link in variant link-time+post-build / pre-compile in variant pre-compile, default-value=false  # Specifies if CanNm performs an additional transition from Network Mode to Repeat Message State (true) or not (false).
        float CanNmRemoteSleepIndTime: 0..65.535, set at link in variant link-time+post-build / pre-compile in variant pre-compile  # Timeout for Remote Sleep Indication. It defines the time in seconds how long it shall take to recognize that all other nodes are ready to sleep.
        float CanNmRepeatMessageTime: 0..65.535, set at link in variant link-time+post-build / pre-compile in variant pre-compile  # Timeout for Repeat Message State. It defines the time in seconds how long the NM shall stay in the Repeat Message State.
        boolean CanNmRetryFirstMessageRequest [0..1]: set at link in variant link-time+post-build / pre-compile in variant pre-compile, default-value=false  # Specifies if first message request in CanNm is repeated until accepted by CanIf.
        float CanNmTimeoutTime: 0.002..65.535, set at link in variant link-time+post-build / pre-compile in variant pre-compile  # Network Timeout for NM PDUs. It denotes the time in seconds how long the NM shall stay in the Network Mode before transition into Prepare Bus-Sleep Mode shall take place.
        integer CanNmUserDataLength [0..1]: 0..8, set at link in variant link-time+post-build / pre-compile in variant pre-compile  # Defines the length of the user data contained in the NM PDU. Please note that this parameter is deprecated and will be removed in future.
        float CanNmWaitBusSleepTime: 0.001..65.535, set at link in variant link-time+post-build / pre-compile in variant pre-compile  # Timeout for bus calm down phase. It denotes the time in seconds how long the NM shall stay in the Prepare Bus-Sleep Mode before transition into Bus-Sleep Mode shall take place.
        reference CanNmNetworkHandle: set at link in variant link-time / post-build in variant post-build / pre-compile in variant pre-compile, destination=CanStateManagerNetworks  # Channel identifier configured for the respective CanNm channel. The CanNmChannelHandle shall be encoded in the canNmRxPduId parameter which is passed to CanNm_RxIndication() function called by the CanIf.
        reference CanNmPnEraRxNSduRef [0..1]: set at link in variant link-time+post-build / pre-compile in variant pre-compile, destination=Pdu  # Reference to a Pdu in the COM-Stack. The SduRef is required for every CanNm Channel, because ERA is reported per channel.
        symbolic name reference CanNmChannelIdRef: destination=NmChannelConfig  # Channel identifier configured for the respective AUTOSAR NM cluster. It is used by referring to the respective NM channel handle. It must be unique for each AUTOSAR NM cluster within one ECU.
        container CanNmRxPdu  # This container is used to configure the Rx PDU Properties that are used for the CanNm Channel.
          integer CanNmRxPduId: 0.., set at link in variant link-time+post-build / pre-compile in variant pre-compile  # This parameter defines the Rx PDU ID of the CanIf L-PDU range that is associated with this CanNmChannel. ImplementationType: PduIdType
          reference CanNmRxPduRef: set at link in variant link-time+post-build / pre-compile in variant pre-compile, destination=Pdu  # Reference to the global PDU that is used by this CanNmChannel.
        container CanNmTxPdu [0..1]  # This container is used to configure the Tx PDU Properties that are used for the CanNm Channel.
          reference CanNmTxPduRef: set at link in variant link-time+post-build / pre-compile in variant pre-compile, destination=Pdu  # The reference to the common PDU structure.
        container CanNmUserDataTxPdu [0..1]  # This optional container is used to configure the UserNm PDU. This container is only available if CanNmComUserDataSupport is enabled.
          integer CanNmTxUserDataPduId: 0..65535, set at link in variant link-time+post-build / pre-compile in variant pre-compile, symbolic-name-value=true  # This parameter defines the Handle ID of the NM User Data I-PDU.
          reference CanNmTxUserDataPduRef: set at link in variant link-time+post-build / pre-compile in variant pre-compile, destination=Pdu  # Reference to the NM User Data I-PDU in the global PDU collection.
      container CanNmPnInfo [0..1]  # PN information configuration
        integer CanNmPnInfoLength: 1..7, set at link in variant link-time+post-build / pre-compile in variant pre-compile, default-value=1  # Specifies the length of the PN request information in the NM PDU.
        integer CanNmPnInfoOffset: 1..7, set at link in variant link-time+post-build / pre-compile in variant pre-compile, default-value=1  # Specifies the offset of the PN request information in the NM PDU.
        container CanNmPnFilterMaskByte [0..7]  # Filter mask byte configuration
          integer CanNmPnFilterMaskByteIndex: 0..6, set at link in variant link-time+post-build / pre-compile in variant pre-compile  # Index of the filter mask byte. Specifies the position within the filter mask byte array.
          integer CanNmPnFilterMaskByteValue: 0..255, set at link in variant link-time+post-build / pre-compile in variant pre-compile, default-value=0  # Parameter to configure the filter mask byte.
  module definition CanSM [0..1]: variants link-time/post-build/pre-compile  # Configuration of the CanSM module
    container CanSMGeneral  # Container for general pre-compile parameters of the CanSM module.
      boolean CanSMDevErrorDetect: set at pre-compile  # Enables and disables the development error detection and notification mechanism.
      float CanSMMainFunctionTimePeriod: 0.001..65.535, set at pre-compile  # This parameter defines the cycle time of the function CanSM_MainFunction in seconds.
      boolean CanSMPncSupport [0..1]: set at pre-compile, default-value=false  # Enables or disables support of partial networking. False: Partial Networking is disabled True: Partial Networking is enabled
      boolean CanSMVersionInfoApi: set at pre-compile  # Activate/Deactivate the version information API (CanSM_GetVersionInfo). true: version information API activated. false: version information API deactivated.
    container CanStateManagerConfiguration: multiple-configuration-container=true  # This container contains the global parameters of the CanSM and sub containers, which are for the CAN network specific configuration.
      container CanStateManagerNetworks [1..*]  # This container contains the CAN network specific parameters of each CAN network
        integer CanSMBorCounterL1ToL2: 0..255, set at link in variant link-time / post-build in variant post-build / pre-compile in variant pre-compile  # This threshold defines at which bus-off-counter value the bus-off recovery state machine switches from level 1 to level 2.
        float CanSMBorTimeL1: 0..65.535, set at link in variant link-time / post-build in variant post-build / pre-compile in variant pre-compile  # This time parameter defines in seconds the duration of the bus-off recovery time in level 1 (short recovery time).
        float CanSMBorTimeL2: 0..65.535, set at link in variant link-time / post-build in variant post-build / pre-compile in variant pre-compile  # This time parameter defines in seconds the duration of the bus-off recovery time in level 2 (long recovery time).
        float CanSMBorTimeTxEnsured: 0..65.535, set at link in variant link-time / post-build in variant post-build / pre-compile in variant pre-compile  # This parameter defines in seconds the duration of the bus-off event check. This check assesses, if the recovery has been successful after the recovery reenables the transmit path. If a new bus-off occurs during this time period, the CanSM assesses this bus-off as sequential bus-off without successful recovery. Because a bus-off only can be detected, when PDUs are transmitted, the time has to be great enough to ensure that PDUs are transmitted again.
        boolean CanSMBorTxConfirmationPolling: set at pre-compile  # This parameter shall configure, if the CanSM polls the CanIf_GetTxConfirmationState API to decide the bus-off state to be recovered instead of using the CanSMBorTimeTxEnsured parameter for this decision.
        symbolic name reference CanSMNetworkHandle: destination=ComMChannel  # Unique handle to identify one certain CAN network. Reference to one of the network handles configured for the ComM.
        symbolic name reference CanSMTransceiverId: destination=CanIfTransceiverDrvConfig  # ID of the CAN transceiver assigned to the configured network handle. Reference to one of the transceivers of CanTrcv configuration.
        symbolic name reference CanSMTransceiverPnSupport: destination=CanTrcvChannel  # Indicates the ability of partial networking for the configured CAN transceiver. The information about the ability of the transceiver to support the selective wake-up function is hold in the parameter CanTrcvHwPnSupport.
        container CanStateManagerControllers [1..*]  # This container contains the controller IDs assigned to a CAN network.
          symbolic name reference CanSMControllerId: destination=CanIfControllerConfig  # Unique handle to identify one certain CAN controller. Reference to one of the CAN controllers of CAN driver (Can) configuration.
  module definition CanTp [0..1]: variants post-build/pre-compile  # Configuration of the CanTp (CAN Transport Protocol) module.
    container CanTpChannel [1..*]  # This container contains the configuration parameters of the CanTp channel.
      enumeration CanTpChannelMode: {CANTP_MODE_FULL_DUPLEX, CANTP_MODE_HALF_DUPLEX}, set at pre-compile  # The CAN Transport Layer supports half and full duplex channel modes.
      container CanTpRxNSdu [0..*]  # The following parameters needs to be configured for each CAN N-SDU that the CanTp module receives via the CanTpChannel.
        enumeration CanTpAddressingFormat: {CANTP_EXTENDED, CANTP_STANDARD}, set at pre-compile  # Declares which communication addressing mode is supported for this Rx N-SDU. Enum values: CanTpStandard. To use normal addressing format. CanTpExtended. To use extended addressing format.
        integer CanTpBs: set at post-build in variant post-build / pre-compile in variant pre-compile  # Sets the maximum number of N-PDUs the CanTp receiver allows the sender to send, before waiting for an authorization to continue transmission of the following N-PDUs.For further details on this parameter value see ISO 15765-2 specification. Note: For reasons of buffer length, the CAN Transport Layer can adapt the BS value within the limit of this maximum BS
        float CanTpNar: set at post-build in variant post-build / pre-compile in variant pre-compile  # Value in seconds of the N_Ar timeout. N_Ar is the time for transmission of a CAN frame (any N_PDU) on the receiver side.
        float CanTpNbr: set at post-build in variant post-build / pre-compile in variant pre-compile  # Value in seconds of the performance requirement for (N_Br + N_Ar). N_Br is the elapsed time between the receiving indication of a FF or CF or the transmit confirmation of a FC, until the transmit request of the next FC.
        float CanTpNcr: set at post-build in variant post-build / pre-compile in variant pre-compile  # Value in seconds of the N_Cr timeout. N_Cr is the time until reception of the next Consecutive Frame N_PDU.
        integer CanTpRxDl [0..1]: set at pre-compile  # Data Length Code of this RxNsdu. In case of variable message length, this value indicates the minimum data length. Depending on SF or FF N-SDU the value will be limited to 7 (6 for an extended addressing format) and 4095 respectively. This parameter is set to obsolete and will be removed in future.
        integer CanTpRxNSduId: 0.., set at pre-compile, symbolic-name-value=true  # Unique identifier to a structure that contains all useful information to process the reception of a RxNsdu.
        enumeration CanTpRxPaddingActivation: {CANTP_OFF, CANTP_ON}, set at pre-compile  # Defines if the receive frame uses padding or not. Definition of enumeration values: CanTpOn: The N-PDU received uses padding for SF, FC and the last CF. (N-PDU length is always 8 bytes) CanTpOff: The N-PDU received does not use padding for SF, CF and the last CF. (N-PDU length is dynamic)
        enumeration CanTpRxTaType: {CANTP_FUNCTIONAL, CANTP_PHYSICAL}, set at pre-compile  # Declares the communication type of this Rx N-SDU.
        integer CanTpRxWftMax: set at post-build in variant post-build / pre-compile in variant pre-compile  # This parameter indicates how many Flow Control wait N-PDUs can be consecutively transmitted by the receiver. It is local to the node and is not transmitted inside the FC protocol data unit. CanTpRxWftMax is used to avoid sender nodes being potentially hooked-up in case of a temporarily reception inability on the part of the receiver nodes, whereby the sender could be waiting continuously.
        integer CanTpSTmin: set at post-build in variant post-build / pre-compile in variant pre-compile  # Sets the duration of the minimum time the CanTp sender shall wait between the transmissions of two CF N-PDUs. For further details on this parameter value see ISO 15765-2 specification.
        boolean CanTpStaticBlockSize: set at post-build in variant post-build / pre-compile in variant pre-compile, default-value=false  # If this parameter is TRUE, the BlockSize will remain the same as in the first flow control. If this parameter is FALSE, the BlockSize is dynamic.
        reference CanTpRxNSduRef: set at link in variant post-build / pre-compile in variant pre-compile, destination=Pdu  # Reference to a Pdu in the COM-Stack.
        container CanTpNSa [0..1]  # Contains the parameters needed to configure each RxNSdu or TxNSdu with CanTpAddressingFormat set to CanTpExtended.
          integer CanTpNSa: set at pre-compile  # If an RxNSdu ora TxNSdu is configured for extended addressing format, this parameter contains the transport protocol source address's value.
        container CanTpNTa [0..1]  # The following parameters need to be configured for each RxNsdu or TxNsdu with the CanTpAddressingFormat set to CanTpExtended.
          integer CanTpNTa: set at pre-compile  # If an RxNsdu or a TxNsdu is configured for extended addressing format, this parameter contains the transport protocol target address's value.
        container CanTpRxNPdu  # Used for grouping of the ID of a PDU and the Reference to a PDU.
          integer CanTpRxNPduId: 0.., set at pre-compile, symbolic-name-value=true  # The N-PDU identifier attached to the RxNsdu is identified by CanTpRxNSduId. Each RxNsdu identifier is linked to only one SF/FF/CF N-PDU identifier. Nevertheless, in the case of extended addressing format, the same N-PDU identifier can be used for several N-SDU identifiers. The distinction is made by the N_TA value (first data byte of SF or FF frames).
          reference CanTpRxNPduRef: set at post-build in variant post-build / pre-compile in variant pre-compile, destination=Pdu  # Reference to a Pdu in the COM-Stack.
        container CanTpTxFcNPdu [0..1]  # Used for grouping of the ID of a PDU and the Reference to a PDU.
          reference CanTpTxFcNPduRef: set at post-build in variant post-build / pre-compile in variant pre-compile, destination=Pdu  # Reference to a Pdu in the COM-Stack.
      container CanTpTxNSdu [0..*]  # The following parameters needs to be configured for each CAN N-SDU that the CanTp module transmits via the CanTpChannel.
        enumeration CanTpAddressingMode: {CANTP_EXTENDED, CANTP_STANDARD}, set at pre-compile  # Declares which communication addressing format is supported for this TxNsdu. Definition of Enumeration values: CanTpStandard to use normal addressing format. CanTpExtended to use extended addressing format (the N_TA container of this TxNsdu will be used).
        float CanTpNas: set at post-build in variant post-build / pre-compile in variant pre-compile  # Value in second of the N_As timeout. N_As is the time for transmission of a CAN frame (any N_PDU) on the part of the sender.
        float CanTpNbs: set at post-build in variant post-build / pre-compile in variant pre-compile  # Value in seconds of the N_Bs timeout. N_Bs is the time of transmission until reception of the next Flow Control N_PDU.
        float CanTpNcs: set at post-build in variant post-build / pre-compile in variant pre-compile  # Value in seconds of the performance requirement of (N_Cs + N_As). N_Cs is the time which elapses between the transmit request of a CF N-PDU until the transmit request of the next CF N-PDU.
        integer CanTpTxDl [0..1]: set at pre-compile  # Data Length Code of this TxNsdu. In case of variable length message, this value indicates the minimum data length. This parameter is set to obsolete and will be removed in future.
        integer CanTpTxNSduId: 0.., set at pre-compile, symbolic-name-value=true  # Unique identifier to a structure that contains all useful information to process the transmission of a TxNsdu.
        enumeration CanTpTxPaddingActivation: {CANTP_OFF, CANTP_ON}, set at pre-compile  # Defines if the transmit frame use padding or not. Definition of Enumeration values: CanTpOn The transmit N-PDU uses padding for SF, FC and the last CF. (N-PDU length is always 8 bytes) CanTpOff The transmit N-PDU does not use padding for SF, CF and the last CF. (N-PDU length is dynamic)
        enumeration CanTpTxTaType: {CANTP_FUNCTIONAL, CANTP_PHYSICAL}, set at pre-compile  # Declares the communication type of this TxNsdu. Enumeration values: CanTpPhysical. Used for 1:1 communication. CanTpFunctional. Used for 1:n communication.
        reference CanTpTxNSduRef: set at link in variant post-build / pre-compile in variant pre-compile, destination=Pdu  # Reference to a Pdu in the COM-Stack.
        container CanTpNSa [0..1]  # Contains the parameters needed to configure each RxNSdu or TxNSdu with CanTpAddressingFormat set to CanTpExtended.
          integer CanTpNSa: set at pre-compile  # If an RxNSdu ora TxNSdu is configured for extended addressing format, this parameter contains the transport protocol source address's value.
        container CanTpNTa [0..1]  # The following parameters need to be configured for each RxNsdu or TxNsdu with the CanTpAddressingFormat set to CanTpExtended.
          integer CanTpNTa: set at pre-compile  # If an RxNsdu or a TxNsdu is configured for extended addressing format, this parameter contains the transport protocol target address's value.
        container CanTpRxFcNPdu [0..1]  # Used for grouping of the ID of a PDU and the Reference to a PDU.
          integer CanTpRxFcNPduId: 0.., set at pre-compile, symbolic-name-value=true  # N-PDU identifier attached to the FC N-PDU of this TxNsdu identified by CanTpTxNSduId. Each TxNsdu identifier is linked to one Rx FC N-PDU identifier only. However, in the case of extended addressing format, the same FC N-PDU identifier can be used for several N-SDU identifiers. The distinction is made by means of the N_TA value (first data byte of FC frames).
          reference CanTpRxFcNPduRef: set at post-build in variant post-build / pre-compile in variant pre-compile, destination=Pdu  # Reference to a Pdu in the COM-Stack.
        container CanTpTxNPdu  # Used for grouping of the ID of a PDU and the Reference to a PDU.
          reference CanTpTxNPduRef: set at post-build in variant post-build / pre-compile in variant pre-compile, destination=Pdu  # Reference to a Pdu in the COM-Stack.
    container CanTpGeneral  # This container contains the general configuration parameters of the CanTp module.
      boolean CanTpChangeParameterApi: set at pre-compile  # This parameter, if set to true, enables the CanTp_ChangeParameter Api for this Module.
      boolean CanTpDevErrorDetect: set at pre-compile  # Switches the Development Error Detection and Notification ON or OFF
      float CanTpMainFunctionPeriod: 0..0.255, set at post-build in variant post-build / pre-compile in variant pre-compile  # Allow to configure the time for the MainFunction (as float in seconds). Please note: This configuration value shall be equal to the value in the ScheduleManger module.
      integer CanTpPaddingByte: 0..255, set at pre-compile  # Used for the initialization of unused bytes with a certain value
      boolean CanTpTc: set at pre-compile  # Preprocessor switch for enabling Transmit Cancellation and Receive Cancellation.
  module definition CanTrcv [0..*]: variants post-build/pre-compile  # Configuration of the CanTrcv (CAN Transceiver driver) module.
    container CanTrcvConfigSet: multiple-configuration-container=true  # This is the multiple configuration set container for CAN Transceiver.
      integer CanTrcvSPICommRetries: 0..255, set at post-build in variant post-build / pre-compile in variant pre-compile, default-value=0  # Indicates the maximum number of communication retries in case of a failed SPI communication (applies both to timed out communication and to errors/NACK in the response data). If configured value is '0', no retry is allowed (communication is expected to succeed at first try).
      integer CanTrcvSPICommTimeout: 0..100, set at post-build in variant post-build / pre-compile in variant pre-compile, default-value=0  # Indicates the maximum time allowed to the CanTrcv for replying (either positively or negatively) to a SPI command. Timeout is configured in milliseconds. Timeout value of '0' means that no specific timeout is to be used by CanTrcv and the communication is executed at the best of the SPI HW capacity.
      container CanTrcvChannel [1..*]  # Container gives CAN transceiver driver information about a single CAN transceiver channel. Any CAN transceiver driver has such CAN transceiver channels.
        integer CanTrcvChannelId: set at pre-compile, symbolic-name-value=true  # Unique identifier of the CAN Transceiver Channel.
        boolean CanTrcvChannelUsed: set at pre-compile, default-value=true  # Shall the related CAN transceiver channel be used?
        boolean CanTrcvControlsPowerSupply: set at pre-compile, default-value=false  # Is ECU power supply controlled by this transceiver? TRUE = Controlled by transceiver. FALSE = Not controlled by transceiver.
        boolean CanTrcvHwPnSupport: set at pre-compile, default-value=false  # Indicates whether the transceiver has the ability to be selectively woken up by a Wake-up Frame (WUF). TRUE = Selective wakeup functionality is available in transceiver. FALSE = Selective wakeup functionality is not available in transceiver.
        enumeration CanTrcvInitState: {CANTRCV_OP_MODE_NORMAL, CANTRCV_OP_MODE_SLEEP, CANTRCV_OP_MODE_STANDBY}, set at pre-compile, default-value=CANTRCV_OP_MODE_NORMAL  # State of CAN transceiver after call to CanTrcv_Init.
        integer CanTrcvMaxBaudrate: 0..1000, set at pre-compile  # Max baudrate for transceiver hardware type. Only used for validation purposes. Value shall be configured by configuration tool based on transceiver hardware type.
        boolean CanTrcvWakeupByBusUsed: set at pre-compile, default-value=false  # Is wake up by bus supported? If CAN transceiver hardware does not support wake up by bus value is always FALSE. If CAN transceiver hardware supports wake up by bus value is TRUE or FALSE depending whether it is used or not. TRUE = Is used. FALSE = Is not used.
        symbolic name reference CanTrcvIcuChannelRef [0..1]: destination=IcuChannel  # Reference to the IcuChannel to enable/disable the interrupts for wakeups.
        symbolic name reference CanTrcvWakeupSourceRef: destination=EcuMWakeupSource  # Reference to a wakeup source in the EcuM configuration. This reference is only needed if CanTrcvWakeupByBusUsed is true. Implementation Type: reference to EcuM_WakeupSourceType
        choice container CanTrcvAccess [1..*]
          container CanTrcvDioAccess [0..1]  # Container gives CAN transceiver driver information about accessing ports and port pins. In addition relation between CAN transceiver hardware pin names and Dio port access information is given. If a CAN transceiver hardware has no Dio interface, there is no instance of this container.
            string CanTrcvHardwareInterfaceName: set at pre-compile  # CAN transceiver hardware interface name. It is typically the name of a pin. From a Dio point of view it is either a port, a single channel or a channel group. Depending on this fact either CANTRCV_DIO_PORT_SYMBOLIC_NAME or CANTRCV_DIO_CHANNEL_SYMBOLIC_NAME or CANTRCV_DIO_CHANNEL_GROUP_SYMBOLIC_NAME shall reference a Dio configuration. The CAN transceiver driver implementation description shall list up this name for the appropriate CAN transceiver hardware.
            choice reference CanTrcvDioSymNameRef: set at pre-compile, destination=[DioChannel, DioChannelGroup, DioPort]  # Choice Reference to a DIO Port, DIO Channel or DIO Channel Group. This reference replaces the CANTRCV_DIO_PORT_SYM_NAME, CANTRCV_DIO_CHANNEL_SYM_NAME and CANTRCV_DIO_GROUP_SYM_NAME references in the Can Trcv SWS.
          container CanTrcvSpiAccess [0..1]  # Container gives CAN transceiver driver information about accessing Spi. If a CAN transceiver hardware has no Spi interface, there is no instance of this container.
            container CanTrcvSpiSequence [1..*]  # Container gives information about the SPI sequences used to access a CAN Transceiver device. It is assumed that one SPI sequence used by a CAN transceiver device is for its exclusive use.
              boolean CanTrcvSpiAccessSynchronous [0..1]: set at pre-compile, default-value=false  # This parameter is used to define whether the access to the Spi sequence is synchronous or asynchronous. true: SPI access is synchronous. false: SPI access is asynchronous.
              symbolic name reference CanTrcvSpiSequenceName [0..*]: destination=SpiSequence  # Reference to a Spi sequence configuration container.
        container CanTrcvPartialNetwork [0..1]  # Container gives CAN transceiver driver information about the configuration of Partial Networking functionality.
          integer CanTrcvBaudRate: 0..1000, set at post-build in variant post-build / pre-compile in variant pre-compile  # Indicates the CAN Bus communication baud rate in kbps.
          boolean CanTrcvBusErrFlag: set at post-build in variant post-build / pre-compile in variant pre-compile, default-value=false  # Indicates if the Bus Error (BUSERR) flag is managed by the BSW. This flag is set if a bus failure is detected by the transceiver. TRUE = Supported by transceiver and managed by BSW. FALSE = Not managed by BSW.
          boolean CanTrcvPnCanIdIsExtended: set at post-build in variant post-build / pre-compile in variant pre-compile, default-value=false  # Indicates whether extended or standard ID is used. TRUE = Extended Can identifier is used. FALSE = Standard Can identifier is used.
          boolean CanTrcvPnEnabled: set at post-build in variant post-build / pre-compile in variant pre-compile, default-value=false  # Indicates whether the selective wake-up function is enabled or disabled in HW. TRUE = Selective wakeup feature is enabled in the transceiver hardware FALSE = Selective wakeup feature is disabled in the transceiver hardware
          integer CanTrcvPnFrameCanId: 0..4294967295, set at post-build in variant post-build / pre-compile in variant pre-compile  # CAN ID of the Wake-up Frame (WUF).
          integer CanTrcvPnFrameCanIdMask: 0..4294967295, set at post-build in variant post-build / pre-compile in variant pre-compile  # ID Mask for the selective activation of the transceiver. It is used to enableFrame Wake-up (WUF) on a group of IDs.
          integer CanTrcvPnFrameDlc: 0..8, set at post-build in variant post-build / pre-compile in variant pre-compile  # Data Length of the Wake-up Frame (WUF).
          boolean CanTrcvPowerOnFlag: set at post-build in variant post-build / pre-compile in variant pre-compile, default-value=false  # Description: Indicates if the Power On Reset (POR) flag is available and is managed by the transceiver. TRUE = Supported by Hardware. FALSE = Not supported by Hardware.
          container CanTrcvPnFrameDataMaskSpec [1..8]  # Defines data payload mask to be used on the received payload in order to determine if the transceiver must be woken up by the received Wake-up Frame (WUF).
            integer CanTrcvPnFrameDataMask: 0..255, set at post-build in variant post-build / pre-compile in variant pre-compile  # Defines the n byte (Byte0 = LSB) of the data payload mask to be used on the received payload in order to determine if the transceiver must be woken up by the received Wake-up Frame (WUF).
            integer CanTrcvPnFrameDataMaskIndex: 0..7, set at post-build in variant post-build / pre-compile in variant pre-compile  # holds the position n in frame of the mask-part
    container CanTrcvGeneral  # Container gives CAN transceiver driver basic information.
      boolean CanTrcvDevErrorDetect: set at pre-compile  # Switches development error detection and notification on and off. If switched on, #define CANTRCV_DEV _ERROR_DETECT ON shall be generated. If switched off, #define CANTRCV_DEV_ERROR _DETECT OFF shall be generated. Define shall be part of file CanTrcv_Cfg.h.
      boolean CanTrcvGetVersionInfo: set at pre-compile, default-value=false  # Switches version information API on and off. If switched off, function need not be present in compiled code.
      integer CanTrcvIndex: set at pre-compile  # Specifies the InstanceId of this module instance. If only one instance is present it shall have the Id 0.
      enumeration CanTrcvWakeUpSupport: {CANTRCV_WAKEUP_BY_ISR, CANTRCV_WAKEUP_NOT_SUPPORTED, CAVTRCV_WAKEUP_BY_POLLING}, set at pre-compile  # Informs whether wake up is supported by ISR, by polling or whether it is not supported. In case no wake up is supported by CAN transceiver hardware setting has to be always NO. Only in case wake up is supported by polling main function CanTrcv_main has to be present in source code and called by CanIf.
  module definition Cdd [0..*]: variants link-time/post-build/pre-compile  # The CDD module describes the minimal requirements that are necessary for the configuration of a CDD with respect to the surrounding standardized BSW modules.
    container CddComStackContribution [0..1]  # Contribution of COM Stack modules.
      container CddComIfUpperLayerContribution [0..1]  # Parameters that are necessary for the configuration of a Complex Device Driver that serves as the UpperLayer of the Com Interface module.
        container CddComIfUpperLayerRxPdu [0..*]  # This container specifies Tx PDUs that are exchanged between the CDD and the standardized BSW module.
          integer CddComIfHandleId [0..1]: 0..65535, symbolic-name-value=true  # ECU wide unique, symbolic handle for the Pdu.
          reference CddComIfPduRef: destination=Pdu  # Reference to the "global" Pdu structure to allow harmonization of handle IDs in the COM-Stack.
        container CddComIfUpperLayerTxPdu [0..*]  # This container specifies Tx PDUs that are exchanged between the CDD and the standardized BSW module.
          integer CddComIfHandleId [0..1]: 0..65535, symbolic-name-value=true  # ECU wide unique, symbolic handle for the Pdu.
          reference CddComIfPduRef: destination=Pdu  # Reference to the "global" Pdu structure to allow harmonization of handle IDs in the COM-Stack.
      container CddPduRUpperLayerContribution [0..1]  # Contribution of COM Stack modules.
        container CddPduRUpperLayerRxPdu [0..*]  # This container specifies PDUs that are exchanged between the CDD and the standardized BSW module.
          integer CddPduRUpperLayerHandleId [0..1]: 0..65535, symbolic-name-value=true  # ECU wide unique, symbolic handle for the Pdu.
          reference CddPduRUpperLayerPduRef: destination=Pdu  # Reference to the "global" Pdu structure to allow harmonization of handle IDs in the COM-Stack.
        container CddPduRUpperLayerTxPdu [0..*]  # This container specifies PDUs that are exchanged between the CDD and the standardized BSW module.
          integer CddPduRUpperLayerHandleId [0..1]: 0..65535, symbolic-name-value=true  # ECU wide unique, symbolic handle for the Pdu.
          reference CddPduRUpperLayerPduRef: destination=Pdu  # Reference to the "global" Pdu structure to allow harmonization of handle IDs in the COM-Stack.
    container CddConfigSet [0..1]: multiple-configuration-container=true  # Configuration set container of the Cdd.
      container CddComStackContribution [0..1]  # Contribution of COM Stack modules.
        container CddComIfUpperLayerContribution [0..1]  # Parameters that are necessary for the configuration of a Complex Device Driver that serves as the UpperLayer of the Com Interface module.
          container CddComIfUpperLayerRxPdu [0..*]  # This container specifies Tx PDUs that are exchanged between the CDD and the standardized BSW module.
            integer CddComIfHandleId [0..1]: 0..65535, symbolic-name-value=true  # ECU wide unique, symbolic handle for the Pdu.
            reference CddComIfPduRef: destination=Pdu  # Reference to the "global" Pdu structure to allow harmonization of handle IDs in the COM-Stack.
          container CddComIfUpperLayerTxPdu [0..*]  # This container specifies Tx PDUs that are exchanged between the CDD and the standardized BSW module.
            integer CddComIfHandleId [0..1]: 0..65535, symbolic-name-value=true  # ECU wide unique, symbolic handle for the Pdu.
            reference CddComIfPduRef: destination=Pdu  # Reference to the "global" Pdu structure to allow harmonization of handle IDs in the COM-Stack.
        container CddPduRUpperLayerContribution [0..1]  # Contribution of COM Stack modules.
          container CddPduRUpperLayerRxPdu [0..*]  # This container specifies PDUs that are exchanged between the CDD and the standardized BSW module.
            integer CddPduRUpperLayerHandleId [0..1]: 0..65535, symbolic-name-value=true  # ECU wide unique, symbolic handle for the Pdu.
            reference CddPduRUpperLayerPduRef: destination=Pdu  # Reference to the "global" Pdu structure to allow harmonization of handle IDs in the COM-Stack.
          container CddPduRUpperLayerTxPdu [0..*]  # This container specifies PDUs that are exchanged between the CDD and the standardized BSW module.
            integer CddPduRUpperLayerHandleId [0..1]: 0..65535, symbolic-name-value=true  # ECU wide unique, symbolic handle for the Pdu.
            reference CddPduRUpperLayerPduRef: destination=Pdu  # Reference to the "global" Pdu structure to allow harmonization of handle IDs in the COM-Stack.
  module definition Com [0..1]: variants link-time/post-build/pre-compile  # COM540: Configuration of the Com module.
    container ComConfig: multiple-configuration-container=true  # This container contains the configuration parameters and sub containers of the COM module. This container is a MultipleConfigurationContainer, i.e. this container and its sub-containers exist once per configuration set.
      integer ComConfigurationId: set at link in variant link-time / post-build in variant post-build / pre-compile in variant pre-compile  # This ID is returned by a call to Com_GetConfigurationId.
      container ComGwMapping [0..*]  # Each instance of this container defines one mapping of the integrated Signal Gateway.
        choice container ComGwDestination [1..*]  # Each instance of this choice container allows to define one routing destination either by reference to an already configured COM signal / signal group or by a destination description container.
          container ComGwDestinationDescription [0..1]  # Description of a gateway destination. This container allows defining a gateway destination without the configuration of a complete COM signal. This allows adding / changing gateway relations post build without the configuration of new signals.
            integer ComBitPosition: 0..2031, set at link in variant link-time / post-build in variant post-build / pre-compile in variant pre-compile  # Starting position within the I-PDU. This parameter refers to the position in the I-PDU and not in the shadow buffer.
            integer ComSignalDataInvalidValue [0..1]: set at link in variant link-time+post-build / pre-compile in variant pre-compile  # COM391: On receiver side: When this value is received it is recognized as the invalid value and the appropriate invalid action (as specified by ComDataInvalidAction) is performed. COM501: On sender side: This configures the data invalid value that is used by a call to Com_InvalidateSignal.
            enumeration ComSignalEndianess: {BIG_ENDIAN, LITTLE_ENDIAN, OPAQUE}, set at link in variant link-time / post-build in variant post-build / pre-compile in variant pre-compile  # Defines the endianness of the signal's network representation.
            integer ComSignalInitValue [0..1]: set at link in variant link-time / post-build in variant post-build / pre-compile in variant pre-compile, default-value=0  # COM170: Initial value for this signal. The default value is 0. The lower n-bits of the configured Integer shall be used as init-value for an n-bit sized signal type. COM483: If the signal is of type UINT[n], the Integer's least significant byte shall be assigned to the byte array’s last byte. The second-least significant byte shall be assigned to the byte array’s last but one byte, and so on.
            enumeration ComTransferProperty [0..1]: {PENDING, TRIGGERED, TRIGGERED_ON_CHANGE, TRIGGERED_ON_CHANGE_WITHOUT_REPETITION, TRIGGERED_WITHOUT_REPETITION}, set at link in variant link-time / post-build in variant post-build / pre-compile in variant pre-compile  # Defines if a write access to this signal can trigger the transmission of the corresponding I-PDU. If the I-PDU is triggered, depends also on the transmission mode of the corresponding I-PDU. TRIGGERED: Depending on the transmission mode, a write access to this signal can trigger the transmission of the corresponding I-PDU. PENDING: A write access to this signal never triggers the transmission of the corresponding I-PDU. TRIGGERED_ON_CHANGE: Depending on the transmission mode, a write access to this signal can trigger the transmission of the corresponding I-PDU, but only in case the written value is different to the locally stored (last written or init) value. TRIGGERED_WITHOUT_REPETITION: Depending on the transmission mode, a write access to this signal can trigger the transmission of the corresponding I-PDU just once without a repetition. TRIGGERED_ON_CHANGE_WITHOUT_REPETITION: Depending on the transmission mode, a write access to this signal can trigger the transmission of the corresponding I-PDU just once without a repetition, but only in case the written value is different to the locally stored (last written or init) value.
            integer ComUpdateBitPosition [0..1]: 0..2031, set at link in variant link-time / post-build in variant post-build / pre-compile in variant pre-compile  # Bit position of update-bit inside I-PDU. If this attribute is omitted then there is no update-bit. This setting must be consistently on sender and on receiver side.
            symbolic name reference ComGwIPduRef: destination=ComIPdu  # Symbolic reference to an I-PDU of a Signal Gateway source or destination description.
          container ComGwSignal [0..1]  # This container allows specifying a gateway source or destination respectively with a reference to a ComSignal, a ComGroupSignal or a ComSignalGroup.
            choice reference ComGwSignalRef: set at link in variant link-time / post-build in variant post-build / pre-compile in variant pre-compile, destination=[ComGroupSignal, ComSignal, ComSignalGroup]  # Reference to an object of a gateway relation. Either to a ComSignal, ComGroupSignal or to a SignalGroup.
        choice container ComGwSource  # This choice container allows the definition of the gateway source signal either by reference to an already configured COM signal / signal group or by a source description container.
          container ComGwSignal [0..1]  # This container allows specifying a gateway source or destination respectively with a reference to a ComSignal, a ComGroupSignal or a ComSignalGroup.
            choice reference ComGwSignalRef: set at link in variant link-time / post-build in variant post-build / pre-compile in variant pre-compile, destination=[ComGroupSignal, ComSignal, ComSignalGroup]  # Reference to an object of a gateway relation. Either to a ComSignal, ComGroupSignal or to a SignalGroup.
          container ComGwSourceDescription [0..1]  # Description of a gateway source. This container allows defining a gateway source without the configuration of a complete COM signal. This allows adding / changing gateway relations post build without the configuration of new signals.
            integer ComBitPosition: 0..2031, set at link in variant link-time / post-build in variant post-build / pre-compile in variant pre-compile  # Starting position within the I-PDU. This parameter refers to the position in the I-PDU and not in the shadow buffer.
            integer ComBitSize: 0..64, set at link in variant link-time / post-build in variant post-build / pre-compile in variant pre-compile  # Size in bits.
            enumeration ComSignalEndianess: {BIG_ENDIAN, LITTLE_ENDIAN, OPAQUE}, set at link in variant link-time / post-build in variant post-build / pre-compile in variant pre-compile  # Defines the endianness of the signal's network representation.
            enumeration ComSignalType: {BOOLEAN, SINT16, SINT32, SINT8, UINT16, UINT32, UINT8, UINT8_N}, set at link in variant link-time / post-build in variant post-build / pre-compile in variant pre-compile  # The AUTOSAR type of the signal. Whether or not the signal is signed or unsigned can be found by examining the value of this attribute. This type could also be used to reserved appropriate storage in AUTOSAR COM.
            integer ComUpdateBitPosition [0..1]: 0..2031, set at link in variant link-time / post-build in variant post-build / pre-compile in variant pre-compile  # Bit position of update-bit inside I-PDU. If this attribute is omitted then there is no update-bit. This setting must be consistently on sender and on receiver side.
            symbolic name reference ComGwIPduRef: destination=ComIPdu  # Symbolic reference to an I-PDU of a Signal Gateway source or destination description.
      container ComIPdu [0..*]  # Contains the configuration parameters of Com I-Pdus. COM174: The shortName is used as the symbolic name (ComIpduName) of this I-Pdu when communicating with the PduR. This parameter is only stored in the XML file, and must not be used within the implementation.
        function name ComIPduCallout [0..1]: set at pre-compile  # If there is a callout defined for this I-PDU this parameter contains the name of the callout function..
        integer ComIPduRxHandleId [0..1]: set at link in variant link-time+post-build / pre-compile in variant pre-compile, symbolic-name-value=true  # The numerical value used as the ID of this I-PDU. The Com_IPduRxHandleId is required by the API calls to receive I-PDUs from the PduR. It is only present for I-PDU is received from the PduR, because Com is the starting module for Tx I-PDUs and there is no need to define IDs for Tx I-PDUs in the Com module.
        enumeration ComIPduSignalProcessing [0..1]: {DEFERED, IMMEDIATE}, set at link in variant link-time / post-build in variant post-build / pre-compile in variant pre-compile  # For the definition of the two modes Immediate and Defered, see COM298.
        integer ComIPduSize: 0..254, set at link in variant link-time / post-build in variant post-build / pre-compile in variant pre-compile  # The size of the I-PDU in bytes. The maximum size is limited by the underlying communication interface. 0-8 for CAN and LIN 0-254 for FlexRay
        function name ComIPduTriggerTransmitCallout [0..1]: set at pre-compile  # If there is a trigger transmit callout defined for this I-PDU this parameter contains the name of the callout function.
        enumeration ComIpduDirection: {RECEIVE, SEND}, set at link in variant link-time / post-build in variant post-build / pre-compile in variant pre-compile  # The direction defines if this I-PDU, and therefore the contributing signals and signal groups, shall be send or received.
        reference ComIPduGroupRef [0..*]: set at link in variant link-time / post-build in variant post-build / pre-compile in variant pre-compile, destination=ComIPduGroup  # Reference to all I-PDU groups including this I-PDU.
        reference ComIPduSignalGroupRef [0..*]: set at link in variant link-time / post-build in variant post-build / pre-compile in variant pre-compile, destination=ComSignalGroup  # References to all signal groups contained in this I-Pdu
        reference ComIPduSignalRef [0..*]: set at link in variant link-time / post-build in variant post-build / pre-compile in variant pre-compile, destination=ComSignal  # References to all signals contained in this I-PDU.
        reference PduIdRef: set at link in variant post-build / pre-compile in variant pre-compile, destination=Pdu  # Reference to the "global" Pdu structure to allow harmonization of handle IDs in the COM-Stack.
        container ComTxIPdu [0..1]  # This container contains additional transmission related configuration parameters of COM I-PDUs
          enumeration ComTxIPduClearUpdateBit [0..1]: {Confirmation, Transmit, TriggerTransmit}, set at link in variant link-time / post-build in variant post-build / pre-compile in variant pre-compile  # Defines when the update-bits of signals or signal groups, contained in this I-PDU, will be cleared.
          integer ComTxIPduMinimumDelayTimeFactor [0..1]: set at link in variant link-time / post-build in variant post-build / pre-compile in variant pre-compile, origin=AUTOSAR_ECUC V3.0  # COM181: Minimum delay between successive transmissions of this I-PDU, independent of the transmission mode. There is only one minimum delay time parameter for the I-PDU. This minimum delay time does not change with mode changes. Neither is the timer reset. This means that mode changes are not allowed to violate the minimum delay time. It is not possible to monitor the minumum delay time for I-PDUs that are requested using the Com_TriggerTransmit API. Depending on the implementation, this timeout may be implemented as a 32-bit or a 16-bit counter. COM471: No minimum delay time monitoring shall take place, if ComTxIPduMinimumDelayTimeFactor is omitted or configured to 0.
          integer ComTxIPduUnusedAreasDefault: 0..255, set at link in variant link-time+post-build / pre-compile in variant pre-compile  # AUTOSAR COM fills not used areas of an I-PDU with this bit-pattern. This attribute is mandatory to avoid undefined behaviour. This byte-pattern will be repeated throughout the I-PDU.
          container ComTxModeFalse [0..1]  # This container contains the configuration parameters of COM transmission modes in the case the ComFilter evaluates to false.
            container ComTxMode  # This container contains the configuration parameters of COM transmission modes.
              enumeration ComTxModeMode: {DIRECT, MIXED, NONE, PERIODIC}, set at link in variant link-time / post-build in variant post-build / pre-compile in variant pre-compile  # The available transmission modes described in [18] shall be extended by the additional mode None. The transmission mode None shall not have any further sub-attributes in the ComTxMode object.
              integer ComTxModeNumberOfRepetitions [0..1]: 0..255, set at link in variant link-time / post-build in variant post-build / pre-compile in variant pre-compile  # Defines the number of repetitions for the Direct/N-Times transmission mode and the event driven part of Mixed transmission mode.
              integer ComTxModeRepetitionPeriodFactor [0..1]: set at link in variant link-time / post-build in variant post-build / pre-compile in variant pre-compile  # Period of the repetition of the n transmission for the Direct/NTimes transmission mode and the event driven part of the Mixed transmission mode. Depending on the implementation, this timeout may be implemented as a 32-bit or a 16-bit counter.
              integer ComTxModeTimeOffsetFactor [0..1]: set at link in variant link-time / post-build in variant post-build / pre-compile in variant pre-compile  # Time until first transmission of this I-PDU. ComTxModeTimeOffsetFactor defines the time between Com_IpduGroupStart and the first transmission of the cyclic part of this transmission request for this I-PDU. Depending on the implementation, this timeout may be implemented as a 32-bit or a 16-bit counter.
              integer ComTxModeTimePeriodFactor [0..1]: set at link in variant link-time / post-build in variant post-build / pre-compile in variant pre-compile  # Period of the repetition of cyclic transmissions. Depending on the implementation, this timeout may be implemented as a 32-bit or a 16-bit counter.
          container ComTxModeTrue [0..1]  # This container contains the configuration parameters of COM transmission modes in the case the ComFilter evaluates to true.
            container ComTxMode  # This container contains the configuration parameters of COM transmission modes.
              enumeration ComTxModeMode: {DIRECT, MIXED, NONE, PERIODIC}, set at link in variant link-time / post-build in variant post-build / pre-compile in variant pre-compile  # The available transmission modes described in [18] shall be extended by the additional mode None. The transmission mode None shall not have any further sub-attributes in the ComTxMode object.
              integer ComTxModeNumberOfRepetitions [0..1]: 0..255, set at link in variant link-time / post-build in variant post-build / pre-compile in variant pre-compile  # Defines the number of repetitions for the Direct/N-Times transmission mode and the event driven part of Mixed transmission mode.
              integer ComTxModeRepetitionPeriodFactor [0..1]: set at link in variant link-time / post-build in variant post-build / pre-compile in variant pre-compile  # Period of the repetition of the n transmission for the Direct/NTimes transmission mode and the event driven part of the Mixed transmission mode. Depending on the implementation, this timeout may be implemented as a 32-bit or a 16-bit counter.
              integer ComTxModeTimeOffsetFactor [0..1]: set at link in variant link-time / post-build in variant post-build / pre-compile in variant pre-compile  # Time until first transmission of this I-PDU. ComTxModeTimeOffsetFactor defines the time between Com_IpduGroupStart and the first transmission of the cyclic part of this transmission request for this I-PDU. Depending on the implementation, this timeout may be implemented as a 32-bit or a 16-bit counter.
              integer ComTxModeTimePeriodFactor [0..1]: set at link in variant link-time / post-build in variant post-build / pre-compile in variant pre-compile  # Period of the repetition of cyclic transmissions. Depending on the implementation, this timeout may be implemented as a 32-bit or a 16-bit counter.
      container ComIPduGroup [0..*]  # Contains the configuration parameters of Com I-Pdu groups. COM126: The shortName is used as the symbolic name of the I-Pdu group (ComIpduGroupName). This parameter is only stored in the XML file, and must not be used within the implementation.
        integer ComIPduGroupHandleId: 0..65535, set at link in variant link-time+post-build / pre-compile in variant pre-compile, symbolic-name-value=true  # The numerical value used as the ID of this I-PDU Group . The ComIPduGroupHandleId is required by the API calls to start and stop I-PDU Groups. For the rational for the range see COM187.
        reference ComIPduGroupGroupRef [0..*]: set at link in variant link-time / post-build in variant post-build / pre-compile in variant pre-compile, destination=ComIPduGroup  # References to all I-PDU groups including this I-PDU group. If this reference is omitted, this I-PDU group is not included in another I-PDU group.
      container ComSignal [0..*]  # Contains the configuration parameters of Com signals. COM163: The shortName is used as the symbolic name of the signal (ComSignalName). This name is also used as the handle name for the signal. This parameter is only stored in the XML file, and must not be used within the implementation.
        integer ComBitPosition: 0..2031, set at link in variant link-time / post-build in variant post-build / pre-compile in variant pre-compile  # Starting position within the I-PDU. This parameter refers to the position in the I-PDU and not in the shadow buffer.
        integer ComBitSize: 0..64, set at link in variant link-time+post-build / pre-compile in variant pre-compile  # Size in bits.
        enumeration ComDataInvalidAction [0..1]: {NOTIFY, REPLACE}, set at link in variant link-time+post-build / pre-compile in variant pre-compile  # This parameter defines the action performed upon reception of an invalid signal. Relating to signal groups the action in case if one of the included signals is an invalid signal. If Replace is used the ComSignalInitValue will be used for the replacement.
        function name ComErrorNotification [0..1]: set at link in variant link-time+post-build / pre-compile in variant pre-compile  # Only valid on sender side: Name of Com_CbkTxErr callback function to be called. If this parameter is omitted no error notification shall take place.
        integer ComFirstTimeoutFactor [0..1]: set at link in variant link-time+post-build / pre-compile in variant pre-compile  # Defines the first timeout period for the deadline monitoring. Details can be found in [17]. Note: See also COM263 for the configuration of the remaining timeout periods. Depending on the implementation, this timeout may be implemented as a 32-bit or a 16-bit counter.
        integer ComHandleId: set at link in variant link-time+post-build / pre-compile in variant pre-compile, symbolic-name-value=true  # The numerical value used as the ID. For signals it is required by the API calls Com_UpdateShadowSignal, Com_ReceiveShadowSignal and Com_InvalidateShadowSignal. For signals groups it is required by the Com_SendSignalGroup and Com_ReceiveSignalGroup calls.
        boolean ComInitialValueOnly [0..1]: set at link in variant link-time+post-build / pre-compile in variant pre-compile  # If set to true this parameter defines that the respective signal's initial value shall be put into the respective Pdu but there will not be any update of the value through the RTE. Thus the Com implementation does not need to expect any API calls for this signal.
        function name ComInvalidNotification [0..1]: set at link in variant link-time+post-build / pre-compile in variant pre-compile  # Only valid on receiver side: Name of Com_CbkRxInv callback function to be called. Name of the function which notifies the RTE about the reception of an invalidated signal/ signal group. Only applicable if ComSignalDataInvalidAction is configured to Notify.
        function name ComNotification [0..1]: set at link in variant link-time+post-build / pre-compile in variant pre-compile  # On sender side: Name of Com_CbkTxAck callback function to be called. On receiver side: Name of Com_CbkRxAck callback function to be called. If this parameter is omitted no notification shall take place.
        enumeration ComRxDataTimeoutAction [0..1]: {NONE, REPLACE}, set at link in variant link-time+post-build / pre-compile in variant pre-compile  # COM412: This parameter defines the action performed upon a reception timeout violation. COM500: If this parameter is omitted or configured to None no replacement shall take place. COM470: Relating to signals: When this parameter is set to Replace, the replacement value used shall be the ComInitValue. COM513: Relating to signal groups: When this parameter is set to Replace, all included signals shall be set to their ComInitValue.
        integer ComSignalDataInvalidValue [0..1]: set at link in variant link-time+post-build / pre-compile in variant pre-compile  # COM391: On receiver side: When this value is received it is recognized as the invalid value and the appropriate invalid action (as specified by ComDataInvalidAction) is performed. COM501: On sender side: This configures the data invalid value that is used by a call to Com_InvalidateSignal.
        enumeration ComSignalEndianess: {BIG_ENDIAN, LITTLE_ENDIAN, OPAQUE}, set at link in variant link-time / post-build in variant post-build / pre-compile in variant pre-compile  # Defines the endianness of the signal's network representation.
        integer ComSignalInitValue [0..1]: set at link in variant link-time / post-build in variant post-build / pre-compile in variant pre-compile, default-value=0  # COM170: Initial value for this signal. The default value is 0. The lower n-bits of the configured Integer shall be used as init-value for an n-bit sized signal type. COM483: If the signal is of type UINT[n], the Integer's least significant byte shall be assigned to the byte array’s last byte. The second-least significant byte shall be assigned to the byte array’s last but one byte, and so on.
        integer ComSignalLength [0..1]: 1..8, set at link in variant link-time+post-build / pre-compile in variant pre-compile  # The ComSignalLength specifies the n (in Bytes: 1..8) of the type UINT8[n]. For other types it will be ignored.
        enumeration ComSignalType: {BOOLEAN, SINT16, SINT32, SINT8, UINT16, UINT32, UINT8, UINT8_N}, set at link in variant link-time / post-build in variant post-build / pre-compile in variant pre-compile  # The AUTOSAR type of the signal. Whether or not the signal is signed or unsigned can be found by examining the value of this attribute. This type could also be used to reserved appropriate storage in AUTOSAR COM.
        integer ComTimeoutFactor [0..1]: set at link in variant link-time+post-build / pre-compile in variant pre-compile  # COM263: Defines the timeout period for the deadline monitoring. Details can be found in [17]. Note: The period for the ComFirstTimeoutFactor could differ from the ComTimeoutFactor. Depending on the implementation, this timeout may be implemented as a 32-bit or a 16-bit counter. COM264: If deadline monitoring is used on a signal with an update-bit this defines the timeout for deadline monitoring. COM333: If the timeout is omitted or configured to 0 than no timeout monitoring shall take place. In this case ComFirstTimeoutFactor shall be ignored.
        function name ComTimeoutNotification [0..1]: set at link in variant link-time+post-build / pre-compile in variant pre-compile  # On sender side: Name of Com_CbkTxTOut callback function to be called. On receiver side: Name of Com_CbkRxTOut callback function to be called.
        enumeration ComTransferProperty [0..1]: {PENDING, TRIGGERED, TRIGGERED_ON_CHANGE, TRIGGERED_ON_CHANGE_WITHOUT_REPETITION, TRIGGERED_WITHOUT_REPETITION}, set at link in variant link-time / post-build in variant post-build / pre-compile in variant pre-compile  # Defines if a write access to this signal can trigger the transmission of the corresponding I-PDU. If the I-PDU is triggered, depends also on the transmission mode of the corresponding I-PDU. TRIGGERED: Depending on the transmission mode, a write access to this signal can trigger the transmission of the corresponding I-PDU. PENDING: A write access to this signal never triggers the transmission of the corresponding I-PDU. TRIGGERED_ON_CHANGE: Depending on the transmission mode, a write access to this signal can trigger the transmission of the corresponding I-PDU, but only in case the written value is different to the locally stored (last written or init) value. TRIGGERED_WITHOUT_REPETITION: Depending on the transmission mode, a write access to this signal can trigger the transmission of the corresponding I-PDU just once without a repetition. TRIGGERED_ON_CHANGE_WITHOUT_REPETITION: Depending on the transmission mode, a write access to this signal can trigger the transmission of the corresponding I-PDU just once without a repetition, but only in case the written value is different to the locally stored (last written or init) value.
        integer ComUpdateBitPosition [0..1]: 0..2031, set at link in variant link-time / post-build in variant post-build / pre-compile in variant pre-compile  # Bit position of update-bit inside I-PDU. If this attribute is omitted then there is no update-bit. This setting must be consistently on sender and on receiver side.
        foreign reference SystemTemplateSystemSignalRef: destination-type=ISignalToIPduMapping  # Reference to the ISignalToIPduMapping that contains a reference to the ISignal (System Template) which this ComSignal (or ComGroupSignal) represents.
        container ComFilter [0..1]  # This container contains the configuration parameters of COM Filters. Note: On sender side the container is used to specify the transmission mode conditions.
          enumeration ComFilterAlgorithm: {ALWAYS, MASKED_NEW_DIFFERS_MASKED_OLD, MASKED_NEW_DIFFERS_X, MASKED_NEW_EQUALS_X, NEVER, NEW_IS_OUTSIDE, NEW_IS_WITHIN, ONE_EVERY_N}, set at link in variant link-time+post-build / pre-compile in variant pre-compile  # The range of values is specified in the [17] specification, chapter 2.2.2, Reception Filtering.
          integer ComFilterMask [0..1]: set at link in variant link-time+post-build / pre-compile in variant pre-compile  # The name of this attribute corresponds to the parameter name in the [17] specification of Reception Filtering. Only the least significant 32 bits are significant.
          integer ComFilterMax [0..1]: set at link in variant link-time+post-build / pre-compile in variant pre-compile  # The name of this attribute corresponds to the parameter name in the [17] specification of Reception Filtering. Only the least significant 32 bits are significant.
          integer ComFilterMin [0..1]: set at link in variant link-time+post-build / pre-compile in variant pre-compile  # The name of this attribute corresponds to the parameter name in the [17] specification of Reception Filtering. Only the least significant 32 bits are significant.
          integer ComFilterOffset [0..1]: set at link in variant link-time+post-build / pre-compile in variant pre-compile  # The name of this attribute corresponds to the parameter name in the [17] specification of Reception Filtering. Only the least significant 32 bits are significant. Range = 0..(ComFilterPeriodFactor-1)
          integer ComFilterPeriodFactor [0..1]: set at link in variant link-time+post-build / pre-compile in variant pre-compile  # The name of this attribute corresponds to the parameter name in the [17] specification of Reception Filtering. Only the least significant 32 are significant.
          integer ComFilterX [0..1]: set at link in variant link-time+post-build / pre-compile in variant pre-compile  # The name of this attribute corresponds to the parameter name in the [17] specification of Reception Filtering. Only the least significant 32 bits are significant.
      container ComSignalGroup [0..*]  # Contains the configuration parameters of Com signal groups. COM044: The shortName is used as the symbolic name of the signal group (ComSignalGroupName). This name is also used as the handle name for the signal group. This parameter is only stored in the XML file, and must not be used within the implementation.
        enumeration ComDataInvalidAction [0..1]: {NOTIFY, REPLACE}, set at link in variant link-time+post-build / pre-compile in variant pre-compile  # This parameter defines the action performed upon reception of an invalid signal. Relating to signal groups the action in case if one of the included signals is an invalid signal. If Replace is used the ComSignalInitValue will be used for the replacement.
        function name ComErrorNotification [0..1]: set at link in variant link-time+post-build / pre-compile in variant pre-compile  # Only valid on sender side: Name of Com_CbkTxErr callback function to be called. If this parameter is omitted no error notification shall take place.
        integer ComFirstTimeoutFactor [0..1]: set at link in variant link-time+post-build / pre-compile in variant pre-compile  # Defines the first timeout period for the deadline monitoring. Details can be found in [17]. Note: See also COM263 for the configuration of the remaining timeout periods. Depending on the implementation, this timeout may be implemented as a 32-bit or a 16-bit counter.
        integer ComHandleId: set at link in variant link-time+post-build / pre-compile in variant pre-compile, symbolic-name-value=true  # The numerical value used as the ID. For signals it is required by the API calls Com_UpdateShadowSignal, Com_ReceiveShadowSignal and Com_InvalidateShadowSignal. For signals groups it is required by the Com_SendSignalGroup and Com_ReceiveSignalGroup calls.
        boolean ComInitialValueOnly [0..1]: set at link in variant link-time+post-build / pre-compile in variant pre-compile  # If set to true this parameter defines that the initial values of all group signals of the ComSignalGroup shall be put into the respective Pdu but there will not be any update of the values through the RTE. Thus the Com implementation does not need to expect any API calls for this signal group.
        function name ComInvalidNotification [0..1]: set at link in variant link-time+post-build / pre-compile in variant pre-compile  # Only valid on receiver side: Name of Com_CbkRxInv callback function to be called. Name of the function which notifies the RTE about the reception of an invalidated signal/ signal group. Only applicable if ComSignalDataInvalidAction is configured to Notify.
        function name ComNotification [0..1]: set at link in variant link-time+post-build / pre-compile in variant pre-compile  # On sender side: Name of Com_CbkTxAck callback function to be called. On receiver side: Name of Com_CbkRxAck callback function to be called. If this parameter is omitted no notification shall take place.
        enumeration ComRxDataTimeoutAction [0..1]: {NONE, REPLACE}, set at link in variant link-time+post-build / pre-compile in variant pre-compile  # COM412: This parameter defines the action performed upon a reception timeout violation. COM500: If this parameter is omitted or configured to None no replacement shall take place. COM470: Relating to signals: When this parameter is set to Replace, the replacement value used shall be the ComInitValue. COM513: Relating to signal groups: When this parameter is set to Replace, all included signals shall be set to their ComInitValue.
        integer ComTimeoutFactor [0..1]: set at link in variant link-time+post-build / pre-compile in variant pre-compile  # COM263: Defines the timeout period for the deadline monitoring. Details can be found in [17]. Note: The period for the ComFirstTimeoutFactor could differ from the ComTimeoutFactor. Depending on the implementation, this timeout may be implemented as a 32-bit or a 16-bit counter. COM264: If deadline monitoring is used on a signal with an update-bit this defines the timeout for deadline monitoring. COM333: If the timeout is omitted or configured to 0 than no timeout monitoring shall take place. In this case ComFirstTimeoutFactor shall be ignored.
        function name ComTimeoutNotification [0..1]: set at link in variant link-time+post-build / pre-compile in variant pre-compile  # On sender side: Name of Com_CbkTxTOut callback function to be called. On receiver side: Name of Com_CbkRxTOut callback function to be called.
        enumeration ComTransferProperty [0..1]: {PENDING, TRIGGERED, TRIGGERED_ON_CHANGE, TRIGGERED_ON_CHANGE_WITHOUT_REPETITION, TRIGGERED_WITHOUT_REPETITION}, set at link in variant link-time / post-build in variant post-build / pre-compile in variant pre-compile  # Defines if a write access to this signal can trigger the transmission of the corresponding I-PDU. If the I-PDU is triggered, depends also on the transmission mode of the corresponding I-PDU. TRIGGERED: Depending on the transmission mode, a write access to this signal can trigger the transmission of the corresponding I-PDU. PENDING: A write access to this signal never triggers the transmission of the corresponding I-PDU. TRIGGERED_ON_CHANGE: Depending on the transmission mode, a write access to this signal can trigger the transmission of the corresponding I-PDU, but only in case the written value is different to the locally stored (last written or init) value. TRIGGERED_WITHOUT_REPETITION: Depending on the transmission mode, a write access to this signal can trigger the transmission of the corresponding I-PDU just once without a repetition. TRIGGERED_ON_CHANGE_WITHOUT_REPETITION: Depending on the transmission mode, a write access to this signal can trigger the transmission of the corresponding I-PDU just once without a repetition, but only in case the written value is different to the locally stored (last written or init) value.
        integer ComUpdateBitPosition [0..1]: 0..2031, set at link in variant link-time / post-build in variant post-build / pre-compile in variant pre-compile  # Bit position of update-bit inside I-PDU. If this attribute is omitted then there is no update-bit. This setting must be consistently on sender and on receiver side.
        foreign reference SystemTemplateSignalGroupRef: destination-type=ISignalToIPduMapping  # Reference to the ISignalToIPduMapping that contains a reference to the ISignal (SystemTemplate) which this ComSignalGroup represents.
        container ComGroupSignal [0..*]  # COM520: This container contains the configuration parameters of group signals. I.e. signals that are included within a signal group. COM521: The shortName is used as the symbolic name of the signal (ComSignalName). This name is also used as the handle name for the signal. This parameter is only stored in the XML file, and must not be used within the implementation.
          integer ComBitPosition: 0..2031, set at link in variant link-time / post-build in variant post-build / pre-compile in variant pre-compile  # Starting position within the I-PDU. This parameter refers to the position in the I-PDU and not in the shadow buffer.
          integer ComBitSize: 0..64, set at link in variant link-time+post-build / pre-compile in variant pre-compile  # Size in bits.
          integer ComHandleId: set at link in variant link-time+post-build / pre-compile in variant pre-compile, symbolic-name-value=true  # The numerical value used as the ID. For signals it is required by the API calls Com_UpdateShadowSignal, Com_ReceiveShadowSignal and Com_InvalidateShadowSignal. For signals groups it is required by the Com_SendSignalGroup and Com_ReceiveSignalGroup calls.
          integer ComSignalDataInvalidValue [0..1]: set at link in variant link-time+post-build / pre-compile in variant pre-compile  # COM391: On receiver side: When this value is received it is recognized as the invalid value and the appropriate invalid action (as specified by ComDataInvalidAction) is performed. COM501: On sender side: This configures the data invalid value that is used by a call to Com_InvalidateSignal.
          enumeration ComSignalEndianess: {BIG_ENDIAN, LITTLE_ENDIAN, OPAQUE}, set at link in variant link-time / post-build in variant post-build / pre-compile in variant pre-compile  # Defines the endianness of the signal's network representation.
          integer ComSignalInitValue [0..1]: set at link in variant link-time / post-build in variant post-build / pre-compile in variant pre-compile, default-value=0  # COM170: Initial value for this signal. The default value is 0. The lower n-bits of the configured Integer shall be used as init-value for an n-bit sized signal type. COM483: If the signal is of type UINT[n], the Integer's least significant byte shall be assigned to the byte array’s last byte. The second-least significant byte shall be assigned to the byte array’s last but one byte, and so on.
          integer ComSignalLength [0..1]: 1..8, set at link in variant link-time+post-build / pre-compile in variant pre-compile  # The ComSignalLength specifies the n (in Bytes: 1..8) of the type UINT8[n]. For other types it will be ignored.
          enumeration ComSignalType: {BOOLEAN, SINT16, SINT32, SINT8, UINT16, UINT32, UINT8, UINT8_N}, set at link in variant link-time / post-build in variant post-build / pre-compile in variant pre-compile  # The AUTOSAR type of the signal. Whether or not the signal is signed or unsigned can be found by examining the value of this attribute. This type could also be used to reserved appropriate storage in AUTOSAR COM.
          enumeration ComTransferProperty [0..1]: {PENDING, TRIGGERED_ON_CHANGE}, set at link in variant link-time / post-build in variant post-build / pre-compile in variant pre-compile  # Optionally defines whether this group signal shall contribute to the TRIGGERED_ON_CHANGE transfer property of the signal group. If at least one group signal of a signal group has the "ComTransferProperty" configured all other group signals of that signal group shall have the attribute configured as well. PENDING: a change of the value of this group signal shall not be considered in the evaluation of the signal groups ComTransferProperty. TRIGGERED_ON_CHANGE: a change of the value of this group signal shall be considered in the in the evaluation of the signal groups ComTransferProperty.
          foreign reference SystemTemplateSystemSignalRef: destination-type=ISignalToIPduMapping  # Reference to the ISignalToIPduMapping that contains a reference to the ISignal (System Template) which this ComSignal (or ComGroupSignal) represents.
          container ComFilter [0..1]  # This container contains the configuration parameters of COM Filters. Note: On sender side the container is used to specify the transmission mode conditions.
            enumeration ComFilterAlgorithm: {ALWAYS, MASKED_NEW_DIFFERS_MASKED_OLD, MASKED_NEW_DIFFERS_X, MASKED_NEW_EQUALS_X, NEVER, NEW_IS_OUTSIDE, NEW_IS_WITHIN, ONE_EVERY_N}, set at link in variant link-time+post-build / pre-compile in variant pre-compile  # The range of values is specified in the [17] specification, chapter 2.2.2, Reception Filtering.
            integer ComFilterMask [0..1]: set at link in variant link-time+post-build / pre-compile in variant pre-compile  # The name of this attribute corresponds to the parameter name in the [17] specification of Reception Filtering. Only the least significant 32 bits are significant.
            integer ComFilterMax [0..1]: set at link in variant link-time+post-build / pre-compile in variant pre-compile  # The name of this attribute corresponds to the parameter name in the [17] specification of Reception Filtering. Only the least significant 32 bits are significant.
            integer ComFilterMin [0..1]: set at link in variant link-time+post-build / pre-compile in variant pre-compile  # The name of this attribute corresponds to the parameter name in the [17] specification of Reception Filtering. Only the least significant 32 bits are significant.
            integer ComFilterOffset [0..1]: set at link in variant link-time+post-build / pre-compile in variant pre-compile  # The name of this attribute corresponds to the parameter name in the [17] specification of Reception Filtering. Only the least significant 32 bits are significant. Range = 0..(ComFilterPeriodFactor-1)
            integer ComFilterPeriodFactor [0..1]: set at link in variant link-time+post-build / pre-compile in variant pre-compile  # The name of this attribute corresponds to the parameter name in the [17] specification of Reception Filtering. Only the least significant 32 are significant.
            integer ComFilterX [0..1]: set at link in variant link-time+post-build / pre-compile in variant pre-compile  # The name of this attribute corresponds to the parameter name in the [17] specification of Reception Filtering. Only the least significant 32 bits are significant.
    container ComGeneral  # Contains the general configuration parameters of the Com module.
      float ComConfigurationTimeBase: set at pre-compile  # If no "ComTimeBase" container is specified this value defines the period between successive calls to the Main Functions (Rx, Tx, Routing) of AUTOSAR COM in seconds. In this case this "ComConfigurationTimeBase" value is used by the COM generator to take the values of the Tx/Rx/Routing related timing configuration parameters of the COM module to internal implementation specific counter or tick values. The COM module's internal timing handling is implementation specific. If additionally a "ComTimeBase" container and its mandatory parameters ComTxTimeBase, ComRxTimeBase and ComGwTimeBase are specified this value defines the time base for all timing configuration parameters (which are specified as factors of this "ComConfigurationTimeBase"). In this case the time base parameters from "ComTimeBase" container are used by the COM generator to transform the values of the Tx/Rx/Routing related timing configuration parameters of the COM module to internal implementation specific counter or tick values to support the possibly different time bases for Tx/Rx/Routing. The COM module's internal timing handling is implementation specific.
      boolean ComConfigurationUseDet [0..1]: set at pre-compile  # The error hook shall contain code to call the Det. If this parameter is configured COM_DEV_ERROR_DETECT shall be set to ON as output of the configuration tool. (as input for the source code), see COM028.
      boolean ComRetryFailedTransmitRequests [0..1]: set at pre-compile, default-value=false  # If this Parameter is set to true, retry of failed transmission requests is enabled. If this Parameter is not present, the default value is assumed.
      integer ComSupportedIPduGroups: 0..65535, set at pre-compile  # Defines the maximum number of supported I-PDU groups.
      string ComUserCbkHeaderFile [0..*]: set at pre-compile  # Defines header files for callback functions which shall be included by the COM module. The minimum length for this StringParamDef is 1. The maximum length for this StringParamDef is 32.
      boolean ComVersionInfoApi: set at pre-compile  # Activate/Deactivate the version information API (Com_GetVersionInfo). True: version information API activated False: version information API deactivated
      container ComTimeBase [0..1]  # Contains the timebase parameters for Tx, Rx and routing.
        float ComGwTimeBase: set at pre-compile  # The period between successive calls to Com_MainFunctionRouteSignals in seconds. This parameter may be used by the COM generator to transform the values of the signal gateway related timing configuration parameters of the COM module to internal implementation specific counter or tick values. The COM module's internal timing handling is implementation specific. The COM module (generator) might rely on the fact that Com_MainFunctionRouteSignals is scheduled according to the value configured here.
        float ComRxTimeBase: set at pre-compile  # The period between successive calls to Com_MainFunctionRx in seconds. This parameter may be used by the COM generator to transform the values of the reception related timing configuration parameters of the COM module to internal implementation specific counter or tick values. The COM module's internal timing handling is implementation specific. The COM module (generator) may rely on the fact that Com_MainFunctionRx is scheduled according to the value configured here.
        float ComTxTimeBase: set at pre-compile  # The period between successive calls to Com_MainFunctionTx in seconds. This parameter may be used by the COM generator to transform the values of the transmission related timing configuration parameters of the COM module to internal implementation specific counter or tick values. The COM module's internal timing handling is implementation specific. The COM module (generator) may rely on the fact that Com_MainFunctionTx is scheduled according to the value configured here.
  module definition ComM [0..1]: variants post-build/pre-compile  # Configuration of the ComM (Communications Manager) module.
    container ComMConfigSet: multiple-configuration-container=true  # This container is the base for a multiple configuration set.
      boolean ComMPncEnabled [0..1]: set at post-build in variant post-build / pre-compile in variant pre-compile, default-value=false  # Defines whether in this configuration set the partial networking is enabled. true: Enabled false: Disabled
      container ComMChannel [1..*]  # This container contains the configuration (parameters) of the bus channel(s). The channel parameters shall be harmonized within the whole communication stack.
        enumeration ComMBusType: {COMM_BUS_TYPE_CAN, COMM_BUS_TYPE_CDD, COMM_BUS_TYPE_FR, COMM_BUS_TYPE_INTERNAL, COMM_BUS_TYPE_LIN}, set at pre-compile  # Identifies the bus type of the channel.
        string ComMCDDBusPrefix [0..1]: set at pre-compile  # Prefix to be used for API calls to CDD.
        integer ComMChannelId: 0..255, set at pre-compile, symbolic-name-value=true  # Channel identification number of the corresponding channel.
        float ComMMainFunctionPeriod: 0.004..0.1, set at pre-compile, default-value=0.02  # Specifies the period in seconds that the MainFunction has to be triggered with. Comment: ComM scheduling shall be at lest as fast as the communication stack and a schedule longer than 100ms makes no sense for communication.
        boolean ComMNoCom: set at pre-compile, default-value=false  # ECU is not allowed to change state of the channel to "Silent Communication" or "Full Communication". true: Enabled - Not allowed to switch to "Silent Communication mode" or "Full Communication mode" false: disabled This is the default/init value corresponding to a runtime variable that can be cahnged using ComM_LimitChannelToNoComMode().
        boolean ComMNoFullCom: set at pre-compile, default-value=false  # ECU is not allowed to change state of the channel to "Full Communication". TRUE - enabled - Not allowed to switch to "Full Communication mode" FALSE - disabled (default) This parameter is the default/init value of a corresponding runtime variable that can be changed using ComM_LimitChannelToNoComMode(). ComMNmVariant != FULL: ComM_LimitChannelToNoComMode() can be used. ComMNmVariant = PASSIVE: ComM_LimitChannelToNoComMode() shall not be used.
        boolean ComMNoWakeUpInhibitionNvmStorage: set at pre-compile  # If this parameter is set to "true", the NoWakeUp inhibition state of the channel shall be stored (in some implementation specific way) in the block pointed to by ComMGlobalNvmBlockDescriptor.
        boolean ComMNoWakeup: set at pre-compile, default-value=false  # Defines if an ECU is not allowed to wake-up the channel. true: Enabled (not allowed to wake-up)) false: Disabled This is the default/init value of a runtime variable that can be changed during runtime using ComM_PreventWakeUp().
        enumeration ComMPncGatewayType [0..1]: {COMM_GATEWAY_TYPE_ACTIVE, COMM_GATEWAY_TYPE_PASSIVE}, set at pre-compile, default-value=COMM_GATEWAY_TYPE_ACTIVE  # Identifies the Partial Network Gateway behaviour of a ComMChannel.
        container ComMNetworkManagement  # This container contains the configuration parameters of the networkmanagement.
          float ComMNmLightTimeout [0..1]: 0..255, set at pre-compile, default-value=10  # Defines the timeout (in seconds) after state "ready sleep" is left.
          enumeration ComMNmVariant: {FULL, LIGHT, NONE, PASSIVE}, set at pre-compile, default-value=FULL  # Defines the functionality of the networkmanagement. Shall be harmonized with NM configuration.
          boolean ComMPncNmRequest: set at pre-compile, default-value=false  # If ComMPncNmRequest equals true then every time a ComM user requests full communciation Nm shall be called using the API CanNm_NetworkRequest (if ComMBusType equals COMM_BUS_TYPE_CAN) or FrNm_NetworkRequest (if ComMBusType equals COMM_BUS_TYPE_FR).
        container ComMUserPerChannel [0..*]  # This container contains a list of identifiers that are needed to refer to a user in the system which is linked to a channel.
          reference ComMUserChannel: set at pre-compile, destination=ComMUser  # Reference to the ComMUser that corresponds to this channel user. ImplementationType: COMM_UserHandleType
      container ComMPnc [0..*]  # This container contains the configuration of the partial network cluster (PNC).
        integer ComMPncId: 8..63, set at pre-compile, symbolic-name-value=true  # Partial network cluster identification number.
        reference ComMChannelPerPnc [0..*]: set at pre-compile, destination=ComMChannel  # Reference to the ComMChannel that is required for this PNC. ImplementationType: COMM_ChannelType
        reference ComMUserPerPnc [0..*]: set at pre-compile, destination=ComMUser  # Reference to the ComMUsers that correspond to this PNC. ImplementationType: COMM_UserHandleType
        container ComMPncComSignal [0..*]  # Represents the PncComSignals which are used to communicate the EIRA and ERA status of this PNC.
          enumeration ComMPncComSignalDirection: {RX, TX}, set at pre-compile  # Indicates the communication direction of this PncComSignal.
          enumeration ComMPncComSignalKind [0..1]: {EIRA, ERA}, set at pre-compile  # Indicates whether this PncComSignal represents EIRA or ERA PNC information. This parameter ComMPncComSignalKind is optional and shall be ignored when ComMPncComSignalDirection equals TX.
          reference ComMPncComSignalChannelRef [0..1]: set at pre-compile, destination=ComMChannel  # Reference to the ComMChannel which is used to determine whether this PncComSignal shall participate in the active or passive role (via the parameter ComMPncGatewayType of the ComMChannel). This information may be available by following the ComMPncComSignalRef and analyse the Com configuration as well.
          symbolic name reference ComMPncComSignalRef: destination=ComSignal  # Reference to the ComSignal which is used to transport the partial network channel request information.
      container ComMUser [1..*]  # This container contains a list of identifiers that are needed to refer to a user in the system which is designated to request Communication modes.
        integer ComMUserIdentifier: 0.., set at pre-compile, symbolic-name-value=true  # An identifier that is needed to refer to a user in the system which is designated to request Communication modes. ImplementationType: ComM_UserHandleType
    container ComMGeneral  # General configuration parameters of the Communication Manager.
      boolean ComMDevErrorDetect: set at pre-compile, default-value=false  # Switches the Development Error Detection and Notification ON or OFF. true: Enabled false: Disabled
      integer ComMEcuGroupClassification: 0..7, set at pre-compile, default-value=3  # Defines whether a mode inhibition affects the ECU or not. Bit 0 (LSB): Wake Up inhibition can be enabled Bit 1 (MSB): Limitation to "No Communication" mode can be enabled e.g. 00000011: Wake up inhibition and limitation to "No Communication" mode can be enabled
      boolean ComMModeLimitationEnabled: set at pre-compile, default-value=false  # true if mode limitation functionality shall be enabled. true: Enabled false: Disabled
      boolean ComMNoCom: set at pre-compile, default-value=false  # The ECU is not allowed to change state of the ECU to "Silent Communication" or "Full Communication". true: Enabled (not allowed to switch to Silent Communication mode or Full Communication mode) false: Disabled
      boolean ComMPncGatewayEnabled [0..1]: set at pre-compile, default-value=false  # Enables or disables support of Partial Network Gateway. False: Partial Networking Gateway is disabled True: Partial Networking Gateway is enabled
      float ComMPncPrepareSleepTimer [0..1]: 0..63, set at pre-compile  # Time in seconds the PNC state machine shall wait in PNC_PREPARE_SLEEP.
      boolean ComMPncSupport: set at pre-compile, default-value=false  # Enables or disables support of partial networking. False: Partial Networking is disabled True: Partial Networking is enabled
      boolean ComMResetAfterForcingNoComm: set at pre-compile, default-value=false  # ComM shall perform a reset after entering "No Communication" mode because of an active mode limitation to "No Communication" mode. true: Enabled false: Disabled
      boolean ComMSynchronousWakeUp: set at pre-compile, default-value=true  # Wake up of one channel shall lead to a wake up of all channels if true. true: Enabled false: Disabled
      float ComMTMinFullComModeDuration: 0.001..65, set at pre-compile, default-value=5  # Minimum time duration in seconds, spent in the Full Communication mode.
      boolean ComMVersionInfoApi: set at pre-compile, default-value=true  # Switches the possibility to read the published information with the service ComM_GetPublishedInformation(). true: Enabled false: Disabled
      boolean ComMWakeupInhibitionEnabled: set at pre-compile, default-value=false  # true if wake up inhibition functionality enabled. true: Enabled false: Disabled
      symbolic name reference ComMGlobalNvmBlockDescriptor [0..1]: destination=NvmBlockDescriptor  # Reference to NVRAM block containing the none volatile data. If this parameter is not configured it means that no NVRam is used at all.
  module definition Crc [0..1]: variants pre-compile  # Configuration of the Crc (Crc routines) module.
    container CrcGeneral  # General configuration of CRC module
      enumeration Crc16Mode: {CRC_16_HARDWARE, CRC_16_RUNTIME, CRC_16_TABLE}, set at pre-compile  # Switch to select one of the available CRC16 calculation methods.
      enumeration Crc32Mode: {CRC_32_HARDWARE, CRC_32_RUNTIME, CRC_32_TABLE}, set at pre-compile  # Switch to select one of the available CRC32 calculation methods.
      enumeration Crc8H2FMode: {CRC_8H2F_HARDWARE, CRC_8H2F_RUNTIME, CRC_8H2F_TABLE}, set at pre-compile  # Switch to select one of the available CRC 8-bit (2Fh polynomial) calculation methods
      enumeration Crc8Mode: {CRC_8_HARDWARE, CRC_8_RUNTIME, CRC_8_TABLE}, set at pre-compile  # Switch to select one of the available CRC 8-bit (SAE J1850) calculation methods.
      boolean CrcVersionInfoApi: set at pre-compile  # Pre-processor switch to enable / disable the API to read out the modules version information. true: Version info API enabled. false: Version info API disabled.
    container CrcPublishedInformation  # Additional published parameters not covered by CommonPublishedInformation container. Note that these parameters do not have any configuration class setting, since they are published information.
      integer CrcInitialValue16  # Initial value for the 16-bit CRC calculation.
      integer CrcInitialValue32  # Initial value for the 32-bit CRC calculation.
      integer CrcInitialValue8  # Initial value for the 8-bit (SAE J1850) CRC calculation.
      integer CrcInitialValue8H2F  # Initial value for the 8-bit (2Fh polynomial) CRC calculation.
